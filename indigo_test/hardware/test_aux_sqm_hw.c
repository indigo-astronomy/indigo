// Copyright (c) 2026 INDIGO initiative
// All rights reserved.
//
// You may use this software under the terms of 'INDIGO Astronomy
// open-source license' (see LICENSE.md).
//
// THIS SOFTWARE IS PROVIDED BY THE AUTHORS 'AS IS' AND ANY EXPRESS
// OR IMPLIED WARRANTIES, INCLUDING, BUT NOT LIMITED TO, THE IMPLIED
// WARRANTIES OF MERCHANTABILITY AND FITNESS FOR A PARTICULAR PURPOSE
// ARE DISCLAIMED. IN NO EVENT SHALL THE AUTHOR BE LIABLE FOR ANY
// DIRECT, INDIRECT, INCIDENTAL, SPECIAL, EXEMPLARY, OR CONSEQUENTIAL
// DAMAGES (INCLUDING, BUT NOT LIMITED TO, PROCUREMENT OF SUBSTITUTE
// GOODS OR SERVICES; LOSS OF USE, DATA, OR PROFITS; OR BUSINESS
// INTERRUPTION) HOWEVER CAUSED AND ON ANY THEORY OF LIABILITY,
// WHETHER IN CONTRACT, STRICT LIABILITY, OR TORT (INCLUDING
// NEGLIGENCE OR OTHERWISE) ARISING IN ANY WAY OUT OF THE USE OF THIS
// SOFTWARE, EVEN IF ADVISED OF THE POSSIBILITY OF SUCH DAMAGE.

// Code is generated by AI

// Opt-in acceptance test for a physically connected Unihedron SQM-LU (or SQM-LU-DL), or for the Arduino
// sketch aux_sqm_simulator.ino running on a board. It checks the handshake and the reading (every field
// of table 8.3 within its range, the Bortle class derived from it), that the 10 s poll keeps both
// properties OK, that interval reports the meter sends on its own (section 8.7) do not break the
// handshake, reconnects and runs driver INIT/SHUTDOWN.
//
// The interval reporting case sets the RAM period only ("p...x") and restores the period it found; the
// EEPROM is never written.
//
// The port comes from SQM_HW_PORT. The driver has no match pattern, so the port must be given.

#include <math.h>
#include <stdlib.h>
#include <indigo/indigo_uni_io.h>
#include <indigo_drivers/aux_sqm/indigo_aux_sqm.h>
#include "hardware_test_common.h"

#define DEVICE_NAME "Unihedron SQM"
#define X_AUX_SENSOR_FREQUENCY_ITEM_NAME "X_AUX_SENSOR_FREQUENCY"
#define X_AUX_SENSOR_COUNTS_ITEM_NAME "X_AUX_SENSOR_COUNTS"
#define X_AUX_SENSOR_PERIOD_ITEM_NAME "X_AUX_SENSOR_PERIOD"

#define SHORT_TIMEOUT 15.0
#define POLL_SECONDS 10

static int meter = -1;
static const char *serial_port = NULL;

static bool select_port(void) {
	if (serial_port == NULL || !*serial_port) {
		fprintf(stderr, "    set SQM_HW_PORT to the meter's serial port\n");
		return false;
	}
	printf("Using port %s\n", serial_port);
	return hw_set_text(meter, DEVICE_PORT_PROPERTY_NAME, DEVICE_PORT_ITEM_NAME, serial_port, INDIGO_OK_STATE, SHORT_TIMEOUT);
}

static double value_of(const char *property, const char *item) {
	double value = NAN;
	hw_number_item(meter, property, item, &value);
	return value;
}

// Sends one command to the meter directly, with the driver disconnected, and returns the first reply line
// starting with the command letter (or 'I' for an interval setting command). Interval reports are skipped.
static bool raw_command(const char *command, char reply_letter, char *reply, size_t size) {
	indigo_uni_handle *handle = indigo_uni_open_serial_with_speed(serial_port, 115200, INDIGO_LOG_DEBUG);
	if (handle == NULL) {
		return false;
	}
	bool ok = false;
	if (indigo_uni_discard(handle) >= 0 && indigo_uni_write(handle, command, (long)strlen(command)) > 0) {
		for (int i = 0; i < 6 && !ok; i++) {
			if (indigo_uni_read_section(handle, reply, size - 1, "\n", "\r\n", INDIGO_DELAY(1)) <= 0) {
				break;
			}
			ok = reply[0] == reply_letter && reply[1] == ',';
		}
	}
	indigo_uni_close(&handle);
	return ok;
}

static void sqm_publishes_the_property_contract(void) {
	ASSERT_TRUE((hw_device_interface(meter) & INDIGO_INTERFACE_AUX_SQM) != 0);
	static const char *weather_items[] = { AUX_WEATHER_SKY_BRIGHTNESS_ITEM_NAME, AUX_WEATHER_SKY_TEMPERATURE_ITEM_NAME, AUX_WEATHER_SKY_BORTLE_CLASS_ITEM_NAME };
	static const char *info_items[] = { X_AUX_SENSOR_FREQUENCY_ITEM_NAME, X_AUX_SENSOR_COUNTS_ITEM_NAME, X_AUX_SENSOR_PERIOD_ITEM_NAME };
	for (int i = 0; i < ARRAY_SIZE(weather_items); i++) {
		ASSERT_TRUE(hw_item_defined(meter, AUX_WEATHER_PROPERTY_NAME, weather_items[i]));
	}
	for (int i = 0; i < ARRAY_SIZE(info_items); i++) {
		ASSERT_TRUE(hw_item_defined(meter, AUX_INFO_PROPERTY_NAME, info_items[i]));
	}
}

// The properties are defined before the first poll fills them. A reading always has a sensor frequency
// (frequency mode) or a period (period mode), so a non-zero one marks the first poll.
static bool wait_for_first_reading(void) {
	double deadline = indigo_monotonic_time() + SHORT_TIMEOUT;
	while (indigo_monotonic_time() < deadline) {
		if (value_of(AUX_INFO_PROPERTY_NAME, X_AUX_SENSOR_FREQUENCY_ITEM_NAME) > 0 || value_of(AUX_INFO_PROPERTY_NAME, X_AUX_SENSOR_PERIOD_ITEM_NAME) > 0) {
			return true;
		}
		indigo_usleep(10000);
	}
	fprintf(stderr, "    no reading arrived\n");
	return false;
}

static void sqm_reports_a_plausible_reading(void) {
	ASSERT_TRUE(wait_for_first_reading());
	ASSERT_TRUE(hw_wait_settled(meter, AUX_WEATHER_PROPERTY_NAME, INDIGO_OK_STATE, SHORT_TIMEOUT));
	ASSERT_TRUE(hw_wait_settled(meter, AUX_INFO_PROPERTY_NAME, INDIGO_OK_STATE, SHORT_TIMEOUT));
	double brightness = value_of(AUX_WEATHER_PROPERTY_NAME, AUX_WEATHER_SKY_BRIGHTNESS_ITEM_NAME);
	double temperature = value_of(AUX_WEATHER_PROPERTY_NAME, AUX_WEATHER_SKY_TEMPERATURE_ITEM_NAME);
	double bortle = value_of(AUX_WEATHER_PROPERTY_NAME, AUX_WEATHER_SKY_BORTLE_CLASS_ITEM_NAME);
	double frequency = value_of(AUX_INFO_PROPERTY_NAME, X_AUX_SENSOR_FREQUENCY_ITEM_NAME);
	double counts = value_of(AUX_INFO_PROPERTY_NAME, X_AUX_SENSOR_COUNTS_ITEM_NAME);
	double period = value_of(AUX_INFO_PROPERTY_NAME, X_AUX_SENSOR_PERIOD_ITEM_NAME);
	printf("    %.2f mpsas, Bortle %g, %.1f C, %.0f Hz, %.0f counts, %.3f s\n", brightness, bortle, temperature, frequency, counts, period);
	// 0.00 means the sensor reached the upper brightness limit; daylight reads negative.
	ASSERT_TRUE(brightness > -20 && brightness < 25);
	ASSERT_TRUE(temperature >= -40 && temperature <= 85);
	ASSERT_TRUE(bortle >= 1 && bortle <= 9);
	ASSERT_TRUE(frequency >= 0 && frequency <= 1000000);
	ASSERT_TRUE(counts >= 0);
	ASSERT_TRUE(period >= 0 && period <= 300);
}

// The meter has no unsolicited output by default, the driver asks every 10 s. Two polls later both
// properties are still OK; an unanswered poll would have turned them ALERT.
static void sqm_keeps_polling(void) {
	hw_forget_states();
	indigo_usleep((2 * POLL_SECONDS + 2) * 1000000L);
	ASSERT_TRUE(hw_connected(meter));
	ASSERT_EQ_INT(INDIGO_OK_STATE, hw_property_state(meter, AUX_WEATHER_PROPERTY_NAME));
	ASSERT_TRUE((hw_states_seen(meter, AUX_WEATHER_PROPERTY_NAME) & (1u << INDIGO_ALERT_STATE)) == 0);
}

// With interval reports every second the meter talks on its own; every connection still succeeds and
// every poll still reads a reading.
static void sqm_tolerates_interval_reports(void) {
	char reply[128] = "";
	ASSERT_TRUE(hw_disconnect(meter, SHORT_TIMEOUT));
	ASSERT_TRUE(raw_command("Ix", 'I', reply, sizeof(reply)));
	printf("    interval settings %s\n", reply);
	long ram_period = atol(reply + 14);
	char command[16];
	ASSERT_TRUE(raw_command("p0000000001x", 'I', reply, sizeof(reply)));
	for (int i = 0; i < 5; i++) {
		ASSERT_TRUE(hw_connect(meter, SHORT_TIMEOUT));
		ASSERT_TRUE(hw_wait_settled(meter, AUX_WEATHER_PROPERTY_NAME, INDIGO_OK_STATE, SHORT_TIMEOUT));
		ASSERT_TRUE(hw_disconnect(meter, SHORT_TIMEOUT));
	}
	ASSERT_TRUE(hw_connect(meter, SHORT_TIMEOUT));
	hw_forget_states();
	indigo_usleep((POLL_SECONDS + 2) * 1000000L);
	ASSERT_EQ_INT(INDIGO_OK_STATE, hw_property_state(meter, AUX_WEATHER_PROPERTY_NAME));
	ASSERT_TRUE((hw_states_seen(meter, AUX_WEATHER_PROPERTY_NAME) & (1u << INDIGO_ALERT_STATE)) == 0);
	ASSERT_TRUE(hw_disconnect(meter, SHORT_TIMEOUT));
	snprintf(command, sizeof(command), "p%010ldx", ram_period);
	ASSERT_TRUE(raw_command(command, 'I', reply, sizeof(reply)));
	ASSERT_EQ_INT((int)ram_period, atoi(reply + 14));
	ASSERT_TRUE(hw_connect(meter, SHORT_TIMEOUT));
}

static void sqm_reconnects(void) {
	ASSERT_TRUE(hw_disconnect(meter, SHORT_TIMEOUT));
	ASSERT_TRUE(hw_property_hidden(meter, AUX_WEATHER_PROPERTY_NAME));
	ASSERT_TRUE(hw_connect(meter, SHORT_TIMEOUT));
	ASSERT_TRUE(hw_wait_settled(meter, AUX_WEATHER_PROPERTY_NAME, INDIGO_OK_STATE, SHORT_TIMEOUT));
}

static void sqm_rejects_shutdown_while_connected(void) {
	ASSERT_EQ_INT(INDIGO_BUSY, indigo_aux_sqm(INDIGO_DRIVER_SHUTDOWN, NULL));
	ASSERT_TRUE(hw_connected(meter));
}

static void sqm_reinitializes(void) {
	ASSERT_TRUE(hw_disconnect(meter, SHORT_TIMEOUT));
	ASSERT_EQ_INT(INDIGO_OK, indigo_aux_sqm(INDIGO_DRIVER_SHUTDOWN, NULL));
	ASSERT_EQ_INT(-1, hw_device_index(DEVICE_NAME));
	ASSERT_EQ_INT(INDIGO_OK, indigo_aux_sqm(INDIGO_DRIVER_INIT, NULL));
	meter = hw_wait_for_device(DEVICE_NAME, SHORT_TIMEOUT);
	ASSERT_TRUE(meter >= 0);
	ASSERT_TRUE(select_port());
	ASSERT_TRUE(hw_connect(meter, SHORT_TIMEOUT));
	ASSERT_TRUE(hw_wait_settled(meter, AUX_WEATHER_PROPERTY_NAME, INDIGO_OK_STATE, SHORT_TIMEOUT));
}

int main(int argc, char **argv) {
	if (argc < 2 || strcmp(argv[1], "--run")) {
		fprintf(stderr, "Physical SQM test: run explicitly with --run (or make test-aux-sqm-hw).\n");
		return 2;
	}
	setvbuf(stdout, NULL, _IONBF, 0);
	for (int i = 2; i < argc; i++) {
		if (!strcmp(argv[i], "--debug")) {
			indigo_set_log_level(INDIGO_LOG_DEBUG);
		}
	}
	if (!indigo_test_use_private_home()) {
		return 1;
	}
	serial_port = hw_port("SQM_HW_PORT");
	const indigo_test_case tests[] = {
		{ "sqm_publishes_the_property_contract", sqm_publishes_the_property_contract },
		{ "sqm_reports_a_plausible_reading", sqm_reports_a_plausible_reading },
		{ "sqm_keeps_polling", sqm_keeps_polling },
		{ "sqm_tolerates_interval_reports", sqm_tolerates_interval_reports },
		{ "sqm_reconnects", sqm_reconnects },
		{ "sqm_rejects_shutdown_while_connected", sqm_rejects_shutdown_while_connected },
		{ "sqm_reinitializes", sqm_reinitializes }
	};
	int result = 1;
	bool started = false, initialized = false;
	HW_CHECK(hw_start() == INDIGO_OK);
	started = true;
	HW_CHECK(hw_attach_client("SQM hardware test") == INDIGO_OK);
	HW_CHECK(indigo_aux_sqm(INDIGO_DRIVER_INIT, NULL) == INDIGO_OK);
	initialized = true;
	meter = hw_wait_for_device(DEVICE_NAME, SHORT_TIMEOUT);
	HW_CHECK(meter >= 0);
	HW_CHECK(select_port());
	HW_CHECK(hw_connect(meter, SHORT_TIMEOUT));
	result = indigo_run_tests("SQM hardware", tests, ARRAY_SIZE(tests));
cleanup:
	if (!hw_disconnect(meter, SHORT_TIMEOUT)) {
		indigo_test_failures++;
	}
	if (initialized && indigo_aux_sqm(INDIGO_DRIVER_SHUTDOWN, NULL) != INDIGO_OK) {
		indigo_test_failures++;
	}
	indigo_detach_client(&hw_client);
	if (started) {
		indigo_stop();
	}
	hw_release_properties();
	indigo_test_remove_private_home();
	return indigo_test_failures ? 1 : result;
}
