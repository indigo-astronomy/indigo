// Copyright (c) 2026 INDIGO initiative
// All rights reserved.
//
// You may use this software under the terms of 'INDIGO Astronomy
// open-source license' (see LICENSE.md).
//
// THIS SOFTWARE IS PROVIDED BY THE AUTHORS 'AS IS' AND ANY EXPRESS
// OR IMPLIED WARRANTIES, INCLUDING, BUT NOT LIMITED TO, THE IMPLIED
// WARRANTIES OF MERCHANTABILITY AND FITNESS FOR A PARTICULAR PURPOSE
// ARE DISCLAIMED. IN NO EVENT SHALL THE AUTHOR BE LIABLE FOR ANY
// DIRECT, INDIRECT, INCIDENTAL, SPECIAL, EXEMPLARY, OR CONSEQUENTIAL
// DAMAGES (INCLUDING, BUT NOT LIMITED TO, PROCUREMENT OF SUBSTITUTE
// GOODS OR SERVICES; LOSS OF USE, DATA, OR PROFITS; OR BUSINESS
// INTERRUPTION) HOWEVER CAUSED AND ON ANY THEORY OF LIABILITY,
// WHETHER IN CONTRACT, STRICT LIABILITY, OR TORT (INCLUDING
// NEGLIGENCE OR OTHERWISE) ARISING IN ANY WAY OUT OF THE USE OF THIS
// SOFTWARE, EVEN IF ADVISED OF THE POSSIBILITY OF SUCH DAMAGE.

// Code is generated by AI

// Opt-in acceptance test for a physically connected NexDome rotator with firmware 3.x, or for the Arduino
// sketch dome_nexdome3_simulator.ino running on a board. It reads the firmware, the XBee link state and
// the shutter battery, slews to an azimuth and back, moves by steps both ways, aborts a rotation, opens and
// closes the shutter, finds home, changes the rotator and shutter velocity and reads it back, saves and
// reloads the settings, parks and refuses a slew while parked, reconnects and runs driver INIT/SHUTDOWN.
//
// THE DOME ROTATES AND THE SHUTTER OPENS. The session returns the dome to the azimuth, shutter and park
// state it found and restores the velocities before it saves them to EEPROM, so the stored settings are
// those it found.
//
// The port comes from NEXDOME3_HW_PORT (a serial port, or nexdome://host for a network bridge).

#include <math.h>
#include <stdlib.h>
#include <indigo_drivers/dome_nexdome3/indigo_dome_nexdome3.h>
#include "dome_hw_common.h"

#define DEVICE_NAME "NexDome3"

#define SHORT_TIMEOUT 15.0
#define MOTION_TIMEOUT 240.0
// GAR takes whole degrees.
#define AZIMUTH_TOLERANCE 1.0

static int dome = -1;
static const char *serial_port = NULL;
static bool state_captured = false, shutter_was_open = false, was_parked = false;
static double initial_azimuth = 0, initial_velocity[2];

static bool select_port(void) {
	if (serial_port == NULL || !*serial_port) {
		fprintf(stderr, "    set NEXDOME3_HW_PORT to the rotator's port\n");
		return false;
	}
	printf("Using port %s\n", serial_port);
	return hw_set_text(dome, DEVICE_PORT_PROPERTY_NAME, DEVICE_PORT_ITEM_NAME, serial_port, INDIGO_OK_STATE, SHORT_TIMEOUT);
}

// The settings and the first status reports arrive after the connection.
static bool wait_for_first_status(void) {
	double deadline = indigo_monotonic_time() + SHORT_TIMEOUT;
	double velocity = 0;
	while (indigo_monotonic_time() < deadline) {
		if (hw_number_item(dome, "X_VELOCITY", "ROTATOR", &velocity) && velocity > 0 && (dome_hw_switch_is(dome, DOME_SHUTTER_PROPERTY_NAME, DOME_SHUTTER_OPENED_ITEM_NAME) || dome_hw_switch_is(dome, DOME_SHUTTER_PROPERTY_NAME, DOME_SHUTTER_CLOSED_ITEM_NAME))) {
			indigo_usleep(2000000);
			return true;
		}
		indigo_usleep(10000);
	}
	fprintf(stderr, "    the settings and the shutter state were never read\n");
	return false;
}

static bool set_velocity(double rotator, double shutter) {
	static const char *items[] = { "ROTATOR", "SHUTTER" };
	double values[] = { rotator, shutter };
	if (!dome_hw_idle(dome, "X_VELOCITY", SHORT_TIMEOUT)) {
		return false;
	}
	indigo_change_number_property(&hw_client, DEVICE_NAME, "X_VELOCITY", 2, items, values);
	return hw_wait_number(dome, "X_VELOCITY", "ROTATOR", rotator, 0, SHORT_TIMEOUT) && hw_wait_number(dome, "X_VELOCITY", "SHUTTER", shutter, 0, SHORT_TIMEOUT);
}

static bool capture_state(void) {
	if (!wait_for_first_status() || !dome_hw_idle(dome, DOME_HORIZONTAL_COORDINATES_PROPERTY_NAME, MOTION_TIMEOUT)) {
		return false;
	}
	initial_azimuth = dome_hw_azimuth(dome);
	shutter_was_open = dome_hw_switch_is(dome, DOME_SHUTTER_PROPERTY_NAME, DOME_SHUTTER_OPENED_ITEM_NAME);
	was_parked = dome_hw_switch_is(dome, DOME_PARK_PROPERTY_NAME, DOME_PARK_PARKED_ITEM_NAME);
	if (!hw_number_item(dome, "X_VELOCITY", "ROTATOR", initial_velocity) || !hw_number_item(dome, "X_VELOCITY", "SHUTTER", initial_velocity + 1)) {
		return false;
	}
	printf("    azimuth %.1f, shutter %s, %s, velocity %g/%g\n", initial_azimuth, shutter_was_open ? "open" : "closed", was_parked ? "parked" : "unparked", initial_velocity[0], initial_velocity[1]);
	return !isnan(initial_azimuth);
}

static void restore_initial_state(void) {
	if (dome < 0 || !state_captured || !hw_connected(dome)) {
		return;
	}
	double rotator = 0, shutter = 0;
	if (hw_number_item(dome, "X_VELOCITY", "ROTATOR", &rotator) && hw_number_item(dome, "X_VELOCITY", "SHUTTER", &shutter) && (rotator != initial_velocity[0] || shutter != initial_velocity[1])) {
		set_velocity(initial_velocity[0], initial_velocity[1]);
	}
	if (dome_hw_switch_is(dome, DOME_PARK_PROPERTY_NAME, DOME_PARK_PARKED_ITEM_NAME)) {
		dome_hw_park(dome, false, SHORT_TIMEOUT);
	}
	if (dome_hw_switch_is(dome, DOME_SHUTTER_PROPERTY_NAME, DOME_SHUTTER_OPENED_ITEM_NAME) != shutter_was_open) {
		dome_hw_open_close(dome, DOME_SHUTTER_PROPERTY_NAME, shutter_was_open, INDIGO_OK_STATE, MOTION_TIMEOUT);
	}
	if (was_parked) {
		dome_hw_park(dome, true, MOTION_TIMEOUT);
	} else {
		dome_hw_goto(dome, round(initial_azimuth), INDIGO_OK_STATE, MOTION_TIMEOUT);
	}
}

static void nexdome3_publishes_the_property_contract(void) {
	char model[INDIGO_VALUE_SIZE] = "", firmware[INDIGO_VALUE_SIZE] = "", link[INDIGO_VALUE_SIZE] = "";
	ASSERT_TRUE((hw_device_interface(dome) & INDIGO_INTERFACE_DOME) != 0);
	ASSERT_TRUE(hw_text_item(dome, INFO_PROPERTY_NAME, INFO_DEVICE_MODEL_ITEM_NAME, model, sizeof(model)));
	ASSERT_TRUE(hw_text_item(dome, INFO_PROPERTY_NAME, INFO_DEVICE_FW_REVISION_ITEM_NAME, firmware, sizeof(firmware)));
	hw_text_item(dome, "X_XB_STATE", "XB_STATE", link, sizeof(link));
	printf("    model %s, firmware %s, XBee %s\n", model, firmware, *link ? link : "-");
	ASSERT_STREQ("NexDome", model);
	ASSERT_TRUE(firmware[0] >= '3');
	static const char *properties[] = { "X_FIND_HOME", "X_HOME_POSITION", "X_MOVE_THRESHOLD", "X_BATTERY_POWER", "X_ACCELERATION_TIME", "X_VELOCITY", "X_RANGE", "X_SETTINGS", "X_RAIN_SENSOR", "X_XB_STATE" };
	for (int i = 0; i < ARRAY_SIZE(properties); i++) {
		ASSERT_TRUE(hw_property_defined(dome, properties[i]));
	}
	ASSERT_TRUE(hw_property_hidden(dome, DOME_SPEED_PROPERTY_NAME));
	ASSERT_TRUE(initial_azimuth >= 0 && initial_azimuth <= 360);
}

static void nexdome3_slews_to_an_azimuth(void) {
	if (was_parked) {
		ASSERT_TRUE(dome_hw_park(dome, false, SHORT_TIMEOUT));
	}
	double target = dome_hw_normalize(round(initial_azimuth) + 40);
	ASSERT_TRUE(dome_hw_goto(dome, target, INDIGO_OK_STATE, MOTION_TIMEOUT));
	ASSERT_TRUE(dome_hw_at(dome, target, AZIMUTH_TOLERANCE));
	ASSERT_TRUE(dome_hw_goto(dome, dome_hw_normalize(target - 25), INDIGO_OK_STATE, MOTION_TIMEOUT));
	ASSERT_TRUE(dome_hw_at(dome, dome_hw_normalize(target - 25), AZIMUTH_TOLERANCE));
}

static void nexdome3_moves_by_steps(void) {
	double start = dome_hw_azimuth(dome);
	ASSERT_TRUE(dome_hw_steps(dome, true, 15, MOTION_TIMEOUT));
	ASSERT_TRUE(dome_hw_at(dome, dome_hw_normalize(start + 15), AZIMUTH_TOLERANCE));
	ASSERT_TRUE(dome_hw_steps(dome, false, 15, MOTION_TIMEOUT));
	ASSERT_TRUE(dome_hw_at(dome, start, AZIMUTH_TOLERANCE));
}

static void nexdome3_aborts_a_rotation(void) {
	double start = dome_hw_azimuth(dome);
	double target = dome_hw_normalize(round(start) + 120);
	ASSERT_TRUE(dome_hw_idle(dome, DOME_HORIZONTAL_COORDINATES_PROPERTY_NAME, SHORT_TIMEOUT));
	unsigned before = hw_revision(dome, DOME_HORIZONTAL_COORDINATES_PROPERTY_NAME);
	indigo_change_number_property_1(&hw_client, DEVICE_NAME, DOME_HORIZONTAL_COORDINATES_PROPERTY_NAME, DOME_HORIZONTAL_COORDINATES_AZ_ITEM_NAME, target);
	ASSERT_TRUE(hw_wait_state(dome, DOME_HORIZONTAL_COORDINATES_PROPERTY_NAME, before, INDIGO_BUSY_STATE, SHORT_TIMEOUT));
	indigo_usleep(3000000);
	ASSERT_TRUE(dome_hw_abort(dome, SHORT_TIMEOUT));
	ASSERT_TRUE(dome_hw_idle(dome, DOME_HORIZONTAL_COORDINATES_PROPERTY_NAME, MOTION_TIMEOUT));
	indigo_usleep(3000000);
	double stopped = dome_hw_azimuth(dome);
	printf("    stopped at %.1f on the way from %.1f to %.1f, state %d\n", stopped, start, target, hw_property_state(dome, DOME_HORIZONTAL_COORDINATES_PROPERTY_NAME));
	ASSERT_TRUE(dome_hw_azimuth_distance(stopped, target) > 2);
	indigo_usleep(3000000);
	ASSERT_TRUE(dome_hw_at(dome, stopped, AZIMUTH_TOLERANCE));
	ASSERT_TRUE(hw_property_state(dome, DOME_HORIZONTAL_COORDINATES_PROPERTY_NAME) != INDIGO_BUSY_STATE);
}

static void nexdome3_moves_the_shutter(void) {
	bool open = dome_hw_switch_is(dome, DOME_SHUTTER_PROPERTY_NAME, DOME_SHUTTER_OPENED_ITEM_NAME);
	ASSERT_TRUE(dome_hw_open_close(dome, DOME_SHUTTER_PROPERTY_NAME, !open, INDIGO_OK_STATE, MOTION_TIMEOUT));
	ASSERT_TRUE(dome_hw_open_close(dome, DOME_SHUTTER_PROPERTY_NAME, open, INDIGO_OK_STATE, MOTION_TIMEOUT));
	indigo_usleep(3000000);
	ASSERT_TRUE(dome_hw_switch_is(dome, DOME_SHUTTER_PROPERTY_NAME, open ? DOME_SHUTTER_OPENED_ITEM_NAME : DOME_SHUTTER_CLOSED_ITEM_NAME));
	double volts = 0;
	ASSERT_TRUE(hw_number_item(dome, "X_BATTERY_POWER", "VOLTAGE", &volts));
	printf("    shutter battery %.2f V\n", volts);
}

static void nexdome3_finds_home(void) {
	ASSERT_TRUE(dome_hw_idle(dome, "X_FIND_HOME", SHORT_TIMEOUT));
	unsigned before = hw_revision(dome, "X_FIND_HOME");
	indigo_change_switch_property_1(&hw_client, DEVICE_NAME, "X_FIND_HOME", "FIND_HOME", true);
	ASSERT_TRUE(dome_hw_settles(dome, "X_FIND_HOME", before, INDIGO_OK_STATE, MOTION_TIMEOUT));
	ASSERT_TRUE(dome_hw_idle(dome, DOME_HORIZONTAL_COORDINATES_PROPERTY_NAME, MOTION_TIMEOUT));
	printf("    home at %.1f\n", dome_hw_azimuth(dome));
}

// The velocities are read back from the controller; the ones found are saved to EEPROM and reloaded.
static void nexdome3_changes_and_saves_settings(void) {
	ASSERT_TRUE(set_velocity(initial_velocity[0] > 600 ? initial_velocity[0] - 100 : initial_velocity[0] + 100, initial_velocity[1] > 600 ? initial_velocity[1] - 100 : initial_velocity[1] + 100));
	ASSERT_TRUE(set_velocity(initial_velocity[0], initial_velocity[1]));
	ASSERT_TRUE(hw_set_switch(dome, "X_SETTINGS", "SAVE_EEPROM", INDIGO_OK_STATE, SHORT_TIMEOUT));
	ASSERT_TRUE(hw_set_switch(dome, "X_SETTINGS", "LOAD_EEPROM", INDIGO_OK_STATE, SHORT_TIMEOUT));
	indigo_usleep(2000000);
	ASSERT_TRUE(hw_wait_number(dome, "X_VELOCITY", "ROTATOR", initial_velocity[0], 0, SHORT_TIMEOUT));
	ASSERT_TRUE(hw_wait_number(dome, "X_VELOCITY", "SHUTTER", initial_velocity[1], 0, SHORT_TIMEOUT));
}

static void nexdome3_parks(void) {
	ASSERT_TRUE(dome_hw_park(dome, true, MOTION_TIMEOUT));
	double parked = dome_hw_azimuth(dome);
	printf("    parked at %.1f\n", parked);
	ASSERT_TRUE(dome_hw_goto(dome, dome_hw_normalize(round(parked) + 90), INDIGO_ALERT_STATE, SHORT_TIMEOUT));
	ASSERT_TRUE(dome_hw_at(dome, parked, AZIMUTH_TOLERANCE));
	ASSERT_TRUE(dome_hw_park(dome, false, SHORT_TIMEOUT));
	ASSERT_TRUE(dome_hw_goto(dome, dome_hw_normalize(round(parked) + 10), INDIGO_OK_STATE, MOTION_TIMEOUT));
}

static void nexdome3_reconnects(void) {
	double azimuth = dome_hw_azimuth(dome);
	ASSERT_TRUE(hw_disconnect(dome, SHORT_TIMEOUT));
	ASSERT_TRUE(hw_property_hidden(dome, DOME_SHUTTER_PROPERTY_NAME));
	ASSERT_TRUE(hw_connect(dome, SHORT_TIMEOUT));
	ASSERT_TRUE(wait_for_first_status());
	ASSERT_TRUE(dome_hw_at(dome, azimuth, AZIMUTH_TOLERANCE));
}

static void nexdome3_rejects_shutdown_while_connected(void) {
	ASSERT_EQ_INT(INDIGO_BUSY, indigo_dome_nexdome3(INDIGO_DRIVER_SHUTDOWN, NULL));
	ASSERT_TRUE(hw_connected(dome));
}

static void nexdome3_reinitializes(void) {
	ASSERT_TRUE(hw_disconnect(dome, SHORT_TIMEOUT));
	ASSERT_EQ_INT(INDIGO_OK, indigo_dome_nexdome3(INDIGO_DRIVER_SHUTDOWN, NULL));
	ASSERT_EQ_INT(-1, hw_device_index(DEVICE_NAME));
	ASSERT_EQ_INT(INDIGO_OK, indigo_dome_nexdome3(INDIGO_DRIVER_INIT, NULL));
	dome = hw_wait_for_device(DEVICE_NAME, SHORT_TIMEOUT);
	ASSERT_TRUE(dome >= 0);
	ASSERT_TRUE(select_port());
	ASSERT_TRUE(hw_connect(dome, SHORT_TIMEOUT));
	ASSERT_TRUE(wait_for_first_status());
}

int main(int argc, char **argv) {
	if (argc < 2 || strcmp(argv[1], "--run")) {
		fprintf(stderr, "Physical NexDome 3 test: run explicitly with --run (or make test-dome-nexdome3-hw).\n");
		return 2;
	}
	setvbuf(stdout, NULL, _IONBF, 0);
	for (int i = 2; i < argc; i++) {
		if (!strcmp(argv[i], "--debug")) {
			indigo_set_log_level(INDIGO_LOG_DEBUG);
		}
	}
	if (!indigo_test_use_private_home()) {
		return 1;
	}
	serial_port = hw_port("NEXDOME3_HW_PORT");
	const indigo_test_case tests[] = {
		{ "nexdome3_publishes_the_property_contract", nexdome3_publishes_the_property_contract },
		{ "nexdome3_slews_to_an_azimuth", nexdome3_slews_to_an_azimuth },
		{ "nexdome3_moves_by_steps", nexdome3_moves_by_steps },
		{ "nexdome3_aborts_a_rotation", nexdome3_aborts_a_rotation },
		{ "nexdome3_moves_the_shutter", nexdome3_moves_the_shutter },
		{ "nexdome3_finds_home", nexdome3_finds_home },
		{ "nexdome3_changes_and_saves_settings", nexdome3_changes_and_saves_settings },
		{ "nexdome3_parks", nexdome3_parks },
		{ "nexdome3_reconnects", nexdome3_reconnects },
		{ "nexdome3_rejects_shutdown_while_connected", nexdome3_rejects_shutdown_while_connected },
		{ "nexdome3_reinitializes", nexdome3_reinitializes }
	};
	int result = 1;
	bool started = false, initialized = false;
	HW_CHECK(hw_start() == INDIGO_OK);
	started = true;
	HW_CHECK(hw_attach_client("NexDome 3 hardware test") == INDIGO_OK);
	HW_CHECK(indigo_dome_nexdome3(INDIGO_DRIVER_INIT, NULL) == INDIGO_OK);
	initialized = true;
	dome = hw_wait_for_device(DEVICE_NAME, SHORT_TIMEOUT);
	HW_CHECK(dome >= 0);
	HW_CHECK(select_port());
	HW_CHECK(hw_connect(dome, SHORT_TIMEOUT));
	HW_CHECK(capture_state());
	state_captured = true;
	result = indigo_run_tests("NexDome 3 hardware", tests, ARRAY_SIZE(tests));
cleanup:
	restore_initial_state();
	if (!hw_disconnect(dome, SHORT_TIMEOUT)) {
		indigo_test_failures++;
	}
	if (initialized && indigo_dome_nexdome3(INDIGO_DRIVER_SHUTDOWN, NULL) != INDIGO_OK) {
		indigo_test_failures++;
	}
	indigo_detach_client(&hw_client);
	if (started) {
		indigo_stop();
	}
	hw_release_properties();
	indigo_test_remove_private_home();
	return indigo_test_failures ? 1 : result;
}
