// Copyright (c) 2026 INDIGO initiative
// All rights reserved.
//
// You may use this software under the terms of 'INDIGO Astronomy
// open-source license' (see LICENSE.md).
//
// THIS SOFTWARE IS PROVIDED BY THE AUTHORS 'AS IS' AND ANY EXPRESS
// OR IMPLIED WARRANTIES, INCLUDING, BUT NOT LIMITED TO, THE IMPLIED
// WARRANTIES OF MERCHANTABILITY AND FITNESS FOR A PARTICULAR PURPOSE
// ARE DISCLAIMED. IN NO EVENT SHALL THE AUTHOR BE LIABLE FOR ANY
// DIRECT, INDIRECT, INCIDENTAL, SPECIAL, EXEMPLARY, OR CONSEQUENTIAL
// DAMAGES (INCLUDING, BUT NOT LIMITED TO, PROCUREMENT OF SUBSTITUTE
// GOODS OR SERVICES; LOSS OF USE, DATA, OR PROFITS; OR BUSINESS
// INTERRUPTION) HOWEVER CAUSED AND ON ANY THEORY OF LIABILITY,
// WHETHER IN CONTRACT, STRICT LIABILITY, OR TORT (INCLUDING
// NEGLIGENCE OR OTHERWISE) ARISING IN ANY WAY OUT OF THE USE OF THIS
// SOFTWARE, EVEN IF ADVISED OF THE POSSIBILITY OF SUCH DAMAGE.

// Code is generated by AI

// Opt-in acceptance test for a physically connected PegasusAstro FlatMaster, or for the Arduino sketch
// aux_flatmaster_simulator.ino running on a board. It checks the status and firmware handshake,
// switches the panel on and off, sets the intensity at the ends and in the middle of the range,
// repeats a request, reconnects and runs driver INIT/SHUTDOWN.
//
// THE PANEL LIGHTS UP. The session leaves the light off and restores the intensity it found.
//
// The port comes from FLATMASTER_HW_PORT, or from the port the driver matched by its FTDI pattern.

#include <math.h>
#include <stdlib.h>
#include <indigo_drivers/aux_flatmaster/indigo_aux_flatmaster.h>
#include "hardware_test_common.h"

#define DEVICE_NAME "PegasusAstro FlatMaster"

#define SHORT_TIMEOUT 15.0

static int box = -1;
static const char *serial_port = NULL;
static double initial_intensity = 0;
static bool state_captured = false;

static bool select_port(void) {
	if (serial_port == NULL || !*serial_port) {
		char detected[INDIGO_VALUE_SIZE] = "";
		if (hw_text_item(box, DEVICE_PORT_PROPERTY_NAME, DEVICE_PORT_ITEM_NAME, detected, sizeof(detected)) && *detected) {
			printf("Using the port the driver detected: %s\n", detected);
			return true;
		}
		fprintf(stderr, "    set FLATMASTER_HW_PORT to the panel's serial port\n");
		return false;
	}
	printf("Using port %s\n", serial_port);
	return hw_set_text(box, DEVICE_PORT_PROPERTY_NAME, DEVICE_PORT_ITEM_NAME, serial_port, INDIGO_OK_STATE, SHORT_TIMEOUT);
}

static bool set_light(bool on) {
	return hw_set_switch(box, AUX_LIGHT_SWITCH_PROPERTY_NAME, on ? AUX_LIGHT_SWITCH_ON_ITEM_NAME : AUX_LIGHT_SWITCH_OFF_ITEM_NAME, INDIGO_OK_STATE, SHORT_TIMEOUT);
}

static bool light_is(bool on) {
	bool value = !on;
	return hw_switch_item(box, AUX_LIGHT_SWITCH_PROPERTY_NAME, AUX_LIGHT_SWITCH_ON_ITEM_NAME, &value) && value == on;
}

static bool set_intensity(double percent) {
	double value = -1;
	return hw_set_number(box, AUX_LIGHT_INTENSITY_PROPERTY_NAME, AUX_LIGHT_INTENSITY_ITEM_NAME, percent, INDIGO_OK_STATE, SHORT_TIMEOUT) && hw_number_item(box, AUX_LIGHT_INTENSITY_PROPERTY_NAME, AUX_LIGHT_INTENSITY_ITEM_NAME, &value) && value == percent;
}

static void restore_initial_state(void) {
	if (box < 0 || !state_captured || !hw_connected(box)) {
		return;
	}
	set_intensity(initial_intensity);
	set_light(false);
}

static void flatmaster_publishes_the_property_contract(void) {
	double min = -1, max = -1;
	char model[INDIGO_VALUE_SIZE] = "", firmware[INDIGO_VALUE_SIZE] = "";
	ASSERT_TRUE(hw_text_item(box, INFO_PROPERTY_NAME, INFO_DEVICE_MODEL_ITEM_NAME, model, sizeof(model)));
	ASSERT_STREQ("PegasusAstro FlatMaster", model);
	// V answers the firmware version, "V:2.x" from firmware 2.1 on; the prefix is not published.
	ASSERT_TRUE(hw_text_item(box, INFO_PROPERTY_NAME, INFO_DEVICE_FW_REVISION_ITEM_NAME, firmware, sizeof(firmware)));
	ASSERT_TRUE(*firmware && strcmp(firmware, "Unknown") && strncmp(firmware, "V:", 2));
	printf("    %s firmware %s\n", model, firmware);
	ASSERT_TRUE((hw_device_interface(box) & INDIGO_INTERFACE_AUX_LIGHTBOX) != 0);
	ASSERT_STREQ(DEVICE_NAME, hw_device_name(box));
	ASSERT_TRUE(hw_property_defined(box, AUX_LIGHT_SWITCH_PROPERTY_NAME));
	ASSERT_TRUE(hw_property_defined(box, AUX_LIGHT_INTENSITY_PROPERTY_NAME));
	ASSERT_TRUE(hw_number_item_range(box, AUX_LIGHT_INTENSITY_PROPERTY_NAME, AUX_LIGHT_INTENSITY_ITEM_NAME, &min, &max));
	ASSERT_EQ_INT(0, (int)min);
	ASSERT_EQ_INT(100, (int)max);
	printf("    intensity %g%% at connect\n", initial_intensity);
}

static void flatmaster_switches_the_light(void) {
	ASSERT_TRUE(set_light(true));
	ASSERT_TRUE(light_is(true));
	ASSERT_TRUE(set_light(false));
	ASSERT_TRUE(light_is(false));
	// Repeating a request is answered the same way.
	ASSERT_TRUE(set_light(false));
	ASSERT_TRUE(light_is(false));
	ASSERT_TRUE(set_light(true));
	ASSERT_TRUE(set_light(true));
	ASSERT_TRUE(light_is(true));
	ASSERT_TRUE(set_light(false));
}

// The intensity is a percentage the driver scales to the panel's inverted 20 to 255 (220 before
// firmware 2.1); with the light off it is remembered for the next switch-on.
static void flatmaster_sets_the_intensity(void) {
	ASSERT_TRUE(set_light(true));
	static const double values[] = { 0, 1, 50, 99, 100, 37 };
	for (int i = 0; i < ARRAY_SIZE(values); i++) {
		ASSERT_TRUE(set_intensity(values[i]));
	}
	ASSERT_TRUE(set_intensity(37));
	ASSERT_TRUE(set_light(false));
}

static void flatmaster_reconnects(void) {
	ASSERT_TRUE(set_intensity(60));
	ASSERT_TRUE(hw_disconnect(box, SHORT_TIMEOUT));
	ASSERT_TRUE(hw_property_hidden(box, AUX_LIGHT_SWITCH_PROPERTY_NAME));
	ASSERT_TRUE(hw_connect(box, SHORT_TIMEOUT));
	ASSERT_TRUE(hw_property_defined(box, AUX_LIGHT_SWITCH_PROPERTY_NAME));
	ASSERT_TRUE(set_light(true));
	ASSERT_TRUE(set_intensity(20));
	ASSERT_TRUE(set_light(false));
}

static void flatmaster_rejects_shutdown_while_connected(void) {
	ASSERT_EQ_INT(INDIGO_BUSY, indigo_aux_flatmaster(INDIGO_DRIVER_SHUTDOWN, NULL));
	ASSERT_TRUE(set_light(true));
	ASSERT_TRUE(set_light(false));
}

static void flatmaster_reinitializes(void) {
	ASSERT_TRUE(hw_disconnect(box, SHORT_TIMEOUT));
	ASSERT_EQ_INT(INDIGO_OK, indigo_aux_flatmaster(INDIGO_DRIVER_SHUTDOWN, NULL));
	ASSERT_EQ_INT(-1, hw_device_index(DEVICE_NAME));
	ASSERT_EQ_INT(INDIGO_OK, indigo_aux_flatmaster(INDIGO_DRIVER_INIT, NULL));
	box = hw_wait_for_device(DEVICE_NAME, SHORT_TIMEOUT);
	ASSERT_TRUE(box >= 0);
	ASSERT_TRUE(select_port());
	ASSERT_TRUE(hw_connect(box, SHORT_TIMEOUT));
	ASSERT_TRUE(set_light(true));
	ASSERT_TRUE(set_intensity(80));
	ASSERT_TRUE(set_light(false));
}

int main(int argc, char **argv) {
	if (argc < 2 || strcmp(argv[1], "--run")) {
		fprintf(stderr, "Physical PegasusAstro FlatMaster test: run explicitly with --run (or make test-aux-flatmaster-hw).\n");
		return 2;
	}
	setvbuf(stdout, NULL, _IONBF, 0);
	for (int i = 2; i < argc; i++) {
		if (!strcmp(argv[i], "--debug")) {
			indigo_set_log_level(INDIGO_LOG_DEBUG);
		}
	}
	// AUX_LIGHT_INTENSITY is persistent, so the session keeps its configuration out of the user's own folder.
	if (!indigo_test_use_private_home()) {
		return 1;
	}
	serial_port = hw_port("FLATMASTER_HW_PORT");
	const indigo_test_case tests[] = {
		{ "flatmaster_publishes_the_property_contract", flatmaster_publishes_the_property_contract },
		{ "flatmaster_switches_the_light", flatmaster_switches_the_light },
		{ "flatmaster_sets_the_intensity", flatmaster_sets_the_intensity },
		{ "flatmaster_reconnects", flatmaster_reconnects },
		{ "flatmaster_rejects_shutdown_while_connected", flatmaster_rejects_shutdown_while_connected },
		{ "flatmaster_reinitializes", flatmaster_reinitializes }
	};
	int result = 1;
	bool started = false, initialized = false;
	HW_CHECK(hw_start() == INDIGO_OK);
	started = true;
	HW_CHECK(hw_attach_client("PegasusAstro FlatMaster hardware test") == INDIGO_OK);
	HW_CHECK(indigo_aux_flatmaster(INDIGO_DRIVER_INIT, NULL) == INDIGO_OK);
	initialized = true;
	box = hw_wait_for_device(DEVICE_NAME, SHORT_TIMEOUT);
	HW_CHECK(box >= 0);
	HW_CHECK(select_port());
	HW_CHECK(hw_connect(box, SHORT_TIMEOUT));
	HW_CHECK(hw_number_item(box, AUX_LIGHT_INTENSITY_PROPERTY_NAME, AUX_LIGHT_INTENSITY_ITEM_NAME, &initial_intensity));
	state_captured = true;
	result = indigo_run_tests("PegasusAstro FlatMaster hardware", tests, ARRAY_SIZE(tests));
cleanup:
	restore_initial_state();
	if (!hw_disconnect(box, SHORT_TIMEOUT)) {
		indigo_test_failures++;
	}
	if (initialized && indigo_aux_flatmaster(INDIGO_DRIVER_SHUTDOWN, NULL) != INDIGO_OK) {
		indigo_test_failures++;
	}
	indigo_detach_client(&hw_client);
	if (started) {
		indigo_stop();
	}
	hw_release_properties();
	indigo_test_remove_private_home();
	return indigo_test_failures ? 1 : result;
}
