// Copyright (c) 2026 INDIGO initiative
// All rights reserved.
//
// You may use this software under the terms of 'INDIGO Astronomy
// open-source license' (see LICENSE.md).
//
// THIS SOFTWARE IS PROVIDED BY THE AUTHORS 'AS IS' AND ANY EXPRESS
// OR IMPLIED WARRANTIES, INCLUDING, BUT NOT LIMITED TO, THE IMPLIED
// WARRANTIES OF MERCHANTABILITY AND FITNESS FOR A PARTICULAR PURPOSE
// ARE DISCLAIMED. IN NO EVENT SHALL THE AUTHOR BE LIABLE FOR ANY
// DIRECT, INDIRECT, INCIDENTAL, SPECIAL, EXEMPLARY, OR CONSEQUENTIAL
// DAMAGES (INCLUDING, BUT NOT LIMITED TO, PROCUREMENT OF SUBSTITUTE
// GOODS OR SERVICES; LOSS OF USE, DATA, OR PROFITS; OR BUSINESS
// INTERRUPTION) HOWEVER CAUSED AND ON ANY THEORY OF LIABILITY,
// WHETHER IN CONTRACT, STRICT LIABILITY, OR TORT (INCLUDING
// NEGLIGENCE OR OTHERWISE) ARISING IN ANY WAY OUT OF THE USE OF THIS
// SOFTWARE, EVEN IF ADVISED OF THE POSSIBILITY OF SUCH DAMAGE.

// Code is generated by AI

// Opt-in acceptance test for a physically connected ASTROMECHANICS Canon EF lens controller, or for the
// Arduino sketch focuser_astromechanics_simulator.ino running on a board. It checks the property contract,
// moves to absolute positions and by steps both ways, refuses a second move while one runs, sets the
// aperture, reconnects while the lens still moves (the controller has no stop command), reconnects at
// rest and runs driver INIT/SHUTDOWN.
//
// THE LENS FOCUS MOVES AND THE APERTURE CLOSES. The session returns the lens to the position it found and
// sets the aperture back to the value it found.
//
// The port comes from ASTROMECHANICS_HW_PORT.

#include <math.h>
#include <stdlib.h>
#include <indigo_drivers/focuser_astromechanics/indigo_focuser_astromechanics.h>
#include "focuser_hw_common.h"

#define DEVICE_NAME "ASTROMECHANICS Focuser"

#define SHORT_TIMEOUT 15.0
#define MOVE_TIMEOUT 60.0
#define TRAVEL 1500

static int focuser = -1;
static const char *serial_port = NULL;
static bool state_captured = false;
static double initial_position = 0, initial_aperture = 0, base = 0;

static bool select_port(void) {
	if (serial_port == NULL || !*serial_port) {
		fprintf(stderr, "    set ASTROMECHANICS_HW_PORT to the controller's port\n");
		return false;
	}
	printf("Using port %s\n", serial_port);
	return hw_set_text(focuser, DEVICE_PORT_PROPERTY_NAME, DEVICE_PORT_ITEM_NAME, serial_port, INDIGO_OK_STATE, SHORT_TIMEOUT);
}

static void restore_initial_state(void) {
	if (focuser < 0 || !state_captured || !hw_connected(focuser)) {
		return;
	}
	focuser_hw_idle(focuser, FOCUSER_POSITION_PROPERTY_NAME, MOVE_TIMEOUT);
	focuser_hw_goto(focuser, initial_position, INDIGO_OK_STATE, MOVE_TIMEOUT);
	focuser_hw_set_number(focuser, "X_FOCUSER_APERTURE", "APERURE", initial_aperture, INDIGO_OK_STATE, SHORT_TIMEOUT);
}

static void astromechanics_publishes_the_property_contract(void) {
	double min = -1, max = -1;
	ASSERT_TRUE((hw_device_interface(focuser) & INDIGO_INTERFACE_FOCUSER) != 0);
	ASSERT_TRUE(hw_number_item_range(focuser, FOCUSER_POSITION_PROPERTY_NAME, FOCUSER_POSITION_ITEM_NAME, &min, &max));
	ASSERT_EQ_INT(0, (int)min);
	ASSERT_EQ_INT(9999, (int)max);
	ASSERT_TRUE(hw_property_defined(focuser, "X_FOCUSER_APERTURE"));
	// No stop command, no speed, no temperature.
	ASSERT_TRUE(hw_property_hidden(focuser, FOCUSER_ABORT_MOTION_PROPERTY_NAME));
	ASSERT_TRUE(hw_property_hidden(focuser, FOCUSER_SPEED_PROPERTY_NAME));
	ASSERT_TRUE(hw_property_hidden(focuser, FOCUSER_TEMPERATURE_PROPERTY_NAME));
	printf("    position %g, aperture %g\n", initial_position, initial_aperture);
}

static void astromechanics_moves_to_absolute_positions(void) {
	ASSERT_TRUE(focuser_hw_goto(focuser, base + TRAVEL, INDIGO_OK_STATE, MOVE_TIMEOUT));
	ASSERT_TRUE(focuser_hw_goto(focuser, base + 7, INDIGO_OK_STATE, MOVE_TIMEOUT));
	ASSERT_TRUE(focuser_hw_goto(focuser, base, INDIGO_OK_STATE, MOVE_TIMEOUT));
	// A move to the position the lens is at ends at once.
	ASSERT_TRUE(focuser_hw_goto(focuser, base, INDIGO_OK_STATE, SHORT_TIMEOUT));
}

static void astromechanics_moves_by_steps(void) {
	ASSERT_TRUE(focuser_hw_steps(focuser, true, 250, INDIGO_OK_STATE, MOVE_TIMEOUT));
	ASSERT_EQ_INT((int)base + 250, (int)focuser_hw_position(focuser));
	ASSERT_TRUE(focuser_hw_steps(focuser, false, 250, INDIGO_OK_STATE, MOVE_TIMEOUT));
	ASSERT_EQ_INT((int)base, (int)focuser_hw_position(focuser));
}

// A second request while a move runs is refused; the first move still ends at its target.
static void astromechanics_refuses_a_second_move(void) {
	ASSERT_TRUE(focuser_hw_start_goto(focuser, base + TRAVEL, SHORT_TIMEOUT));
	hw_request_number(focuser, FOCUSER_POSITION_PROPERTY_NAME, FOCUSER_POSITION_ITEM_NAME, base + 100);
	hw_request_number(focuser, FOCUSER_STEPS_PROPERTY_NAME, FOCUSER_STEPS_ITEM_NAME, 100);
	ASSERT_TRUE(focuser_hw_idle(focuser, FOCUSER_POSITION_PROPERTY_NAME, MOVE_TIMEOUT));
	ASSERT_EQ_INT(INDIGO_OK_STATE, hw_property_state(focuser, FOCUSER_POSITION_PROPERTY_NAME));
	ASSERT_EQ_INT((int)base + TRAVEL, (int)focuser_hw_position(focuser));
	ASSERT_TRUE(focuser_hw_goto(focuser, base, INDIGO_OK_STATE, MOVE_TIMEOUT));
}

static void astromechanics_sets_the_aperture(void) {
	static const double values[] = { 4, 0, 12 };
	for (int i = 0; i < ARRAY_SIZE(values); i++) {
		ASSERT_TRUE(focuser_hw_set_number(focuser, "X_FOCUSER_APERTURE", "APERURE", values[i], INDIGO_OK_STATE, SHORT_TIMEOUT));
		ASSERT_EQ_INT((int)values[i], (int)focuser_hw_value(focuser, "X_FOCUSER_APERTURE", "APERURE"));
	}
	ASSERT_TRUE(focuser_hw_set_number(focuser, "X_FOCUSER_APERTURE", "APERURE", initial_aperture, INDIGO_OK_STATE, SHORT_TIMEOUT));
}

// The controller cannot be stopped, so a lens still moving at the connection is followed until it settles.
static void astromechanics_reconnects_while_the_lens_moves(void) {
	ASSERT_TRUE(focuser_hw_start_goto(focuser, base + TRAVEL, SHORT_TIMEOUT));
	ASSERT_TRUE(hw_disconnect(focuser, SHORT_TIMEOUT));
	ASSERT_TRUE(hw_connect(focuser, SHORT_TIMEOUT));
	ASSERT_TRUE(focuser_hw_idle(focuser, FOCUSER_POSITION_PROPERTY_NAME, MOVE_TIMEOUT));
	ASSERT_EQ_INT(INDIGO_OK_STATE, hw_property_state(focuser, FOCUSER_POSITION_PROPERTY_NAME));
	ASSERT_EQ_INT((int)base + TRAVEL, (int)focuser_hw_position(focuser));
	ASSERT_TRUE(focuser_hw_goto(focuser, base, INDIGO_OK_STATE, MOVE_TIMEOUT));
}

static void astromechanics_reconnects(void) {
	ASSERT_TRUE(hw_disconnect(focuser, SHORT_TIMEOUT));
	ASSERT_TRUE(hw_property_hidden(focuser, FOCUSER_POSITION_PROPERTY_NAME));
	ASSERT_TRUE(hw_connect(focuser, SHORT_TIMEOUT));
	ASSERT_EQ_INT((int)base, (int)focuser_hw_position(focuser));
	ASSERT_EQ_INT(INDIGO_OK_STATE, hw_property_state(focuser, FOCUSER_POSITION_PROPERTY_NAME));
}

static void astromechanics_rejects_shutdown_while_connected(void) {
	ASSERT_EQ_INT(INDIGO_BUSY, indigo_focuser_astromechanics(INDIGO_DRIVER_SHUTDOWN, NULL));
	ASSERT_TRUE(hw_connected(focuser));
}

static void astromechanics_reinitializes(void) {
	ASSERT_TRUE(hw_disconnect(focuser, SHORT_TIMEOUT));
	ASSERT_EQ_INT(INDIGO_OK, indigo_focuser_astromechanics(INDIGO_DRIVER_SHUTDOWN, NULL));
	ASSERT_EQ_INT(-1, hw_device_index(DEVICE_NAME));
	ASSERT_EQ_INT(INDIGO_OK, indigo_focuser_astromechanics(INDIGO_DRIVER_INIT, NULL));
	focuser = hw_wait_for_device(DEVICE_NAME, SHORT_TIMEOUT);
	ASSERT_TRUE(focuser >= 0);
	ASSERT_TRUE(select_port());
	ASSERT_TRUE(hw_connect(focuser, SHORT_TIMEOUT));
	ASSERT_EQ_INT((int)base, (int)focuser_hw_position(focuser));
}

int main(int argc, char **argv) {
	if (argc < 2 || strcmp(argv[1], "--run")) {
		fprintf(stderr, "Physical ASTROMECHANICS test: run explicitly with --run (or make test-focuser-astromechanics-hw).\n");
		return 2;
	}
	setvbuf(stdout, NULL, _IONBF, 0);
	for (int i = 2; i < argc; i++) {
		if (!strcmp(argv[i], "--debug")) {
			indigo_set_log_level(INDIGO_LOG_DEBUG);
		}
	}
	if (!indigo_test_use_private_home()) {
		return 1;
	}
	serial_port = hw_port("ASTROMECHANICS_HW_PORT");
	const indigo_test_case tests[] = {
		{ "astromechanics_publishes_the_property_contract", astromechanics_publishes_the_property_contract },
		{ "astromechanics_moves_to_absolute_positions", astromechanics_moves_to_absolute_positions },
		{ "astromechanics_moves_by_steps", astromechanics_moves_by_steps },
		{ "astromechanics_refuses_a_second_move", astromechanics_refuses_a_second_move },
		{ "astromechanics_sets_the_aperture", astromechanics_sets_the_aperture },
		{ "astromechanics_reconnects_while_the_lens_moves", astromechanics_reconnects_while_the_lens_moves },
		{ "astromechanics_reconnects", astromechanics_reconnects },
		{ "astromechanics_rejects_shutdown_while_connected", astromechanics_rejects_shutdown_while_connected },
		{ "astromechanics_reinitializes", astromechanics_reinitializes }
	};
	int result = 1;
	bool started = false, initialized = false;
	HW_CHECK(hw_start() == INDIGO_OK);
	started = true;
	HW_CHECK(hw_attach_client("ASTROMECHANICS hardware test") == INDIGO_OK);
	HW_CHECK(indigo_focuser_astromechanics(INDIGO_DRIVER_INIT, NULL) == INDIGO_OK);
	initialized = true;
	focuser = hw_wait_for_device(DEVICE_NAME, SHORT_TIMEOUT);
	HW_CHECK(focuser >= 0);
	HW_CHECK(select_port());
	HW_CHECK(hw_connect(focuser, SHORT_TIMEOUT));
	HW_CHECK(focuser_hw_idle(focuser, FOCUSER_POSITION_PROPERTY_NAME, MOVE_TIMEOUT));
	initial_position = focuser_hw_position(focuser);
	initial_aperture = focuser_hw_value(focuser, "X_FOCUSER_APERTURE", "APERURE");
	// The moves stay inside the range from wherever the lens is.
	base = initial_position > 9999 - TRAVEL - 300 ? 9999 - TRAVEL - 300 : initial_position;
	state_captured = true;
	result = indigo_run_tests("ASTROMECHANICS hardware", tests, ARRAY_SIZE(tests));
cleanup:
	restore_initial_state();
	if (!hw_disconnect(focuser, SHORT_TIMEOUT)) {
		indigo_test_failures++;
	}
	if (initialized && indigo_focuser_astromechanics(INDIGO_DRIVER_SHUTDOWN, NULL) != INDIGO_OK) {
		indigo_test_failures++;
	}
	indigo_detach_client(&hw_client);
	if (started) {
		indigo_stop();
	}
	hw_release_properties();
	indigo_test_remove_private_home();
	return indigo_test_failures ? 1 : result;
}
