// Copyright (c) 2026 INDIGO initiative
// All rights reserved.
//
// You may use this software under the terms of 'INDIGO Astronomy
// open-source license' (see LICENSE.md).
//
// THIS SOFTWARE IS PROVIDED BY THE AUTHORS 'AS IS' AND ANY EXPRESS
// OR IMPLIED WARRANTIES, INCLUDING, BUT NOT LIMITED TO, THE IMPLIED
// WARRANTIES OF MERCHANTABILITY AND FITNESS FOR A PARTICULAR PURPOSE
// ARE DISCLAIMED. IN NO EVENT SHALL THE AUTHOR BE LIABLE FOR ANY
// DIRECT, INDIRECT, INCIDENTAL, SPECIAL, EXEMPLARY, OR CONSEQUENTIAL
// DAMAGES (INCLUDING, BUT NOT LIMITED TO, PROCUREMENT OF SUBSTITUTE
// GOODS OR SERVICES; LOSS OF USE, DATA, OR PROFITS; OR BUSINESS
// INTERRUPTION) HOWEVER CAUSED AND ON ANY THEORY OF LIABILITY,
// WHETHER IN CONTRACT, STRICT LIABILITY, OR TORT (INCLUDING
// NEGLIGENCE OR OTHERWISE) ARISING IN ANY WAY OUT OF THE USE OF THIS
// SOFTWARE, EVEN IF ADVISED OF THE POSSIBILITY OF SUCH DAMAGE.

// Code is generated by AI

// Opt-in acceptance test for a physically connected Pegasus Astro Prodigy Microfocuser, or for the Arduino sketch
// focuser_prodigy_simulator.ino running on a board. It checks the values read at the connection, moves to absolute
// positions and by steps both ways, aborts a move, syncs, keeps a move inside the limits, parks, writes and reads back
// the speed and backlash (kept over a reconnect), switches the power and USB ports of the powerbox device, restarts
// the controller once the focuser is disconnected, reconnects and runs driver INIT/SHUTDOWN.
//
// THE FOCUSER MOVES AND THE PORTS SWITCH. The session writes back the settings and port states it found and returns
// to the position it found.
//
// The port comes from PRODIGY_HW_PORT.

#include <math.h>
#include <stdlib.h>
#include <indigo_drivers/focuser_prodigy/indigo_focuser_prodigy.h>
#include "focuser_hw_common.h"

#define FOCUSER_NAME "Pegasus Prodigy Focuser"
#define AUX_NAME "Pegasus Prodigy Powerbox"

#define SHORT_TIMEOUT 15.0
#define MOVE_TIMEOUT 120.0
#define TRAVEL 1500

static int focuser = -1, aux = -1;
static const char *serial_port = NULL;
static bool state_captured = false, temperature_present = false;
static double initial_position = 0, initial_speed = 0, initial_backlash = 0, base = 0;
static bool initial_ports[4];
static const char *port_property[4] = { AUX_POWER_OUTLET_PROPERTY_NAME, AUX_POWER_OUTLET_PROPERTY_NAME, AUX_USB_PORT_PROPERTY_NAME, AUX_USB_PORT_PROPERTY_NAME };
static const char *port_item[4] = { AUX_POWER_OUTLET_1_ITEM_NAME, AUX_POWER_OUTLET_2_ITEM_NAME, AUX_USB_PORT_1_ITEM_NAME, AUX_USB_PORT_2_ITEM_NAME };

static bool select_port(void) {
	if (serial_port == NULL || !*serial_port) {
		fprintf(stderr, "    set PRODIGY_HW_PORT to the controller's port\n");
		return false;
	}
	printf("Using port %s\n", serial_port);
	return hw_set_text(focuser, DEVICE_PORT_PROPERTY_NAME, DEVICE_PORT_ITEM_NAME, serial_port, INDIGO_OK_STATE, SHORT_TIMEOUT);
}

static bool set_number(const char *property, const char *item, double value) {
	return focuser_hw_set_number(focuser, property, item, value, INDIGO_OK_STATE, SHORT_TIMEOUT) && focuser_hw_value(focuser, property, item) == value;
}

static double value(const char *property, const char *item) {
	return focuser_hw_value(focuser, property, item);
}

static bool port_is(int index) {
	bool on = false;
	hw_switch_item(aux, port_property[index], port_item[index], &on);
	return on;
}

static bool set_port(int index, bool on) {
	return hw_set_switch_value(aux, port_property[index], port_item[index], on, INDIGO_OK_STATE, SHORT_TIMEOUT) && port_is(index) == on;
}

static bool set_limits(double min, double max) {
	unsigned before = hw_revision(focuser, FOCUSER_LIMITS_PROPERTY_NAME);
	static const char *items[] = { FOCUSER_LIMITS_MIN_POSITION_ITEM_NAME, FOCUSER_LIMITS_MAX_POSITION_ITEM_NAME };
	double values[] = { min, max };
	indigo_change_number_property(&hw_client, hw_device_name(focuser), FOCUSER_LIMITS_PROPERTY_NAME, 2, items, values);
	return focuser_hw_settles(focuser, FOCUSER_LIMITS_PROPERTY_NAME, before, INDIGO_OK_STATE, SHORT_TIMEOUT);
}

static void restore_initial_state(void) {
	if (!state_captured) {
		return;
	}
	if (aux >= 0 && hw_connected(aux)) {
		for (int i = 0; i < 4; i++) {
			if (port_is(i) != initial_ports[i]) {
				set_port(i, initial_ports[i]);
			}
		}
	}
	if (focuser < 0 || !hw_connected(focuser)) {
		return;
	}
	focuser_hw_idle(focuser, FOCUSER_POSITION_PROPERTY_NAME, MOVE_TIMEOUT);
	set_limits(-999999, 999999);
	set_number(FOCUSER_BACKLASH_PROPERTY_NAME, FOCUSER_BACKLASH_ITEM_NAME, initial_backlash);
	focuser_hw_goto(focuser, initial_position, INDIGO_OK_STATE, MOVE_TIMEOUT);
	set_number(FOCUSER_SPEED_PROPERTY_NAME, FOCUSER_SPEED_ITEM_NAME, initial_speed);
}

static void prodigy_publishes_the_values(void) {
	char model[INDIGO_VALUE_SIZE] = "", firmware[INDIGO_VALUE_SIZE] = "";
	ASSERT_TRUE((hw_device_interface(focuser) & INDIGO_INTERFACE_FOCUSER) != 0);
	ASSERT_TRUE((hw_device_interface(aux) & INDIGO_INTERFACE_AUX_POWERBOX) != 0);
	ASSERT_TRUE(hw_text_item(focuser, INFO_PROPERTY_NAME, INFO_DEVICE_MODEL_ITEM_NAME, model, sizeof(model)));
	ASSERT_TRUE(hw_text_item(focuser, INFO_PROPERTY_NAME, INFO_DEVICE_FW_REVISION_ITEM_NAME, firmware, sizeof(firmware)));
	double temperature = value(FOCUSER_TEMPERATURE_PROPERTY_NAME, FOCUSER_TEMPERATURE_ITEM_NAME);
	printf("    %s firmware %s, position %g, speed %g, backlash %g, ports %d%d%d%d, %s %.1f C\n", model, firmware, initial_position, initial_speed, initial_backlash, initial_ports[0], initial_ports[1], initial_ports[2], initial_ports[3], temperature_present ? "temperature" : "no probe,", temperature);
	ASSERT_TRUE(!strcmp(model, "Prodigy Microfocuser"));
	ASSERT_TRUE(strchr(firmware, '.') != NULL);
	ASSERT_TRUE(initial_speed >= 100 && initial_speed <= 1000);
	ASSERT_TRUE(initial_backlash >= 0 && initial_backlash <= 9999);
	if (temperature_present) {
		ASSERT_TRUE(temperature > -50 && temperature < 60);
	}
}

static void prodigy_moves_to_absolute_positions(void) {
	ASSERT_TRUE(focuser_hw_goto(focuser, base + TRAVEL, INDIGO_OK_STATE, MOVE_TIMEOUT));
	ASSERT_TRUE(focuser_hw_goto(focuser, base + 11, INDIGO_OK_STATE, MOVE_TIMEOUT));
	ASSERT_TRUE(focuser_hw_goto(focuser, base, INDIGO_OK_STATE, MOVE_TIMEOUT));
	ASSERT_TRUE(focuser_hw_goto(focuser, base, INDIGO_OK_STATE, SHORT_TIMEOUT));
}

// INDIGO counts an inward move as increasing the position (the 2.0 driver did as well); the steps are checked by
// distance and by the way back.
static void prodigy_moves_by_steps(void) {
	ASSERT_TRUE(focuser_hw_steps(focuser, true, 250, INDIGO_OK_STATE, MOVE_TIMEOUT));
	ASSERT_EQ_INT(250, abs((int)(focuser_hw_position(focuser) - base)));
	ASSERT_TRUE(focuser_hw_steps(focuser, false, 250, INDIGO_OK_STATE, MOVE_TIMEOUT));
	ASSERT_EQ_INT((int)base, (int)focuser_hw_position(focuser));
}

static void prodigy_aborts_a_move(void) {
	ASSERT_TRUE(set_number(FOCUSER_SPEED_PROPERTY_NAME, FOCUSER_SPEED_ITEM_NAME, 400));
	ASSERT_TRUE(focuser_hw_start_goto(focuser, base + TRAVEL, SHORT_TIMEOUT));
	indigo_usleep(1500000);
	ASSERT_TRUE(focuser_hw_abort(focuser, SHORT_TIMEOUT));
	ASSERT_TRUE(focuser_hw_idle(focuser, FOCUSER_POSITION_PROPERTY_NAME, SHORT_TIMEOUT));
	ASSERT_EQ_INT(INDIGO_ALERT_STATE, hw_property_state(focuser, FOCUSER_POSITION_PROPERTY_NAME));
	double stopped = focuser_hw_position(focuser);
	printf("    stopped at %g on the way from %g to %g\n", stopped, base, base + TRAVEL);
	ASSERT_TRUE(stopped > base && stopped < base + TRAVEL);
	// the aborted move keeps the requested target, also across idle polls
	double requested = 0;
	ASSERT_TRUE(hw_number_item_target(focuser, FOCUSER_POSITION_PROPERTY_NAME, FOCUSER_POSITION_ITEM_NAME, &requested));
	ASSERT_EQ_INT((int)(base + TRAVEL), (int)requested);
	indigo_usleep(2500000);
	ASSERT_EQ_INT((int)stopped, (int)focuser_hw_position(focuser));
	ASSERT_TRUE(hw_number_item_target(focuser, FOCUSER_POSITION_PROPERTY_NAME, FOCUSER_POSITION_ITEM_NAME, &requested));
	ASSERT_EQ_INT((int)(base + TRAVEL), (int)requested);
	ASSERT_TRUE(focuser_hw_goto(focuser, base, INDIGO_OK_STATE, MOVE_TIMEOUT));
}

// A sync sets the coordinate without moving; syncing back restores it.
static void prodigy_syncs(void) {
	ASSERT_TRUE(focuser_hw_set_switch(focuser, FOCUSER_ON_POSITION_SET_PROPERTY_NAME, FOCUSER_ON_POSITION_SET_SYNC_ITEM_NAME, SHORT_TIMEOUT));
	ASSERT_TRUE(focuser_hw_goto(focuser, base + 1234, INDIGO_OK_STATE, SHORT_TIMEOUT));
	indigo_usleep(1000000);
	ASSERT_EQ_INT((int)base + 1234, (int)focuser_hw_position(focuser));
	ASSERT_TRUE(focuser_hw_goto(focuser, base, INDIGO_OK_STATE, SHORT_TIMEOUT));
	ASSERT_TRUE(focuser_hw_set_switch(focuser, FOCUSER_ON_POSITION_SET_PROPERTY_NAME, FOCUSER_ON_POSITION_SET_GOTO_ITEM_NAME, SHORT_TIMEOUT));
	ASSERT_EQ_INT((int)base, (int)focuser_hw_position(focuser));
}

// A move is kept inside the limits; limits that exclude the focuser are refused.
static void prodigy_keeps_inside_the_limits(void) {
	ASSERT_TRUE(set_limits(base - 100, base + 100));
	ASSERT_TRUE(focuser_hw_goto(focuser, base + 500, INDIGO_OK_STATE, MOVE_TIMEOUT) || focuser_hw_position(focuser) == base + 100);
	ASSERT_EQ_INT((int)base + 100, (int)focuser_hw_position(focuser));
	unsigned before = hw_revision(focuser, FOCUSER_LIMITS_PROPERTY_NAME);
	static const char *items[] = { FOCUSER_LIMITS_MIN_POSITION_ITEM_NAME, FOCUSER_LIMITS_MAX_POSITION_ITEM_NAME };
	double values[] = { base + 200, base + 300 };
	indigo_change_number_property(&hw_client, hw_device_name(focuser), FOCUSER_LIMITS_PROPERTY_NAME, 2, items, values);
	ASSERT_TRUE(focuser_hw_settles(focuser, FOCUSER_LIMITS_PROPERTY_NAME, before, INDIGO_ALERT_STATE, SHORT_TIMEOUT));
	ASSERT_TRUE(set_limits(-999999, 999999));
	ASSERT_TRUE(focuser_hw_goto(focuser, base, INDIGO_OK_STATE, MOVE_TIMEOUT));
}

static void prodigy_parks(void) {
	unsigned before = hw_revision(focuser, "X_FOCUSER_PARK");
	hw_request_switch(focuser, "X_FOCUSER_PARK", "PARK", true);
	ASSERT_TRUE(focuser_hw_settles(focuser, "X_FOCUSER_PARK", before, INDIGO_OK_STATE, MOVE_TIMEOUT));
	ASSERT_TRUE(focuser_hw_idle(focuser, FOCUSER_POSITION_PROPERTY_NAME, MOVE_TIMEOUT));
	ASSERT_EQ_INT(0, (int)focuser_hw_position(focuser));
	ASSERT_TRUE(focuser_hw_goto(focuser, base, INDIGO_OK_STATE, MOVE_TIMEOUT));
}

// The speed and backlash are confirmed by the controller and kept over a reconnect.
static void prodigy_changes_the_settings(void) {
	ASSERT_TRUE(set_number(FOCUSER_SPEED_PROPERTY_NAME, FOCUSER_SPEED_ITEM_NAME, 1000));
	ASSERT_TRUE(set_number(FOCUSER_SPEED_PROPERTY_NAME, FOCUSER_SPEED_ITEM_NAME, 250));
	ASSERT_TRUE(set_number(FOCUSER_BACKLASH_PROPERTY_NAME, FOCUSER_BACKLASH_ITEM_NAME, 37));
	ASSERT_TRUE(hw_disconnect(focuser, SHORT_TIMEOUT));
	ASSERT_TRUE(hw_connect(focuser, SHORT_TIMEOUT));
	ASSERT_EQ_INT(250, (int)value(FOCUSER_SPEED_PROPERTY_NAME, FOCUSER_SPEED_ITEM_NAME));
	ASSERT_EQ_INT(37, (int)value(FOCUSER_BACKLASH_PROPERTY_NAME, FOCUSER_BACKLASH_ITEM_NAME));
	ASSERT_TRUE(set_number(FOCUSER_BACKLASH_PROPERTY_NAME, FOCUSER_BACKLASH_ITEM_NAME, initial_backlash));
	ASSERT_TRUE(set_number(FOCUSER_SPEED_PROPERTY_NAME, FOCUSER_SPEED_ITEM_NAME, initial_speed));
}

// Every power and USB port switches both ways, confirmed by the port status, and keeps its state over a reconnect.
static void prodigy_switches_the_ports(void) {
	for (int i = 0; i < 4; i++) {
		ASSERT_TRUE(set_port(i, !initial_ports[i]));
	}
	ASSERT_TRUE(hw_disconnect(aux, SHORT_TIMEOUT));
	ASSERT_TRUE(hw_connect(aux, SHORT_TIMEOUT));
	for (int i = 0; i < 4; i++) {
		ASSERT_EQ_INT(!initial_ports[i], port_is(i));
		ASSERT_TRUE(set_port(i, initial_ports[i]));
	}
}

// The restart is refused while the focuser is connected and works once it is disconnected.
static void prodigy_restarts_the_controller(void) {
	ASSERT_TRUE(hw_set_switch(aux, "X_AUX_REBOOT", "REBOOT", INDIGO_ALERT_STATE, SHORT_TIMEOUT));
	ASSERT_TRUE(hw_connected(focuser));
	ASSERT_TRUE(hw_disconnect(focuser, SHORT_TIMEOUT));
	unsigned before = hw_revision(aux, "X_AUX_REBOOT");
	hw_request_switch(aux, "X_AUX_REBOOT", "REBOOT", true);
	ASSERT_TRUE(focuser_hw_settles(aux, "X_AUX_REBOOT", before, INDIGO_OK_STATE, SHORT_TIMEOUT));
	ASSERT_TRUE(hw_connect(focuser, SHORT_TIMEOUT));
	ASSERT_EQ_INT((int)base, (int)focuser_hw_position(focuser));
}

static void prodigy_reconnects(void) {
	ASSERT_TRUE(hw_disconnect(focuser, SHORT_TIMEOUT));
	ASSERT_TRUE(hw_property_hidden(focuser, FOCUSER_POSITION_PROPERTY_NAME));
	ASSERT_TRUE(hw_connect(focuser, SHORT_TIMEOUT));
	ASSERT_EQ_INT((int)base, (int)focuser_hw_position(focuser));
	ASSERT_EQ_INT(INDIGO_OK_STATE, hw_property_state(focuser, FOCUSER_POSITION_PROPERTY_NAME));
}

static void prodigy_rejects_shutdown_while_connected(void) {
	ASSERT_EQ_INT(INDIGO_BUSY, indigo_focuser_prodigy(INDIGO_DRIVER_SHUTDOWN, NULL));
	ASSERT_TRUE(hw_connected(focuser));
}

static void prodigy_reinitializes(void) {
	ASSERT_TRUE(hw_disconnect(aux, SHORT_TIMEOUT));
	ASSERT_TRUE(hw_disconnect(focuser, SHORT_TIMEOUT));
	ASSERT_EQ_INT(INDIGO_OK, indigo_focuser_prodigy(INDIGO_DRIVER_SHUTDOWN, NULL));
	ASSERT_EQ_INT(-1, hw_device_index(FOCUSER_NAME));
	ASSERT_EQ_INT(INDIGO_OK, indigo_focuser_prodigy(INDIGO_DRIVER_INIT, NULL));
	focuser = hw_wait_for_device(FOCUSER_NAME, SHORT_TIMEOUT);
	aux = hw_wait_for_device(AUX_NAME, SHORT_TIMEOUT);
	ASSERT_TRUE(focuser >= 0 && aux >= 0);
	ASSERT_TRUE(select_port());
	ASSERT_TRUE(hw_connect(focuser, SHORT_TIMEOUT));
	ASSERT_TRUE(hw_connect(aux, SHORT_TIMEOUT));
	ASSERT_EQ_INT((int)base, (int)focuser_hw_position(focuser));
}

int main(int argc, char **argv) {
	if (argc < 2 || strcmp(argv[1], "--run")) {
		fprintf(stderr, "Physical Prodigy test: run explicitly with --run (or make test-focuser-prodigy-hw).\n");
		return 2;
	}
	setvbuf(stdout, NULL, _IONBF, 0);
	for (int i = 2; i < argc; i++) {
		if (!strcmp(argv[i], "--debug")) {
			indigo_set_log_level(INDIGO_LOG_DEBUG);
		}
	}
	if (!indigo_test_use_private_home()) {
		return 1;
	}
	serial_port = hw_port("PRODIGY_HW_PORT");
	const indigo_test_case tests[] = {
		{ "prodigy_publishes_the_values", prodigy_publishes_the_values },
		{ "prodigy_moves_to_absolute_positions", prodigy_moves_to_absolute_positions },
		{ "prodigy_moves_by_steps", prodigy_moves_by_steps },
		{ "prodigy_aborts_a_move", prodigy_aborts_a_move },
		{ "prodigy_syncs", prodigy_syncs },
		{ "prodigy_keeps_inside_the_limits", prodigy_keeps_inside_the_limits },
		{ "prodigy_parks", prodigy_parks },
		{ "prodigy_changes_the_settings", prodigy_changes_the_settings },
		{ "prodigy_switches_the_ports", prodigy_switches_the_ports },
		{ "prodigy_restarts_the_controller", prodigy_restarts_the_controller },
		{ "prodigy_reconnects", prodigy_reconnects },
		{ "prodigy_rejects_shutdown_while_connected", prodigy_rejects_shutdown_while_connected },
		{ "prodigy_reinitializes", prodigy_reinitializes }
	};
	int result = 1;
	bool started = false, initialized = false;
	HW_CHECK(hw_start() == INDIGO_OK);
	started = true;
	HW_CHECK(hw_attach_client("Prodigy hardware test") == INDIGO_OK);
	HW_CHECK(indigo_focuser_prodigy(INDIGO_DRIVER_INIT, NULL) == INDIGO_OK);
	initialized = true;
	focuser = hw_wait_for_device(FOCUSER_NAME, SHORT_TIMEOUT);
	aux = hw_wait_for_device(AUX_NAME, SHORT_TIMEOUT);
	HW_CHECK(focuser >= 0 && aux >= 0);
	HW_CHECK(select_port());
	HW_CHECK(hw_connect(focuser, SHORT_TIMEOUT));
	HW_CHECK(hw_connect(aux, SHORT_TIMEOUT));
	HW_CHECK(focuser_hw_idle(focuser, FOCUSER_POSITION_PROPERTY_NAME, MOVE_TIMEOUT));
	temperature_present = hw_property_state(focuser, FOCUSER_TEMPERATURE_PROPERTY_NAME) == INDIGO_OK_STATE;
	initial_position = focuser_hw_position(focuser);
	initial_speed = value(FOCUSER_SPEED_PROPERTY_NAME, FOCUSER_SPEED_ITEM_NAME);
	initial_backlash = value(FOCUSER_BACKLASH_PROPERTY_NAME, FOCUSER_BACKLASH_ITEM_NAME);
	for (int i = 0; i < 4; i++) {
		initial_ports[i] = port_is(i);
	}
	base = initial_position < 500 ? 500 : initial_position;
	state_captured = true;
	result = indigo_run_tests("Prodigy hardware", tests, ARRAY_SIZE(tests));
cleanup:
	restore_initial_state();
	if (!hw_disconnect(aux, SHORT_TIMEOUT) || !hw_disconnect(focuser, SHORT_TIMEOUT)) {
		indigo_test_failures++;
	}
	if (initialized && indigo_focuser_prodigy(INDIGO_DRIVER_SHUTDOWN, NULL) != INDIGO_OK) {
		indigo_test_failures++;
	}
	indigo_detach_client(&hw_client);
	if (started) {
		indigo_stop();
	}
	hw_release_properties();
	indigo_test_remove_private_home();
	return indigo_test_failures ? 1 : result;
}
