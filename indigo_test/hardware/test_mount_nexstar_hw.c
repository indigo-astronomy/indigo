// Copyright (c) 2026 INDIGO initiative
// All rights reserved.
//
// You may use this software under the terms of 'INDIGO Astronomy
// open-source license' (see LICENSE.md).
//
// THIS SOFTWARE IS PROVIDED BY THE AUTHORS 'AS IS' AND ANY EXPRESS
// OR IMPLIED WARRANTIES, INCLUDING, BUT NOT LIMITED TO, THE IMPLIED
// WARRANTIES OF MERCHANTABILITY AND FITNESS FOR A PARTICULAR PURPOSE
// ARE DISCLAIMED. IN NO EVENT SHALL THE AUTHOR BE LIABLE FOR ANY
// DIRECT, INDIRECT, INCIDENTAL, SPECIAL, EXEMPLARY, OR CONSEQUENTIAL
// DAMAGES (INCLUDING, BUT NOT LIMITED TO, PROCUREMENT OF SUBSTITUTE
// GOODS OR SERVICES; LOSS OF USE, DATA, OR PROFITS; OR BUSINESS
// INTERRUPTION) HOWEVER CAUSED AND ON ANY THEORY OF LIABILITY,
// WHETHER IN CONTRACT, STRICT LIABILITY, OR TORT (INCLUDING
// NEGLIGENCE OR OTHERWISE) ARISING IN ANY WAY OUT OF THE USE OF THIS
// SOFTWARE, EVEN IF ADVISED OF THE POSSIBILITY OF SUCH DAMAGE.

// Code is generated by AI

// Interactive physical NexStar SE / NexStar+ acceptance in north EQ mode on a wedge.
// --identity reads only; --run executes the acceptance stages and stops at the first failure.
// The mount moves by small relative offsets. Current park is checked against mechanical axes
// before a park command is allowed. Cleanup stops commanded motion, restores the observing
// site, and leaves the requested EQ tracking mode. Configuration is isolated in a private HOME.
// MOUNT_NEXSTAR_HW_PORT is required. USB unplug/replug is deliberately not performed.
// Guider statistics measure host command-write endpoints, not physical motor/electrical timing.
#include <math.h>
#include <stdarg.h>
#include <indigo_drivers/mount_nexstar/indigo_mount_nexstar.h>
#include "hardware_test_common.h"

extern void (*tc_debug)(const char *format, ...);

static int mount = -1;
static int gps = -1;
static bool gps_only = false;
static pthread_mutex_t edge_mutex = PTHREAD_MUTEX_INITIALIZER;
static double edge_on[2], edge_off[2];
static unsigned site_queries;
static double original_site[2];
static bool site_captured = false;

static void protocol_log(const char *format, ...) {
	double timestamp = indigo_monotonic_time();
	va_list arguments;
	va_start(arguments, format);
	char line[1024];
	vsnprintf(line, sizeof(line), format, arguments);
	fprintf(stderr, "%s", line);
	unsigned bytes[8];
	if (sscanf(line, "libnexstar: write %x %x %x %x %x %x %x %x", bytes, bytes + 1, bytes + 2, bytes + 3, bytes + 4, bytes + 5, bytes + 6, bytes + 7) == 8 && bytes[0] == 0x50 && bytes[1] == 2 && (bytes[2] == 16 || bytes[2] == 17) && (bytes[3] == 0x24 || bytes[3] == 0x25)) {
		int axis = bytes[2] - 16;
		pthread_mutex_lock(&edge_mutex);
		if (bytes[4]) {
			edge_on[axis] = timestamp;
		} else if (edge_on[axis] && !edge_off[axis]) {
			edge_off[axis] = timestamp;
		}
		pthread_mutex_unlock(&edge_mutex);
	}
	if (!strcmp(line, "libnexstar: write 77")) {
		pthread_mutex_lock(&edge_mutex);
		site_queries++;
		pthread_mutex_unlock(&edge_mutex);
	}
	va_end(arguments);
	fputc('\n', stderr);
}

static void nexstar_identity_and_readback(void) {
	char value[INDIGO_VALUE_SIZE];
	ASSERT_TRUE(hw_device_interface(mount) & INDIGO_INTERFACE_MOUNT);
	const char *items[] = { MOUNT_INFO_VENDOR_ITEM_NAME, MOUNT_INFO_MODEL_ITEM_NAME, MOUNT_INFO_FIRMWARE_ITEM_NAME };
	for (int i = 0; i < ARRAY_SIZE(items); i++) {
		ASSERT_TRUE(hw_text_item(mount, MOUNT_INFO_PROPERTY_NAME, items[i], value, sizeof(value)));
		printf("%s=%s\n", items[i], value);
		ASSERT_TRUE(value[0] != 0);
	}
	unsigned before = hw_revision(mount, MOUNT_EQUATORIAL_COORDINATES_PROPERTY_NAME);
	ASSERT_TRUE(hw_wait_state(mount, MOUNT_EQUATORIAL_COORDINATES_PROPERTY_NAME, before, INDIGO_OK_STATE, 15));
	const char *props[] = { MOUNT_EQUATORIAL_COORDINATES_PROPERTY_NAME, GEOGRAPHIC_COORDINATES_PROPERTY_NAME, UTC_TIME_PROPERTY_NAME, MOUNT_TRACKING_PROPERTY_NAME, "TRACKING_MODE" };
	for (int i = 0; i < ARRAY_SIZE(props); i++) {
		printf("PROPERTY %s defined=%d state=%d\n", props[i], hw_property_defined(mount, props[i]), hw_property_state(mount, props[i]));
		ASSERT_TRUE(hw_property_defined(mount, props[i]));
		ASSERT_EQ_INT(INDIGO_OK_STATE, hw_property_state(mount, props[i]));
	}
	double ra, dec;
	ASSERT_TRUE(hw_number_item(mount, MOUNT_EQUATORIAL_COORDINATES_PROPERTY_NAME, MOUNT_EQUATORIAL_COORDINATES_RA_ITEM_NAME, &ra));
	ASSERT_TRUE(hw_number_item(mount, MOUNT_EQUATORIAL_COORDINATES_PROPERTY_NAME, MOUNT_EQUATORIAL_COORDINATES_DEC_ITEM_NAME, &dec));
	printf("RA=%g DEC=%g\n", ra, dec);
	ASSERT_TRUE(isfinite(ra) && ra >= 0 && ra < 24 && isfinite(dec) && fabs(dec) <= 90);
}

static bool selected(int device, const char *property, const char *item) {
	bool value = false;
	return hw_switch_item(device, property, item, &value) && value;
}

static bool fresh_position(double *ra, double *dec) {
	unsigned before = hw_revision(mount, MOUNT_EQUATORIAL_COORDINATES_PROPERTY_NAME);
	if (!hw_wait_state(mount, MOUNT_EQUATORIAL_COORDINATES_PROPERTY_NAME, before, INDIGO_OK_STATE, 15)) {
		return false;
	}
	return hw_number_item(mount, MOUNT_EQUATORIAL_COORDINATES_PROPERTY_NAME, MOUNT_EQUATORIAL_COORDINATES_RA_ITEM_NAME, ra) && hw_number_item(mount, MOUNT_EQUATORIAL_COORDINATES_PROPERTY_NAME, MOUNT_EQUATORIAL_COORDINATES_DEC_ITEM_NAME, dec);
}

static bool coordinates(double ra, double dec, bool sync) {
	if (!hw_set_switch(mount, MOUNT_ON_COORDINATES_SET_PROPERTY_NAME, sync ? MOUNT_ON_COORDINATES_SET_SYNC_ITEM_NAME : MOUNT_ON_COORDINATES_SET_TRACK_ITEM_NAME, INDIGO_OK_STATE, 10)) {
		return false;
	}
	unsigned before = hw_revision(mount, MOUNT_EQUATORIAL_COORDINATES_PROPERTY_NAME);
	indigo_change_number_property(&hw_client, hw_device_name(mount), MOUNT_EQUATORIAL_COORDINATES_PROPERTY_NAME, 2, (const char *[]){ MOUNT_EQUATORIAL_COORDINATES_RA_ITEM_NAME, MOUNT_EQUATORIAL_COORDINATES_DEC_ITEM_NAME }, (double[]){ ra, dec });
	if (!hw_wait_state(mount, MOUNT_EQUATORIAL_COORDINATES_PROPERTY_NAME, before, INDIGO_OK_STATE, 90)) {
		return false;
	}
	double actual_ra, actual_dec;
	if (!fresh_position(&actual_ra, &actual_dec)) {
		return false;
	}
	double error = hypot(remainder(actual_ra - ra, 24) * 15 * cos(dec * M_PI / 180), actual_dec - dec);
	printf("Arrival requested %.7f %.7f readback %.7f %.7f error_deg %.6f\n", ra, dec, actual_ra, actual_dec, error);
	return error < 0.15;
}

static void nexstar_wedge_mode_and_property_contract(void) {
	const char *properties[] = { MOUNT_LST_TIME_PROPERTY_NAME, MOUNT_PARK_PROPERTY_NAME, MOUNT_PARK_SET_PROPERTY_NAME, MOUNT_PARK_POSITION_PROPERTY_NAME, MOUNT_SLEW_RATE_PROPERTY_NAME, MOUNT_MOTION_RA_PROPERTY_NAME, MOUNT_MOTION_DEC_PROPERTY_NAME, MOUNT_ON_COORDINATES_SET_PROPERTY_NAME, MOUNT_HORIZONTAL_COORDINATES_PROPERTY_NAME, MOUNT_ABORT_MOTION_PROPERTY_NAME, MOUNT_EPOCH_PROPERTY_NAME, MOUNT_SET_HOST_TIME_PROPERTY_NAME };
	for (int i = 0; i < ARRAY_SIZE(properties); i++) {
		printf("Contract %s\n", properties[i]);
		ASSERT_TRUE(hw_property_defined(mount, properties[i]));
	}
	ASSERT_TRUE(!hw_property_defined(mount, MOUNT_HOME_PROPERTY_NAME));
	ASSERT_TRUE(!hw_property_defined(mount, MOUNT_TRACK_RATE_PROPERTY_NAME));
	ASSERT_TRUE(!hw_property_defined(mount, MOUNT_SIDE_OF_PIER_PROPERTY_NAME));
	ASSERT_TRUE(hw_set_switch(mount, "TRACKING_MODE", "EQ", INDIGO_OK_STATE, 10));
	ASSERT_TRUE(hw_set_switch(mount, MOUNT_TRACKING_PROPERTY_NAME, MOUNT_TRACKING_ON_ITEM_NAME, INDIGO_OK_STATE, 10));
	ASSERT_TRUE(hw_disconnect(mount, 15));
	ASSERT_TRUE(hw_connect(mount, 30));
	ASSERT_TRUE(selected(mount, "TRACKING_MODE", "EQ"));
	ASSERT_TRUE(selected(mount, MOUNT_TRACKING_PROPERTY_NAME, MOUNT_TRACKING_ON_ITEM_NAME));
}

static bool fresh_site_readback(void) {
	pthread_mutex_lock(&edge_mutex);
	unsigned before = site_queries;
	pthread_mutex_unlock(&edge_mutex);
	double deadline = indigo_monotonic_time() + 15;
	while (indigo_monotonic_time() < deadline) {
		pthread_mutex_lock(&edge_mutex);
		bool completed = site_queries >= before + 2;
		pthread_mutex_unlock(&edge_mutex);
		if (completed) {
			return true;
		}
		indigo_usleep(20000);
	}
	return false;
}

static void nexstar_site_clock_and_tracking(void) {
	double lat, lon;
	ASSERT_TRUE(hw_number_item(mount, GEOGRAPHIC_COORDINATES_PROPERTY_NAME, GEOGRAPHIC_COORDINATES_LATITUDE_ITEM_NAME, &lat));
	ASSERT_TRUE(hw_number_item(mount, GEOGRAPHIC_COORDINATES_PROPERTY_NAME, GEOGRAPHIC_COORDINATES_LONGITUDE_ITEM_NAME, &lon));
	original_site[0] = lat;
	original_site[1] = lon;
	site_captured = true;
	ASSERT_TRUE(hw_set_number(mount, GEOGRAPHIC_COORDINATES_PROPERTY_NAME, GEOGRAPHIC_COORDINATES_LATITUDE_ITEM_NAME, lat, INDIGO_OK_STATE, 10));
	ASSERT_TRUE(fresh_site_readback());
	double readback;
	ASSERT_TRUE(hw_number_item(mount, GEOGRAPHIC_COORDINATES_PROPERTY_NAME, GEOGRAPHIC_COORDINATES_LONGITUDE_ITEM_NAME, &readback));
	ASSERT_TRUE(fabs(readback - lon) < 1.0 / 3600);
	ASSERT_TRUE(hw_set_number(mount, GEOGRAPHIC_COORDINATES_PROPERTY_NAME, GEOGRAPHIC_COORDINATES_LONGITUDE_ITEM_NAME, lon, INDIGO_OK_STATE, 10));
	ASSERT_TRUE(fresh_site_readback());
	ASSERT_TRUE(hw_number_item(mount, GEOGRAPHIC_COORDINATES_PROPERTY_NAME, GEOGRAPHIC_COORDINATES_LATITUDE_ITEM_NAME, &readback));
	ASSERT_TRUE(fabs(readback - lat) < 1.0 / 3600);
	char utc[INDIGO_VALUE_SIZE];
	ASSERT_TRUE(hw_text_item(mount, UTC_TIME_PROPERTY_NAME, UTC_TIME_ITEM_NAME, utc, sizeof(utc)));
	printf("Controller UTC %s site %.6f %.6f\n", utc, lat, lon);
	ASSERT_TRUE(hw_set_text(mount, UTC_TIME_PROPERTY_NAME, UTC_TIME_ITEM_NAME, utc, INDIGO_OK_STATE, 10));
	ASSERT_TRUE(hw_set_switch(mount, MOUNT_TRACKING_PROPERTY_NAME, MOUNT_TRACKING_OFF_ITEM_NAME, INDIGO_OK_STATE, 10));
	ASSERT_TRUE(selected(mount, MOUNT_TRACKING_PROPERTY_NAME, MOUNT_TRACKING_OFF_ITEM_NAME));
	ASSERT_TRUE(hw_set_switch(mount, MOUNT_TRACKING_PROPERTY_NAME, MOUNT_TRACKING_ON_ITEM_NAME, INDIGO_OK_STATE, 10));
}

static void nexstar_sync_and_small_goto(void) {
	double ra, dec;
	ASSERT_TRUE(fresh_position(&ra, &dec));
	ASSERT_TRUE(coordinates(ra, dec, true));
	ASSERT_TRUE(coordinates(fmod(ra + 0.02, 24), dec + (dec < 75 ? 0.3 : -0.3), false));
	ASSERT_TRUE(coordinates(ra, dec, false));
	ASSERT_TRUE(coordinates(ra, dec, false));
}

static void nexstar_manual_rates_directions_and_abort(void) {
	const char *rates[] = { MOUNT_SLEW_RATE_GUIDE_ITEM_NAME, MOUNT_SLEW_RATE_CENTERING_ITEM_NAME, MOUNT_SLEW_RATE_FIND_ITEM_NAME, MOUNT_SLEW_RATE_MAX_ITEM_NAME };
	for (int i = 0; i < ARRAY_SIZE(rates); i++) {
		ASSERT_TRUE(hw_set_switch(mount, MOUNT_SLEW_RATE_PROPERTY_NAME, rates[i], INDIGO_OK_STATE, 10));
	}
	ASSERT_TRUE(hw_set_switch(mount, MOUNT_SLEW_RATE_PROPERTY_NAME, MOUNT_SLEW_RATE_FIND_ITEM_NAME, INDIGO_OK_STATE, 10));
	const char *directions[] = { MOUNT_MOTION_EAST_ITEM_NAME, MOUNT_MOTION_WEST_ITEM_NAME, MOUNT_MOTION_NORTH_ITEM_NAME, MOUNT_MOTION_SOUTH_ITEM_NAME };
	for (int i = 0; i < 4; i++) {
		const char *property = i < 2 ? MOUNT_MOTION_RA_PROPERTY_NAME : MOUNT_MOTION_DEC_PROPERTY_NAME;
		double ra, dec, after_ra, after_dec;
		ASSERT_TRUE(fresh_position(&ra, &dec));
		ASSERT_TRUE(hw_set_switch(mount, property, directions[i], INDIGO_BUSY_STATE, 10));
		indigo_usleep(800000);
		ASSERT_TRUE(hw_set_switch_value(mount, property, directions[i], false, INDIGO_OK_STATE, 10));
		ASSERT_TRUE(fresh_position(&after_ra, &after_dec));
		double displacement = hypot(remainder(after_ra - ra, 24) * 15 * cos(dec * M_PI / 180), after_dec - dec);
		printf("Manual %s movement %.6f deg\n", directions[i], displacement);
		ASSERT_TRUE(displacement > 0.01 && displacement < 3);
	}
	ASSERT_TRUE(hw_set_switch(mount, MOUNT_MOTION_RA_PROPERTY_NAME, MOUNT_MOTION_EAST_ITEM_NAME, INDIGO_BUSY_STATE, 10));
	ASSERT_TRUE(hw_set_switch(mount, MOUNT_MOTION_DEC_PROPERTY_NAME, MOUNT_MOTION_NORTH_ITEM_NAME, INDIGO_BUSY_STATE, 10));
	ASSERT_TRUE(hw_set_switch_value(mount, MOUNT_MOTION_RA_PROPERTY_NAME, MOUNT_MOTION_EAST_ITEM_NAME, false, INDIGO_OK_STATE, 10));
	ASSERT_EQ_INT(INDIGO_BUSY_STATE, hw_property_state(mount, MOUNT_MOTION_DEC_PROPERTY_NAME));
	ASSERT_TRUE(hw_set_switch(mount, MOUNT_ABORT_MOTION_PROPERTY_NAME, MOUNT_ABORT_MOTION_ITEM_NAME, INDIGO_OK_STATE, 10));
	ASSERT_EQ_INT(INDIGO_OK_STATE, hw_property_state(mount, MOUNT_MOTION_DEC_PROPERTY_NAME));
	double ra, dec;
	ASSERT_TRUE(fresh_position(&ra, &dec));
	ASSERT_TRUE(coordinates(ra, dec, false));
}

static void nexstar_goto_abort_and_recovery(void) {
	double ra, dec;
	ASSERT_TRUE(fresh_position(&ra, &dec));
	unsigned before = hw_revision(mount, MOUNT_EQUATORIAL_COORDINATES_PROPERTY_NAME);
	indigo_change_number_property(&hw_client, hw_device_name(mount), MOUNT_EQUATORIAL_COORDINATES_PROPERTY_NAME, 2, (const char *[]){ MOUNT_EQUATORIAL_COORDINATES_RA_ITEM_NAME, MOUNT_EQUATORIAL_COORDINATES_DEC_ITEM_NAME }, (double[]){ ra, dec + (dec < 70 ? 3 : -3) });
	ASSERT_TRUE(hw_wait_state(mount, MOUNT_EQUATORIAL_COORDINATES_PROPERTY_NAME, before, INDIGO_BUSY_STATE, 10));
	ASSERT_TRUE(hw_set_switch(mount, MOUNT_ABORT_MOTION_PROPERTY_NAME, MOUNT_ABORT_MOTION_ITEM_NAME, INDIGO_OK_STATE, 10));
	ASSERT_TRUE(fresh_position(&ra, &dec));
	ASSERT_TRUE(coordinates(fmod(ra + .01, 24), dec, false));
}

static int guider = -1;
static const char *guide_directions[] = { GUIDER_GUIDE_EAST_ITEM_NAME, GUIDER_GUIDE_WEST_ITEM_NAME, GUIDER_GUIDE_NORTH_ITEM_NAME, GUIDER_GUIDE_SOUTH_ITEM_NAME };

static bool pulse(int direction, double milliseconds, bool wait) {
	const char *property = direction < 2 ? GUIDER_GUIDE_RA_PROPERTY_NAME : GUIDER_GUIDE_DEC_PROPERTY_NAME;
	unsigned before = hw_revision(guider, property);
	hw_request_number(guider, property, guide_directions[direction], milliseconds);
	if (!hw_wait_state(guider, property, before, wait ? INDIGO_OK_STATE : INDIGO_BUSY_STATE, 10)) {
		return false;
	}
	return !wait || hw_wait_number(guider, property, guide_directions[direction], 0, 0, 3);
}

static void nexstar_guider_directions_replacement_and_axes(void) {
	guider = hw_wait_for_device("Mount Nexstar (guider)", 5);
	ASSERT_TRUE(guider >= 0 && hw_connect(guider, 20));
	ASSERT_TRUE(hw_device_interface(guider) & INDIGO_INTERFACE_GUIDER);
	ASSERT_TRUE(hw_set_switch(guider, "COMMAND_GUIDE_RATE", "GUIDE_100", INDIGO_OK_STATE, 10));
	ASSERT_TRUE(pulse(0, 100, true));
	ASSERT_TRUE(hw_set_switch(guider, "COMMAND_GUIDE_RATE", "GUIDE_50", INDIGO_OK_STATE, 10));
	for (int i = 0; i < 4; i++) {
		hw_forget_states();
		ASSERT_TRUE(pulse(i, 300, true));
		ASSERT_TRUE(hw_states_seen(guider, i < 2 ? GUIDER_GUIDE_RA_PROPERTY_NAME : GUIDER_GUIDE_DEC_PROPERTY_NAME) & (1u << INDIGO_BUSY_STATE));
	}
	ASSERT_TRUE(pulse(0, 0, true));
	ASSERT_TRUE(pulse(0, 2000, false));
	ASSERT_TRUE(pulse(1, 200, true));
	ASSERT_TRUE(pulse(2, 1500, false));
	ASSERT_TRUE(pulse(0, 200, true));
	ASSERT_EQ_INT(INDIGO_BUSY_STATE, hw_property_state(guider, GUIDER_GUIDE_DEC_PROPERTY_NAME));
	ASSERT_TRUE(hw_wait_settled(guider, GUIDER_GUIDE_DEC_PROPERTY_NAME, INDIGO_OK_STATE, 5));
}

static void nexstar_shared_connection_orders_and_pending_disconnect(void) {
	ASSERT_TRUE(hw_disconnect(mount, 20));
	ASSERT_TRUE(pulse(1, 100, true));
	ASSERT_TRUE(hw_disconnect(guider, 20));
	ASSERT_TRUE(hw_connect(guider, 30));
	ASSERT_TRUE(pulse(2, 100, true));
	ASSERT_TRUE(hw_connect(mount, 30));
	ASSERT_TRUE(pulse(0, 3000, false));
	ASSERT_TRUE(hw_disconnect(guider, 20));
	double ra, dec;
	ASSERT_TRUE(fresh_position(&ra, &dec));
	ASSERT_TRUE(hw_connect(guider, 20));
	ASSERT_TRUE(pulse(1, 100, true));
	ASSERT_TRUE(hw_disconnect(guider, 20));
	ASSERT_TRUE(hw_disconnect(mount, 20));
	ASSERT_TRUE(hw_disconnect(mount, 10));
	ASSERT_TRUE(hw_connect(mount, 30));
	ASSERT_TRUE(fresh_position(&ra, &dec));
}

static int compare_error(const void *a, const void *b) {
	double left = *(const double *)a, right = *(const double *)b;
	return (left > right) - (left < right);
}

static void nexstar_guider_transport_timing(void) {
	ASSERT_TRUE(hw_connect(guider, 20));
	const int durations[] = { 20, 100, 500 };
	for (int workload = 0; workload < 2; workload++) {
		ASSERT_TRUE(hw_set_switch(mount, MOUNT_TRACKING_PROPERTY_NAME, workload ? MOUNT_TRACKING_ON_ITEM_NAME : MOUNT_TRACKING_OFF_ITEM_NAME, INDIGO_OK_STATE, 10));
		for (int direction = 0; direction < 4; direction++) {
			for (int duration = 0; duration < ARRAY_SIZE(durations); duration++) {
				double errors[4], sum = 0, squares = 0, absolute = 0;
				for (int repeat = -1; repeat < 4; repeat++) {
					pthread_mutex_lock(&edge_mutex);
					edge_on[direction / 2] = edge_off[direction / 2] = 0;
					pthread_mutex_unlock(&edge_mutex);
					ASSERT_TRUE(pulse(direction, durations[duration], true));
					pthread_mutex_lock(&edge_mutex);
					double on = edge_on[direction / 2], off = edge_off[direction / 2];
					pthread_mutex_unlock(&edge_mutex);
					ASSERT_TRUE(on > 0 && off >= on);
					if (repeat >= 0) {
						double error = 1000 * (off - on) - durations[duration];
						errors[repeat] = error;
						sum += error;
						squares += error * error;
						absolute = fmax(absolute, fabs(error));
					}
				}
				qsort(errors, 4, sizeof(double), compare_error);
				double mean = sum / 4;
				printf("GUIDE_TIMING tracking=%d direction=%s requested_ms=%d n=4 actual_mean_ms=%.3f signed_error_ms min=%.3f mean=%.3f median=%.3f p95=%.3f p99=%.3f max=%.3f sd=%.3f max_abs=%.3f mean_percent=%.3f\n", workload, guide_directions[direction], durations[duration], durations[duration] + mean, errors[0], mean, (errors[1] + errors[2]) / 2, errors[3], errors[3], errors[3], sqrt(fmax(0, squares / 4 - mean * mean)), absolute, mean * 100 / durations[duration]);
			}
		}
	}
	ASSERT_TRUE(hw_set_switch(mount, MOUNT_TRACKING_PROPERTY_NAME, MOUNT_TRACKING_ON_ITEM_NAME, INDIGO_OK_STATE, 10));
	ASSERT_TRUE(hw_disconnect(guider, 20));
}

extern int open_telescope(char *port);
extern int close_telescope(int descriptor);
extern int _tc_get_azalt(int descriptor, double *azimuth, double *altitude, char precise);

static void nexstar_current_park_and_unpark(void) {
	double ra, dec, ha, park_dec;
	ASSERT_TRUE(fresh_position(&ra, &dec));
	ASSERT_TRUE(hw_set_switch(mount, MOUNT_PARK_SET_PROPERTY_NAME, MOUNT_PARK_SET_CURRENT_ITEM_NAME, INDIGO_OK_STATE, 10));
	ASSERT_TRUE(hw_number_item(mount, MOUNT_PARK_POSITION_PROPERTY_NAME, MOUNT_PARK_POSITION_HA_ITEM_NAME, &ha));
	ASSERT_TRUE(hw_number_item(mount, MOUNT_PARK_POSITION_PROPERTY_NAME, MOUNT_PARK_POSITION_DEC_ITEM_NAME, &park_dec));
	ASSERT_TRUE(hw_disconnect(mount, 20));
	int descriptor = open_telescope(getenv("MOUNT_NEXSTAR_HW_PORT"));
	ASSERT_TRUE(descriptor >= 0);
	double axis_ra, axis_dec;
	int status = _tc_get_azalt(descriptor, &axis_ra, &axis_dec, 1);
	close_telescope(descriptor);
	ASSERT_EQ_INT(0, status);
	ASSERT_TRUE(hw_connect(mount, 30));
	printf("Current park encoded axes %.6f %.6f controller axes %.6f %.6f\n", (ha + 12) * 15, park_dec, axis_ra, axis_dec);
	// Refuse an unexpected large park movement: CURRENT must describe the current axes.
	ASSERT_TRUE(fabs(remainder((ha + 12) * 15 - axis_ra, 360)) < 3);
	ASSERT_TRUE(fabs(remainder(park_dec - axis_dec, 360)) < 3);
	unsigned before = hw_revision(mount, MOUNT_PARK_PROPERTY_NAME);
	hw_request_switch(mount, MOUNT_PARK_PROPERTY_NAME, MOUNT_PARK_PARKED_ITEM_NAME, true);
	ASSERT_TRUE(hw_wait_state(mount, MOUNT_PARK_PROPERTY_NAME, before, INDIGO_OK_STATE, 90));
	ASSERT_TRUE(selected(mount, MOUNT_PARK_PROPERTY_NAME, MOUNT_PARK_PARKED_ITEM_NAME));
	ASSERT_TRUE(selected(mount, MOUNT_TRACKING_PROPERTY_NAME, MOUNT_TRACKING_OFF_ITEM_NAME));
	ASSERT_TRUE(hw_set_switch(mount, MOUNT_PARK_PROPERTY_NAME, MOUNT_PARK_UNPARKED_ITEM_NAME, INDIGO_OK_STATE, 10));
	ASSERT_TRUE(hw_disconnect(mount, 20));
	descriptor = open_telescope(getenv("MOUNT_NEXSTAR_HW_PORT"));
	ASSERT_TRUE(descriptor >= 0);
	double parked_ra, parked_dec;
	status = _tc_get_azalt(descriptor, &parked_ra, &parked_dec, 1);
	close_telescope(descriptor);
	ASSERT_EQ_INT(0, status);
	printf("Park arrival axes %.6f %.6f\n", parked_ra, parked_dec);
	ASSERT_TRUE(fabs(remainder(parked_ra - axis_ra, 360)) < 0.15);
	ASSERT_TRUE(fabs(remainder(parked_dec - axis_dec, 360)) < 0.15);
	ASSERT_TRUE(hw_connect(mount, 30));
	ASSERT_TRUE(hw_set_switch(mount, "TRACKING_MODE", "EQ", INDIGO_OK_STATE, 10));
	ASSERT_TRUE(hw_set_switch(mount, MOUNT_TRACKING_PROPERTY_NAME, MOUNT_TRACKING_ON_ITEM_NAME, INDIGO_OK_STATE, 10));
	ASSERT_TRUE(fresh_position(&ra, &dec));
}

static void nexstar_gps_presence_and_sibling_survival(void) {
	gps = hw_wait_for_device("Mount Nexstar (gps)", 10);
	ASSERT_TRUE(gps >= 0);
	unsigned before = hw_revision(gps, CONNECTION_PROPERTY_NAME);
	hw_request_switch(gps, CONNECTION_PROPERTY_NAME, CONNECTION_CONNECTED_ITEM_NAME, true);
	double deadline = indigo_monotonic_time() + 20;
	while (indigo_monotonic_time() < deadline && (hw_revision(gps, CONNECTION_PROPERTY_NAME) <= before || hw_property_state(gps, CONNECTION_PROPERTY_NAME) == INDIGO_BUSY_STATE)) {
		indigo_usleep(20000);
	}
	if (hw_connected(gps)) {
		ASSERT_TRUE(hw_device_interface(gps) & INDIGO_INTERFACE_GPS);
		ASSERT_TRUE(hw_property_defined(gps, GPS_STATUS_PROPERTY_NAME));
		char firmware[INDIGO_VALUE_SIZE];
		ASSERT_TRUE(hw_text_item(gps, INFO_PROPERTY_NAME, INFO_DEVICE_FW_REVISION_ITEM_NAME, firmware, sizeof(firmware)));
		ASSERT_TRUE(firmware[0] && strcmp(firmware, "N/A"));
		indigo_property_state no_fix = INDIGO_IDLE_STATE, fix_3d = INDIGO_IDLE_STATE;
		deadline = indigo_monotonic_time() + 15;
		do {
			hw_light_item(gps, GPS_STATUS_PROPERTY_NAME, GPS_STATUS_NO_FIX_ITEM_NAME, &no_fix);
			hw_light_item(gps, GPS_STATUS_PROPERTY_NAME, GPS_STATUS_3D_FIX_ITEM_NAME, &fix_3d);
			if (no_fix == INDIGO_ALERT_STATE || fix_3d == INDIGO_OK_STATE) {
				break;
			}
			indigo_usleep(20000);
		} while (indigo_monotonic_time() < deadline);
		ASSERT_TRUE(no_fix == INDIGO_ALERT_STATE || fix_3d == INDIGO_OK_STATE);
		printf("GPS accessory detected: firmware %s, status %s; fix accuracy not tested\n", firmware, fix_3d == INDIGO_OK_STATE ? "3D fix" : "no fix");
		ASSERT_TRUE(hw_disconnect(gps, 15));
	} else {
		ASSERT_EQ_INT(INDIGO_ALERT_STATE, hw_property_state(gps, CONNECTION_PROPERTY_NAME));
		printf("GPS accessory absent: rejection verified, fix acquisition not applicable\n");
		ASSERT_TRUE(!gps_only);
	}
	double ra, dec;
	ASSERT_TRUE(fresh_position(&ra, &dec));
}

static void nexstar_refused_port_and_driver_reinitialization(void) {
	ASSERT_TRUE(hw_disconnect(mount, 20));
	ASSERT_TRUE(hw_set_text(mount, DEVICE_PORT_PROPERTY_NAME, DEVICE_PORT_ITEM_NAME, "/dev/null", INDIGO_OK_STATE, 10));
	ASSERT_TRUE(hw_set_switch(mount, CONNECTION_PROPERTY_NAME, CONNECTION_CONNECTED_ITEM_NAME, INDIGO_ALERT_STATE, 15));
	ASSERT_TRUE(!hw_connected(mount));
	ASSERT_TRUE(hw_set_text(mount, DEVICE_PORT_PROPERTY_NAME, DEVICE_PORT_ITEM_NAME, getenv("MOUNT_NEXSTAR_HW_PORT"), INDIGO_OK_STATE, 10));
	ASSERT_TRUE(hw_connect(mount, 30));
	double ra, dec;
	ASSERT_TRUE(fresh_position(&ra, &dec));
	ASSERT_TRUE(hw_disconnect(mount, 20));
	ASSERT_EQ_INT(INDIGO_OK, indigo_mount_nexstar(INDIGO_DRIVER_SHUTDOWN, NULL));
	ASSERT_EQ_INT(INDIGO_OK, indigo_mount_nexstar(INDIGO_DRIVER_INIT, NULL));
	mount = hw_wait_for_device("Mount Nexstar", 10);
	ASSERT_TRUE(mount >= 0);
	ASSERT_TRUE(hw_set_text(mount, DEVICE_PORT_PROPERTY_NAME, DEVICE_PORT_ITEM_NAME, getenv("MOUNT_NEXSTAR_HW_PORT"), INDIGO_OK_STATE, 10));
	ASSERT_TRUE(hw_connect(mount, 30));
	ASSERT_TRUE(fresh_position(&ra, &dec));
}

int main(int argc, char **argv) {
	if (argc != 2 || (strcmp(argv[1], "--identity") && strcmp(argv[1], "--run") && strcmp(argv[1], "--gps"))) {
		fprintf(stderr, "Use --identity, --gps or --run with MOUNT_NEXSTAR_HW_PORT set.\n");
		return 2;
	}
	const char *port = getenv("MOUNT_NEXSTAR_HW_PORT");
	if (port == NULL || !indigo_test_use_private_home()) {
		return 2;
	}
	gps_only = !strcmp(argv[1], "--gps");
	setvbuf(stdout, NULL, _IONBF, 0);
	indigo_set_log_level(INDIGO_LOG_DEBUG);
	tc_debug = protocol_log;
	bool started = false, initialized = false, attached = false;
	int result = 1;
	HW_CHECK(indigo_start() == INDIGO_OK);
	started = true;
	HW_CHECK(hw_attach_client("NexStar hardware acceptance") == INDIGO_OK);
	attached = true;
	HW_CHECK(indigo_mount_nexstar(INDIGO_DRIVER_INIT, NULL) == INDIGO_OK);
	initialized = true;
	mount = hw_wait_for_device("Mount Nexstar", 10);
	HW_CHECK(mount >= 0);
	HW_CHECK(hw_set_text(mount, DEVICE_PORT_PROPERTY_NAME, DEVICE_PORT_ITEM_NAME, port, INDIGO_OK_STATE, 10));
	HW_CHECK(hw_connect(mount, 45));
	const indigo_test_case tests[] = {
		{ "nexstar_identity_and_readback", nexstar_identity_and_readback },
		{ "nexstar_wedge_mode_and_property_contract", nexstar_wedge_mode_and_property_contract },
		{ "nexstar_site_clock_and_tracking", nexstar_site_clock_and_tracking },
		{ "nexstar_sync_and_small_goto", nexstar_sync_and_small_goto },
		{ "nexstar_manual_rates_directions_and_abort", nexstar_manual_rates_directions_and_abort },
		{ "nexstar_goto_abort_and_recovery", nexstar_goto_abort_and_recovery },
		{ "nexstar_guider_directions_replacement_and_axes", nexstar_guider_directions_replacement_and_axes },
		{ "nexstar_shared_connection_orders_and_pending_disconnect", nexstar_shared_connection_orders_and_pending_disconnect },
		{ "nexstar_guider_transport_timing", nexstar_guider_transport_timing },
		{ "nexstar_current_park_and_unpark", nexstar_current_park_and_unpark },
		{ "nexstar_gps_presence_and_sibling_survival", nexstar_gps_presence_and_sibling_survival },
		{ "nexstar_refused_port_and_driver_reinitialization", nexstar_refused_port_and_driver_reinitialization }
	};
	result = 0;
	int count = !strcmp(argv[1], "--identity") ? 1 : ARRAY_SIZE(tests);
	for (int i = 0; i < count; i++) {
		if (gps_only && tests[i].function != nexstar_gps_presence_and_sibling_survival) {
			continue;
		}
		result = indigo_run_tests("NexStar physical hardware", tests + i, 1);
		if (result) {
			break;
		}
	}
cleanup:
	if (gps >= 0 && !hw_disconnect(gps, 20)) {
		indigo_test_failures++;
	}
	if (guider >= 0 && !hw_disconnect(guider, 20)) {
		indigo_test_failures++;
	}
	if (!strcmp(argv[1], "--run") && mount >= 0 && hw_connected(mount)) {
		if (!hw_set_switch(mount, MOUNT_ABORT_MOTION_PROPERTY_NAME, MOUNT_ABORT_MOTION_ITEM_NAME, INDIGO_OK_STATE, 15)) {
			indigo_test_failures++;
		}
	}
	if (site_captured && mount >= 0 && hw_connected(mount)) {
		unsigned before = hw_revision(mount, GEOGRAPHIC_COORDINATES_PROPERTY_NAME);
		indigo_change_number_property(&hw_client, hw_device_name(mount), GEOGRAPHIC_COORDINATES_PROPERTY_NAME, 2, (const char *[]){ GEOGRAPHIC_COORDINATES_LATITUDE_ITEM_NAME, GEOGRAPHIC_COORDINATES_LONGITUDE_ITEM_NAME }, original_site);
		if (!hw_wait_state(mount, GEOGRAPHIC_COORDINATES_PROPERTY_NAME, before, INDIGO_OK_STATE, 10)) {
			indigo_test_failures++;
		}
	}
	if (mount >= 0 && !hw_disconnect(mount, 45)) {
		indigo_test_failures++;
	}
	if (initialized && indigo_mount_nexstar(INDIGO_DRIVER_SHUTDOWN, NULL) != INDIGO_OK) {
		indigo_test_failures++;
	}
	if (attached) {
		indigo_detach_client(&hw_client);
	}
	if (started) {
		indigo_stop();
	}
	hw_release_properties();
	indigo_test_remove_private_home();
	return indigo_test_failures ? 1 : result;
}
