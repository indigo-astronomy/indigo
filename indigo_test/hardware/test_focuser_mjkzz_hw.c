// Copyright (c) 2026 INDIGO initiative
// All rights reserved.
//
// You may use this software under the terms of 'INDIGO Astronomy
// open-source license' (see LICENSE.md).
//
// THIS SOFTWARE IS PROVIDED BY THE AUTHORS 'AS IS' AND ANY EXPRESS
// OR IMPLIED WARRANTIES, INCLUDING, BUT NOT LIMITED TO, THE IMPLIED
// WARRANTIES OF MERCHANTABILITY AND FITNESS FOR A PARTICULAR PURPOSE
// ARE DISCLAIMED. IN NO EVENT SHALL THE AUTHOR BE LIABLE FOR ANY
// DIRECT, INDIRECT, INCIDENTAL, SPECIAL, EXEMPLARY, OR CONSEQUENTIAL
// DAMAGES (INCLUDING, BUT NOT LIMITED TO, PROCUREMENT OF SUBSTITUTE
// GOODS OR SERVICES; LOSS OF USE, DATA, OR PROFITS; OR BUSINESS
// INTERRUPTION) HOWEVER CAUSED AND ON ANY THEORY OF LIABILITY,
// WHETHER IN CONTRACT, STRICT LIABILITY, OR TORT (INCLUDING
// NEGLIGENCE OR OTHERWISE) ARISING IN ANY WAY OUT OF THE USE OF THIS
// SOFTWARE, EVEN IF ADVISED OF THE POSSIBILITY OF SUCH DAMAGE.

// Code is generated by AI

// Opt-in acceptance test for a physically connected MJKZZ Serial Camera Motion Controller, or for
// the Arduino sketch focuser_mjkzz_simulator.ino running on a board. It runs the focuser hardware
// acceptance checklist of DRIVER_TESTING_RULES.md: the identity handshake, the published property
// contract, absolute and relative motion with position readback, the overlapping request, abort
// while moving and while idle, the four speeds, a disconnect during a move, reconnect and driver
// INIT/SHUTDOWN.
//
// THE RAIL PHYSICALLY MOVES. Every move is relative to the position the controller reported when
// the session started, the longest single move is MJKZZ_HW_TRAVEL steps (default 200) forward,
// every scenario moves back, and the session restores the starting position and speed before it
// disconnects. The driver writes the motor power and micro step registers at every connect.
//
// The port comes from MJKZZ_HW_PORT. The driver has no match pattern, so the port must be given.

#include <math.h>
#include <stdlib.h>
#include <indigo_drivers/focuser_mjkzz/indigo_focuser_mjkzz.h>
#include "hardware_test_common.h"

#define DEVICE_NAME "MJKZZ Rail"

#define SHORT_TIMEOUT 15.0
// The default travel at the slowest speed (the sketch steps every 40 ms at speed 3), with margin.
#define MOVE_TIMEOUT 60.0
// The idle position poll runs every second.
#define POLL_TIMEOUT 5.0

#define FASTEST_SPEED 0
#define SLOWEST_SPEED 3

static int focuser = -1;
static const char *serial_port = NULL;
static double travel = 200;
static double initial_position, initial_speed;
static bool state_captured = false;

static bool select_port(void) {
	if (serial_port == NULL || !*serial_port) {
		fprintf(stderr, "    set MJKZZ_HW_PORT to the controller's serial port\n");
		return false;
	}
	printf("Using port %s\n", serial_port);
	return hw_set_text(focuser, DEVICE_PORT_PROPERTY_NAME, DEVICE_PORT_ITEM_NAME, serial_port, INDIGO_OK_STATE, SHORT_TIMEOUT);
}

static double position(void) {
	double value = -1;
	hw_number_item(focuser, FOCUSER_POSITION_PROPERTY_NAME, FOCUSER_POSITION_ITEM_NAME, &value);
	return value;
}

static bool move_to(double target) {
	unsigned before = hw_revision(focuser, FOCUSER_POSITION_PROPERTY_NAME);
	hw_request_number(focuser, FOCUSER_POSITION_PROPERTY_NAME, FOCUSER_POSITION_ITEM_NAME, target);
	if (!hw_wait_state(focuser, FOCUSER_POSITION_PROPERTY_NAME, before, INDIGO_OK_STATE, MOVE_TIMEOUT)) {
		return false;
	}
	return hw_wait_number(focuser, FOCUSER_POSITION_PROPERTY_NAME, FOCUSER_POSITION_ITEM_NAME, target, 0, POLL_TIMEOUT);
}

static bool move_by(const char *direction, double steps) {
	if (!hw_set_switch(focuser, FOCUSER_DIRECTION_PROPERTY_NAME, direction, INDIGO_OK_STATE, SHORT_TIMEOUT)) {
		return false;
	}
	unsigned before = hw_revision(focuser, FOCUSER_STEPS_PROPERTY_NAME);
	hw_request_number(focuser, FOCUSER_STEPS_PROPERTY_NAME, FOCUSER_STEPS_ITEM_NAME, steps);
	return hw_wait_state(focuser, FOCUSER_STEPS_PROPERTY_NAME, before, INDIGO_OK_STATE, MOVE_TIMEOUT);
}

static bool set_speed(double speed) {
	return hw_set_number(focuser, FOCUSER_SPEED_PROPERTY_NAME, FOCUSER_SPEED_ITEM_NAME, speed, INDIGO_OK_STATE, SHORT_TIMEOUT);
}

static bool capture_initial_state(void) {
	if (!hw_number_item(focuser, FOCUSER_POSITION_PROPERTY_NAME, FOCUSER_POSITION_ITEM_NAME, &initial_position)) {
		return false;
	}
	if (!hw_number_item(focuser, FOCUSER_SPEED_PROPERTY_NAME, FOCUSER_SPEED_ITEM_NAME, &initial_speed)) {
		return false;
	}
	state_captured = true;
	return true;
}

static void restore_initial_state(void) {
	if (focuser < 0 || !state_captured || !hw_connected(focuser)) {
		return;
	}
	hw_set_switch(focuser, FOCUSER_ABORT_MOTION_PROPERTY_NAME, FOCUSER_ABORT_MOTION_ITEM_NAME, INDIGO_OK_STATE, SHORT_TIMEOUT);
	set_speed(FASTEST_SPEED);
	if (move_to(initial_position)) {
		printf("Restored the starting position %g\n", initial_position);
	}
	set_speed(initial_speed);
}

static void mjkzz_reports_identity_and_capabilities(void) {
	char model[INDIGO_VALUE_SIZE] = "", firmware[INDIGO_VALUE_SIZE] = "", port[INDIGO_VALUE_SIZE] = "";
	ASSERT_TRUE((hw_device_interface(focuser) & INDIGO_INTERFACE_FOCUSER) != 0);
	ASSERT_STREQ(DEVICE_NAME, hw_device_name(focuser));
	ASSERT_TRUE(hw_text_item(focuser, INFO_PROPERTY_NAME, INFO_DEVICE_MODEL_ITEM_NAME, model, sizeof(model)));
	ASSERT_STREQ("MJKZZ Serial Camera Motion Controller", model);
	// The version answer fills the firmware revision.
	ASSERT_TRUE(hw_text_item(focuser, INFO_PROPERTY_NAME, INFO_DEVICE_FW_REVISION_ITEM_NAME, firmware, sizeof(firmware)));
	ASSERT_TRUE(*firmware && strcmp(firmware, "0.0.0.0"));
	ASSERT_TRUE(hw_text_item(focuser, DEVICE_PORT_PROPERTY_NAME, DEVICE_PORT_ITEM_NAME, port, sizeof(port)));
	printf("    %s firmware %s on %s, position %g, speed %g\n", model, firmware, port, initial_position, initial_speed);
}

static void mjkzz_publishes_the_property_contract(void) {
	double min = 0, max = 0;
	ASSERT_TRUE(hw_property_defined(focuser, FOCUSER_SPEED_PROPERTY_NAME));
	ASSERT_TRUE(hw_property_defined(focuser, FOCUSER_DIRECTION_PROPERTY_NAME));
	ASSERT_TRUE(hw_property_defined(focuser, FOCUSER_STEPS_PROPERTY_NAME));
	ASSERT_TRUE(hw_property_defined(focuser, FOCUSER_POSITION_PROPERTY_NAME));
	ASSERT_TRUE(hw_property_defined(focuser, FOCUSER_ABORT_MOTION_PROPERTY_NAME));
	// The controller has none of these, so the driver must leave them hidden.
	ASSERT_TRUE(hw_property_hidden(focuser, FOCUSER_ON_POSITION_SET_PROPERTY_NAME));
	ASSERT_TRUE(hw_property_hidden(focuser, FOCUSER_REVERSE_MOTION_PROPERTY_NAME));
	ASSERT_TRUE(hw_property_hidden(focuser, FOCUSER_TEMPERATURE_PROPERTY_NAME));
	ASSERT_TRUE(hw_property_hidden(focuser, FOCUSER_LIMITS_PROPERTY_NAME));
	ASSERT_TRUE(hw_property_hidden(focuser, FOCUSER_BACKLASH_PROPERTY_NAME));
	ASSERT_TRUE(hw_property_hidden(focuser, FOCUSER_COMPENSATION_PROPERTY_NAME));
	ASSERT_TRUE(hw_number_item_range(focuser, FOCUSER_SPEED_PROPERTY_NAME, FOCUSER_SPEED_ITEM_NAME, &min, &max));
	ASSERT_EQ_INT(FASTEST_SPEED, (int)min);
	ASSERT_EQ_INT(SLOWEST_SPEED, (int)max);
	ASSERT_TRUE(hw_number_item_range(focuser, FOCUSER_POSITION_PROPERTY_NAME, FOCUSER_POSITION_ITEM_NAME, &min, &max));
	ASSERT_EQ_INT(-32768, (int)min);
	ASSERT_EQ_INT(32767, (int)max);
	ASSERT_EQ_INT(INDIGO_OK_STATE, hw_property_state(focuser, FOCUSER_POSITION_PROPERTY_NAME));
}

static void mjkzz_moves_to_an_absolute_position(void) {
	ASSERT_TRUE(set_speed(FASTEST_SPEED));
	hw_forget_states();
	ASSERT_TRUE(move_to(initial_position + travel));
	ASSERT_TRUE((hw_states_seen(focuser, FOCUSER_POSITION_PROPERTY_NAME) & (1u << INDIGO_BUSY_STATE)) != 0);
	ASSERT_TRUE(move_to(initial_position));
	ASSERT_NEAR(initial_position, position(), 0);
}

static void mjkzz_moves_relative_in_both_directions(void) {
	ASSERT_TRUE(set_speed(FASTEST_SPEED));
	ASSERT_TRUE(move_by(FOCUSER_DIRECTION_MOVE_OUTWARD_ITEM_NAME, travel));
	ASSERT_TRUE(hw_wait_number(focuser, FOCUSER_POSITION_PROPERTY_NAME, FOCUSER_POSITION_ITEM_NAME, initial_position + travel, 0, POLL_TIMEOUT));
	ASSERT_TRUE(move_by(FOCUSER_DIRECTION_MOVE_INWARD_ITEM_NAME, travel));
	ASSERT_TRUE(hw_wait_number(focuser, FOCUSER_POSITION_PROPERTY_NAME, FOCUSER_POSITION_ITEM_NAME, initial_position, 0, POLL_TIMEOUT));
	ASSERT_TRUE(move_by(FOCUSER_DIRECTION_MOVE_OUTWARD_ITEM_NAME, 0));
	ASSERT_NEAR(initial_position, position(), 0);
}

// A second request while the rail runs is refused, and the first move finishes at its own target.
static void mjkzz_rejects_an_overlapping_move(void) {
	double first = initial_position + travel;
	ASSERT_TRUE(set_speed(SLOWEST_SPEED));
	unsigned before = hw_revision(focuser, FOCUSER_POSITION_PROPERTY_NAME);
	hw_request_number(focuser, FOCUSER_POSITION_PROPERTY_NAME, FOCUSER_POSITION_ITEM_NAME, first);
	ASSERT_TRUE(hw_wait_state(focuser, FOCUSER_POSITION_PROPERTY_NAME, before, INDIGO_BUSY_STATE, SHORT_TIMEOUT));
	hw_request_number(focuser, FOCUSER_POSITION_PROPERTY_NAME, FOCUSER_POSITION_ITEM_NAME, initial_position + round(travel / 3));
	ASSERT_TRUE(hw_wait_settled(focuser, FOCUSER_POSITION_PROPERTY_NAME, INDIGO_OK_STATE, MOVE_TIMEOUT));
	ASSERT_TRUE(hw_wait_number(focuser, FOCUSER_POSITION_PROPERTY_NAME, FOCUSER_POSITION_ITEM_NAME, first, 0, POLL_TIMEOUT));
	ASSERT_TRUE(set_speed(FASTEST_SPEED));
	ASSERT_TRUE(move_to(initial_position));
}

// Abort stops the rail mid-move, ends both motion properties ALERT at the stopped position and
// leaves the driver able to take a fresh move.
static void mjkzz_aborts_a_move(void) {
	double target = initial_position + travel;
	ASSERT_TRUE(set_speed(SLOWEST_SPEED));
	unsigned before = hw_revision(focuser, FOCUSER_POSITION_PROPERTY_NAME);
	hw_request_number(focuser, FOCUSER_POSITION_PROPERTY_NAME, FOCUSER_POSITION_ITEM_NAME, target);
	ASSERT_TRUE(hw_wait_state(focuser, FOCUSER_POSITION_PROPERTY_NAME, before, INDIGO_BUSY_STATE, SHORT_TIMEOUT));
	indigo_usleep(1500000);
	ASSERT_TRUE(hw_set_switch(focuser, FOCUSER_ABORT_MOTION_PROPERTY_NAME, FOCUSER_ABORT_MOTION_ITEM_NAME, INDIGO_OK_STATE, SHORT_TIMEOUT));
	ASSERT_EQ_INT(INDIGO_ALERT_STATE, hw_property_state(focuser, FOCUSER_POSITION_PROPERTY_NAME));
	ASSERT_EQ_INT(INDIGO_ALERT_STATE, hw_property_state(focuser, FOCUSER_STEPS_PROPERTY_NAME));
	double stopped = position(), stopped_target = -1;
	ASSERT_TRUE(hw_number_item_target(focuser, FOCUSER_POSITION_PROPERTY_NAME, FOCUSER_POSITION_ITEM_NAME, &stopped_target));
	printf("    aborted at %g, between %g and %g\n", stopped, initial_position, target);
	ASSERT_TRUE(stopped > initial_position && stopped < target);
	ASSERT_NEAR(stopped, stopped_target, 0);
	// The rail really stopped: two idle polls later the position is the same and the move stays ALERT.
	indigo_usleep(2500000);
	ASSERT_NEAR(stopped, position(), 0);
	ASSERT_EQ_INT(INDIGO_ALERT_STATE, hw_property_state(focuser, FOCUSER_POSITION_PROPERTY_NAME));
	ASSERT_TRUE(set_speed(FASTEST_SPEED));
	ASSERT_TRUE(move_to(initial_position));
}

static void mjkzz_accepts_an_abort_while_idle(void) {
	ASSERT_NEAR(initial_position, position(), 0);
	ASSERT_TRUE(hw_set_switch(focuser, FOCUSER_ABORT_MOTION_PROPERTY_NAME, FOCUSER_ABORT_MOTION_ITEM_NAME, INDIGO_OK_STATE, SHORT_TIMEOUT));
	ASSERT_EQ_INT(INDIGO_OK_STATE, hw_property_state(focuser, FOCUSER_POSITION_PROPERTY_NAME));
	ASSERT_NEAR(initial_position, position(), 0);
	ASSERT_TRUE(move_to(initial_position + round(travel / 4)));
	ASSERT_TRUE(move_to(initial_position));
}

// Every speed reaches the controller, and the larger value is the slower one.
static void mjkzz_changes_the_speed(void) {
	for (int speed = FASTEST_SPEED; speed <= SLOWEST_SPEED; speed++) {
		ASSERT_TRUE(set_speed(speed));
	}
	double distance = round(travel / 2);
	ASSERT_TRUE(set_speed(FASTEST_SPEED));
	double started = indigo_monotonic_time();
	ASSERT_TRUE(move_to(initial_position + distance));
	double fast = indigo_monotonic_time() - started;
	ASSERT_TRUE(move_to(initial_position));
	ASSERT_TRUE(set_speed(SLOWEST_SPEED));
	started = indigo_monotonic_time();
	ASSERT_TRUE(move_to(initial_position + distance));
	double slow = indigo_monotonic_time() - started;
	printf("    %g steps took %.2f s at speed %d and %.2f s at speed %d\n", distance, fast, FASTEST_SPEED, slow, SLOWEST_SPEED);
	ASSERT_TRUE(slow > fast);
	ASSERT_TRUE(set_speed(FASTEST_SPEED));
	ASSERT_TRUE(move_to(initial_position));
}

// Disconnecting while the rail runs stops it; after reconnect the position is read back inside the
// travel and a fresh move works.
static void mjkzz_survives_a_disconnect_during_a_move(void) {
	ASSERT_TRUE(set_speed(SLOWEST_SPEED));
	unsigned before = hw_revision(focuser, FOCUSER_POSITION_PROPERTY_NAME);
	hw_request_number(focuser, FOCUSER_POSITION_PROPERTY_NAME, FOCUSER_POSITION_ITEM_NAME, initial_position + travel);
	ASSERT_TRUE(hw_wait_state(focuser, FOCUSER_POSITION_PROPERTY_NAME, before, INDIGO_BUSY_STATE, SHORT_TIMEOUT));
	indigo_usleep(1000000);
	ASSERT_TRUE(hw_disconnect(focuser, MOVE_TIMEOUT));
	indigo_usleep(1000000);
	ASSERT_TRUE(hw_connect(focuser, SHORT_TIMEOUT));
	ASSERT_EQ_INT(INDIGO_OK_STATE, hw_property_state(focuser, FOCUSER_POSITION_PROPERTY_NAME));
	double stopped = position();
	printf("    the disconnect stopped the rail at %g\n", stopped);
	ASSERT_TRUE(stopped > initial_position && stopped < initial_position + travel);
	// It stays where it stopped.
	indigo_usleep(2500000);
	ASSERT_NEAR(stopped, position(), 0);
	ASSERT_TRUE(set_speed(FASTEST_SPEED));
	ASSERT_TRUE(move_to(initial_position));
}

static void mjkzz_reconnects(void) {
	ASSERT_TRUE(hw_disconnect(focuser, SHORT_TIMEOUT));
	ASSERT_TRUE(hw_connect(focuser, SHORT_TIMEOUT));
	ASSERT_EQ_INT(INDIGO_OK_STATE, hw_property_state(focuser, FOCUSER_POSITION_PROPERTY_NAME));
	ASSERT_NEAR(initial_position, position(), 0);
	ASSERT_TRUE(move_to(initial_position + round(travel / 3)));
	ASSERT_TRUE(move_to(initial_position));
}

static void mjkzz_reinitializes(void) {
	ASSERT_TRUE(hw_disconnect(focuser, SHORT_TIMEOUT));
	ASSERT_EQ_INT(INDIGO_OK, indigo_focuser_mjkzz(INDIGO_DRIVER_SHUTDOWN, NULL));
	ASSERT_EQ_INT(-1, hw_device_index(DEVICE_NAME));
	ASSERT_EQ_INT(INDIGO_OK, indigo_focuser_mjkzz(INDIGO_DRIVER_INIT, NULL));
	focuser = hw_wait_for_device(DEVICE_NAME, SHORT_TIMEOUT);
	ASSERT_TRUE(focuser >= 0);
	ASSERT_TRUE(select_port());
	ASSERT_TRUE(hw_connect(focuser, SHORT_TIMEOUT));
	ASSERT_NEAR(initial_position, position(), 0);
}

int main(int argc, char **argv) {
	if (argc < 2 || strcmp(argv[1], "--run")) {
		fprintf(stderr, "Physical MJKZZ test: run explicitly with --run (or make test-focuser-mjkzz-hw).\n");
		return 2;
	}
	setvbuf(stdout, NULL, _IONBF, 0);
	for (int i = 2; i < argc; i++) {
		if (!strcmp(argv[i], "--debug")) {
			indigo_set_log_level(INDIGO_LOG_DEBUG);
		}
	}
	if (!indigo_test_use_private_home()) {
		return 1;
	}
	serial_port = hw_port("MJKZZ_HW_PORT");
	const char *requested_travel = getenv("MJKZZ_HW_TRAVEL");
	if (requested_travel != NULL && atoi(requested_travel) > 0) {
		travel = atoi(requested_travel);
	}
	const indigo_test_case tests[] = {
		{ "mjkzz_reports_identity_and_capabilities", mjkzz_reports_identity_and_capabilities },
		{ "mjkzz_publishes_the_property_contract", mjkzz_publishes_the_property_contract },
		{ "mjkzz_moves_to_an_absolute_position", mjkzz_moves_to_an_absolute_position },
		{ "mjkzz_moves_relative_in_both_directions", mjkzz_moves_relative_in_both_directions },
		{ "mjkzz_rejects_an_overlapping_move", mjkzz_rejects_an_overlapping_move },
		{ "mjkzz_aborts_a_move", mjkzz_aborts_a_move },
		{ "mjkzz_accepts_an_abort_while_idle", mjkzz_accepts_an_abort_while_idle },
		{ "mjkzz_changes_the_speed", mjkzz_changes_the_speed },
		{ "mjkzz_survives_a_disconnect_during_a_move", mjkzz_survives_a_disconnect_during_a_move },
		{ "mjkzz_reconnects", mjkzz_reconnects },
		{ "mjkzz_reinitializes", mjkzz_reinitializes }
	};
	int result = 1;
	bool started = false, initialized = false;
	HW_CHECK(hw_start() == INDIGO_OK);
	started = true;
	HW_CHECK(hw_attach_client("MJKZZ hardware test") == INDIGO_OK);
	HW_CHECK(indigo_focuser_mjkzz(INDIGO_DRIVER_INIT, NULL) == INDIGO_OK);
	initialized = true;
	focuser = hw_wait_for_device(DEVICE_NAME, SHORT_TIMEOUT);
	HW_CHECK(focuser >= 0);
	HW_CHECK(select_port());
	HW_CHECK(hw_connect(focuser, SHORT_TIMEOUT));
	HW_CHECK(capture_initial_state());
	printf("Starting position %g, speed %g, travel %g steps\n", initial_position, initial_speed, travel);
	result = indigo_run_tests("MJKZZ hardware", tests, ARRAY_SIZE(tests));
cleanup:
	restore_initial_state();
	if (!hw_disconnect(focuser, MOVE_TIMEOUT)) {
		indigo_test_failures++;
	}
	if (initialized && indigo_focuser_mjkzz(INDIGO_DRIVER_SHUTDOWN, NULL) != INDIGO_OK) {
		indigo_test_failures++;
	}
	indigo_detach_client(&hw_client);
	if (started) {
		indigo_stop();
	}
	hw_release_properties();
	indigo_test_remove_private_home();
	return indigo_test_failures ? 1 : result;
}
