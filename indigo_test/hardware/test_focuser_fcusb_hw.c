// Copyright (c) 2026 INDIGO initiative
// All rights reserved.
//
// You may use this software under the terms of 'INDIGO Astronomy
// open-source license' (see LICENSE.md).
//
// THIS SOFTWARE IS PROVIDED BY THE AUTHORS 'AS IS' AND ANY EXPRESS
// OR IMPLIED WARRANTIES, INCLUDING, BUT NOT LIMITED TO, THE IMPLIED
// WARRANTIES OF MERCHANTABILITY AND FITNESS FOR A PARTICULAR PURPOSE
// ARE DISCLAIMED. IN NO EVENT SHALL THE AUTHOR BE LIABLE FOR ANY
// DIRECT, INDIRECT, INCIDENTAL, SPECIAL, EXEMPLARY, OR CONSEQUENTIAL
// DAMAGES (INCLUDING, BUT NOT LIMITED TO, PROCUREMENT OF SUBSTITUTE
// GOODS OR SERVICES; LOSS OF USE, DATA, OR PROFITS; OR BUSINESS
// INTERRUPTION) HOWEVER CAUSED AND ON ANY THEORY OF LIABILITY,
// WHETHER IN CONTRACT, STRICT LIABILITY, OR TORT (INCLUDING
// NEGLIGENCE OR OTHERWISE) ARISING IN ANY WAY OUT OF THE USE OF THIS
// SOFTWARE, EVEN IF ADVISED OF THE POSSIBILITY OF SUCH DAMAGE.

// Code is generated by AI

// Opt-in acceptance test for a physically connected Shoestring FCUSB focuser controller. It runs
// the focuser hardware acceptance checklist of DRIVER_TESTING_RULES.md against the real
// controller, as far as an open-loop DC controller can implement it: discovery through the libusb
// hot-plug enumeration, the published property contract, timed moves in both directions, the
// motor power and the PWM frequency, abort during a move and while idle, the persistence of the
// driver settings, a disconnect during a move, reconnect and driver INIT/SHUTDOWN.
//
// THE MOTOR PHYSICALLY RUNS. The controller has no encoder, so FOCUSER_STEPS is a run time in
// milliseconds and there is no position to return to. Every move this test makes is short and
// every scenario is followed by the opposite move of the same length, so a focuser wired to the
// controller ends up close to where it started. Nothing here can detect a mechanical end stop,
// so run it on a drawtube that is not close to one.
//
// Physical hot-plug is not part of this test; it is driven by the faked libusb boundary of
// indigo_test/integration/test_focuser_fcusb_sdk.c.

#include <indigo_drivers/focuser_fcusb/indigo_focuser_fcusb.h>
#include "hardware_test_common.h"

// One USB HID transaction plus the driver's own connection work.
#define SHORT_TIMEOUT 15.0
// The longest move a scenario waits for, plus the completion latency.
#define MOVE_TIMEOUT 20.0

// Driver-defined property names, declared in the generated source rather than in the header.
#define X_FOCUSER_FREQUENCY_PROPERTY_NAME "X_FOCUSER_FREQUENCY"
#define X_FOCUSER_FREQUENCY_1_ITEM_NAME "FREQUENCY_1"
#define X_FOCUSER_FREQUENCY_4_ITEM_NAME "FREQUENCY_4"
#define X_FOCUSER_FREQUENCY_16_ITEM_NAME "FREQUENCY_16"

// The run time of a single move, in milliseconds. Short enough to be harmless on a real drawtube,
// long enough to be told apart from the command latency.
#define MOVE_MILLISECONDS 300

static int focuser = -1;
static double initial_power = 0;

static bool move(const char *direction, double milliseconds, double *elapsed) {
	if (!hw_set_switch(focuser, FOCUSER_DIRECTION_PROPERTY_NAME, direction, INDIGO_OK_STATE, SHORT_TIMEOUT)) {
		return false;
	}
	unsigned before = hw_revision(focuser, FOCUSER_STEPS_PROPERTY_NAME);
	double started = indigo_monotonic_time();
	hw_request_number(focuser, FOCUSER_STEPS_PROPERTY_NAME, FOCUSER_STEPS_ITEM_NAME, milliseconds);
	if (!hw_wait_state(focuser, FOCUSER_STEPS_PROPERTY_NAME, before, INDIGO_OK_STATE, MOVE_TIMEOUT)) {
		return false;
	}
	if (elapsed != NULL) {
		*elapsed = (indigo_monotonic_time() - started) * 1000;
	}
	return true;
}

// A completed move leaves the item at zero, so the next request for the same run time is a
// genuine change and not a repeat of the value the property already holds.
static bool steps_are_cleared(void) {
	double value = -1;
	if (!hw_number_item(focuser, FOCUSER_STEPS_PROPERTY_NAME, FOCUSER_STEPS_ITEM_NAME, &value)) {
		return false;
	}
	if (value != 0) {
		fprintf(stderr, "    FOCUSER_STEPS.STEPS is %g after the move, expected 0\n", value);
		return false;
	}
	return true;
}

// Runs the motor back for as long as it was just run forward, so the scenario leaves the drawtube
// where it found it.
static bool move_back(const char *direction, double milliseconds) {
	return move(direction, milliseconds, NULL) && steps_are_cleared();
}

static void fcusb_reports_identity_and_capabilities(void) {
	char name[INDIGO_VALUE_SIZE] = "";
	ASSERT_TRUE((hw_device_interface(focuser) & INDIGO_INTERFACE_FOCUSER) != 0);
	// The controller has no identity of its own beyond the name libfcusb derives from the USB
	// descriptor, which the driver uses as the device name and publishes through INFO.
	printf("    device %s\n", hw_device_name(focuser));
	ASSERT_TRUE(strstr(hw_device_name(focuser), "FCUSB") != NULL);
	ASSERT_TRUE(hw_text_item(focuser, INFO_PROPERTY_NAME, INFO_DEVICE_NAME_ITEM_NAME, name, sizeof(name)));
	ASSERT_STREQ(hw_device_name(focuser), name);
	ASSERT_EQ_INT(1, hw_device_count());
}

static void fcusb_publishes_the_property_contract(void) {
	double power = -1, min = -1, max = -1;
	bool frequency = false;
	ASSERT_TRUE(hw_property_defined(focuser, FOCUSER_STEPS_PROPERTY_NAME));
	ASSERT_TRUE(hw_property_defined(focuser, FOCUSER_DIRECTION_PROPERTY_NAME));
	ASSERT_TRUE(hw_property_defined(focuser, FOCUSER_ABORT_MOTION_PROPERTY_NAME));
	ASSERT_TRUE(hw_property_defined(focuser, FOCUSER_SPEED_PROPERTY_NAME));
	ASSERT_TRUE(hw_property_defined(focuser, X_FOCUSER_FREQUENCY_PROPERTY_NAME));
	// The controller is open loop, so it has no position, no sync, no temperature and no backlash
	// compensation of its own, and it is not a serial device.
	ASSERT_TRUE(hw_property_hidden(focuser, FOCUSER_POSITION_PROPERTY_NAME));
	ASSERT_TRUE(hw_property_hidden(focuser, FOCUSER_ON_POSITION_SET_PROPERTY_NAME));
	ASSERT_TRUE(hw_property_hidden(focuser, FOCUSER_TEMPERATURE_PROPERTY_NAME));
	ASSERT_TRUE(hw_property_hidden(focuser, FOCUSER_BACKLASH_PROPERTY_NAME));
	ASSERT_TRUE(hw_property_hidden(focuser, DEVICE_PORT_PROPERTY_NAME));
	ASSERT_TRUE(hw_property_hidden(focuser, DEVICE_PORTS_PROPERTY_NAME));
	ASSERT_TRUE(hw_property_hidden(focuser, SIMULATION_PROPERTY_NAME));
	// The speed item drives the motor power instead of a step rate.
	ASSERT_TRUE(hw_number_item(focuser, FOCUSER_SPEED_PROPERTY_NAME, FOCUSER_SPEED_ITEM_NAME, &power));
	ASSERT_TRUE(hw_number_item_range(focuser, FOCUSER_SPEED_PROPERTY_NAME, FOCUSER_SPEED_ITEM_NAME, &min, &max));
	ASSERT_TRUE(max == 255);
	printf("    motor power %g of %g\n", power, max);
	ASSERT_TRUE(hw_switch_item(focuser, X_FOCUSER_FREQUENCY_PROPERTY_NAME, X_FOCUSER_FREQUENCY_1_ITEM_NAME, &frequency));
}

static void fcusb_moves_in_both_directions(void) {
	double elapsed = 0;
	hw_forget_states();
	ASSERT_TRUE(move(FOCUSER_DIRECTION_MOVE_INWARD_ITEM_NAME, MOVE_MILLISECONDS, &elapsed));
	printf("    inward move of %d ms completed in %.1f ms\n", MOVE_MILLISECONDS, elapsed);
	// The move is advertised BUSY for its whole run time and completed OK when the motor stops.
	ASSERT_TRUE((hw_states_seen(focuser, FOCUSER_STEPS_PROPERTY_NAME) & (1u << INDIGO_BUSY_STATE)) != 0);
	ASSERT_TRUE(elapsed > MOVE_MILLISECONDS - 50 && elapsed < MOVE_MILLISECONDS + 1500);
	ASSERT_TRUE(steps_are_cleared());
	ASSERT_TRUE(move(FOCUSER_DIRECTION_MOVE_OUTWARD_ITEM_NAME, MOVE_MILLISECONDS, &elapsed));
	printf("    outward move of %d ms completed in %.1f ms\n", MOVE_MILLISECONDS, elapsed);
	ASSERT_TRUE(elapsed > MOVE_MILLISECONDS - 50 && elapsed < MOVE_MILLISECONDS + 1500);
	ASSERT_TRUE(steps_are_cleared());
}

static void fcusb_aborts_a_move(void) {
	bool aborting = true;
	unsigned before = hw_revision(focuser, FOCUSER_STEPS_PROPERTY_NAME);
	ASSERT_TRUE(hw_set_switch(focuser, FOCUSER_DIRECTION_PROPERTY_NAME, FOCUSER_DIRECTION_MOVE_INWARD_ITEM_NAME, INDIGO_OK_STATE, SHORT_TIMEOUT));
	hw_request_number(focuser, FOCUSER_STEPS_PROPERTY_NAME, FOCUSER_STEPS_ITEM_NAME, 10000);
	ASSERT_TRUE(hw_wait_settled(focuser, FOCUSER_STEPS_PROPERTY_NAME, INDIGO_BUSY_STATE, SHORT_TIMEOUT));
	indigo_usleep(300000);
	double started = indigo_monotonic_time();
	ASSERT_TRUE(hw_set_switch(focuser, FOCUSER_ABORT_MOTION_PROPERTY_NAME, FOCUSER_ABORT_MOTION_ITEM_NAME, INDIGO_OK_STATE, SHORT_TIMEOUT));
	// The abort stops the motor at once and reports the move as failed, not as completed.
	ASSERT_TRUE(hw_wait_state(focuser, FOCUSER_STEPS_PROPERTY_NAME, before, INDIGO_ALERT_STATE, SHORT_TIMEOUT));
	printf("    abort answered in %.1f ms\n", (indigo_monotonic_time() - started) * 1000);
	ASSERT_TRUE(hw_switch_item(focuser, FOCUSER_ABORT_MOTION_PROPERTY_NAME, FOCUSER_ABORT_MOTION_ITEM_NAME, &aborting));
	ASSERT_TRUE(!aborting);
	// An abort with no move running is accepted as well, and a fresh move still works.
	ASSERT_TRUE(hw_set_switch(focuser, FOCUSER_ABORT_MOTION_PROPERTY_NAME, FOCUSER_ABORT_MOTION_ITEM_NAME, INDIGO_OK_STATE, SHORT_TIMEOUT));
	// About 300 ms of the aborted inward move actually ran, so the drawtube goes back that far.
	ASSERT_TRUE(move_back(FOCUSER_DIRECTION_MOVE_OUTWARD_ITEM_NAME, MOVE_MILLISECONDS));
}

static void fcusb_changes_the_motor_power(void) {
	double power = -1;
	// Half power is still enough to turn a focuser motor, and the controller takes the value with
	// the next move command rather than on its own.
	ASSERT_TRUE(hw_set_number(focuser, FOCUSER_SPEED_PROPERTY_NAME, FOCUSER_SPEED_ITEM_NAME, 128, INDIGO_OK_STATE, SHORT_TIMEOUT));
	ASSERT_TRUE(hw_number_item(focuser, FOCUSER_SPEED_PROPERTY_NAME, FOCUSER_SPEED_ITEM_NAME, &power));
	ASSERT_TRUE(power == 128);
	ASSERT_TRUE(move(FOCUSER_DIRECTION_MOVE_INWARD_ITEM_NAME, MOVE_MILLISECONDS, NULL));
	ASSERT_TRUE(move_back(FOCUSER_DIRECTION_MOVE_OUTWARD_ITEM_NAME, MOVE_MILLISECONDS));
	ASSERT_TRUE(hw_set_number(focuser, FOCUSER_SPEED_PROPERTY_NAME, FOCUSER_SPEED_ITEM_NAME, initial_power, INDIGO_OK_STATE, SHORT_TIMEOUT));
	ASSERT_TRUE(hw_number_item(focuser, FOCUSER_SPEED_PROPERTY_NAME, FOCUSER_SPEED_ITEM_NAME, &power));
	ASSERT_TRUE(power == initial_power);
}

static void fcusb_changes_the_pwm_frequency(void) {
	static const char *items[] = { X_FOCUSER_FREQUENCY_4_ITEM_NAME, X_FOCUSER_FREQUENCY_16_ITEM_NAME, X_FOCUSER_FREQUENCY_1_ITEM_NAME };
	for (unsigned i = 0; i < ARRAY_SIZE(items); i++) {
		bool selected = false;
		ASSERT_TRUE(hw_set_switch(focuser, X_FOCUSER_FREQUENCY_PROPERTY_NAME, items[i], INDIGO_OK_STATE, SHORT_TIMEOUT));
		ASSERT_TRUE(hw_switch_item(focuser, X_FOCUSER_FREQUENCY_PROPERTY_NAME, items[i], &selected));
		ASSERT_TRUE(selected);
		// The frequency reaches the controller with the next move, so each setting gets one.
		ASSERT_TRUE(move(FOCUSER_DIRECTION_MOVE_INWARD_ITEM_NAME, MOVE_MILLISECONDS, NULL));
		ASSERT_TRUE(move_back(FOCUSER_DIRECTION_MOVE_OUTWARD_ITEM_NAME, MOVE_MILLISECONDS));
	}
}

static void fcusb_restores_the_setting_after_a_reconnect(void) {
	bool selected = false;
	// X_FOCUSER_FREQUENCY is persistent, so the value a client saves has to come back with the
	// device. The session runs against a private HOME, so this writes no configuration of the
	// user's own.
	ASSERT_TRUE(hw_set_switch(focuser, X_FOCUSER_FREQUENCY_PROPERTY_NAME, X_FOCUSER_FREQUENCY_4_ITEM_NAME, INDIGO_OK_STATE, SHORT_TIMEOUT));
	ASSERT_TRUE(hw_save_configuration(focuser, SHORT_TIMEOUT));
	ASSERT_TRUE(hw_disconnect(focuser, SHORT_TIMEOUT));
	ASSERT_TRUE(hw_connect(focuser, SHORT_TIMEOUT));
	ASSERT_TRUE(hw_switch_item(focuser, X_FOCUSER_FREQUENCY_PROPERTY_NAME, X_FOCUSER_FREQUENCY_4_ITEM_NAME, &selected));
	ASSERT_TRUE(selected);
	ASSERT_TRUE(hw_set_switch(focuser, X_FOCUSER_FREQUENCY_PROPERTY_NAME, X_FOCUSER_FREQUENCY_1_ITEM_NAME, INDIGO_OK_STATE, SHORT_TIMEOUT));
	ASSERT_TRUE(hw_save_configuration(focuser, SHORT_TIMEOUT));
	ASSERT_TRUE(hw_disconnect(focuser, SHORT_TIMEOUT));
	ASSERT_TRUE(hw_connect(focuser, SHORT_TIMEOUT));
	ASSERT_TRUE(hw_switch_item(focuser, X_FOCUSER_FREQUENCY_PROPERTY_NAME, X_FOCUSER_FREQUENCY_1_ITEM_NAME, &selected));
	ASSERT_TRUE(selected);
}

static void fcusb_survives_a_disconnect_during_a_move(void) {
	ASSERT_TRUE(hw_set_switch(focuser, FOCUSER_DIRECTION_PROPERTY_NAME, FOCUSER_DIRECTION_MOVE_INWARD_ITEM_NAME, INDIGO_OK_STATE, SHORT_TIMEOUT));
	hw_request_number(focuser, FOCUSER_STEPS_PROPERTY_NAME, FOCUSER_STEPS_ITEM_NAME, 10000);
	ASSERT_TRUE(hw_wait_settled(focuser, FOCUSER_STEPS_PROPERTY_NAME, INDIGO_BUSY_STATE, SHORT_TIMEOUT));
	indigo_usleep(300000);
	// Closing the controller stops the motor, so the disconnect must not wait for the move and
	// must not leave the motor running.
	ASSERT_TRUE(hw_disconnect(focuser, SHORT_TIMEOUT));
	ASSERT_TRUE(hw_connect(focuser, SHORT_TIMEOUT));
	ASSERT_TRUE(hw_property_state(focuser, FOCUSER_STEPS_PROPERTY_NAME) != INDIGO_BUSY_STATE);
	ASSERT_TRUE(move_back(FOCUSER_DIRECTION_MOVE_OUTWARD_ITEM_NAME, MOVE_MILLISECONDS));
}

static void fcusb_reconnects(void) {
	ASSERT_TRUE(hw_disconnect(focuser, SHORT_TIMEOUT));
	// Disconnecting an already disconnected device is tolerated: the request is a no-op the driver
	// answers without an ALERT, so there is no new revision to wait for.
	hw_request_switch(focuser, CONNECTION_PROPERTY_NAME, CONNECTION_DISCONNECTED_ITEM_NAME, true);
	indigo_usleep(500000);
	ASSERT_EQ_INT(INDIGO_OK_STATE, hw_property_state(focuser, CONNECTION_PROPERTY_NAME));
	ASSERT_TRUE(!hw_connected(focuser));
	ASSERT_TRUE(hw_connect(focuser, SHORT_TIMEOUT));
	ASSERT_TRUE((hw_device_interface(focuser) & INDIGO_INTERFACE_FOCUSER) != 0);
	ASSERT_TRUE(move(FOCUSER_DIRECTION_MOVE_INWARD_ITEM_NAME, MOVE_MILLISECONDS, NULL));
	ASSERT_TRUE(move_back(FOCUSER_DIRECTION_MOVE_OUTWARD_ITEM_NAME, MOVE_MILLISECONDS));
}

static void fcusb_reinitializes(void) {
	ASSERT_TRUE(hw_connect(focuser, SHORT_TIMEOUT));
	// A driver with a connected device must refuse to shut down instead of pulling the controller
	// out from under its client.
	ASSERT_EQ_INT(INDIGO_BUSY, indigo_focuser_fcusb(INDIGO_DRIVER_SHUTDOWN, NULL));
	ASSERT_TRUE(hw_disconnect(focuser, SHORT_TIMEOUT));
	ASSERT_EQ_INT(INDIGO_OK, indigo_focuser_fcusb(INDIGO_DRIVER_SHUTDOWN, NULL));
	ASSERT_EQ_INT(INDIGO_OK, indigo_focuser_fcusb(INDIGO_DRIVER_INIT, NULL));
	focuser = hw_wait_for_device(NULL, SHORT_TIMEOUT);
	ASSERT_TRUE(focuser >= 0);
	ASSERT_TRUE(hw_connect(focuser, SHORT_TIMEOUT));
	ASSERT_TRUE(move(FOCUSER_DIRECTION_MOVE_INWARD_ITEM_NAME, MOVE_MILLISECONDS, NULL));
	ASSERT_TRUE(move_back(FOCUSER_DIRECTION_MOVE_OUTWARD_ITEM_NAME, MOVE_MILLISECONDS));
}

int main(int argc, char **argv) {
	if (argc < 2 || strcmp(argv[1], "--run")) {
		fprintf(stderr, "Physical Shoestring FCUSB test: run explicitly with --run (or make test-focuser-fcusb-hw).\n");
		return 2;
	}
	setvbuf(stdout, NULL, _IONBF, 0);
	for (int i = 2; i < argc; i++) {
		if (!strcmp(argv[i], "--debug")) {
			indigo_set_log_level(INDIGO_LOG_DEBUG);
		}
	}
	// X_FOCUSER_FREQUENCY is persistent and one scenario saves it, so the session keeps its
	// configuration out of the user's own folder.
	if (!indigo_test_use_private_home()) {
		return 1;
	}
	const indigo_test_case tests[] = {
		{ "fcusb_reports_identity_and_capabilities", fcusb_reports_identity_and_capabilities },
		{ "fcusb_publishes_the_property_contract", fcusb_publishes_the_property_contract },
		{ "fcusb_moves_in_both_directions", fcusb_moves_in_both_directions },
		{ "fcusb_aborts_a_move", fcusb_aborts_a_move },
		{ "fcusb_changes_the_motor_power", fcusb_changes_the_motor_power },
		{ "fcusb_changes_the_pwm_frequency", fcusb_changes_the_pwm_frequency },
		{ "fcusb_restores_the_setting_after_a_reconnect", fcusb_restores_the_setting_after_a_reconnect },
		{ "fcusb_survives_a_disconnect_during_a_move", fcusb_survives_a_disconnect_during_a_move },
		{ "fcusb_reconnects", fcusb_reconnects },
		{ "fcusb_reinitializes", fcusb_reinitializes }
	};
	int result = 1;
	bool started = false, initialized = false;
	HW_CHECK(indigo_start() == INDIGO_OK);
	started = true;
	HW_CHECK(hw_attach_client("Shoestring FCUSB hardware test") == INDIGO_OK);
	HW_CHECK(indigo_focuser_fcusb(INDIGO_DRIVER_INIT, NULL) == INDIGO_OK);
	initialized = true;
	focuser = hw_wait_for_device(NULL, SHORT_TIMEOUT);
	HW_CHECK(focuser >= 0);
	printf("Found %s\n", hw_device_name(focuser));
	HW_CHECK(hw_connect(focuser, SHORT_TIMEOUT));
	// The power the controller came up with is restored by the scenario that changes it.
	HW_CHECK(hw_number_item(focuser, FOCUSER_SPEED_PROPERTY_NAME, FOCUSER_SPEED_ITEM_NAME, &initial_power));
	result = indigo_run_tests("Shoestring FCUSB hardware", tests, ARRAY_SIZE(tests));
cleanup:
	if (!hw_disconnect(focuser, SHORT_TIMEOUT)) {
		indigo_test_failures++;
	}
	if (initialized && indigo_focuser_fcusb(INDIGO_DRIVER_SHUTDOWN, NULL) != INDIGO_OK) {
		indigo_test_failures++;
	}
	indigo_detach_client(&hw_client);
	if (started) {
		indigo_stop();
	}
	hw_release_properties();
	indigo_test_remove_private_home();
	return indigo_test_failures ? 1 : result;
}
