// Copyright (c) 2026 INDIGO initiative
// All rights reserved.
//
// You may use this software under the terms of 'INDIGO Astronomy
// open-source license' (see LICENSE.md).
//
// THIS SOFTWARE IS PROVIDED BY THE AUTHORS 'AS IS' AND ANY EXPRESS
// OR IMPLIED WARRANTIES, INCLUDING, BUT NOT LIMITED TO, THE IMPLIED
// WARRANTIES OF MERCHANTABILITY AND FITNESS FOR A PARTICULAR PURPOSE
// ARE DISCLAIMED. IN NO EVENT SHALL THE AUTHOR BE LIABLE FOR ANY
// DIRECT, INDIRECT, INCIDENTAL, SPECIAL, EXEMPLARY, OR CONSEQUENTIAL
// DAMAGES (INCLUDING, BUT NOT LIMITED TO, PROCUREMENT OF SUBSTITUTE
// GOODS OR SERVICES; LOSS OF USE, DATA, OR PROFITS; OR BUSINESS
// INTERRUPTION) HOWEVER CAUSED AND ON ANY THEORY OF LIABILITY,
// WHETHER IN CONTRACT, STRICT LIABILITY, OR TORT (INCLUDING
// NEGLIGENCE OR OTHERWISE) ARISING IN ANY WAY OUT OF THE USE OF THIS
// SOFTWARE, EVEN IF ADVISED OF THE POSSIBILITY OF SUCH DAMAGE.

// Code is generated by AI

// Opt-in acceptance test for a physically connected Shoestring GPUSB autoguide adapter. It runs
// the guider hardware acceptance checklist of DRIVER_TESTING_RULES.md against the real adapter:
// discovery through the libusb hot-plug enumeration, the published property contract, pulses in
// all four directions, both axes at once, same axis replacement, the zero request, a pulse
// interrupted by a disconnect, reconnect and driver INIT/SHUTDOWN.
//
// The adapter only closes opto-isolated ST4 relays, so nothing moves unless a mount is wired to
// it. Every scenario leaves both axes released.
//
// gpusb_measures_guide_pulse_duration is the guiding-pulse measurement required by
// indigo_drivers/AGENTS.override.md. The relay edges are written inside the driver, so the only
// endpoints a client can observe are the request and the completion of the public property: this
// is software completion timing of the real USB command path, not an electrical measurement of
// the relay output. See indigo_drivers/guider_gpusb/REFACTOR.md.
//
// Physical hot-plug is not part of this test; it is driven by the faked libusb boundary of
// indigo_test/integration/test_guider_gpusb_sdk.c.

#include <math.h>
#include <indigo_drivers/guider_gpusb/indigo_guider_gpusb.h>
#include "hardware_test_common.h"

// One USB HID transaction plus the driver's own connection work.
#define SHORT_TIMEOUT 15.0
// The longest pulse a scenario starts, plus the completion latency.
#define PULSE_TIMEOUT 10.0

#define SAMPLES 4
#define WARMUP 1

static int guider = -1;
static const char *directions[] = { GUIDER_GUIDE_NORTH_ITEM_NAME, GUIDER_GUIDE_SOUTH_ITEM_NAME, GUIDER_GUIDE_EAST_ITEM_NAME, GUIDER_GUIDE_WEST_ITEM_NAME };

static const char *axis_of(int direction) {
	return direction < 2 ? GUIDER_GUIDE_DEC_PROPERTY_NAME : GUIDER_GUIDE_RA_PROPERTY_NAME;
}

// One pulse, with the elapsed time from the request to the completion the client sees.
static bool pulse(int direction, double milliseconds, double *elapsed) {
	const char *property = axis_of(direction);
	unsigned before = hw_revision(guider, property);
	double started = indigo_monotonic_time();
	hw_request_number(guider, property, directions[direction], milliseconds);
	if (!hw_wait_state(guider, property, before, INDIGO_OK_STATE, PULSE_TIMEOUT)) {
		return false;
	}
	if (elapsed != NULL) {
		*elapsed = (indigo_monotonic_time() - started) * 1000;
	}
	return true;
}

// A completed pulse leaves its item at zero, so the next request for the same item is a genuine
// change and not a repeat of the value the property already holds.
static bool item_cleared(int direction) {
	double value = -1;
	if (!hw_number_item(guider, axis_of(direction), directions[direction], &value)) {
		return false;
	}
	if (value != 0) {
		fprintf(stderr, "    %s.%s is %g after the pulse, expected 0\n", axis_of(direction), directions[direction], value);
		return false;
	}
	return true;
}

static int compare_double(const void *a, const void *b) {
	double left = *(const double *)a, right = *(const double *)b;
	return left < right ? -1 : (left > right ? 1 : 0);
}

static double percentile(double *sorted, int count, double fraction) {
	int index = (int)(fraction * (count - 1) + 0.5);
	return sorted[index < 0 ? 0 : (index >= count ? count - 1 : index)];
}

static void report_statistics(const char *label, double requested, double *samples, int count) {
	double sorted[64], sum = 0, sum_squares = 0, max_absolute = 0;
	for (int i = 0; i < count; i++) {
		sorted[i] = samples[i];
		sum += samples[i];
		if (fabs(samples[i] - requested) > max_absolute) {
			max_absolute = fabs(samples[i] - requested);
		}
	}
	double mean = sum / count;
	for (int i = 0; i < count; i++) {
		sum_squares += (samples[i] - mean) * (samples[i] - mean);
	}
	qsort(sorted, count, sizeof(double), compare_double);
	double deviation = count > 1 ? sqrt(sum_squares / (count - 1)) : 0;
	printf("    %-6s requested %6.1f ms  n=%d  min %7.2f  mean %7.2f  median %7.2f  p95 %7.2f  p99 %7.2f  max %7.2f  sd %6.2f  error %+6.2f ms (%+5.2f %%)  max |error| %6.2f ms\n", label, requested, count, sorted[0], mean, percentile(sorted, count, 0.5), percentile(sorted, count, 0.95), percentile(sorted, count, 0.99), sorted[count - 1], deviation, mean - requested, 100 * (mean - requested) / requested, max_absolute);
}

static void gpusb_reports_identity_and_capabilities(void) {
	char name[INDIGO_VALUE_SIZE] = "";
	ASSERT_TRUE((hw_device_interface(guider) & INDIGO_INTERFACE_GUIDER) != 0);
	// The adapter has no identity of its own beyond the name libgpusb derives from the USB
	// descriptor, which the driver uses as the device name and publishes through INFO.
	printf("    device %s\n", hw_device_name(guider));
	ASSERT_TRUE(strstr(hw_device_name(guider), "GPUSB") != NULL);
	ASSERT_TRUE(hw_text_item(guider, INFO_PROPERTY_NAME, INFO_DEVICE_NAME_ITEM_NAME, name, sizeof(name)));
	ASSERT_STREQ(hw_device_name(guider), name);
	ASSERT_EQ_INT(1, hw_device_count());
}

static void gpusb_publishes_the_property_contract(void) {
	for (int i = 0; i < 4; i++) {
		double value = -1, min = -1, max = -1;
		ASSERT_TRUE(hw_number_item(guider, axis_of(i), directions[i], &value));
		ASSERT_TRUE(value == 0);
		ASSERT_TRUE(hw_number_item_range(guider, axis_of(i), directions[i], &min, &max));
		ASSERT_TRUE(min == 0 && max > 0);
	}
	// The relays have no rate of their own and the adapter is not a serial device, so neither
	// GUIDER_RATE nor the port properties may be published.
	ASSERT_TRUE(hw_property_hidden(guider, GUIDER_RATE_PROPERTY_NAME));
	ASSERT_TRUE(hw_property_hidden(guider, DEVICE_PORT_PROPERTY_NAME));
	ASSERT_TRUE(hw_property_hidden(guider, DEVICE_PORTS_PROPERTY_NAME));
	ASSERT_TRUE(hw_property_hidden(guider, SIMULATION_PROPERTY_NAME));
	ASSERT_TRUE(hw_property_hidden(guider, AUTHENTICATION_PROPERTY_NAME));
	ASSERT_TRUE(hw_property_defined(guider, CONFIG_PROPERTY_NAME));
	ASSERT_TRUE(hw_property_defined(guider, PROFILE_PROPERTY_NAME));
}

static void gpusb_pulses_in_all_four_directions(void) {
	for (int i = 0; i < 4; i++) {
		double elapsed = 0;
		hw_forget_states();
		ASSERT_TRUE(pulse(i, 300, &elapsed));
		// The pulse is advertised BUSY and completed OK; both transitions have to be published.
		ASSERT_TRUE((hw_states_seen(guider, axis_of(i)) & (1u << INDIGO_BUSY_STATE)) != 0);
		ASSERT_TRUE(item_cleared(i));
		printf("    %s %s completed in %.1f ms\n", axis_of(i), directions[i], elapsed);
		ASSERT_TRUE(elapsed > 250 && elapsed < 1500);
	}
}

static void gpusb_pulses_both_axes_at_once(void) {
	unsigned ra_before = hw_revision(guider, GUIDER_GUIDE_RA_PROPERTY_NAME), dec_before = hw_revision(guider, GUIDER_GUIDE_DEC_PROPERTY_NAME);
	hw_forget_states();
	double started = indigo_monotonic_time();
	hw_request_number(guider, GUIDER_GUIDE_RA_PROPERTY_NAME, GUIDER_GUIDE_EAST_ITEM_NAME, 600);
	hw_request_number(guider, GUIDER_GUIDE_DEC_PROPERTY_NAME, GUIDER_GUIDE_NORTH_ITEM_NAME, 600);
	// Each axis keeps its own relay bit, so completing one must not release the other early nor
	// leave it running.
	ASSERT_TRUE(hw_wait_state(guider, GUIDER_GUIDE_RA_PROPERTY_NAME, ra_before, INDIGO_OK_STATE, PULSE_TIMEOUT));
	ASSERT_TRUE(hw_wait_state(guider, GUIDER_GUIDE_DEC_PROPERTY_NAME, dec_before, INDIGO_OK_STATE, PULSE_TIMEOUT));
	double elapsed = (indigo_monotonic_time() - started) * 1000;
	printf("    both axes completed in %.1f ms\n", elapsed);
	ASSERT_TRUE(elapsed > 550 && elapsed < 2000);
	ASSERT_TRUE((hw_states_seen(guider, GUIDER_GUIDE_RA_PROPERTY_NAME) & (1u << INDIGO_BUSY_STATE)) != 0);
	ASSERT_TRUE((hw_states_seen(guider, GUIDER_GUIDE_DEC_PROPERTY_NAME) & (1u << INDIGO_BUSY_STATE)) != 0);
	for (int i = 0; i < 4; i++) {
		ASSERT_TRUE(item_cleared(i));
	}
}

static void gpusb_replaces_a_pulse_on_the_same_axis(void) {
	hw_forget_states();
	hw_request_number(guider, GUIDER_GUIDE_RA_PROPERTY_NAME, GUIDER_GUIDE_EAST_ITEM_NAME, 3000);
	ASSERT_TRUE(hw_wait_settled(guider, GUIDER_GUIDE_RA_PROPERTY_NAME, INDIGO_BUSY_STATE, SHORT_TIMEOUT));
	indigo_usleep(200000);
	// The second request replaces the first one, so the axis completes on the new duration and
	// the finalizer of the replaced pulse must not clear it earlier or later.
	unsigned before = hw_revision(guider, GUIDER_GUIDE_RA_PROPERTY_NAME);
	double started = indigo_monotonic_time();
	hw_request_number(guider, GUIDER_GUIDE_RA_PROPERTY_NAME, GUIDER_GUIDE_WEST_ITEM_NAME, 400);
	ASSERT_TRUE(hw_wait_state(guider, GUIDER_GUIDE_RA_PROPERTY_NAME, before, INDIGO_OK_STATE, PULSE_TIMEOUT));
	double elapsed = (indigo_monotonic_time() - started) * 1000;
	printf("    replacement completed %.1f ms after the second request\n", elapsed);
	ASSERT_TRUE(elapsed > 350 && elapsed < 1500);
	ASSERT_TRUE(item_cleared(2));
	ASSERT_TRUE(item_cleared(3));
}

static void gpusb_stops_on_a_zero_request(void) {
	hw_forget_states();
	hw_request_number(guider, GUIDER_GUIDE_DEC_PROPERTY_NAME, GUIDER_GUIDE_SOUTH_ITEM_NAME, 3000);
	ASSERT_TRUE(hw_wait_settled(guider, GUIDER_GUIDE_DEC_PROPERTY_NAME, INDIGO_BUSY_STATE, SHORT_TIMEOUT));
	unsigned before = hw_revision(guider, GUIDER_GUIDE_DEC_PROPERTY_NAME);
	double started = indigo_monotonic_time();
	hw_request_number(guider, GUIDER_GUIDE_DEC_PROPERTY_NAME, GUIDER_GUIDE_SOUTH_ITEM_NAME, 0);
	ASSERT_TRUE(hw_wait_state(guider, GUIDER_GUIDE_DEC_PROPERTY_NAME, before, INDIGO_OK_STATE, SHORT_TIMEOUT));
	double elapsed = (indigo_monotonic_time() - started) * 1000;
	printf("    zero request released the relay in %.1f ms\n", elapsed);
	// The relay is released immediately, not when the replaced pulse would have ended.
	ASSERT_TRUE(elapsed < 1000);
	ASSERT_TRUE(item_cleared(0));
	ASSERT_TRUE(item_cleared(1));
	// A fresh pulse after the stop still works.
	ASSERT_TRUE(pulse(1, 200, NULL));
}

static void gpusb_measures_guide_pulse_duration(void) {
	static const double requested[] = { 20, 50, 100, 200, 500 };
	double all[ARRAY_SIZE(requested) * 4 * (SAMPLES - WARMUP)];
	int all_count = 0;
	printf("    endpoint: public property request to OK completion, idle adapter, no other workload\n");
	for (unsigned r = 0; r < ARRAY_SIZE(requested); r++) {
		for (int direction = 0; direction < 4; direction++) {
			double samples[SAMPLES];
			int count = 0;
			for (int i = 0; i < SAMPLES; i++) {
				double elapsed = 0;
				ASSERT_TRUE(pulse(direction, requested[r], &elapsed));
				if (i >= WARMUP) {
					samples[count++] = elapsed;
					all[all_count++] = elapsed - requested[r];
				}
			}
			report_statistics(directions[direction], requested[r], samples, count);
		}
	}
	double worst = 0;
	for (int i = 0; i < all_count; i++) {
		if (fabs(all[i]) > worst) {
			worst = fabs(all[i]);
		}
	}
	printf("    %d samples, worst signed error %.2f ms\n", all_count, worst);
	// A liveness bound, not a precision requirement: the completion is scheduled by the host, so
	// the statistics above are the result and this only catches a pulse that never ended.
	ASSERT_TRUE(worst < 500);
}

static void gpusb_survives_a_disconnect_during_a_pulse(void) {
	hw_forget_states();
	hw_request_number(guider, GUIDER_GUIDE_RA_PROPERTY_NAME, GUIDER_GUIDE_WEST_ITEM_NAME, 3000);
	ASSERT_TRUE(hw_wait_settled(guider, GUIDER_GUIDE_RA_PROPERTY_NAME, INDIGO_BUSY_STATE, SHORT_TIMEOUT));
	indigo_usleep(200000);
	// Closing the adapter releases every relay, so the disconnect must not wait for the pulse and
	// must not leave the driver holding a closed relay.
	ASSERT_TRUE(hw_disconnect(guider, SHORT_TIMEOUT));
	ASSERT_TRUE(hw_connect(guider, SHORT_TIMEOUT));
	ASSERT_TRUE(hw_property_state(guider, GUIDER_GUIDE_RA_PROPERTY_NAME) != INDIGO_BUSY_STATE);
	ASSERT_TRUE(pulse(2, 200, NULL));
	ASSERT_TRUE(item_cleared(2));
}

static void gpusb_reconnects(void) {
	ASSERT_TRUE(hw_disconnect(guider, SHORT_TIMEOUT));
	// Disconnecting an already disconnected device is tolerated: the request is a no-op the driver
	// answers without an ALERT, so there is no new revision to wait for.
	hw_request_switch(guider, CONNECTION_PROPERTY_NAME, CONNECTION_DISCONNECTED_ITEM_NAME, true);
	indigo_usleep(500000);
	ASSERT_EQ_INT(INDIGO_OK_STATE, hw_property_state(guider, CONNECTION_PROPERTY_NAME));
	ASSERT_TRUE(!hw_connected(guider));
	ASSERT_TRUE(hw_connect(guider, SHORT_TIMEOUT));
	ASSERT_TRUE((hw_device_interface(guider) & INDIGO_INTERFACE_GUIDER) != 0);
	ASSERT_TRUE(pulse(0, 200, NULL));
}

static void gpusb_reinitializes(void) {
	ASSERT_TRUE(hw_connect(guider, SHORT_TIMEOUT));
	// A driver with a connected device must refuse to shut down instead of pulling the adapter out
	// from under its client.
	ASSERT_EQ_INT(INDIGO_BUSY, indigo_guider_gpusb(INDIGO_DRIVER_SHUTDOWN, NULL));
	ASSERT_TRUE(hw_disconnect(guider, SHORT_TIMEOUT));
	ASSERT_EQ_INT(INDIGO_OK, indigo_guider_gpusb(INDIGO_DRIVER_SHUTDOWN, NULL));
	ASSERT_EQ_INT(INDIGO_OK, indigo_guider_gpusb(INDIGO_DRIVER_INIT, NULL));
	guider = hw_wait_for_device(NULL, SHORT_TIMEOUT);
	ASSERT_TRUE(guider >= 0);
	ASSERT_TRUE(hw_connect(guider, SHORT_TIMEOUT));
	ASSERT_TRUE(pulse(3, 200, NULL));
}

int main(int argc, char **argv) {
	if (argc < 2 || strcmp(argv[1], "--run")) {
		fprintf(stderr, "Physical Shoestring GPUSB test: run explicitly with --run (or make test-guider-gpusb-hw).\n");
		return 2;
	}
	setvbuf(stdout, NULL, _IONBF, 0);
	for (int i = 2; i < argc; i++) {
		if (!strcmp(argv[i], "--debug")) {
			indigo_set_log_level(INDIGO_LOG_DEBUG);
		}
	}
	// X_CONFIG has no counterpart here, but the guider properties are still saved by a CONFIG
	// request, so the session keeps its configuration out of the user's own folder.
	if (!indigo_test_use_private_home()) {
		return 1;
	}
	const indigo_test_case tests[] = {
		{ "gpusb_reports_identity_and_capabilities", gpusb_reports_identity_and_capabilities },
		{ "gpusb_publishes_the_property_contract", gpusb_publishes_the_property_contract },
		{ "gpusb_pulses_in_all_four_directions", gpusb_pulses_in_all_four_directions },
		{ "gpusb_pulses_both_axes_at_once", gpusb_pulses_both_axes_at_once },
		{ "gpusb_replaces_a_pulse_on_the_same_axis", gpusb_replaces_a_pulse_on_the_same_axis },
		{ "gpusb_stops_on_a_zero_request", gpusb_stops_on_a_zero_request },
		{ "gpusb_measures_guide_pulse_duration", gpusb_measures_guide_pulse_duration },
		{ "gpusb_survives_a_disconnect_during_a_pulse", gpusb_survives_a_disconnect_during_a_pulse },
		{ "gpusb_reconnects", gpusb_reconnects },
		{ "gpusb_reinitializes", gpusb_reinitializes }
	};
	int result = 1;
	bool started = false, initialized = false;
	HW_CHECK(indigo_start() == INDIGO_OK);
	started = true;
	HW_CHECK(hw_attach_client("Shoestring GPUSB hardware test") == INDIGO_OK);
	HW_CHECK(indigo_guider_gpusb(INDIGO_DRIVER_INIT, NULL) == INDIGO_OK);
	initialized = true;
	guider = hw_wait_for_device(NULL, SHORT_TIMEOUT);
	HW_CHECK(guider >= 0);
	printf("Found %s\n", hw_device_name(guider));
	HW_CHECK(hw_connect(guider, SHORT_TIMEOUT));
	result = indigo_run_tests("Shoestring GPUSB hardware", tests, ARRAY_SIZE(tests));
cleanup:
	if (!hw_disconnect(guider, SHORT_TIMEOUT)) {
		indigo_test_failures++;
	}
	if (initialized && indigo_guider_gpusb(INDIGO_DRIVER_SHUTDOWN, NULL) != INDIGO_OK) {
		indigo_test_failures++;
	}
	indigo_detach_client(&hw_client);
	if (started) {
		indigo_stop();
	}
	hw_release_properties();
	indigo_test_remove_private_home();
	return indigo_test_failures ? 1 : result;
}
