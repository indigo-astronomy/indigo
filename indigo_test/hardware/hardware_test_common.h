// Copyright (c) 2026 INDIGO initiative
// All rights reserved.
//
// You may use this software under the terms of 'INDIGO Astronomy
// open-source license' (see LICENSE.md).
//
// THIS SOFTWARE IS PROVIDED BY THE AUTHORS 'AS IS' AND ANY EXPRESS
// OR IMPLIED WARRANTIES, INCLUDING, BUT NOT LIMITED TO, THE IMPLIED
// WARRANTIES OF MERCHANTABILITY AND FITNESS FOR A PARTICULAR PURPOSE
// ARE DISCLAIMED. IN NO EVENT SHALL THE AUTHOR BE LIABLE FOR ANY
// DIRECT, INDIRECT, INCIDENTAL, SPECIAL, EXEMPLARY, OR CONSEQUENTIAL
// DAMAGES (INCLUDING, BUT NOT LIMITED TO, PROCUREMENT OF SUBSTITUTE
// GOODS OR SERVICES; LOSS OF USE, DATA, OR PROFITS; OR BUSINESS
// INTERRUPTION) HOWEVER CAUSED AND ON ANY THEORY OF LIABILITY,
// WHETHER IN CONTRACT, STRICT LIABILITY, OR TORT (INCLUDING
// NEGLIGENCE OR OTHERWISE) ARISING IN ANY WAY OUT OF THE USE OF THIS
// SOFTWARE, EVEN IF ADVISED OF THE POSSIBILITY OF SUCH DAMAGE.

// Code is generated by AI

// Shared harness for the opt-in hardware acceptance tests in this directory. It is the property
// observation, wait and request code every one of them needs: an in-process client that caches
// every property it is told about, the revision and state history a scenario needs to assert a
// transition that is over before it can be polled, and bounded waits. The driver specific
// scenarios stay in the per driver test source, as indigo_drivers/AGENTS.override.md requires.

#ifndef indigo_hardware_test_common_h
#define indigo_hardware_test_common_h

#include <pthread.h>
#include <stdio.h>
#include <stdlib.h>
#include <string.h>
#include <unistd.h>
#include <indigo/indigo_bus.h>
#include <indigo/indigo_client.h>
#include <indigo/indigo_driver.h>
#include <indigo/indigo_names.h>
#include <indigo/indigo_timer.h>
#include "../test_runner.h"

#ifndef ARRAY_SIZE
#define ARRAY_SIZE(a) (sizeof(a) / sizeof((a)[0]))
#endif

#define HW_MAX_DEVICES 8
#define HW_MAX_PROPERTIES 64

// For the start-up and tear-down code of main(), which has no test case to fail and therefore
// jumps to its own cleanup label instead.
#define HW_CHECK(condition) do { if (!(condition)) { fprintf(stderr, "%s:%d: %s\n", __FILE__, __LINE__, #condition); indigo_test_failures++; goto cleanup; } } while (0)

typedef struct {
	char name[INDIGO_NAME_SIZE];
	indigo_device *device;
	unsigned interface;
	bool present;
	indigo_property *properties[HW_MAX_PROPERTIES];
	unsigned revisions[HW_MAX_PROPERTIES];
	unsigned states[HW_MAX_PROPERTIES];
} hw_device;

static hw_device hw_devices[HW_MAX_DEVICES];
static pthread_mutex_t hw_mutex = PTHREAD_MUTEX_INITIALIZER;
static char hw_last_message[INDIGO_VALUE_SIZE];
static indigo_client hw_client;
// HW_TRACE=1 prints every property the driver publishes with its state, which is how a scenario
// that fails against a real device is told apart from a device that answered differently.
static bool hw_trace = false;

static int hw_slot(int d, const char *name) {
	for (int p = 0; p < HW_MAX_PROPERTIES; p++) {
		if (hw_devices[d].properties[p] && !strcmp(hw_devices[d].properties[p]->name, name)) {
			return p;
		}
	}
	return -1;
}

static indigo_result hw_observe(indigo_device *device, indigo_property *property, const char *message) {
	pthread_mutex_lock(&hw_mutex);
	int d;
	for (d = 0; d < HW_MAX_DEVICES; d++) {
		if (!*hw_devices[d].name || !strcmp(hw_devices[d].name, property->device)) {
			break;
		}
	}
	if (d < HW_MAX_DEVICES) {
		snprintf(hw_devices[d].name, INDIGO_NAME_SIZE, "%s", property->device);
		hw_devices[d].device = device;
		hw_devices[d].present = true;
		if (!strcmp(property->name, INFO_PROPERTY_NAME)) {
			for (int i = 0; i < property->count; i++) {
				if (!strcmp(property->items[i].name, INFO_DEVICE_INTERFACE_ITEM_NAME)) {
					hw_devices[d].interface = (unsigned)strtoul(property->items[i].text.value, NULL, 10);
				}
			}
		}
		int p = hw_slot(d, property->name);
		if (p < 0) {
			for (p = 0; p < HW_MAX_PROPERTIES && hw_devices[d].properties[p]; p++) { }
		}
		if (p < HW_MAX_PROPERTIES) {
			indigo_release_property(hw_devices[d].properties[p]);
			hw_devices[d].properties[p] = indigo_copy_property(NULL, property);
			hw_devices[d].revisions[p]++;
			hw_devices[d].states[p] |= 1u << property->state;
		}
	}
	pthread_mutex_unlock(&hw_mutex);
	if (hw_trace) {
		fprintf(stderr, "    [trace] %s %s state %d\n", property->device, property->name, property->state);
	}
	if (message && *message) {
		fprintf(stderr, "    %s %s: %s\n", property->device, property->name, message);
	}
	return INDIGO_OK;
}

static indigo_result hw_define_property(indigo_client *client, indigo_device *device, indigo_property *property, const char *message) {
	return hw_observe(device, property, message);
}

static indigo_result hw_update_property(indigo_client *client, indigo_device *device, indigo_property *property, const char *message) {
	return hw_observe(device, property, message);
}

static indigo_result hw_report_message(indigo_client *client, indigo_device *device, indigo_property *property, const char *message) {
	if (message && *message) {
		pthread_mutex_lock(&hw_mutex);
		snprintf(hw_last_message, INDIGO_VALUE_SIZE, "%s", message);
		pthread_mutex_unlock(&hw_mutex);
		fprintf(stderr, "    message: %s\n", message);
	}
	return INDIGO_OK;
}

static indigo_result hw_delete_property(indigo_client *client, indigo_device *device, indigo_property *property, const char *message) {
	pthread_mutex_lock(&hw_mutex);
	for (int d = 0; d < HW_MAX_DEVICES; d++) {
		if (strcmp(hw_devices[d].name, property->device)) {
			continue;
		}
		if (*property->name) {
			int p = hw_slot(d, property->name);
			if (p >= 0) {
				indigo_release_property(hw_devices[d].properties[p]);
				hw_devices[d].properties[p] = NULL;
				hw_devices[d].revisions[p] = 0;
				hw_devices[d].states[p] = 0;
			}
		} else {
			hw_devices[d].present = false;
			for (int p = 0; p < HW_MAX_PROPERTIES; p++) {
				indigo_release_property(hw_devices[d].properties[p]);
				hw_devices[d].properties[p] = NULL;
				hw_devices[d].revisions[p] = 0;
				hw_devices[d].states[p] = 0;
			}
		}
	}
	pthread_mutex_unlock(&hw_mutex);
	return INDIGO_OK;
}

static indigo_result hw_attach_client(const char *name) {
	const char *trace = getenv("HW_TRACE");
	hw_trace = trace != NULL && *trace && strcmp(trace, "0");
	hw_client = (indigo_client){ .version = INDIGO_VERSION_CURRENT, .define_property = hw_define_property, .update_property = hw_update_property, .delete_property = hw_delete_property, .send_message = hw_report_message };
	snprintf(hw_client.name, sizeof(hw_client.name), "%s", name);
	return indigo_attach_client(&hw_client);
}

static void hw_release_properties(void) {
	pthread_mutex_lock(&hw_mutex);
	for (int d = 0; d < HW_MAX_DEVICES; d++) {
		for (int p = 0; p < HW_MAX_PROPERTIES; p++) {
			indigo_release_property(hw_devices[d].properties[p]);
			hw_devices[d].properties[p] = NULL;
		}
	}
	pthread_mutex_unlock(&hw_mutex);
}

static int hw_device_index(const char *name) {
	pthread_mutex_lock(&hw_mutex);
	int result = -1;
	for (int d = 0; d < HW_MAX_DEVICES; d++) {
		if (hw_devices[d].present && !strcmp(hw_devices[d].name, name)) {
			result = d;
		}
	}
	pthread_mutex_unlock(&hw_mutex);
	return result;
}

// How many logical devices the driver has published so far. A driver that enumerates its hardware
// at INIT publishes one device per connected unit, so a scenario that assumes a single unit checks
// this first instead of silently testing whichever one was found first.
static int hw_device_count(void) {
	pthread_mutex_lock(&hw_mutex);
	int result = 0;
	for (int d = 0; d < HW_MAX_DEVICES; d++) {
		if (hw_devices[d].present) {
			result++;
		}
	}
	pthread_mutex_unlock(&hw_mutex);
	return result;
}

static const char *hw_device_name(int d) {
	return d >= 0 && d < HW_MAX_DEVICES ? hw_devices[d].name : "";
}

static unsigned hw_device_interface(int d) {
	return d >= 0 && d < HW_MAX_DEVICES ? hw_devices[d].interface : 0;
}

static bool hw_property_defined(int d, const char *name) {
	pthread_mutex_lock(&hw_mutex);
	bool found = d >= 0 && hw_slot(d, name) >= 0;
	pthread_mutex_unlock(&hw_mutex);
	return found;
}

static bool hw_property_hidden(int d, const char *name) {
	if (hw_property_defined(d, name)) {
		fprintf(stderr, "    %s is published but should stay hidden\n", name);
		return false;
	}
	return true;
}

// Waits until the driver has published a device with this name and its CONNECTION property. Pass
// NULL to take the first device the driver publishes, which is what a hot-plug driver that names
// its devices after the unit it found requires.
static int hw_wait_for_device(const char *name, double timeout) {
	double deadline = indigo_monotonic_time() + timeout;
	while (indigo_monotonic_time() < deadline) {
		int found = -1;
		pthread_mutex_lock(&hw_mutex);
		for (int d = 0; d < HW_MAX_DEVICES && found < 0; d++) {
			if (hw_devices[d].present && (name == NULL || !strcmp(hw_devices[d].name, name)) && hw_slot(d, CONNECTION_PROPERTY_NAME) >= 0) {
				found = d;
			}
		}
		pthread_mutex_unlock(&hw_mutex);
		if (found >= 0) {
			return found;
		}
		indigo_usleep(20000);
	}
	fprintf(stderr, "    the driver did not publish %s\n", name == NULL ? "any device" : name);
	return -1;
}

static unsigned hw_revision(int d, const char *name) {
	pthread_mutex_lock(&hw_mutex);
	int p = hw_slot(d, name);
	unsigned result = p < 0 ? 0 : hw_devices[d].revisions[p];
	pthread_mutex_unlock(&hw_mutex);
	return result;
}

// Every state the property has been published in since the last hw_forget_states(). A short pulse
// or a short exposure is over before a poll can see its BUSY, so that transition can only be
// asserted through this mask.
static unsigned hw_states_seen(int d, const char *name) {
	pthread_mutex_lock(&hw_mutex);
	int p = hw_slot(d, name);
	unsigned result = p < 0 ? 0 : hw_devices[d].states[p];
	pthread_mutex_unlock(&hw_mutex);
	return result;
}

static void hw_forget_states(void) {
	pthread_mutex_lock(&hw_mutex);
	for (int d = 0; d < HW_MAX_DEVICES; d++) {
		for (int p = 0; p < HW_MAX_PROPERTIES; p++) {
			hw_devices[d].states[p] = 0;
		}
	}
	*hw_last_message = 0;
	pthread_mutex_unlock(&hw_mutex);
}

static indigo_property_state hw_property_state(int d, const char *name) {
	pthread_mutex_lock(&hw_mutex);
	int p = hw_slot(d, name);
	indigo_property_state state = p < 0 ? INDIGO_IDLE_STATE : hw_devices[d].properties[p]->state;
	pthread_mutex_unlock(&hw_mutex);
	return state;
}

static bool hw_number_item(int d, const char *name, const char *item, double *value) {
	pthread_mutex_lock(&hw_mutex);
	int p = d < 0 ? -1 : hw_slot(d, name);
	bool found = false;
	if (p >= 0) {
		indigo_property *property = hw_devices[d].properties[p];
		for (int i = 0; i < property->count && !found; i++) {
			if (!strcmp(property->items[i].name, item)) {
				*value = property->items[i].number.value;
				found = true;
			}
		}
	}
	pthread_mutex_unlock(&hw_mutex);
	if (!found) {
		fprintf(stderr, "    missing number item %s.%s\n", name, item);
	}
	return found;
}

static bool hw_number_item_target(int d, const char *name, const char *item, double *value) {
	pthread_mutex_lock(&hw_mutex);
	int p = d < 0 ? -1 : hw_slot(d, name);
	bool found = false;
	if (p >= 0) {
		indigo_property *property = hw_devices[d].properties[p];
		for (int i = 0; i < property->count && !found; i++) {
			if (!strcmp(property->items[i].name, item)) {
				*value = property->items[i].number.target;
				found = true;
			}
		}
	}
	pthread_mutex_unlock(&hw_mutex);
	if (!found) {
		fprintf(stderr, "    missing number item %s.%s\n", name, item);
	}
	return found;
}

static bool hw_number_item_range(int d, const char *name, const char *item, double *min, double *max) {
	pthread_mutex_lock(&hw_mutex);
	int p = d < 0 ? -1 : hw_slot(d, name);
	bool found = false;
	if (p >= 0) {
		indigo_property *property = hw_devices[d].properties[p];
		for (int i = 0; i < property->count && !found; i++) {
			if (!strcmp(property->items[i].name, item)) {
				*min = property->items[i].number.min;
				*max = property->items[i].number.max;
				found = true;
			}
		}
	}
	pthread_mutex_unlock(&hw_mutex);
	if (!found) {
		fprintf(stderr, "    missing number item %s.%s\n", name, item);
	}
	return found;
}

static bool hw_switch_item(int d, const char *name, const char *item, bool *value) {
	pthread_mutex_lock(&hw_mutex);
	int p = d < 0 ? -1 : hw_slot(d, name);
	bool found = false;
	if (p >= 0) {
		indigo_property *property = hw_devices[d].properties[p];
		for (int i = 0; i < property->count && !found; i++) {
			if (!strcmp(property->items[i].name, item)) {
				*value = property->items[i].sw.value;
				found = true;
			}
		}
	}
	pthread_mutex_unlock(&hw_mutex);
	if (!found) {
		fprintf(stderr, "    missing switch item %s.%s\n", name, item);
	}
	return found;
}

static bool hw_text_item(int d, const char *name, const char *item, char *value, size_t size) {
	pthread_mutex_lock(&hw_mutex);
	int p = d < 0 ? -1 : hw_slot(d, name);
	bool found = false;
	if (p >= 0) {
		indigo_property *property = hw_devices[d].properties[p];
		for (int i = 0; i < property->count && !found; i++) {
			if (!strcmp(property->items[i].name, item)) {
				snprintf(value, size, "%s", property->items[i].text.value);
				found = true;
			}
		}
	}
	pthread_mutex_unlock(&hw_mutex);
	if (!found) {
		fprintf(stderr, "    missing text item %s.%s\n", name, item);
	}
	return found;
}

// Waits for a newer revision of the property in the requested state. The revision gate is required
// because an operation that starts and completes in the state the property already had would
// otherwise be satisfied by the value published before the request.
static bool hw_wait_state(int d, const char *name, unsigned after, indigo_property_state state, double timeout) {
	double deadline = indigo_monotonic_time() + timeout;
	while (indigo_monotonic_time() < deadline) {
		pthread_mutex_lock(&hw_mutex);
		int p = d < 0 ? -1 : hw_slot(d, name);
		bool ready = p >= 0 && hw_devices[d].revisions[p] > after && hw_devices[d].properties[p]->state == state;
		pthread_mutex_unlock(&hw_mutex);
		if (ready) {
			return true;
		}
		indigo_usleep(2000);
	}
	fprintf(stderr, "    timeout: %s %s expected state %d, last published state %d\n", hw_device_name(d), name, state, hw_property_state(d, name));
	return false;
}

static bool hw_wait_settled(int d, const char *name, indigo_property_state state, double timeout) {
	double deadline = indigo_monotonic_time() + timeout;
	while (indigo_monotonic_time() < deadline) {
		if (hw_property_state(d, name) == state) {
			return true;
		}
		indigo_usleep(2000);
	}
	fprintf(stderr, "    timeout: %s %s did not settle in state %d (state %d)\n", hw_device_name(d), name, state, hw_property_state(d, name));
	return false;
}

static bool hw_wait_number(int d, const char *name, const char *item, double value, double tolerance, double timeout) {
	double deadline = indigo_monotonic_time() + timeout;
	double current = 0;
	while (indigo_monotonic_time() < deadline) {
		if (hw_number_item(d, name, item, &current) && fabs(current - value) <= tolerance) {
			return true;
		}
		indigo_usleep(2000);
	}
	fprintf(stderr, "    timeout: %s %s.%s is %g, expected %g +/- %g\n", hw_device_name(d), name, item, current, value, tolerance);
	return false;
}

// Switching an item of an ANY_OF_MANY property off needs the explicit false, which a
// ONE_OF_MANY property never does.
static bool hw_set_switch_value(int d, const char *name, const char *item, bool value, indigo_property_state expected, double timeout) {
	unsigned before = hw_revision(d, name);
	indigo_change_switch_property_1(&hw_client, hw_device_name(d), name, item, value);
	return hw_wait_state(d, name, before, expected, timeout);
}

static bool hw_set_switch(int d, const char *name, const char *item, indigo_property_state expected, double timeout) {
	return hw_set_switch_value(d, name, item, true, expected, timeout);
}

static bool hw_set_number(int d, const char *name, const char *item, double value, indigo_property_state expected, double timeout) {
	unsigned before = hw_revision(d, name);
	indigo_change_number_property_1(&hw_client, hw_device_name(d), name, item, value);
	return hw_wait_state(d, name, before, expected, timeout);
}

static bool hw_set_text(int d, const char *name, const char *item, const char *value, indigo_property_state expected, double timeout) {
	unsigned before = hw_revision(d, name);
	indigo_change_text_property_1(&hw_client, hw_device_name(d), name, item, value);
	return hw_wait_state(d, name, before, expected, timeout);
}

// The request without the wait, for a scenario that has to act while the operation is still
// running, such as an abort or a second request on the same axis.
static void hw_request_number(int d, const char *name, const char *item, double value) {
	indigo_change_number_property_1(&hw_client, hw_device_name(d), name, item, value);
}

static void hw_request_switch(int d, const char *name, const char *item, bool value) {
	indigo_change_switch_property_1(&hw_client, hw_device_name(d), name, item, value);
}

// CONFIG SAVE is not answered with an update when the configuration folder is still empty: the
// first save adds the LOAD and REMOVE items, and a property whose item count changes is
// republished as a delete followed by a define. Wait for the cleared SAVE item instead, as
// indigo_test/AGENTS.md requires.
static bool hw_save_configuration(int d, double timeout) {
	indigo_change_switch_property_1(&hw_client, hw_device_name(d), CONFIG_PROPERTY_NAME, CONFIG_SAVE_ITEM_NAME, true);
	double deadline = indigo_monotonic_time() + timeout;
	while (indigo_monotonic_time() < deadline) {
		bool saving = true;
		if (hw_switch_item(d, CONFIG_PROPERTY_NAME, CONFIG_SAVE_ITEM_NAME, &saving) && !saving && hw_property_state(d, CONFIG_PROPERTY_NAME) == INDIGO_OK_STATE) {
			return true;
		}
		indigo_usleep(20000);
	}
	fprintf(stderr, "    timeout: %s CONFIG SAVE was not answered, state %d\n", hw_device_name(d), hw_property_state(d, CONFIG_PROPERTY_NAME));
	return false;
}

static bool hw_connected(int d) {
	bool connected = false;
	return hw_switch_item(d, CONNECTION_PROPERTY_NAME, CONNECTION_CONNECTED_ITEM_NAME, &connected) && connected;
}

static bool hw_connect(int d, double timeout) {
	if (d < 0) {
		fprintf(stderr, "    device not present\n");
		return false;
	}
	if (hw_connected(d)) {
		return true;
	}
	if (!hw_set_switch(d, CONNECTION_PROPERTY_NAME, CONNECTION_CONNECTED_ITEM_NAME, INDIGO_OK_STATE, timeout)) {
		return false;
	}
	return hw_connected(d);
}

static bool hw_disconnect(int d, double timeout) {
	if (d < 0 || !hw_devices[d].present) {
		return true;
	}
	if (!hw_connected(d)) {
		return true;
	}
	return hw_set_switch(d, CONNECTION_PROPERTY_NAME, CONNECTION_DISCONNECTED_ITEM_NAME, INDIGO_OK_STATE, timeout);
}

#endif /* indigo_hardware_test_common_h */
