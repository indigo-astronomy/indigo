// Copyright (c) 2026 INDIGO initiative
// All rights reserved.
//
// You may use this software under the terms of 'INDIGO Astronomy
// open-source license' (see LICENSE.md).
//
// THIS SOFTWARE IS PROVIDED BY THE AUTHORS 'AS IS' AND ANY EXPRESS
// OR IMPLIED WARRANTIES, INCLUDING, BUT NOT LIMITED TO, THE IMPLIED
// WARRANTIES OF MERCHANTABILITY AND FITNESS FOR A PARTICULAR PURPOSE
// ARE DISCLAIMED. IN NO EVENT SHALL THE AUTHOR BE LIABLE FOR ANY
// DIRECT, INDIRECT, INCIDENTAL, SPECIAL, EXEMPLARY, OR CONSEQUENTIAL
// DAMAGES (INCLUDING, BUT NOT LIMITED TO, PROCUREMENT OF SUBSTITUTE
// GOODS OR SERVICES; LOSS OF USE, DATA, OR PROFITS; OR BUSINESS
// INTERRUPTION) HOWEVER CAUSED AND ON ANY THEORY OF LIABILITY,
// WHETHER IN CONTRACT, STRICT LIABILITY, OR TORT (INCLUDING
// NEGLIGENCE OR OTHERWISE) ARISING IN ANY WAY OUT OF THE USE OF THIS
// SOFTWARE, EVEN IF ADVISED OF THE POSSIBILITY OF SUCH DAMAGE.

// Code is generated by AI

// Dome helpers shared by the dome hardware suites: azimuth, steps, park, shutter and flap requests that
// wait for the property to settle, on top of hardware_test_common.h.

#ifndef dome_hw_common_h
#define dome_hw_common_h

#include <math.h>
#include "hardware_test_common.h"

static double dome_hw_azimuth(int d) {
	double value = NAN;
	hw_number_item(d, DOME_HORIZONTAL_COORDINATES_PROPERTY_NAME, DOME_HORIZONTAL_COORDINATES_AZ_ITEM_NAME, &value);
	return value;
}

static double dome_hw_azimuth_distance(double a, double b) {
	double distance = fmod(fabs(a - b), 360);
	return distance > 180 ? 360 - distance : distance;
}

static double dome_hw_normalize(double azimuth) {
	return fmod(fmod(azimuth, 360) + 360, 360);
}

static bool dome_hw_switch_is(int d, const char *property, const char *item) {
	bool value = false;
	return hw_switch_item(d, property, item, &value) && value;
}

// Waits until a property is not BUSY, whatever state it ends in.
static bool dome_hw_idle(int d, const char *property, double timeout) {
	double deadline = indigo_monotonic_time() + timeout;
	while (indigo_monotonic_time() < deadline) {
		if (hw_property_state(d, property) != INDIGO_BUSY_STATE) {
			return true;
		}
		indigo_usleep(10000);
	}
	fprintf(stderr, "    timeout: %s stays BUSY\n", property);
	return false;
}

// Waits for a request published after revision `before` to settle (leave BUSY) and checks the end state.
static bool dome_hw_settles(int d, const char *property, unsigned before, indigo_property_state expected, double timeout) {
	double deadline = indigo_monotonic_time() + timeout;
	while (indigo_monotonic_time() < deadline) {
		indigo_property_state state = hw_property_state(d, property);
		if (hw_revision(d, property) > before && state != INDIGO_BUSY_STATE) {
			if (state != expected) {
				fprintf(stderr, "    %s ended in state %d, expected %d\n", property, state, expected);
			}
			return state == expected;
		}
		indigo_usleep(10000);
	}
	fprintf(stderr, "    timeout: %s did not settle (state %d)\n", property, hw_property_state(d, property));
	return false;
}

// Requests an azimuth and waits for the rotation to end in the expected state.
static bool dome_hw_goto(int d, double azimuth, indigo_property_state expected, double timeout) {
	if (!dome_hw_idle(d, DOME_HORIZONTAL_COORDINATES_PROPERTY_NAME, timeout)) {
		return false;
	}
	unsigned before = hw_revision(d, DOME_HORIZONTAL_COORDINATES_PROPERTY_NAME);
	indigo_change_number_property_1(&hw_client, hw_device_name(d), DOME_HORIZONTAL_COORDINATES_PROPERTY_NAME, DOME_HORIZONTAL_COORDINATES_AZ_ITEM_NAME, azimuth);
	return dome_hw_settles(d, DOME_HORIZONTAL_COORDINATES_PROPERTY_NAME, before, expected, timeout);
}

static bool dome_hw_at(int d, double azimuth, double tolerance) {
	double current = dome_hw_azimuth(d);
	if (dome_hw_azimuth_distance(current, azimuth) > tolerance) {
		fprintf(stderr, "    azimuth %.2f, expected %.2f +/- %.2f\n", current, azimuth, tolerance);
		return false;
	}
	return true;
}

static bool dome_hw_steps(int d, bool clockwise, double steps, double timeout) {
	if (!dome_hw_idle(d, DOME_HORIZONTAL_COORDINATES_PROPERTY_NAME, timeout) || !dome_hw_idle(d, DOME_STEPS_PROPERTY_NAME, timeout)) {
		return false;
	}
	if (!hw_set_switch(d, DOME_DIRECTION_PROPERTY_NAME, clockwise ? DOME_DIRECTION_MOVE_CLOCKWISE_ITEM_NAME : DOME_DIRECTION_MOVE_COUNTERCLOCKWISE_ITEM_NAME, INDIGO_OK_STATE, timeout)) {
		return false;
	}
	unsigned before = hw_revision(d, DOME_STEPS_PROPERTY_NAME);
	indigo_change_number_property_1(&hw_client, hw_device_name(d), DOME_STEPS_PROPERTY_NAME, DOME_STEPS_ITEM_NAME, steps);
	return dome_hw_settles(d, DOME_STEPS_PROPERTY_NAME, before, INDIGO_OK_STATE, timeout) && hw_wait_settled(d, DOME_HORIZONTAL_COORDINATES_PROPERTY_NAME, INDIGO_OK_STATE, timeout);
}

// Opens or closes a two-state switch property (shutter, flap) and waits for the end state.
static bool dome_hw_open_close(int d, const char *property, bool open, indigo_property_state expected, double timeout) {
	if (!dome_hw_idle(d, property, timeout)) {
		return false;
	}
	unsigned before = hw_revision(d, property);
	indigo_change_switch_property_1(&hw_client, hw_device_name(d), property, open ? DOME_SHUTTER_OPENED_ITEM_NAME : DOME_SHUTTER_CLOSED_ITEM_NAME, true);
	double deadline = indigo_monotonic_time() + timeout;
	while (indigo_monotonic_time() < deadline) {
		if (hw_revision(d, property) > before && hw_property_state(d, property) == expected) {
			return expected != INDIGO_OK_STATE || dome_hw_switch_is(d, property, open ? DOME_SHUTTER_OPENED_ITEM_NAME : DOME_SHUTTER_CLOSED_ITEM_NAME);
		}
		if (hw_revision(d, property) > before && expected == INDIGO_OK_STATE && hw_property_state(d, property) == INDIGO_ALERT_STATE) {
			fprintf(stderr, "    %s ended in ALERT\n", property);
			return false;
		}
		indigo_usleep(10000);
	}
	fprintf(stderr, "    timeout: %s did not end in state %d (state %d)\n", property, expected, hw_property_state(d, property));
	return false;
}

static bool dome_hw_park(int d, bool park, double timeout) {
	if (!dome_hw_idle(d, DOME_PARK_PROPERTY_NAME, timeout)) {
		return false;
	}
	unsigned before = hw_revision(d, DOME_PARK_PROPERTY_NAME);
	indigo_change_switch_property_1(&hw_client, hw_device_name(d), DOME_PARK_PROPERTY_NAME, park ? DOME_PARK_PARKED_ITEM_NAME : DOME_PARK_UNPARKED_ITEM_NAME, true);
	double deadline = indigo_monotonic_time() + timeout;
	while (indigo_monotonic_time() < deadline) {
		if (hw_revision(d, DOME_PARK_PROPERTY_NAME) > before && hw_property_state(d, DOME_PARK_PROPERTY_NAME) == INDIGO_OK_STATE && dome_hw_switch_is(d, DOME_PARK_PROPERTY_NAME, park ? DOME_PARK_PARKED_ITEM_NAME : DOME_PARK_UNPARKED_ITEM_NAME)) {
			return true;
		}
		indigo_usleep(10000);
	}
	fprintf(stderr, "    timeout: DOME_PARK did not end %s (state %d)\n", park ? "parked" : "unparked", hw_property_state(d, DOME_PARK_PROPERTY_NAME));
	return false;
}

static bool dome_hw_abort(int d, double timeout) {
	return hw_set_switch(d, DOME_ABORT_MOTION_PROPERTY_NAME, DOME_ABORT_MOTION_ITEM_NAME, INDIGO_OK_STATE, timeout);
}

#endif /* dome_hw_common_h */
