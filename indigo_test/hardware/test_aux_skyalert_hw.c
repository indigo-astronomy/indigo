// Copyright (c) 2026 INDIGO initiative
// All rights reserved.
//
// You may use this software under the terms of 'INDIGO Astronomy
// open-source license' (see LICENSE.md).
//
// THIS SOFTWARE IS PROVIDED BY THE AUTHORS 'AS IS' AND ANY EXPRESS
// OR IMPLIED WARRANTIES, INCLUDING, BUT NOT LIMITED TO, THE IMPLIED
// WARRANTIES OF MERCHANTABILITY AND FITNESS FOR A PARTICULAR PURPOSE
// ARE DISCLAIMED. IN NO EVENT SHALL THE AUTHOR BE LIABLE FOR ANY
// DIRECT, INDIRECT, INCIDENTAL, SPECIAL, EXEMPLARY, OR CONSEQUENTIAL
// DAMAGES (INCLUDING, BUT NOT LIMITED TO, PROCUREMENT OF SUBSTITUTE
// GOODS OR SERVICES; LOSS OF USE, DATA, OR PROFITS; OR BUSINESS
// INTERRUPTION) HOWEVER CAUSED AND ON ANY THEORY OF LIABILITY,
// WHETHER IN CONTRACT, STRICT LIABILITY, OR TORT (INCLUDING
// NEGLIGENCE OR OTHERWISE) ARISING IN ANY WAY OUT OF THE USE OF THIS
// SOFTWARE, EVEN IF ADVISED OF THE POSSIBILITY OF SUCH DAMAGE.

// Code is generated by AI

// Opt-in acceptance test for a physically connected Interactive Astronomy SkyAlert, or for the Arduino
// sketch aux_skyalert_simulator.ino running on a board. It checks the record read at connection (model,
// firmware and every reading within its physical range), that the 10 s poll keeps both properties OK,
// reconnects and runs driver INIT/SHUTDOWN. Nothing is written to the device.
//
// The port comes from SKYALERT_HW_PORT. The driver has no match pattern, so the port must be given.

#include <math.h>
#include <stdlib.h>
#include <indigo_drivers/aux_skyalert/indigo_aux_skyalert.h>
#include "hardware_test_common.h"

#define DEVICE_NAME "Interactive Astronomy SkyAlert"

#define SHORT_TIMEOUT 15.0
#define POLL_SECONDS 10

static int station = -1;
static const char *serial_port = NULL;

static bool select_port(void) {
	if (serial_port == NULL || !*serial_port) {
		fprintf(stderr, "    set SKYALERT_HW_PORT to the SkyAlert's serial port\n");
		return false;
	}
	printf("Using port %s\n", serial_port);
	return hw_set_text(station, DEVICE_PORT_PROPERTY_NAME, DEVICE_PORT_ITEM_NAME, serial_port, INDIGO_OK_STATE, SHORT_TIMEOUT);
}

static double reading(const char *property, const char *item) {
	double value = NAN;
	hw_number_item(station, property, item, &value);
	return value;
}

static void skyalert_publishes_the_property_contract(void) {
	char model[INDIGO_VALUE_SIZE] = "", firmware[INDIGO_VALUE_SIZE] = "";
	ASSERT_TRUE((hw_device_interface(station) & INDIGO_INTERFACE_AUX_SQM) != 0);
	ASSERT_TRUE(hw_text_item(station, INFO_PROPERTY_NAME, INFO_DEVICE_MODEL_ITEM_NAME, model, sizeof(model)));
	ASSERT_TRUE(hw_text_item(station, INFO_PROPERTY_NAME, INFO_DEVICE_FW_REVISION_ITEM_NAME, firmware, sizeof(firmware)));
	printf("    model %s, firmware %s\n", model, firmware);
	ASSERT_STREQ("Interactive Astronomy SkyAlert", model);
	ASSERT_TRUE(*firmware && strcmp(firmware, "Unknown"));
	static const char *weather_items[] = { AUX_WEATHER_TEMPERATURE_ITEM_NAME, AUX_WEATHER_HUMIDITY_ITEM_NAME, AUX_WEATHER_PRESSURE_ITEM_NAME, AUX_WEATHER_WIND_SPEED_ITEM_NAME, AUX_WEATHER_RAIN_ITEM_NAME, AUX_WEATHER_SKY_TEMPERATURE_ITEM_NAME };
	for (int i = 0; i < ARRAY_SIZE(weather_items); i++) {
		ASSERT_TRUE(hw_item_defined(station, AUX_WEATHER_PROPERTY_NAME, weather_items[i]));
	}
	ASSERT_TRUE(hw_item_defined(station, AUX_INFO_PROPERTY_NAME, AUX_WEATHER_SKY_BRIGHTNESS_ITEM_NAME));
	ASSERT_TRUE(hw_item_defined(station, AUX_INFO_PROPERTY_NAME, AUX_INFO_POWER_ITEM_NAME));
}

// Every field within its physical range; the pressure is reported in pascal and published in hPa.
static void skyalert_reports_plausible_readings(void) {
	ASSERT_TRUE(hw_wait_settled(station, AUX_WEATHER_PROPERTY_NAME, INDIGO_OK_STATE, SHORT_TIMEOUT));
	ASSERT_TRUE(hw_wait_settled(station, AUX_INFO_PROPERTY_NAME, INDIGO_OK_STATE, SHORT_TIMEOUT));
	double temperature = reading(AUX_WEATHER_PROPERTY_NAME, AUX_WEATHER_TEMPERATURE_ITEM_NAME);
	double sky = reading(AUX_WEATHER_PROPERTY_NAME, AUX_WEATHER_SKY_TEMPERATURE_ITEM_NAME);
	double humidity = reading(AUX_WEATHER_PROPERTY_NAME, AUX_WEATHER_HUMIDITY_ITEM_NAME);
	double pressure = reading(AUX_WEATHER_PROPERTY_NAME, AUX_WEATHER_PRESSURE_ITEM_NAME);
	double wind = reading(AUX_WEATHER_PROPERTY_NAME, AUX_WEATHER_WIND_SPEED_ITEM_NAME);
	double rain = reading(AUX_WEATHER_PROPERTY_NAME, AUX_WEATHER_RAIN_ITEM_NAME);
	double brightness = reading(AUX_INFO_PROPERTY_NAME, AUX_WEATHER_SKY_BRIGHTNESS_ITEM_NAME);
	double power = reading(AUX_INFO_PROPERTY_NAME, AUX_INFO_POWER_ITEM_NAME);
	printf("    %.1f C, sky %.1f C, %.1f %%, %.1f hPa, wind %g, dampness %g, brightness %g, power %g\n", temperature, sky, humidity, pressure, wind, rain, brightness, power);
	ASSERT_TRUE(temperature > -50 && temperature < 70);
	ASSERT_TRUE(sky > -80 && sky < 70);
	ASSERT_TRUE(humidity >= 0 && humidity <= 100);
	ASSERT_TRUE(pressure > 500 && pressure < 1100);
	ASSERT_TRUE(wind >= 0 && wind <= 1023);
	ASSERT_TRUE(rain >= 0 && rain <= 1023);
	ASSERT_TRUE(brightness >= 0 && brightness <= 1023);
	ASSERT_TRUE(power == 0 || power == 1);
}

// The device has no unsolicited output, the driver asks every 10 s. Two polls later both properties are
// still OK and the device still connected; an unanswered poll would have turned them ALERT.
static void skyalert_keeps_polling(void) {
	indigo_usleep((2 * POLL_SECONDS + 2) * 1000000L);
	ASSERT_TRUE(hw_connected(station));
	ASSERT_EQ_INT(INDIGO_OK_STATE, hw_property_state(station, AUX_WEATHER_PROPERTY_NAME));
	ASSERT_EQ_INT(INDIGO_OK_STATE, hw_property_state(station, AUX_INFO_PROPERTY_NAME));
	ASSERT_TRUE((hw_states_seen(station, AUX_WEATHER_PROPERTY_NAME) & (1 << INDIGO_ALERT_STATE)) == 0);
}

static void skyalert_reconnects(void) {
	ASSERT_TRUE(hw_disconnect(station, SHORT_TIMEOUT));
	ASSERT_TRUE(hw_property_hidden(station, AUX_WEATHER_PROPERTY_NAME));
	char firmware[INDIGO_VALUE_SIZE] = "";
	ASSERT_TRUE(hw_text_item(station, INFO_PROPERTY_NAME, INFO_DEVICE_FW_REVISION_ITEM_NAME, firmware, sizeof(firmware)));
	ASSERT_STREQ("Unknown", firmware);
	ASSERT_TRUE(hw_connect(station, SHORT_TIMEOUT));
	ASSERT_TRUE(hw_wait_settled(station, AUX_WEATHER_PROPERTY_NAME, INDIGO_OK_STATE, SHORT_TIMEOUT));
	ASSERT_TRUE(hw_text_item(station, INFO_PROPERTY_NAME, INFO_DEVICE_FW_REVISION_ITEM_NAME, firmware, sizeof(firmware)));
	ASSERT_TRUE(strcmp(firmware, "Unknown"));
}

static void skyalert_rejects_shutdown_while_connected(void) {
	ASSERT_EQ_INT(INDIGO_BUSY, indigo_aux_skyalert(INDIGO_DRIVER_SHUTDOWN, NULL));
	ASSERT_TRUE(hw_connected(station));
}

static void skyalert_reinitializes(void) {
	ASSERT_TRUE(hw_disconnect(station, SHORT_TIMEOUT));
	ASSERT_EQ_INT(INDIGO_OK, indigo_aux_skyalert(INDIGO_DRIVER_SHUTDOWN, NULL));
	ASSERT_EQ_INT(-1, hw_device_index(DEVICE_NAME));
	ASSERT_EQ_INT(INDIGO_OK, indigo_aux_skyalert(INDIGO_DRIVER_INIT, NULL));
	station = hw_wait_for_device(DEVICE_NAME, SHORT_TIMEOUT);
	ASSERT_TRUE(station >= 0);
	ASSERT_TRUE(select_port());
	ASSERT_TRUE(hw_connect(station, SHORT_TIMEOUT));
	ASSERT_TRUE(hw_wait_settled(station, AUX_WEATHER_PROPERTY_NAME, INDIGO_OK_STATE, SHORT_TIMEOUT));
}

int main(int argc, char **argv) {
	if (argc < 2 || strcmp(argv[1], "--run")) {
		fprintf(stderr, "Physical SkyAlert test: run explicitly with --run (or make test-aux-skyalert-hw).\n");
		return 2;
	}
	setvbuf(stdout, NULL, _IONBF, 0);
	for (int i = 2; i < argc; i++) {
		if (!strcmp(argv[i], "--debug")) {
			indigo_set_log_level(INDIGO_LOG_DEBUG);
		}
	}
	if (!indigo_test_use_private_home()) {
		return 1;
	}
	serial_port = hw_port("SKYALERT_HW_PORT");
	const indigo_test_case tests[] = {
		{ "skyalert_publishes_the_property_contract", skyalert_publishes_the_property_contract },
		{ "skyalert_reports_plausible_readings", skyalert_reports_plausible_readings },
		{ "skyalert_keeps_polling", skyalert_keeps_polling },
		{ "skyalert_reconnects", skyalert_reconnects },
		{ "skyalert_rejects_shutdown_while_connected", skyalert_rejects_shutdown_while_connected },
		{ "skyalert_reinitializes", skyalert_reinitializes }
	};
	int result = 1;
	bool started = false, initialized = false;
	HW_CHECK(hw_start() == INDIGO_OK);
	started = true;
	HW_CHECK(hw_attach_client("SkyAlert hardware test") == INDIGO_OK);
	HW_CHECK(indigo_aux_skyalert(INDIGO_DRIVER_INIT, NULL) == INDIGO_OK);
	initialized = true;
	station = hw_wait_for_device(DEVICE_NAME, SHORT_TIMEOUT);
	HW_CHECK(station >= 0);
	HW_CHECK(select_port());
	HW_CHECK(hw_connect(station, SHORT_TIMEOUT));
	result = indigo_run_tests("SkyAlert hardware", tests, ARRAY_SIZE(tests));
cleanup:
	if (!hw_disconnect(station, SHORT_TIMEOUT)) {
		indigo_test_failures++;
	}
	if (initialized && indigo_aux_skyalert(INDIGO_DRIVER_SHUTDOWN, NULL) != INDIGO_OK) {
		indigo_test_failures++;
	}
	indigo_detach_client(&hw_client);
	if (started) {
		indigo_stop();
	}
	hw_release_properties();
	indigo_test_remove_private_home();
	return indigo_test_failures ? 1 : result;
}
