// Copyright (c) 2026 INDIGO initiative
// All rights reserved.
//
// You may use this software under the terms of 'INDIGO Astronomy
// open-source license' (see LICENSE.md).
//
// THIS SOFTWARE IS PROVIDED BY THE AUTHORS 'AS IS' AND ANY EXPRESS
// OR IMPLIED WARRANTIES, INCLUDING, BUT NOT LIMITED TO, THE IMPLIED
// WARRANTIES OF MERCHANTABILITY AND FITNESS FOR A PARTICULAR PURPOSE
// ARE DISCLAIMED. IN NO EVENT SHALL THE AUTHOR BE LIABLE FOR ANY
// DIRECT, INDIRECT, INCIDENTAL, SPECIAL, EXEMPLARY, OR CONSEQUENTIAL
// DAMAGES (INCLUDING, BUT NOT LIMITED TO, PROCUREMENT OF SUBSTITUTE
// GOODS OR SERVICES; LOSS OF USE, DATA, OR PROFITS; OR BUSINESS
// INTERRUPTION) HOWEVER CAUSED AND ON ANY THEORY OF LIABILITY,
// WHETHER IN CONTRACT, STRICT LIABILITY, OR TORT (INCLUDING
// NEGLIGENCE OR OTHERWISE) ARISING IN ANY WAY OUT OF THE USE OF THIS
// SOFTWARE, EVEN IF ADVISED OF THE POSSIBILITY OF SUCH DAMAGE.

// Code is generated by AI

// Opt-in acceptance test for a physically connected Rigel Systems nFOCUS, or for the Arduino sketch
// focuser_nfocus_simulator.ino running on a board. The nFOCUS has no position readout, so the driver offers
// relative moves only: the suite checks the values read at the connection, moves by steps both ways, aborts a
// move, refuses a speed change during a move, sets the speed and reads it back over a reconnect, and runs
// driver INIT/SHUTDOWN.
//
// THE FOCUSER MOVES. Every move is paired with one back by the same number of steps, and the speed found is
// written back.
//
// The port comes from NFOCUS_HW_PORT.

#include <math.h>
#include <stdlib.h>
#include <indigo_drivers/focuser_nfocus/indigo_focuser_nfocus.h>
#include "focuser_hw_common.h"

#define DEVICE_NAME "nFOCUS"

#define SHORT_TIMEOUT 15.0
#define MOVE_TIMEOUT 120.0

static int focuser = -1;
static const char *serial_port = NULL;
static bool state_captured = false;
static double initial_speed = 0;

static bool select_port(void) {
	if (serial_port == NULL || !*serial_port) {
		fprintf(stderr, "    set NFOCUS_HW_PORT to the focuser's port\n");
		return false;
	}
	printf("Using port %s\n", serial_port);
	return hw_set_text(focuser, DEVICE_PORT_PROPERTY_NAME, DEVICE_PORT_ITEM_NAME, serial_port, INDIGO_OK_STATE, SHORT_TIMEOUT);
}

static bool set_number(const char *property, const char *item, double value) {
	return focuser_hw_set_number(focuser, property, item, value, INDIGO_OK_STATE, SHORT_TIMEOUT) && focuser_hw_value(focuser, property, item) == value;
}

static double speed(void) {
	return focuser_hw_value(focuser, FOCUSER_SPEED_PROPERTY_NAME, FOCUSER_SPEED_ITEM_NAME);
}

static void restore_initial_state(void) {
	if (focuser < 0 || !state_captured || !hw_connected(focuser)) {
		return;
	}
	focuser_hw_idle(focuser, FOCUSER_STEPS_PROPERTY_NAME, MOVE_TIMEOUT);
	set_number(FOCUSER_SPEED_PROPERTY_NAME, FOCUSER_SPEED_ITEM_NAME, initial_speed);
}

// A relative move timed from the request to the end of the motion.
static bool timed_steps(bool outward, double steps, double *elapsed) {
	double start = indigo_monotonic_time();
	bool result = focuser_hw_steps(focuser, outward, steps, INDIGO_OK_STATE, MOVE_TIMEOUT);
	*elapsed = indigo_monotonic_time() - start;
	return result;
}

static void nfocus_publishes_the_values(void) {
	char model[INDIGO_VALUE_SIZE] = "";
	ASSERT_TRUE((hw_device_interface(focuser) & INDIGO_INTERFACE_FOCUSER) != 0);
	ASSERT_TRUE(hw_text_item(focuser, INFO_PROPERTY_NAME, INFO_DEVICE_MODEL_ITEM_NAME, model, sizeof(model)));
	ASSERT_TRUE(!strcmp(model, "Rigel Systems nFOCUS"));
	ASSERT_TRUE(hw_property_hidden(focuser, FOCUSER_POSITION_PROPERTY_NAME));
	ASSERT_TRUE(initial_speed >= 1 && initial_speed <= 250);
	if (hw_property_hidden(focuser, FOCUSER_TEMPERATURE_PROPERTY_NAME)) {
		printf("    speed %g, no temperature probe\n", initial_speed);
	} else {
		double temperature = focuser_hw_value(focuser, FOCUSER_TEMPERATURE_PROPERTY_NAME, FOCUSER_TEMPERATURE_ITEM_NAME);
		printf("    speed %g, %.1f C\n", initial_speed, temperature);
		ASSERT_TRUE(temperature > -50 && temperature < 60);
		ASSERT_EQ_INT(INDIGO_OK_STATE, hw_property_state(focuser, FOCUSER_TEMPERATURE_PROPERTY_NAME));
	}
}

// The motion ends when the controller reports it stopped; a longer move takes longer, a zero-step move ends at once.
static void nfocus_moves_by_steps(void) {
	double short_move = 0, long_move = 0, back = 0, zero = 0;
	ASSERT_TRUE(timed_steps(true, 40, &short_move));
	ASSERT_TRUE(timed_steps(false, 40, &back));
	ASSERT_TRUE(timed_steps(false, 400, &long_move));
	ASSERT_TRUE(timed_steps(true, 400, &back));
	ASSERT_TRUE(timed_steps(true, 0, &zero));
	printf("    40 steps %.1f s, 400 steps %.1f s and %.1f s back, 0 steps %.1f s\n", short_move, long_move, back, zero);
	ASSERT_TRUE(long_move > short_move);
	ASSERT_TRUE(zero < 1);
}

// An aborted move ends in ALERT, and the motor is stopped: the next short move ends in about the same time as
// one from rest.
static void nfocus_aborts_a_move(void) {
	unsigned before = hw_revision(focuser, FOCUSER_STEPS_PROPERTY_NAME);
	ASSERT_TRUE(hw_set_switch(focuser, FOCUSER_DIRECTION_PROPERTY_NAME, FOCUSER_DIRECTION_MOVE_OUTWARD_ITEM_NAME, INDIGO_OK_STATE, SHORT_TIMEOUT));
	hw_request_number(focuser, FOCUSER_STEPS_PROPERTY_NAME, FOCUSER_STEPS_ITEM_NAME, 999);
	ASSERT_TRUE(hw_wait_state(focuser, FOCUSER_STEPS_PROPERTY_NAME, before, INDIGO_BUSY_STATE, SHORT_TIMEOUT));
	indigo_usleep(2000000);
	double start = indigo_monotonic_time();
	ASSERT_TRUE(focuser_hw_abort(focuser, SHORT_TIMEOUT));
	ASSERT_TRUE(focuser_hw_idle(focuser, FOCUSER_STEPS_PROPERTY_NAME, SHORT_TIMEOUT));
	ASSERT_EQ_INT(INDIGO_ALERT_STATE, hw_property_state(focuser, FOCUSER_STEPS_PROPERTY_NAME));
	double aborted = indigo_monotonic_time() - start;
	double after = 0;
	ASSERT_TRUE(timed_steps(false, 40, &after));
	printf("    abort took %.1f s, the next 40 steps %.1f s\n", aborted, after);
	ASSERT_TRUE(after < 5);
}

// A speed requested during a move is refused and the value stays; after the move it is accepted.
static void nfocus_refuses_speed_during_a_move(void) {
	double found = speed();
	double requested = found == 60 ? 61 : 60;
	unsigned before = hw_revision(focuser, FOCUSER_STEPS_PROPERTY_NAME);
	ASSERT_TRUE(hw_set_switch(focuser, FOCUSER_DIRECTION_PROPERTY_NAME, FOCUSER_DIRECTION_MOVE_INWARD_ITEM_NAME, INDIGO_OK_STATE, SHORT_TIMEOUT));
	hw_request_number(focuser, FOCUSER_STEPS_PROPERTY_NAME, FOCUSER_STEPS_ITEM_NAME, 200);
	ASSERT_TRUE(hw_wait_state(focuser, FOCUSER_STEPS_PROPERTY_NAME, before, INDIGO_BUSY_STATE, SHORT_TIMEOUT));
	ASSERT_TRUE(focuser_hw_set_number(focuser, FOCUSER_SPEED_PROPERTY_NAME, FOCUSER_SPEED_ITEM_NAME, requested, INDIGO_ALERT_STATE, SHORT_TIMEOUT));
	ASSERT_EQ_INT((int)found, (int)speed());
	ASSERT_TRUE(focuser_hw_idle(focuser, FOCUSER_STEPS_PROPERTY_NAME, MOVE_TIMEOUT));
	ASSERT_EQ_INT(INDIGO_OK_STATE, hw_property_state(focuser, FOCUSER_STEPS_PROPERTY_NAME));
	ASSERT_TRUE(focuser_hw_steps(focuser, true, 200, INDIGO_OK_STATE, MOVE_TIMEOUT));
	ASSERT_TRUE(set_number(FOCUSER_SPEED_PROPERTY_NAME, FOCUSER_SPEED_ITEM_NAME, requested));
}

// The speed is read back from the controller's on-time at the connection, so a written speed survives a
// reconnect; the range ends are accepted.
static void nfocus_keeps_the_speed(void) {
	ASSERT_TRUE(set_number(FOCUSER_SPEED_PROPERTY_NAME, FOCUSER_SPEED_ITEM_NAME, 1));
	ASSERT_TRUE(set_number(FOCUSER_SPEED_PROPERTY_NAME, FOCUSER_SPEED_ITEM_NAME, 250));
	ASSERT_TRUE(set_number(FOCUSER_SPEED_PROPERTY_NAME, FOCUSER_SPEED_ITEM_NAME, 120));
	ASSERT_TRUE(hw_disconnect(focuser, SHORT_TIMEOUT));
	ASSERT_TRUE(hw_connect(focuser, SHORT_TIMEOUT));
	ASSERT_EQ_INT(120, (int)speed());
	ASSERT_TRUE(set_number(FOCUSER_SPEED_PROPERTY_NAME, FOCUSER_SPEED_ITEM_NAME, initial_speed));
}

static void nfocus_reconnects(void) {
	ASSERT_TRUE(hw_disconnect(focuser, SHORT_TIMEOUT));
	ASSERT_TRUE(hw_property_hidden(focuser, FOCUSER_STEPS_PROPERTY_NAME));
	ASSERT_TRUE(hw_connect(focuser, SHORT_TIMEOUT));
	ASSERT_EQ_INT((int)initial_speed, (int)speed());
	double elapsed = 0;
	ASSERT_TRUE(timed_steps(true, 20, &elapsed));
	ASSERT_TRUE(timed_steps(false, 20, &elapsed));
}

static void nfocus_rejects_shutdown_while_connected(void) {
	ASSERT_EQ_INT(INDIGO_BUSY, indigo_focuser_nfocus(INDIGO_DRIVER_SHUTDOWN, NULL));
	ASSERT_TRUE(hw_connected(focuser));
}

static void nfocus_reinitializes(void) {
	ASSERT_TRUE(hw_disconnect(focuser, SHORT_TIMEOUT));
	ASSERT_EQ_INT(INDIGO_OK, indigo_focuser_nfocus(INDIGO_DRIVER_SHUTDOWN, NULL));
	ASSERT_EQ_INT(-1, hw_device_index(DEVICE_NAME));
	ASSERT_EQ_INT(INDIGO_OK, indigo_focuser_nfocus(INDIGO_DRIVER_INIT, NULL));
	focuser = hw_wait_for_device(DEVICE_NAME, SHORT_TIMEOUT);
	ASSERT_TRUE(focuser >= 0);
	ASSERT_TRUE(select_port());
	ASSERT_TRUE(hw_connect(focuser, SHORT_TIMEOUT));
	ASSERT_EQ_INT((int)initial_speed, (int)speed());
}

int main(int argc, char **argv) {
	if (argc < 2 || strcmp(argv[1], "--run")) {
		fprintf(stderr, "Physical nFOCUS test: run explicitly with --run (or make test-focuser-nfocus-hw).\n");
		return 2;
	}
	setvbuf(stdout, NULL, _IONBF, 0);
	for (int i = 2; i < argc; i++) {
		if (!strcmp(argv[i], "--debug")) {
			indigo_set_log_level(INDIGO_LOG_DEBUG);
		}
	}
	if (!indigo_test_use_private_home()) {
		return 1;
	}
	serial_port = hw_port("NFOCUS_HW_PORT");
	const indigo_test_case tests[] = {
		{ "nfocus_publishes_the_values", nfocus_publishes_the_values },
		{ "nfocus_moves_by_steps", nfocus_moves_by_steps },
		{ "nfocus_aborts_a_move", nfocus_aborts_a_move },
		{ "nfocus_refuses_speed_during_a_move", nfocus_refuses_speed_during_a_move },
		{ "nfocus_keeps_the_speed", nfocus_keeps_the_speed },
		{ "nfocus_reconnects", nfocus_reconnects },
		{ "nfocus_rejects_shutdown_while_connected", nfocus_rejects_shutdown_while_connected },
		{ "nfocus_reinitializes", nfocus_reinitializes }
	};
	int result = 1;
	bool started = false, initialized = false;
	HW_CHECK(hw_start() == INDIGO_OK);
	started = true;
	HW_CHECK(hw_attach_client("nFOCUS hardware test") == INDIGO_OK);
	HW_CHECK(indigo_focuser_nfocus(INDIGO_DRIVER_INIT, NULL) == INDIGO_OK);
	initialized = true;
	focuser = hw_wait_for_device(DEVICE_NAME, SHORT_TIMEOUT);
	HW_CHECK(focuser >= 0);
	HW_CHECK(select_port());
	HW_CHECK(hw_connect(focuser, SHORT_TIMEOUT));
	HW_CHECK(focuser_hw_idle(focuser, FOCUSER_STEPS_PROPERTY_NAME, MOVE_TIMEOUT));
	initial_speed = speed();
	state_captured = true;
	result = indigo_run_tests("nFOCUS hardware", tests, ARRAY_SIZE(tests));
cleanup:
	restore_initial_state();
	if (!hw_disconnect(focuser, SHORT_TIMEOUT)) {
		indigo_test_failures++;
	}
	if (initialized && indigo_focuser_nfocus(INDIGO_DRIVER_SHUTDOWN, NULL) != INDIGO_OK) {
		indigo_test_failures++;
	}
	indigo_detach_client(&hw_client);
	if (started) {
		indigo_stop();
	}
	hw_release_properties();
	indigo_test_remove_private_home();
	return indigo_test_failures ? 1 : result;
}
