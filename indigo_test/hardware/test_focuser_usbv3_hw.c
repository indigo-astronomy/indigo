// Copyright (c) 2026 INDIGO initiative
// All rights reserved.
//
// You may use this software under the terms of 'INDIGO Astronomy
// open-source license' (see LICENSE.md).
//
// THIS SOFTWARE IS PROVIDED BY THE AUTHORS 'AS IS' AND ANY EXPRESS
// OR IMPLIED WARRANTIES, INCLUDING, BUT NOT LIMITED TO, THE IMPLIED
// WARRANTIES OF MERCHANTABILITY AND FITNESS FOR A PARTICULAR PURPOSE
// ARE DISCLAIMED. IN NO EVENT SHALL THE AUTHOR BE LIABLE FOR ANY
// DIRECT, INDIRECT, INCIDENTAL, SPECIAL, EXEMPLARY, OR CONSEQUENTIAL
// DAMAGES (INCLUDING, BUT NOT LIMITED TO, PROCUREMENT OF SUBSTITUTE
// GOODS OR SERVICES; LOSS OF USE, DATA, OR PROFITS; OR BUSINESS
// INTERRUPTION) HOWEVER CAUSED AND ON ANY THEORY OF LIABILITY,
// WHETHER IN CONTRACT, STRICT LIABILITY, OR TORT (INCLUDING
// NEGLIGENCE OR OTHERWISE) ARISING IN ANY WAY OUT OF THE USE OF THIS
// SOFTWARE, EVEN IF ADVISED OF THE POSSIBILITY OF SUCH DAMAGE.

// Code is generated by AI

// Opt-in acceptance test for a physically connected USB_Focus v3 focuser. It runs the focuser
// hardware acceptance checklist of DRIVER_TESTING_RULES.md against the real unit: port detection
// and the identity handshake, the configuration the unit reports, the published property
// contract, relative and absolute moves with position readback, the overlapping request, abort,
// speed, step size, travel limit, temperature compensation, reverse motion, automatic mode, a
// disconnect during a move, reconnect and driver INIT/SHUTDOWN.
//
// THE MOTOR PHYSICALLY RUNS. Every move is a few hundred steps around the position the unit
// reported when the session started, every scenario moves back, and the session restores that
// position before it disconnects, so the drawtube ends up where it was found. Nothing is driven
// against the travel limits.
//
// Every setting the run changes - speed, step size, travel limit, compensation, mode and reverse
// motion - is written back to the value the unit reported at the start, and each one is read back
// from the unit over a reconnect, because the driver takes its settings from the SGETAL
// configuration line at connect time.
//
// The port comes from USBV3_HW_PORT. When it is not set the port the driver itself detected
// through its USB match pattern is used.

#include <stdlib.h>
#include <indigo_drivers/focuser_usbv3/indigo_focuser_usbv3.h>
#include "hardware_test_common.h"

#define DEVICE_NAME "USB_Focus v3"

// One serialized transaction over the link plus the driver's own connection work.
#define SHORT_TIMEOUT 15.0
// A move of a few hundred steps plus the completion poll.
#define MOVE_TIMEOUT 60.0

// Driver-defined property names, declared in the generated source rather than in the header.
#define X_FOCUSER_STEP_SIZE_PROPERTY_NAME "X_FOCUSER_STEP_SIZE"
#define X_FOCUSER_FULL_STEP_ITEM_NAME "FULL_STEP"
#define X_FOCUSER_HALF_STEP_ITEM_NAME "HALF_STEP"

#define MOVE_STEPS 200

static int focuser = -1;
static const char *serial_port = NULL;
// The configuration the unit reported when the session connected for the first time. Every
// scenario restores what it changes, and the session restores the position at the end.
static double initial_position, initial_speed, initial_limit, initial_compensation, initial_threshold;
static bool initial_full_step, initial_reverse;
static char initial_firmware[INDIGO_VALUE_SIZE];

static bool select_port(void) {
	if (serial_port == NULL || !*serial_port) {
		char detected[INDIGO_VALUE_SIZE] = "";
		if (hw_text_item(focuser, DEVICE_PORT_PROPERTY_NAME, DEVICE_PORT_ITEM_NAME, detected, sizeof(detected)) && *detected) {
			printf("Using the port the driver detected: %s\n", detected);
			return true;
		}
		fprintf(stderr, "    no serial port was detected, set USBV3_HW_PORT\n");
		return false;
	}
	printf("Using port %s\n", serial_port);
	return hw_set_text(focuser, DEVICE_PORT_PROPERTY_NAME, DEVICE_PORT_ITEM_NAME, serial_port, INDIGO_OK_STATE, SHORT_TIMEOUT);
}

static double position(void) {
	double value = -1;
	hw_number_item(focuser, FOCUSER_POSITION_PROPERTY_NAME, FOCUSER_POSITION_ITEM_NAME, &value);
	return value;
}

// An absolute move, waited out to its published completion.
static bool move_to(double target) {
	unsigned before = hw_revision(focuser, FOCUSER_POSITION_PROPERTY_NAME);
	hw_request_number(focuser, FOCUSER_POSITION_PROPERTY_NAME, FOCUSER_POSITION_ITEM_NAME, target);
	if (!hw_wait_state(focuser, FOCUSER_POSITION_PROPERTY_NAME, before, INDIGO_OK_STATE, MOVE_TIMEOUT)) {
		return false;
	}
	if (position() != target) {
		fprintf(stderr, "    position is %g after a move to %g\n", position(), target);
		return false;
	}
	return true;
}

// A relative move in the given direction, waited out to its published completion.
static bool move_by(const char *direction, double steps) {
	if (!hw_set_switch(focuser, FOCUSER_DIRECTION_PROPERTY_NAME, direction, INDIGO_OK_STATE, SHORT_TIMEOUT)) {
		return false;
	}
	unsigned before = hw_revision(focuser, FOCUSER_STEPS_PROPERTY_NAME);
	hw_request_number(focuser, FOCUSER_STEPS_PROPERTY_NAME, FOCUSER_STEPS_ITEM_NAME, steps);
	return hw_wait_state(focuser, FOCUSER_STEPS_PROPERTY_NAME, before, INDIGO_OK_STATE, MOVE_TIMEOUT);
}

// The driver reads every setting from the unit's SGETAL configuration line when it connects, so a
// setting is only proven to have reached the unit once it comes back over a reconnect.
static bool reconnect(void) {
	return hw_disconnect(focuser, SHORT_TIMEOUT) && hw_connect(focuser, SHORT_TIMEOUT);
}

static void usbv3_reports_identity_and_capabilities(void) {
	char model[INDIGO_VALUE_SIZE] = "", firmware[INDIGO_VALUE_SIZE] = "", port[INDIGO_VALUE_SIZE] = "";
	ASSERT_TRUE((hw_device_interface(focuser) & INDIGO_INTERFACE_FOCUSER) != 0);
	ASSERT_STREQ(DEVICE_NAME, hw_device_name(focuser));
	ASSERT_TRUE(hw_text_item(focuser, INFO_PROPERTY_NAME, INFO_DEVICE_MODEL_ITEM_NAME, model, sizeof(model)));
	ASSERT_TRUE(hw_text_item(focuser, INFO_PROPERTY_NAME, INFO_DEVICE_FW_REVISION_ITEM_NAME, firmware, sizeof(firmware)));
	// Both come from the unit's own configuration line, so the attach-time placeholder means the
	// identity was never read.
	ASSERT_TRUE(*model && strcmp(model, "Unknown"));
	ASSERT_TRUE(*firmware && strcmp(firmware, "Unknown"));
	ASSERT_TRUE(atoi(firmware) > 0);
	snprintf(initial_firmware, sizeof(initial_firmware), "%s", firmware);
	ASSERT_TRUE(hw_text_item(focuser, DEVICE_PORT_PROPERTY_NAME, DEVICE_PORT_ITEM_NAME, port, sizeof(port)));
	printf("    %s firmware %s on %s, position %g, speed %g, limit %g\n", model, firmware, port, initial_position, initial_speed, initial_limit);
	ASSERT_EQ_INT(1, hw_device_count());
}

static void usbv3_publishes_the_property_contract(void) {
	double value = -1, min = -1, max = -1;
	bool selected = false;
	ASSERT_TRUE(hw_property_defined(focuser, FOCUSER_POSITION_PROPERTY_NAME));
	ASSERT_TRUE(hw_property_defined(focuser, FOCUSER_STEPS_PROPERTY_NAME));
	ASSERT_TRUE(hw_property_defined(focuser, FOCUSER_DIRECTION_PROPERTY_NAME));
	ASSERT_TRUE(hw_property_defined(focuser, FOCUSER_ABORT_MOTION_PROPERTY_NAME));
	ASSERT_TRUE(hw_property_defined(focuser, FOCUSER_SPEED_PROPERTY_NAME));
	ASSERT_TRUE(hw_property_defined(focuser, FOCUSER_LIMITS_PROPERTY_NAME));
	ASSERT_TRUE(hw_property_defined(focuser, FOCUSER_TEMPERATURE_PROPERTY_NAME));
	ASSERT_TRUE(hw_property_defined(focuser, FOCUSER_COMPENSATION_PROPERTY_NAME));
	ASSERT_TRUE(hw_property_defined(focuser, FOCUSER_MODE_PROPERTY_NAME));
	ASSERT_TRUE(hw_property_defined(focuser, FOCUSER_REVERSE_MOTION_PROPERTY_NAME));
	ASSERT_TRUE(hw_property_defined(focuser, X_FOCUSER_STEP_SIZE_PROPERTY_NAME));
	ASSERT_TRUE(hw_property_defined(focuser, DEVICE_PORT_PROPERTY_NAME));
	ASSERT_TRUE(hw_property_hidden(focuser, SIMULATION_PROPERTY_NAME));
	// The speed is the unit's own 1 to 8 scale and the steps are its 16 bit range.
	ASSERT_TRUE(hw_number_item_range(focuser, FOCUSER_SPEED_PROPERTY_NAME, FOCUSER_SPEED_ITEM_NAME, &min, &max));
	ASSERT_TRUE(min == 1 && max == 8);
	ASSERT_TRUE(hw_number_item_range(focuser, FOCUSER_STEPS_PROPERTY_NAME, FOCUSER_STEPS_ITEM_NAME, &min, &max));
	ASSERT_TRUE(min == 1 && max == 65535);
	ASSERT_TRUE(hw_number_item_range(focuser, FOCUSER_COMPENSATION_PROPERTY_NAME, FOCUSER_COMPENSATION_ITEM_NAME, &min, &max));
	ASSERT_TRUE(min == -999 && max == 999);
	ASSERT_TRUE(hw_number_item_range(focuser, FOCUSER_COMPENSATION_PROPERTY_NAME, FOCUSER_COMPENSATION_THRESHOLD_ITEM_NAME, &min, &max));
	ASSERT_TRUE(min == 0 && max == 5);
	ASSERT_TRUE(hw_number_item_range(focuser, FOCUSER_LIMITS_PROPERTY_NAME, FOCUSER_LIMITS_MAX_POSITION_ITEM_NAME, &min, &max));
	ASSERT_TRUE(min == 0 && max == 65535);
	// The travel limit the unit reports is the one a move is clamped to.
	ASSERT_TRUE(hw_number_item(focuser, FOCUSER_LIMITS_PROPERTY_NAME, FOCUSER_LIMITS_MAX_POSITION_ITEM_NAME, &value));
	ASSERT_TRUE(value > 0);
	ASSERT_TRUE(hw_switch_item(focuser, X_FOCUSER_STEP_SIZE_PROPERTY_NAME, X_FOCUSER_FULL_STEP_ITEM_NAME, &selected));
}

static void usbv3_reads_the_temperature(void) {
	double temperature = 0;
	// The unit reports a signed temperature with two decimals, polled by the driver's own timer,
	// whose first reading lands a few milliseconds after the connection is published.
	double deadline = indigo_monotonic_time() + SHORT_TIMEOUT;
	while (indigo_monotonic_time() < deadline && temperature == 0) {
		hw_number_item(focuser, FOCUSER_TEMPERATURE_PROPERTY_NAME, FOCUSER_TEMPERATURE_ITEM_NAME, &temperature);
		indigo_usleep(20000);
	}
	ASSERT_TRUE(hw_number_item(focuser, FOCUSER_TEMPERATURE_PROPERTY_NAME, FOCUSER_TEMPERATURE_ITEM_NAME, &temperature));
	printf("    temperature %.2f C\n", temperature);
	ASSERT_TRUE(temperature > -50 && temperature < 80);
	ASSERT_TRUE(temperature != 0);
}

static void usbv3_moves_relative_in_both_directions(void) {
	double start = position();
	hw_forget_states();
	ASSERT_TRUE(move_by(FOCUSER_DIRECTION_MOVE_OUTWARD_ITEM_NAME, MOVE_STEPS));
	// A move is advertised BUSY and the position it reaches is the one the unit reports.
	ASSERT_TRUE((hw_states_seen(focuser, FOCUSER_POSITION_PROPERTY_NAME) & (1u << INDIGO_BUSY_STATE)) != 0);
	printf("    outward %d steps: %g -> %g\n", MOVE_STEPS, start, position());
	ASSERT_TRUE(position() == start + MOVE_STEPS);
	ASSERT_TRUE(move_by(FOCUSER_DIRECTION_MOVE_INWARD_ITEM_NAME, MOVE_STEPS));
	printf("    inward %d steps: back to %g\n", MOVE_STEPS, position());
	ASSERT_TRUE(position() == start);
}

static void usbv3_moves_to_an_absolute_position(void) {
	double start = position();
	ASSERT_TRUE(move_to(start + MOVE_STEPS));
	ASSERT_TRUE(move_to(start));
	// A move to the position the unit is already at is accepted and changes nothing.
	ASSERT_TRUE(move_to(start));
	ASSERT_TRUE(position() == start);
}

static void usbv3_rejects_an_overlapping_move(void) {
	double start = position();
	unsigned before = hw_revision(focuser, FOCUSER_POSITION_PROPERTY_NAME);
	hw_request_number(focuser, FOCUSER_POSITION_PROPERTY_NAME, FOCUSER_POSITION_ITEM_NAME, start + 3 * MOVE_STEPS);
	ASSERT_TRUE(hw_wait_settled(focuser, FOCUSER_POSITION_PROPERTY_NAME, INDIGO_BUSY_STATE, SHORT_TIMEOUT));
	// The driver refuses a second motion request while one is running, with its own message.
	ASSERT_TRUE(hw_set_number(focuser, FOCUSER_STEPS_PROPERTY_NAME, FOCUSER_STEPS_ITEM_NAME, MOVE_STEPS, INDIGO_ALERT_STATE, SHORT_TIMEOUT));
	ASSERT_TRUE(hw_wait_state(focuser, FOCUSER_POSITION_PROPERTY_NAME, before, INDIGO_OK_STATE, MOVE_TIMEOUT));
	ASSERT_TRUE(position() == start + 3 * MOVE_STEPS);
	ASSERT_TRUE(move_to(start));
}

static void usbv3_aborts_a_move(void) {
	double start = position(), stopped = 0;
	unsigned before = hw_revision(focuser, FOCUSER_POSITION_PROPERTY_NAME);
	hw_request_number(focuser, FOCUSER_POSITION_PROPERTY_NAME, FOCUSER_POSITION_ITEM_NAME, start + 10 * MOVE_STEPS);
	ASSERT_TRUE(hw_wait_settled(focuser, FOCUSER_POSITION_PROPERTY_NAME, INDIGO_BUSY_STATE, SHORT_TIMEOUT));
	indigo_usleep(500000);
	ASSERT_TRUE(hw_set_switch(focuser, FOCUSER_ABORT_MOTION_PROPERTY_NAME, FOCUSER_ABORT_MOTION_ITEM_NAME, INDIGO_OK_STATE, SHORT_TIMEOUT));
	// The abort stops the motor and reports the move as failed, not as completed, and the position
	// it publishes afterwards is the one the unit actually stands at.
	ASSERT_TRUE(hw_wait_state(focuser, FOCUSER_POSITION_PROPERTY_NAME, before, INDIGO_ALERT_STATE, MOVE_TIMEOUT));
	stopped = position();
	printf("    aborted at %g after starting from %g\n", stopped, start);
	ASSERT_TRUE(stopped > start && stopped < start + 10 * MOVE_STEPS);
	// A fresh move works right away and the unit agrees about where it is.
	ASSERT_TRUE(move_to(start));
	ASSERT_TRUE(reconnect());
	ASSERT_TRUE(position() == start);
}

static void usbv3_changes_the_speed(void) {
	double speed = -1, restored = initial_speed == 8 ? 7 : initial_speed + 1;
	ASSERT_TRUE(hw_set_number(focuser, FOCUSER_SPEED_PROPERTY_NAME, FOCUSER_SPEED_ITEM_NAME, restored, INDIGO_OK_STATE, SHORT_TIMEOUT));
	// The unit keeps the speed in its own configuration, so the reconnect proves the command
	// reached it instead of only the property.
	ASSERT_TRUE(reconnect());
	ASSERT_TRUE(hw_number_item(focuser, FOCUSER_SPEED_PROPERTY_NAME, FOCUSER_SPEED_ITEM_NAME, &speed));
	printf("    speed %g came back as %g\n", restored, speed);
	ASSERT_TRUE(speed == restored);
	ASSERT_TRUE(hw_set_number(focuser, FOCUSER_SPEED_PROPERTY_NAME, FOCUSER_SPEED_ITEM_NAME, initial_speed, INDIGO_OK_STATE, SHORT_TIMEOUT));
	ASSERT_TRUE(reconnect());
	ASSERT_TRUE(hw_number_item(focuser, FOCUSER_SPEED_PROPERTY_NAME, FOCUSER_SPEED_ITEM_NAME, &speed));
	ASSERT_TRUE(speed == initial_speed);
}

static void usbv3_changes_the_step_size(void) {
	bool full = false;
	ASSERT_TRUE(hw_set_switch(focuser, X_FOCUSER_STEP_SIZE_PROPERTY_NAME, initial_full_step ? X_FOCUSER_HALF_STEP_ITEM_NAME : X_FOCUSER_FULL_STEP_ITEM_NAME, INDIGO_OK_STATE, SHORT_TIMEOUT));
	ASSERT_TRUE(reconnect());
	ASSERT_TRUE(hw_switch_item(focuser, X_FOCUSER_STEP_SIZE_PROPERTY_NAME, X_FOCUSER_FULL_STEP_ITEM_NAME, &full));
	printf("    step size switched from %s to %s\n", initial_full_step ? "full" : "half", full ? "full" : "half");
	ASSERT_TRUE(full != initial_full_step);
	// The motor runs with the changed step size as well.
	ASSERT_TRUE(move_by(FOCUSER_DIRECTION_MOVE_OUTWARD_ITEM_NAME, MOVE_STEPS));
	ASSERT_TRUE(move_by(FOCUSER_DIRECTION_MOVE_INWARD_ITEM_NAME, MOVE_STEPS));
	ASSERT_TRUE(hw_set_switch(focuser, X_FOCUSER_STEP_SIZE_PROPERTY_NAME, initial_full_step ? X_FOCUSER_FULL_STEP_ITEM_NAME : X_FOCUSER_HALF_STEP_ITEM_NAME, INDIGO_OK_STATE, SHORT_TIMEOUT));
	ASSERT_TRUE(reconnect());
	ASSERT_TRUE(hw_switch_item(focuser, X_FOCUSER_STEP_SIZE_PROPERTY_NAME, X_FOCUSER_FULL_STEP_ITEM_NAME, &full));
	ASSERT_TRUE(full == initial_full_step);
}

static void usbv3_changes_the_travel_limit(void) {
	double limit = -1, narrowed = position() + 2 * MOVE_STEPS;
	ASSERT_TRUE(hw_set_number(focuser, FOCUSER_LIMITS_PROPERTY_NAME, FOCUSER_LIMITS_MAX_POSITION_ITEM_NAME, narrowed, INDIGO_OK_STATE, SHORT_TIMEOUT));
	ASSERT_TRUE(reconnect());
	ASSERT_TRUE(hw_number_item(focuser, FOCUSER_LIMITS_PROPERTY_NAME, FOCUSER_LIMITS_MAX_POSITION_ITEM_NAME, &limit));
	printf("    travel limit %g came back as %g\n", narrowed, limit);
	ASSERT_TRUE(limit == narrowed);
	// A move beyond the limit is clamped to it rather than refused or run past it.
	ASSERT_TRUE(move_to(narrowed + 500) || position() == narrowed);
	ASSERT_TRUE(position() == narrowed);
	ASSERT_TRUE(hw_set_number(focuser, FOCUSER_LIMITS_PROPERTY_NAME, FOCUSER_LIMITS_MAX_POSITION_ITEM_NAME, initial_limit, INDIGO_OK_STATE, SHORT_TIMEOUT));
	ASSERT_TRUE(reconnect());
	ASSERT_TRUE(hw_number_item(focuser, FOCUSER_LIMITS_PROPERTY_NAME, FOCUSER_LIMITS_MAX_POSITION_ITEM_NAME, &limit));
	ASSERT_TRUE(limit == initial_limit);
	ASSERT_TRUE(move_to(initial_position));
}

static void usbv3_changes_the_temperature_compensation(void) {
	double compensation = -1, threshold = -1;
	double wanted = initial_compensation >= 0 ? -12 : 12, wanted_threshold = initial_threshold == 3 ? 2 : 3;
	// The sign of the compensation is a command of its own on this unit, so a negative value
	// exercises a different path than a positive one.
	unsigned before = hw_revision(focuser, FOCUSER_COMPENSATION_PROPERTY_NAME);
	indigo_change_number_property_1(&hw_client, hw_device_name(focuser), FOCUSER_COMPENSATION_PROPERTY_NAME, FOCUSER_COMPENSATION_ITEM_NAME, wanted);
	ASSERT_TRUE(hw_wait_state(focuser, FOCUSER_COMPENSATION_PROPERTY_NAME, before, INDIGO_OK_STATE, SHORT_TIMEOUT));
	ASSERT_TRUE(hw_set_number(focuser, FOCUSER_COMPENSATION_PROPERTY_NAME, FOCUSER_COMPENSATION_THRESHOLD_ITEM_NAME, wanted_threshold, INDIGO_OK_STATE, SHORT_TIMEOUT));
	ASSERT_TRUE(reconnect());
	ASSERT_TRUE(hw_number_item(focuser, FOCUSER_COMPENSATION_PROPERTY_NAME, FOCUSER_COMPENSATION_ITEM_NAME, &compensation));
	ASSERT_TRUE(hw_number_item(focuser, FOCUSER_COMPENSATION_PROPERTY_NAME, FOCUSER_COMPENSATION_THRESHOLD_ITEM_NAME, &threshold));
	printf("    compensation %g/%g came back as %g/%g\n", wanted, wanted_threshold, compensation, threshold);
	ASSERT_TRUE(compensation == wanted);
	ASSERT_TRUE(threshold == wanted_threshold);
	before = hw_revision(focuser, FOCUSER_COMPENSATION_PROPERTY_NAME);
	indigo_change_number_property_1(&hw_client, hw_device_name(focuser), FOCUSER_COMPENSATION_PROPERTY_NAME, FOCUSER_COMPENSATION_ITEM_NAME, initial_compensation);
	ASSERT_TRUE(hw_wait_state(focuser, FOCUSER_COMPENSATION_PROPERTY_NAME, before, INDIGO_OK_STATE, SHORT_TIMEOUT));
	ASSERT_TRUE(hw_set_number(focuser, FOCUSER_COMPENSATION_PROPERTY_NAME, FOCUSER_COMPENSATION_THRESHOLD_ITEM_NAME, initial_threshold, INDIGO_OK_STATE, SHORT_TIMEOUT));
	ASSERT_TRUE(reconnect());
	ASSERT_TRUE(hw_number_item(focuser, FOCUSER_COMPENSATION_PROPERTY_NAME, FOCUSER_COMPENSATION_ITEM_NAME, &compensation));
	ASSERT_TRUE(compensation == initial_compensation);
}

static void usbv3_switches_to_automatic_mode_and_back(void) {
	double temperature = 0;
	bool manual = false;
	// Automatic mode hands the unit its own temperature compensation and stops the driver's
	// polling; manual mode takes the compensation back and starts polling again. That the polling
	// runs again cannot be asserted from a new temperature reading: the framework drops an update
	// that changes nothing, and the unit sits at the same hundredth of a degree for minutes, so a
	// run would depend on the room warming up. What a client can see is the mode itself, the
	// reading the driver keeps, and that the unit still answers.
	ASSERT_TRUE(hw_set_switch(focuser, FOCUSER_MODE_PROPERTY_NAME, FOCUSER_MODE_AUTOMATIC_ITEM_NAME, INDIGO_OK_STATE, SHORT_TIMEOUT));
	ASSERT_TRUE(hw_set_switch(focuser, FOCUSER_MODE_PROPERTY_NAME, FOCUSER_MODE_MANUAL_ITEM_NAME, INDIGO_OK_STATE, SHORT_TIMEOUT));
	ASSERT_TRUE(hw_switch_item(focuser, FOCUSER_MODE_PROPERTY_NAME, FOCUSER_MODE_MANUAL_ITEM_NAME, &manual));
	ASSERT_TRUE(manual);
	ASSERT_TRUE(hw_number_item(focuser, FOCUSER_TEMPERATURE_PROPERTY_NAME, FOCUSER_TEMPERATURE_ITEM_NAME, &temperature));
	ASSERT_TRUE(temperature > -50 && temperature < 80);
	// The unit still moves after the mode roundtrip.
	ASSERT_TRUE(move_by(FOCUSER_DIRECTION_MOVE_OUTWARD_ITEM_NAME, MOVE_STEPS));
	ASSERT_TRUE(move_by(FOCUSER_DIRECTION_MOVE_INWARD_ITEM_NAME, MOVE_STEPS));
}

static void usbv3_reverses_the_motion(void) {
	double start = position();
	ASSERT_TRUE(hw_set_switch(focuser, FOCUSER_REVERSE_MOTION_PROPERTY_NAME, initial_reverse ? FOCUSER_REVERSE_MOTION_DISABLED_ITEM_NAME : FOCUSER_REVERSE_MOTION_ENABLED_ITEM_NAME, INDIGO_OK_STATE, SHORT_TIMEOUT));
	// The same relative request now runs the other way, which is what reversing means for a
	// focuser whose position is counted by the unit.
	ASSERT_TRUE(move_by(FOCUSER_DIRECTION_MOVE_OUTWARD_ITEM_NAME, MOVE_STEPS));
	printf("    reversed outward move: %g -> %g\n", start, position());
	ASSERT_TRUE(position() == start - MOVE_STEPS);
	ASSERT_TRUE(move_by(FOCUSER_DIRECTION_MOVE_INWARD_ITEM_NAME, MOVE_STEPS));
	ASSERT_TRUE(position() == start);
	ASSERT_TRUE(hw_set_switch(focuser, FOCUSER_REVERSE_MOTION_PROPERTY_NAME, initial_reverse ? FOCUSER_REVERSE_MOTION_ENABLED_ITEM_NAME : FOCUSER_REVERSE_MOTION_DISABLED_ITEM_NAME, INDIGO_OK_STATE, SHORT_TIMEOUT));
	ASSERT_TRUE(move_by(FOCUSER_DIRECTION_MOVE_OUTWARD_ITEM_NAME, MOVE_STEPS));
	ASSERT_TRUE(position() == start + MOVE_STEPS);
	ASSERT_TRUE(move_to(start));
}

static void usbv3_survives_a_disconnect_during_a_move(void) {
	double start = position();
	hw_request_number(focuser, FOCUSER_POSITION_PROPERTY_NAME, FOCUSER_POSITION_ITEM_NAME, start + 10 * MOVE_STEPS);
	ASSERT_TRUE(hw_wait_settled(focuser, FOCUSER_POSITION_PROPERTY_NAME, INDIGO_BUSY_STATE, SHORT_TIMEOUT));
	indigo_usleep(500000);
	// The disconnect stops the motor through the unit's own quit command instead of waiting for
	// the move, and the reconnect has to find the unit where it stopped.
	ASSERT_TRUE(hw_disconnect(focuser, SHORT_TIMEOUT));
	ASSERT_TRUE(hw_connect(focuser, SHORT_TIMEOUT));
	ASSERT_TRUE(hw_property_state(focuser, FOCUSER_POSITION_PROPERTY_NAME) != INDIGO_BUSY_STATE);
	printf("    the unit stopped at %g and reconnected there\n", position());
	ASSERT_TRUE(position() > start && position() < start + 10 * MOVE_STEPS);
	ASSERT_TRUE(move_to(start));
}

static void usbv3_reconnects(void) {
	char firmware[INDIGO_VALUE_SIZE] = "";
	ASSERT_TRUE(hw_disconnect(focuser, SHORT_TIMEOUT));
	// Disconnecting an already disconnected device is tolerated: the request is a no-op the driver
	// answers without an ALERT, so there is no new revision to wait for.
	hw_request_switch(focuser, CONNECTION_PROPERTY_NAME, CONNECTION_DISCONNECTED_ITEM_NAME, true);
	indigo_usleep(500000);
	ASSERT_EQ_INT(INDIGO_OK_STATE, hw_property_state(focuser, CONNECTION_PROPERTY_NAME));
	ASSERT_TRUE(!hw_connected(focuser));
	ASSERT_TRUE(hw_connect(focuser, SHORT_TIMEOUT));
	ASSERT_TRUE(hw_text_item(focuser, INFO_PROPERTY_NAME, INFO_DEVICE_FW_REVISION_ITEM_NAME, firmware, sizeof(firmware)));
	ASSERT_STREQ(initial_firmware, firmware);
	ASSERT_TRUE(move_by(FOCUSER_DIRECTION_MOVE_OUTWARD_ITEM_NAME, MOVE_STEPS));
	ASSERT_TRUE(move_by(FOCUSER_DIRECTION_MOVE_INWARD_ITEM_NAME, MOVE_STEPS));
}

static void usbv3_reinitializes(void) {
	ASSERT_TRUE(hw_connect(focuser, SHORT_TIMEOUT));
	// A driver with a connected device must refuse to shut down instead of pulling the port out
	// from under its client.
	ASSERT_EQ_INT(INDIGO_BUSY, indigo_focuser_usbv3(INDIGO_DRIVER_SHUTDOWN, NULL));
	ASSERT_TRUE(hw_disconnect(focuser, SHORT_TIMEOUT));
	ASSERT_EQ_INT(INDIGO_OK, indigo_focuser_usbv3(INDIGO_DRIVER_SHUTDOWN, NULL));
	ASSERT_EQ_INT(INDIGO_OK, indigo_focuser_usbv3(INDIGO_DRIVER_INIT, NULL));
	focuser = hw_wait_for_device(DEVICE_NAME, SHORT_TIMEOUT);
	ASSERT_TRUE(focuser >= 0);
	ASSERT_TRUE(select_port());
	ASSERT_TRUE(hw_connect(focuser, SHORT_TIMEOUT));
	ASSERT_TRUE(position() == initial_position);
	ASSERT_TRUE(move_by(FOCUSER_DIRECTION_MOVE_OUTWARD_ITEM_NAME, MOVE_STEPS));
	ASSERT_TRUE(move_by(FOCUSER_DIRECTION_MOVE_INWARD_ITEM_NAME, MOVE_STEPS));
}

// Reads the configuration the unit came up with, so every scenario can put back what it changes.
static bool capture_initial_state(void) {
	bool full = false, reverse = false;
	if (!hw_number_item(focuser, FOCUSER_POSITION_PROPERTY_NAME, FOCUSER_POSITION_ITEM_NAME, &initial_position)) {
		return false;
	}
	if (!hw_number_item(focuser, FOCUSER_SPEED_PROPERTY_NAME, FOCUSER_SPEED_ITEM_NAME, &initial_speed)) {
		return false;
	}
	if (!hw_number_item(focuser, FOCUSER_LIMITS_PROPERTY_NAME, FOCUSER_LIMITS_MAX_POSITION_ITEM_NAME, &initial_limit)) {
		return false;
	}
	if (!hw_number_item(focuser, FOCUSER_COMPENSATION_PROPERTY_NAME, FOCUSER_COMPENSATION_ITEM_NAME, &initial_compensation)) {
		return false;
	}
	if (!hw_number_item(focuser, FOCUSER_COMPENSATION_PROPERTY_NAME, FOCUSER_COMPENSATION_THRESHOLD_ITEM_NAME, &initial_threshold)) {
		return false;
	}
	if (!hw_switch_item(focuser, X_FOCUSER_STEP_SIZE_PROPERTY_NAME, X_FOCUSER_FULL_STEP_ITEM_NAME, &full)) {
		return false;
	}
	if (!hw_switch_item(focuser, FOCUSER_REVERSE_MOTION_PROPERTY_NAME, FOCUSER_REVERSE_MOTION_ENABLED_ITEM_NAME, &reverse)) {
		return false;
	}
	initial_full_step = full;
	initial_reverse = reverse;
	return true;
}

// Puts back everything the scenarios change, so a run that stops halfway does not leave the unit
// with a narrowed travel limit or a different speed for the next one. The position goes last,
// because it depends on the travel limit being back.
static void restore_initial_state(void) {
	if (focuser < 0 || !hw_connect(focuser, SHORT_TIMEOUT)) {
		return;
	}
	hw_set_number(focuser, FOCUSER_LIMITS_PROPERTY_NAME, FOCUSER_LIMITS_MAX_POSITION_ITEM_NAME, initial_limit, INDIGO_OK_STATE, SHORT_TIMEOUT);
	hw_set_number(focuser, FOCUSER_SPEED_PROPERTY_NAME, FOCUSER_SPEED_ITEM_NAME, initial_speed, INDIGO_OK_STATE, SHORT_TIMEOUT);
	indigo_change_number_property_1(&hw_client, hw_device_name(focuser), FOCUSER_COMPENSATION_PROPERTY_NAME, FOCUSER_COMPENSATION_ITEM_NAME, initial_compensation);
	hw_set_number(focuser, FOCUSER_COMPENSATION_PROPERTY_NAME, FOCUSER_COMPENSATION_THRESHOLD_ITEM_NAME, initial_threshold, INDIGO_OK_STATE, SHORT_TIMEOUT);
	hw_set_switch(focuser, X_FOCUSER_STEP_SIZE_PROPERTY_NAME, initial_full_step ? X_FOCUSER_FULL_STEP_ITEM_NAME : X_FOCUSER_HALF_STEP_ITEM_NAME, INDIGO_OK_STATE, SHORT_TIMEOUT);
	hw_set_switch(focuser, FOCUSER_REVERSE_MOTION_PROPERTY_NAME, initial_reverse ? FOCUSER_REVERSE_MOTION_ENABLED_ITEM_NAME : FOCUSER_REVERSE_MOTION_DISABLED_ITEM_NAME, INDIGO_OK_STATE, SHORT_TIMEOUT);
	hw_set_switch(focuser, FOCUSER_MODE_PROPERTY_NAME, FOCUSER_MODE_MANUAL_ITEM_NAME, INDIGO_OK_STATE, SHORT_TIMEOUT);
	if (move_to(initial_position)) {
		printf("Restored position %g, speed %g, travel limit %g\n", initial_position, initial_speed, initial_limit);
	}
}

int main(int argc, char **argv) {
	if (argc < 2 || strcmp(argv[1], "--run")) {
		fprintf(stderr, "Physical USB_Focus v3 test: run explicitly with --run (or make test-focuser-usbv3-hw).\n");
		return 2;
	}
	setvbuf(stdout, NULL, _IONBF, 0);
	for (int i = 2; i < argc; i++) {
		if (!strcmp(argv[i], "--debug")) {
			indigo_set_log_level(INDIGO_LOG_DEBUG);
		}
	}
	// FOCUSER_REVERSE_MOTION is persistent, so the session keeps its configuration out of the
	// user's own folder.
	if (!indigo_test_use_private_home()) {
		return 1;
	}
	serial_port = getenv("USBV3_HW_PORT");
	const indigo_test_case tests[] = {
		{ "usbv3_reports_identity_and_capabilities", usbv3_reports_identity_and_capabilities },
		{ "usbv3_publishes_the_property_contract", usbv3_publishes_the_property_contract },
		{ "usbv3_reads_the_temperature", usbv3_reads_the_temperature },
		{ "usbv3_moves_relative_in_both_directions", usbv3_moves_relative_in_both_directions },
		{ "usbv3_moves_to_an_absolute_position", usbv3_moves_to_an_absolute_position },
		{ "usbv3_rejects_an_overlapping_move", usbv3_rejects_an_overlapping_move },
		{ "usbv3_aborts_a_move", usbv3_aborts_a_move },
		{ "usbv3_changes_the_speed", usbv3_changes_the_speed },
		{ "usbv3_changes_the_step_size", usbv3_changes_the_step_size },
		{ "usbv3_changes_the_travel_limit", usbv3_changes_the_travel_limit },
		{ "usbv3_changes_the_temperature_compensation", usbv3_changes_the_temperature_compensation },
		{ "usbv3_switches_to_automatic_mode_and_back", usbv3_switches_to_automatic_mode_and_back },
		{ "usbv3_reverses_the_motion", usbv3_reverses_the_motion },
		{ "usbv3_survives_a_disconnect_during_a_move", usbv3_survives_a_disconnect_during_a_move },
		{ "usbv3_reconnects", usbv3_reconnects },
		{ "usbv3_reinitializes", usbv3_reinitializes }
	};
	int result = 1;
	bool started = false, initialized = false;
	HW_CHECK(indigo_start() == INDIGO_OK);
	started = true;
	HW_CHECK(hw_attach_client("USB_Focus v3 hardware test") == INDIGO_OK);
	HW_CHECK(indigo_focuser_usbv3(INDIGO_DRIVER_INIT, NULL) == INDIGO_OK);
	initialized = true;
	focuser = hw_wait_for_device(DEVICE_NAME, SHORT_TIMEOUT);
	HW_CHECK(focuser >= 0);
	HW_CHECK(select_port());
	HW_CHECK(hw_connect(focuser, SHORT_TIMEOUT));
	HW_CHECK(capture_initial_state());
	result = indigo_run_tests("USB_Focus v3 hardware", tests, ARRAY_SIZE(tests));
cleanup:
	// Leave the unit exactly as the session found it, whatever happened above.
	restore_initial_state();
	if (!hw_disconnect(focuser, SHORT_TIMEOUT)) {
		indigo_test_failures++;
	}
	if (initialized && indigo_focuser_usbv3(INDIGO_DRIVER_SHUTDOWN, NULL) != INDIGO_OK) {
		indigo_test_failures++;
	}
	indigo_detach_client(&hw_client);
	if (started) {
		indigo_stop();
	}
	hw_release_properties();
	indigo_test_remove_private_home();
	return indigo_test_failures ? 1 : result;
}
