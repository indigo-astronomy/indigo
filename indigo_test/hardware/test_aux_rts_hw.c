// Copyright (c) 2026 INDIGO initiative
// All rights reserved.
//
// You may use this software under the terms of 'INDIGO Astronomy
// open-source license' (see LICENSE.md).
//
// THIS SOFTWARE IS PROVIDED BY THE AUTHORS 'AS IS' AND ANY EXPRESS
// OR IMPLIED WARRANTIES, INCLUDING, BUT NOT LIMITED TO, THE IMPLIED
// WARRANTIES OF MERCHANTABILITY AND FITNESS FOR A PARTICULAR PURPOSE
// ARE DISCLAIMED. IN NO EVENT SHALL THE AUTHOR BE LIABLE FOR ANY
// DIRECT, INDIRECT, INCIDENTAL, SPECIAL, EXEMPLARY, OR CONSEQUENTIAL
// DAMAGES (INCLUDING, BUT NOT LIMITED TO, PROCUREMENT OF SUBSTITUTE
// GOODS OR SERVICES; LOSS OF USE, DATA, OR PROFITS; OR BUSINESS
// INTERRUPTION) HOWEVER CAUSED AND ON ANY THEORY OF LIABILITY,
// WHETHER IN CONTRACT, STRICT LIABILITY, OR TORT (INCLUDING
// NEGLIGENCE OR OTHERWISE) ARISING IN ANY WAY OUT OF THE USE OF THIS
// SOFTWARE, EVEN IF ADVISED OF THE POSSIBILITY OF SUCH DAMAGE.

// Code is generated by AI

// Opt-in acceptance test for the RTS-on-COM shutter release against a physical serial loopback:
// two USB serial adapters joined by a serial cable. The driver drives RTS on the first adapter,
// which is the whole device interaction, and the second adapter reads that line back. The shutter
// is therefore measured electrically, on a clock that is not the driver's own, which is the one
// thing indigo_test/integration/test_aux_rts_shutter.c structurally cannot do: it replaces
// indigo_uni_open_serial(), indigo_uni_close() and indigo_uni_set_rts() at compile time, so it
// sees only the calls the driver makes and never what the serial port actually does.
//
// No shutter release is wired to the adapter. What the driver opens and closes here is a modem
// control line, which is exactly what it would do with a camera on the other end.
//
// The two ports come from AUX_RTS_HW_PORT and AUX_RTS_HW_MONITOR_PORT and both are required. The
// suite never goes looking for them on its own: finding a loopback by toggling RTS on every
// serial port of the host would also toggle it on a mount or a focuser that happens to be
// plugged in. Prefer the stable /dev/serial/by-id/... names, because the unplug scenario relies
// on the port coming back under the name it left.
//
// Which input of the monitor carries the driver's RTS depends on the cable, so the suite works it
// out before the driver owns the port rather than assuming a wiring. A full-handshake null modem
// puts RTS on CTS; the cable this was developed against puts it on DCD. A straight-through
// extension cable joins two outputs and carries nothing, and the calibration says so instead of
// failing later as a timeout.
//
// The monitor side reads the line with a raw TIOCMGET. indigo_uni_io exposes indigo_uni_get_cts()
// only, which cannot see a line the cable delivers as DCD, and extending the portable I/O layer
// for a test host belongs to a separate change. This is test code on the observing side of the
// cable, never driver code: the driver under test keeps using the portable API throughout.
//
// The unplug scenario is opt-in through --hotplug. It pulls the driver's adapter in the middle of
// an exposure, which is the one failure a shutter release must not answer by latching the shutter
// open.

#include <fcntl.h>
#include <termios.h>
#include <sys/ioctl.h>
#include <indigo_drivers/aux_rts/indigo_aux_rts.h>
#include "hardware_test_common.h"

#define DEVICE_NAME "RTS-on-COM shutter"

// Opening a serial port plus the driver's own connection work.
#define SHORT_TIMEOUT 15.0
// The longest exposure a scenario starts, plus the completion latency.
#define EXPOSURE_TIMEOUT 30.0
// How long a scenario waits for the line to follow a request that has already been accepted.
#define LINE_TIMEOUT 2.0
// Waiting for a human or a script to pull the adapter and put it back.
#define HOTPLUG_TIMEOUT 120.0
// The exposure the unplug scenario interrupts. It has to outlast the unplug itself and then still
// reach its own deadline, because the deadline is the only moment the driver touches the line
// again and therefore the only moment it can find out that the adapter is gone.
#define UNPLUG_EXPOSURE 15.0

// The monitor is polled rather than woken: TIOCMIWAIT is Linux-only and macOS has no equivalent,
// and a poll keeps the same source running on both. Setting RTS on an FTDI adapter is a USB
// control transfer that takes about 0.85 ms to reach the wire, which dominates this interval, so
// an edge is timestamped to about a millisecond either way.
#define MONITOR_POLL_US 500
// Opening the port puts a pulse of a few milliseconds on the line, and the monitoring adapter
// reports a change up to one latency timer period late - 16 ms on an unconfigured FTDI. A request
// timed immediately after a connect would otherwise find the tail of that pulse in its own edge
// log, which is how this suite first mistook a correct connect for an open shutter.
#define MONITOR_SETTLE 0.05
// What the connection itself may leave on the line: the operating system asserts RTS when the port
// is opened and the driver lowers it again, so the camera sees a blip, never an open shutter.
#define CONNECT_PULSE_LIMIT 0.05

// The driver times the exposure itself and the line is read back over USB, so the budget covers
// the driver's own scheduling plus two adapter round trips.
#define HOLD_TOLERANCE 0.1

#define MAX_EDGES 128
#define MAX_COUNTDOWN 64

typedef struct {
	double at;
	bool level;
} rts_edge;

typedef struct {
	bool level_before;
	bool saw_rise;
	bool saw_fall;
	double rise_at;
	double fall_at;
	double held;
	double completed;
	indigo_property_state final_state;
} exposure_result;

static int shutter = -1;
static const char *driver_port = NULL;
static const char *monitor_port = NULL;
static bool hotplug = false;

static int monitor_fd = -1;
static int monitor_mask = 0;
static char monitor_mask_name[32] = "";
static pthread_t monitor_thread;
static pthread_mutex_t monitor_mutex = PTHREAD_MUTEX_INITIALIZER;
static volatile bool monitor_running = false;
static rts_edge monitor_log[MAX_EDGES];
static int monitor_count = 0;
static bool monitor_level_now = false;
static bool monitor_failed = false;

// Opens a port the way indigo_uni_io.c opens one, so the line states this suite observes are the
// ones the driver's own open() produces rather than an artefact of different termios settings.
static int line_open(const char *name) {
	int fd = open(name, O_RDWR | O_NOCTTY | O_SYNC);
	if (fd < 0) {
		fprintf(stderr, "    cannot open %s (%s)\n", name, strerror(errno));
		return -1;
	}
	struct termios options;
	memset(&options, 0, sizeof(options));
	options.c_cflag = CS8 | CLOCAL | CREAD;
	options.c_iflag = IGNPAR;
	options.c_cc[VMIN] = 0;
	options.c_cc[VTIME] = 50;
	cfsetispeed(&options, B9600);
	cfsetospeed(&options, B9600);
	if (tcsetattr(fd, TCSANOW, &options) == -1) {
		fprintf(stderr, "    cannot configure %s (%s)\n", name, strerror(errno));
		close(fd);
		return -1;
	}
	return fd;
}

static bool line_status(int fd, int *status) {
	return ioctl(fd, TIOCMGET, status) >= 0;
}

static void line_set(int fd, int bit, bool on) {
	int flag = bit;
	if (ioctl(fd, on ? TIOCMBIS : TIOCMBIC, &flag) < 0) {
		fprintf(stderr, "    cannot change modem line (%s)\n", strerror(errno));
	}
}

static void describe_mask(int mask, char *buffer, size_t size) {
	snprintf(buffer, size, "%s%s%s%s", (mask & TIOCM_CTS) ? "CTS " : "", (mask & TIOCM_DSR) ? "DSR " : "", (mask & TIOCM_CAR) ? "DCD " : "", (mask & TIOCM_RNG) ? "RI " : "");
	size_t used = strlen(buffer);
	if (used > 0 && buffer[used - 1] == ' ') {
		buffer[used - 1] = 0;
	}
}

static void *monitor_poll(void *data) {
	(void)data;
	while (monitor_running) {
		int status = 0;
		if (!line_status(monitor_fd, &status)) {
			pthread_mutex_lock(&monitor_mutex);
			monitor_failed = true;
			pthread_mutex_unlock(&monitor_mutex);
			indigo_usleep(MONITOR_POLL_US);
			continue;
		}
		bool level = (status & monitor_mask) != 0;
		double at = indigo_monotonic_time();
		pthread_mutex_lock(&monitor_mutex);
		if (level != monitor_level_now) {
			monitor_level_now = level;
			if (monitor_count < MAX_EDGES) {
				monitor_log[monitor_count].at = at;
				monitor_log[monitor_count].level = level;
				monitor_count++;
			}
		}
		pthread_mutex_unlock(&monitor_mutex);
		indigo_usleep(MONITOR_POLL_US);
	}
	return NULL;
}

// Works out which input of the monitor follows the driver's RTS, while the driver port is still
// free. Both of the monitor's own outputs are parked low first, because a cable that crosses them
// back would otherwise make the monitor observe itself.
static bool monitor_calibrate(void) {
	int probe = line_open(driver_port);
	if (probe < 0) {
		return false;
	}
	line_set(monitor_fd, TIOCM_RTS, false);
	line_set(monitor_fd, TIOCM_DTR, false);
	line_set(probe, TIOCM_RTS, false);
	line_set(probe, TIOCM_DTR, false);
	indigo_usleep(200000);
	int low = 0, high = 0;
	bool read_low = line_status(monitor_fd, &low);
	line_set(probe, TIOCM_RTS, true);
	indigo_usleep(200000);
	bool read_high = line_status(monitor_fd, &high);
	line_set(probe, TIOCM_RTS, false);
	indigo_usleep(200000);
	close(probe);
	if (!read_low || !read_high) {
		fprintf(stderr, "    cannot read the modem lines of %s\n", monitor_port);
		return false;
	}
	monitor_mask = (low ^ high) & (TIOCM_CTS | TIOCM_DSR | TIOCM_CAR | TIOCM_RNG);
	if (monitor_mask == 0) {
		fprintf(stderr, "    RTS on %s does not reach any input of %s.\n", driver_port, monitor_port);
		fprintf(stderr, "    A straight-through cable joins two outputs and carries nothing; this needs a\n");
		fprintf(stderr, "    null-modem cable or a null-modem adapter, and both adapters must wire the\n");
		fprintf(stderr, "    handshake lines out.\n");
		return false;
	}
	describe_mask(monitor_mask, monitor_mask_name, sizeof(monitor_mask_name));
	printf("The cable delivers RTS of %s as %s on %s\n", driver_port, monitor_mask_name, monitor_port);
	return true;
}

static bool monitor_start(void) {
	monitor_fd = line_open(monitor_port);
	if (monitor_fd < 0) {
		return false;
	}
	if (!monitor_calibrate()) {
		close(monitor_fd);
		monitor_fd = -1;
		return false;
	}
	int status = 0;
	line_status(monitor_fd, &status);
	monitor_level_now = (status & monitor_mask) != 0;
	monitor_running = true;
	if (pthread_create(&monitor_thread, NULL, monitor_poll, NULL) != 0) {
		fprintf(stderr, "    cannot start the line monitor\n");
		monitor_running = false;
		close(monitor_fd);
		monitor_fd = -1;
		return false;
	}
	return true;
}

static void monitor_stop(void) {
	if (monitor_running) {
		monitor_running = false;
		pthread_join(monitor_thread, NULL);
	}
	if (monitor_fd >= 0) {
		close(monitor_fd);
		monitor_fd = -1;
	}
}

static void monitor_reset(void) {
	pthread_mutex_lock(&monitor_mutex);
	monitor_count = 0;
	monitor_failed = false;
	pthread_mutex_unlock(&monitor_mutex);
}

// Waits until the line has held its level long enough for the monitoring adapter to have reported
// everything that already happened on it. Bounded, and never asserts: a line that is steadily high
// settles just as fast as one that is steadily low, so a caller can still report which it was.
static void monitor_settle(void) {
	double deadline = indigo_monotonic_time() + LINE_TIMEOUT;
	double quiet = indigo_monotonic_time();
	int last = -1;
	while (indigo_monotonic_time() < deadline) {
		pthread_mutex_lock(&monitor_mutex);
		int count = monitor_count;
		pthread_mutex_unlock(&monitor_mutex);
		if (count != last) {
			last = count;
			quiet = indigo_monotonic_time();
		} else if (indigo_monotonic_time() - quiet >= MONITOR_SETTLE) {
			return;
		}
		indigo_usleep(MONITOR_POLL_US);
	}
}

// True once the monitoring adapter has stopped answering, which makes every measurement taken
// since meaningless. A suite that reported confident numbers off a dead adapter would be worse
// than one that failed.
static bool monitor_lost(void) {
	pthread_mutex_lock(&monitor_mutex);
	bool lost = monitor_failed;
	pthread_mutex_unlock(&monitor_mutex);
	return lost;
}

static bool monitor_level(void) {
	pthread_mutex_lock(&monitor_mutex);
	bool level = monitor_level_now;
	pthread_mutex_unlock(&monitor_mutex);
	return level;
}

static int monitor_snapshot(rts_edge *edges, int max) {
	pthread_mutex_lock(&monitor_mutex);
	int count = monitor_count < max ? monitor_count : max;
	memcpy(edges, monitor_log, count * sizeof(rts_edge));
	pthread_mutex_unlock(&monitor_mutex);
	return count;
}

static bool monitor_wait(bool level, double timeout, double *at) {
	double deadline = indigo_monotonic_time() + timeout;
	while (indigo_monotonic_time() < deadline) {
		if (monitor_level() == level) {
			if (at != NULL) {
				*at = indigo_monotonic_time();
			}
			return true;
		}
		indigo_usleep(MONITOR_POLL_US);
	}
	fprintf(stderr, "    the line did not go %s within %.1f s\n", level ? "up" : "down", timeout);
	return false;
}

// Requests an exposure and reports what the cable saw while it ran, next to what the property did.
static bool run_exposure(double seconds, exposure_result *result) {
	memset(result, 0, sizeof(*result));
	result->held = -1;
	monitor_settle();
	monitor_reset();
	result->level_before = monitor_level();
	unsigned before = hw_revision(shutter, CCD_EXPOSURE_PROPERTY_NAME);
	double started = indigo_monotonic_time();
	hw_request_number(shutter, CCD_EXPOSURE_PROPERTY_NAME, CCD_EXPOSURE_ITEM_NAME, seconds);
	if (!hw_wait_state(shutter, CCD_EXPOSURE_PROPERTY_NAME, before, INDIGO_OK_STATE, EXPOSURE_TIMEOUT)) {
		result->final_state = hw_property_state(shutter, CCD_EXPOSURE_PROPERTY_NAME);
		return false;
	}
	result->completed = indigo_monotonic_time() - started;
	result->final_state = hw_property_state(shutter, CCD_EXPOSURE_PROPERTY_NAME);
	if (monitor_lost()) {
		fprintf(stderr, "    %s stopped answering; this measurement is not valid\n", monitor_port);
		return false;
	}
	// The falling edge can land a poll interval after the property was published, so give the
	// monitor that long before the log is read.
	indigo_usleep(3 * MONITOR_POLL_US);
	rts_edge edges[MAX_EDGES];
	int count = monitor_snapshot(edges, MAX_EDGES);
	for (int i = 0; i < count; i++) {
		if (edges[i].level && !result->saw_rise) {
			result->saw_rise = true;
			result->rise_at = edges[i].at;
		} else if (!edges[i].level && result->saw_rise && !result->saw_fall) {
			result->saw_fall = true;
			result->fall_at = edges[i].at;
		}
	}
	if (result->saw_rise && result->saw_fall) {
		result->held = result->fall_at - result->rise_at;
	}
	printf("    %.3f s requested: line %s before the request, %s, completed in %.3f s\n", seconds, result->level_before ? "HIGH" : "low", result->held >= 0 ? "held for" : "no rise/fall pair seen", result->completed);
	if (result->level_before) {
		printf("      edges after the reset:");
		for (int i = 0; i < count; i++) {
			printf(" %s@%+.3fs", edges[i].level ? "up" : "down", edges[i].at - started);
		}
		printf("\n");
	}
	if (result->held >= 0) {
		printf("      measured hold %.3f s, error %+.3f s\n", result->held, result->held - seconds);
	}
	return true;
}

static void rts_reports_identity_and_capabilities(void) {
	indigo_driver_info info = { 0 };
	ASSERT_TRUE(indigo_aux_rts(INDIGO_DRIVER_INFO, &info) == INDIGO_OK);
	printf("    %s %s %d.%d.%d.%d\n", info.name, info.description, (info.version >> 24) & 0xFF, (info.version >> 16) & 0xFF, (info.version >> 8) & 0xFF, info.version & 0xFF);
	ASSERT_STREQ("indigo_aux_rts", info.name);
	ASSERT_EQ_INT(INDIGO_DRIVER_API_3, INDIGO_DRIVER_API_GENERATION(info.version));
	ASSERT_TRUE((hw_device_interface(shutter) & INDIGO_INTERFACE_AUX_SHUTTER) == INDIGO_INTERFACE_AUX_SHUTTER);
}

static void rts_publishes_the_property_contract(void) {
	ASSERT_TRUE(hw_property_defined(shutter, CCD_EXPOSURE_PROPERTY_NAME));
	ASSERT_TRUE(hw_property_defined(shutter, CCD_ABORT_EXPOSURE_PROPERTY_NAME));
	ASSERT_TRUE(hw_item_defined(shutter, CCD_EXPOSURE_PROPERTY_NAME, CCD_EXPOSURE_ITEM_NAME));
	ASSERT_TRUE(hw_item_defined(shutter, CCD_ABORT_EXPOSURE_PROPERTY_NAME, CCD_ABORT_EXPOSURE_ITEM_NAME));
	ASSERT_TRUE(hw_property_defined(shutter, DEVICE_PORT_PROPERTY_NAME));
	ASSERT_TRUE(hw_property_defined(shutter, DEVICE_PORTS_PROPERTY_NAME));
	double min = 0, max = 0;
	ASSERT_TRUE(hw_number_item_range(shutter, CCD_EXPOSURE_PROPERTY_NAME, CCD_EXPOSURE_ITEM_NAME, &min, &max));
	ASSERT_NEAR(0, min, 0.0001);
}

// Connecting a shutter release must not fire it. The driver only ever lowers RTS on disconnect, on
// abort and at the end of an exposure, so this is where an asserted line survives into the session.
static void rts_leaves_the_shutter_closed_on_connect(void) {
	ASSERT_TRUE(hw_disconnect(shutter, SHORT_TIMEOUT));
	ASSERT_TRUE(monitor_wait(false, LINE_TIMEOUT, NULL));
	monitor_reset();
	ASSERT_TRUE(hw_connect(shutter, SHORT_TIMEOUT));
	double connected = indigo_monotonic_time();
	monitor_settle();
	rts_edge edges[MAX_EDGES];
	int count = monitor_snapshot(edges, MAX_EDGES);
	printf("    connecting produced %d edge(s):", count);
	for (int i = 0; i < count; i++) {
		printf(" %s@%+.3fs", edges[i].level ? "up" : "down", edges[i].at - connected);
	}
	printf("\n    the line is %s after connecting\n", monitor_level() ? "HIGH - the shutter is open" : "low");
	ASSERT_FALSE(monitor_level());
	// Either the monitor missed the pulse altogether or it saw exactly one rise and one fall. A
	// lone rise would mean the shutter stayed open, which the level check above already caught.
	ASSERT_TRUE(count == 0 || count == 2);
	if (count == 2) {
		printf("    the connection pulse lasted %.1f ms\n", (edges[1].at - edges[0].at) * 1000);
		ASSERT_TRUE(edges[0].level && !edges[1].level);
		ASSERT_TRUE(edges[1].at - edges[0].at < CONNECT_PULSE_LIMIT);
	}
	exposure_result result;
	ASSERT_TRUE(run_exposure(1.0, &result));
	ASSERT_FALSE(result.level_before);
	ASSERT_TRUE(result.saw_rise);
	ASSERT_TRUE(result.saw_fall);
	ASSERT_NEAR(1.0, result.held, HOLD_TOLERANCE);
}

static void rts_holds_the_line_for_the_requested_time(void) {
	const double durations[] = { 0.3, 1.0, 2.5 };
	for (unsigned i = 0; i < ARRAY_SIZE(durations); i++) {
		exposure_result result;
		ASSERT_TRUE(run_exposure(durations[i], &result));
		ASSERT_EQ_INT(INDIGO_OK_STATE, result.final_state);
		ASSERT_FALSE(result.level_before);
		ASSERT_TRUE(result.saw_rise);
		ASSERT_TRUE(result.saw_fall);
		ASSERT_NEAR(durations[i], result.held, HOLD_TOLERANCE);
		ASSERT_FALSE(monitor_level());
	}
}

// The published countdown is a display of whole seconds; the shutter is timed separately from it.
static void rts_publishes_a_whole_second_countdown(void) {
	double seen[MAX_COUNTDOWN];
	int count = 0;
	monitor_reset();
	unsigned before = hw_revision(shutter, CCD_EXPOSURE_PROPERTY_NAME);
	hw_request_number(shutter, CCD_EXPOSURE_PROPERTY_NAME, CCD_EXPOSURE_ITEM_NAME, 2.5);
	double deadline = indigo_monotonic_time() + EXPOSURE_TIMEOUT;
	while (indigo_monotonic_time() < deadline) {
		double value = 0;
		if (hw_number_item(shutter, CCD_EXPOSURE_PROPERTY_NAME, CCD_EXPOSURE_ITEM_NAME, &value)) {
			if (count == 0 || fabs(seen[count - 1] - value) > 0.0001) {
				if (count < MAX_COUNTDOWN) {
					seen[count++] = value;
				}
			}
		}
		if (hw_revision(shutter, CCD_EXPOSURE_PROPERTY_NAME) != before && hw_property_state(shutter, CCD_EXPOSURE_PROPERTY_NAME) == INDIGO_OK_STATE) {
			break;
		}
		indigo_usleep(20000);
	}
	printf("    published countdown:");
	for (int i = 0; i < count; i++) {
		printf(" %g", seen[i]);
	}
	printf("\n");
	ASSERT_TRUE(count >= 3);
	// seen[0] is the request the framework echoed back with BUSY and is the exact duration asked
	// for; every later value is the driver's own countdown and has to be a whole second.
	for (int i = 1; i < count; i++) {
		ASSERT_NEAR(seen[i], floor(seen[i] + 0.5), 0.0001);
		ASSERT_TRUE(seen[i] < seen[i - 1]);
	}
	ASSERT_NEAR(0, seen[count - 1], 0.0001);
	ASSERT_TRUE(monitor_wait(false, LINE_TIMEOUT, NULL));
}

static void rts_aborts_and_closes_the_shutter(void) {
	monitor_reset();
	unsigned before = hw_revision(shutter, CCD_EXPOSURE_PROPERTY_NAME);
	hw_request_number(shutter, CCD_EXPOSURE_PROPERTY_NAME, CCD_EXPOSURE_ITEM_NAME, 20.0);
	ASSERT_TRUE(monitor_wait(true, LINE_TIMEOUT, NULL));
	indigo_usleep(1000000);
	double requested = indigo_monotonic_time();
	hw_request_switch(shutter, CCD_ABORT_EXPOSURE_PROPERTY_NAME, CCD_ABORT_EXPOSURE_ITEM_NAME, true);
	double closed = 0;
	ASSERT_TRUE(monitor_wait(false, LINE_TIMEOUT, &closed));
	printf("    the shutter closed %.3f s after the abort was requested\n", closed - requested);
	ASSERT_TRUE(hw_wait_state(shutter, CCD_EXPOSURE_PROPERTY_NAME, before, INDIGO_ALERT_STATE, SHORT_TIMEOUT));
	double remaining = 0;
	ASSERT_TRUE(hw_number_item(shutter, CCD_EXPOSURE_PROPERTY_NAME, CCD_EXPOSURE_ITEM_NAME, &remaining));
	ASSERT_NEAR(0, remaining, 0.0001);
	indigo_usleep(2000000);
	ASSERT_FALSE(monitor_level());
	exposure_result result;
	ASSERT_TRUE(run_exposure(1.0, &result));
	ASSERT_NEAR(1.0, result.held, HOLD_TOLERANCE);
}

// Disconnecting with the shutter open must release it rather than leave the camera exposing.
static void rts_releases_the_line_on_disconnect(void) {
	monitor_reset();
	hw_request_number(shutter, CCD_EXPOSURE_PROPERTY_NAME, CCD_EXPOSURE_ITEM_NAME, 20.0);
	ASSERT_TRUE(monitor_wait(true, LINE_TIMEOUT, NULL));
	indigo_usleep(500000);
	ASSERT_TRUE(hw_disconnect(shutter, SHORT_TIMEOUT));
	ASSERT_TRUE(monitor_wait(false, LINE_TIMEOUT, NULL));
	ASSERT_FALSE(hw_property_defined(shutter, CCD_EXPOSURE_PROPERTY_NAME));
	ASSERT_FALSE(hw_property_defined(shutter, CCD_ABORT_EXPOSURE_PROPERTY_NAME));
	ASSERT_TRUE(hw_connect(shutter, SHORT_TIMEOUT));
	ASSERT_TRUE(hw_property_defined(shutter, CCD_EXPOSURE_PROPERTY_NAME));
}

static void rts_reconnects(void) {
	ASSERT_TRUE(hw_disconnect(shutter, SHORT_TIMEOUT));
	ASSERT_TRUE(hw_disconnect(shutter, SHORT_TIMEOUT));
	ASSERT_TRUE(hw_connect(shutter, SHORT_TIMEOUT));
	exposure_result result;
	ASSERT_TRUE(run_exposure(0.5, &result));
	ASSERT_EQ_INT(INDIGO_OK_STATE, result.final_state);
	ASSERT_NEAR(0.5, result.held, HOLD_TOLERANCE);
}

static bool wait_for_port(bool present, double timeout) {
	double deadline = indigo_monotonic_time() + timeout;
	while (indigo_monotonic_time() < deadline) {
		if ((access(driver_port, F_OK) == 0) == present) {
			return true;
		}
		indigo_usleep(100000);
	}
	fprintf(stderr, "    %s did not %s within %.0f s\n", driver_port, present ? "come back" : "disappear", timeout);
	return false;
}

// The adapter is pulled while the shutter is open. A shutter release has no readback of any kind,
// so the driver has nothing to poll and cannot learn that the adapter is gone until it next drives
// the line, which is when the exposure reaches its deadline. What is asserted is that it reports
// the failure there instead of publishing an exposure it never managed to end, that it tears down
// without hanging, and that it works again once the adapter is back.
static void rts_survives_the_adapter_unplug(void) {
	monitor_reset();
	unsigned before = hw_revision(shutter, CCD_EXPOSURE_PROPERTY_NAME);
	hw_request_number(shutter, CCD_EXPOSURE_PROPERTY_NAME, CCD_EXPOSURE_ITEM_NAME, UNPLUG_EXPOSURE);
	ASSERT_TRUE(monitor_wait(true, LINE_TIMEOUT, NULL));
	printf("HOTPLUG_READY\n");
	ASSERT_TRUE(wait_for_port(false, HOTPLUG_TIMEOUT));
	printf("HOTPLUG_REMOVED\n");
	printf("    the line went %s when the adapter lost power\n", monitor_wait(false, LINE_TIMEOUT, NULL) ? "down" : "NOWHERE - the shutter stayed open");
	ASSERT_TRUE(hw_wait_state(shutter, CCD_EXPOSURE_PROPERTY_NAME, before, INDIGO_ALERT_STATE, UNPLUG_EXPOSURE + EXPOSURE_TIMEOUT));
	ASSERT_TRUE(hw_disconnect(shutter, SHORT_TIMEOUT));
	ASSERT_TRUE(wait_for_port(true, HOTPLUG_TIMEOUT));
	printf("HOTPLUG_RECOVERED\n");
	// udev recreates the by-id symlink a moment before the node is usable.
	indigo_usleep(1000000);
	ASSERT_TRUE(hw_connect(shutter, SHORT_TIMEOUT));
	exposure_result result;
	ASSERT_TRUE(run_exposure(1.0, &result));
	ASSERT_EQ_INT(INDIGO_OK_STATE, result.final_state);
	ASSERT_NEAR(1.0, result.held, HOLD_TOLERANCE);
}

int main(int argc, char **argv) {
	if (argc < 2 || strcmp(argv[1], "--run")) {
		fprintf(stderr, "Physical RTS-on-COM loopback test: run explicitly with --run (or make test-aux-rts-hw).\n");
		return 2;
	}
	setvbuf(stdout, NULL, _IONBF, 0);
	for (int i = 2; i < argc; i++) {
		if (!strcmp(argv[i], "--debug")) {
			indigo_set_log_level(INDIGO_LOG_DEBUG);
		} else if (!strcmp(argv[i], "--hotplug")) {
			hotplug = true;
		}
	}
	driver_port = getenv("AUX_RTS_HW_PORT");
	monitor_port = getenv("AUX_RTS_HW_MONITOR_PORT");
	if (driver_port == NULL || !*driver_port || monitor_port == NULL || !*monitor_port) {
		fprintf(stderr, "Set AUX_RTS_HW_PORT to the port the driver drives and AUX_RTS_HW_MONITOR_PORT to the\n");
		fprintf(stderr, "port at the other end of the serial cable. Prefer the /dev/serial/by-id/... names.\n");
		return 2;
	}
	printf("Driver port  %s\nMonitor port %s\n", driver_port, monitor_port);
	if (!indigo_test_use_private_home()) {
		return 1;
	}
	const indigo_test_case tests[] = {
		{ "rts_reports_identity_and_capabilities", rts_reports_identity_and_capabilities },
		{ "rts_publishes_the_property_contract", rts_publishes_the_property_contract },
		{ "rts_leaves_the_shutter_closed_on_connect", rts_leaves_the_shutter_closed_on_connect },
		{ "rts_holds_the_line_for_the_requested_time", rts_holds_the_line_for_the_requested_time },
		{ "rts_publishes_a_whole_second_countdown", rts_publishes_a_whole_second_countdown },
		{ "rts_aborts_and_closes_the_shutter", rts_aborts_and_closes_the_shutter },
		{ "rts_releases_the_line_on_disconnect", rts_releases_the_line_on_disconnect },
		{ "rts_reconnects", rts_reconnects },
		{ "rts_survives_the_adapter_unplug", rts_survives_the_adapter_unplug }
	};
	int count = ARRAY_SIZE(tests) - (hotplug ? 0 : 1);
	int result = 1;
	bool started = false, initialized = false, monitoring = false;
	HW_CHECK(monitor_start());
	monitoring = true;
	HW_CHECK(indigo_start() == INDIGO_OK);
	started = true;
	HW_CHECK(hw_attach_client("RTS-on-COM hardware test") == INDIGO_OK);
	HW_CHECK(indigo_aux_rts(INDIGO_DRIVER_INIT, NULL) == INDIGO_OK);
	initialized = true;
	shutter = hw_wait_for_device(DEVICE_NAME, SHORT_TIMEOUT);
	HW_CHECK(shutter >= 0);
	printf("Found %s\n", hw_device_name(shutter));
	HW_CHECK(!hw_property_defined(shutter, CCD_EXPOSURE_PROPERTY_NAME));
	HW_CHECK(hw_set_text(shutter, DEVICE_PORT_PROPERTY_NAME, DEVICE_PORT_ITEM_NAME, driver_port, INDIGO_OK_STATE, SHORT_TIMEOUT));
	HW_CHECK(hw_connect(shutter, SHORT_TIMEOUT));
	result = indigo_run_tests("RTS-on-COM shutter hardware", tests, count);
cleanup:
	if (!hw_disconnect(shutter, SHORT_TIMEOUT)) {
		indigo_test_failures++;
	}
	if (initialized && indigo_aux_rts(INDIGO_DRIVER_SHUTDOWN, NULL) != INDIGO_OK) {
		indigo_test_failures++;
	}
	indigo_detach_client(&hw_client);
	if (started) {
		indigo_stop();
	}
	hw_release_properties();
	if (monitoring) {
		monitor_stop();
	}
	indigo_test_remove_private_home();
	return indigo_test_failures ? 1 : result;
}
