// Copyright (c) 2026 INDIGO initiative
// All rights reserved.
//
// You may use this software under the terms of 'INDIGO Astronomy
// open-source license' (see LICENSE.md).
//
// THIS SOFTWARE IS PROVIDED BY THE AUTHORS 'AS IS' AND ANY EXPRESS
// OR IMPLIED WARRANTIES, INCLUDING, BUT NOT LIMITED TO, THE IMPLIED
// WARRANTIES OF MERCHANTABILITY AND FITNESS FOR A PARTICULAR PURPOSE
// ARE DISCLAIMED. IN NO EVENT SHALL THE AUTHOR BE LIABLE FOR ANY
// DIRECT, INDIRECT, INCIDENTAL, SPECIAL, EXEMPLARY, OR CONSEQUENTIAL
// DAMAGES (INCLUDING, BUT NOT LIMITED TO, PROCUREMENT OF SUBSTITUTE
// GOODS OR SERVICES; LOSS OF USE, DATA, OR PROFITS; OR BUSINESS
// INTERRUPTION) HOWEVER CAUSED AND ON ANY THEORY OF LIABILITY,
// WHETHER IN CONTRACT, STRICT LIABILITY, OR TORT (INCLUDING
// NEGLIGENCE OR OTHERWISE) ARISING IN ANY WAY OUT OF THE USE OF THIS
// SOFTWARE, EVEN IF ADVISED OF THE POSSIBILITY OF SUCH DAMAGE.

// Code is generated by AI

// Opt-in acceptance test for a physically connected Explore Scientific PMC-Eight mount, written
// against an iEXOS-100 on its serial (PGMR/USB) interface. It runs the mount hardware acceptance
// checklist of DRIVER_TESTING_RULES.md plus the guider standard for the guider logical device, one
// small scenario per case: identity and model detection, the property contract, coordinate
// polling, tracking and tracking rates, a GOTO to a work position near the pole, manual motion in
// both axes, abort, SYNC, a small GOTO, park and unpark, guide pulses including a duration
// measurement and a real axis displacement, the shared connection, a refused port, reconnect and
// driver INIT/SHUTDOWN.
//
// THE MOUNT PHYSICALLY MOVES. The session expects the mount in its park position (counterweight
// down, telescope at the pole), which is where the PMC-Eight counts both axes from zero. The first
// GOTO takes it to a work position 10 degrees from the pole and five hours east of the meridian,
// one hour from the counterweight-down park, which turns the right ascension axis by 15 degrees; every later GOTO is a few degrees
// from wherever the mount stands. The session ends with a park, which gives the mount back the
// position it was found in.
//
// SYNC OVERWRITES THE MOUNT'S POSITION REGISTERS. Each scenario that uses it syncs the original
// position back afterwards. The CONNECTION_MODE commands ESX and ESY are never sent: ESX moves the
// controller's primary interface to WiFi, after which the serial port no longer answers until the
// interface is switched back over the network.
//
// MOUNT_PMC8_HW_PORT names the serial port and is required. MOUNT_PMC8_HW_LATITUDE and
// MOUNT_PMC8_HW_LONGITUDE give the observing site; the driver has no site command, so the values
// only have to be real for the hour angle arithmetic to describe the real sky.

#include <math.h>
#include <stdlib.h>
#include <string.h>
#include <indigo_drivers/mount_pmc8/indigo_mount_pmc8.h>
#include "hardware_test_common.h"

#define MOUNT_DEVICE_NAME "Mount PMC Eight"
#define GUIDER_DEVICE_NAME "Mount PMC Eight (guider)"
#define CONNECTION_MODE_PROPERTY_NAME "CONNECTION_MODE"
#define CONNECTION_MODE_SERIAL_ITEM_NAME "SERIAL"
#define MOUNT_TYPE_PROPERTY_NAME "MOUNT_TYPE"
#define MOUNT_TYPE_AUTO_ITEM_NAME "AUTO"

// The mount is polled once a second, so a readback that has to come from a fresh poll needs a few
// cycles of room.
#define SHORT_TIMEOUT 15.0
#define CONNECT_TIMEOUT 45.0
// The iEXOS-100 slews at a few degrees a second after a long ramp.
#define MOTION_TIMEOUT 240.0
#define POLL_TIMEOUT 12.0
#define PULSE_TIMEOUT 15.0

// The work position every motion scenario starts from: close enough to the pole to keep both axes
// in a small arc of the park position, far enough from it for the right ascension readback to
// mean something.
#define WORK_DEC 80.0
#define WORK_HOUR_ANGLE -5.0
#define DEC_OFFSET 3.0
#define RA_OFFSET 0.1
#define ABORT_DEC_OFFSET 10.0
#define MANUAL_MOTION_SECONDS 3.0
#define MOTION_EPSILON 0.004
#define TRACKING_SECONDS 30.0
#define TRACKING_HELD_RA 0.0025

#define GUIDE_SAMPLES 3
#define GUIDE_WARMUP 2

static int mount = -1, guider = -1;
static const char *serial_port = NULL;
static double site_latitude = 48.15, site_longitude = 17.11;
static bool initial_captured = false;
static bool initial_tracking = false;

// --------------------------------------------------------------------- helpers

static double number_of(int device, const char *property, const char *item) {
	double value = 0;
	hw_number_item(device, property, item, &value);
	return value;
}

static double current_ra(void) {
	return number_of(mount, MOUNT_EQUATORIAL_COORDINATES_PROPERTY_NAME, MOUNT_EQUATORIAL_COORDINATES_RA_ITEM_NAME);
}

static double current_dec(void) {
	return number_of(mount, MOUNT_EQUATORIAL_COORDINATES_PROPERTY_NAME, MOUNT_EQUATORIAL_COORDINATES_DEC_ITEM_NAME);
}

static double current_lst(void) {
	return number_of(mount, MOUNT_LST_TIME_PROPERTY_NAME, MOUNT_LST_TIME_ITEM_NAME);
}

static double normalized_ra(double ra) {
	while (ra < 0) {
		ra += 24;
	}
	return fmod(ra, 24);
}

static double ra_difference(double a, double b) {
	double difference = normalized_ra(a) - normalized_ra(b);
	if (difference > 12) {
		difference -= 24;
	}
	if (difference < -12) {
		difference += 24;
	}
	return difference;
}

// What the right ascension axis itself stands at: the published right ascension moves with the sky
// whenever the mount is not tracking, so a motion scenario measures the hour angle instead.
static double current_hour_angle(void) {
	return ra_difference(current_lst(), current_ra());
}

static double separation(double ra1, double dec1, double ra2, double dec2) {
	double delta_ra = ra_difference(ra1, ra2) * 15 * M_PI / 180;
	double d1 = dec1 * M_PI / 180, d2 = dec2 * M_PI / 180;
	double cosine = sin(d1) * sin(d2) + cos(d1) * cos(d2) * cos(delta_ra);
	if (cosine > 1) {
		cosine = 1;
	}
	if (cosine < -1) {
		cosine = -1;
	}
	return acos(cosine) * 180 / M_PI;
}

// Waits for a coordinate readback that was polled after this call, so a scenario never judges the
// mount by the position it had before the request.
static bool fresh_coordinates(void) {
	unsigned before = hw_revision(mount, MOUNT_EQUATORIAL_COORDINATES_PROPERTY_NAME);
	double deadline = indigo_monotonic_time() + POLL_TIMEOUT;
	while (indigo_monotonic_time() < deadline) {
		if (hw_revision(mount, MOUNT_EQUATORIAL_COORDINATES_PROPERTY_NAME) > before + 1) {
			return true;
		}
		indigo_usleep(10000);
	}
	fprintf(stderr, "    the mount stopped publishing its coordinates\n");
	return false;
}

static bool pointing_is_usable(void) {
	double dec = current_dec(), ra = current_ra();
	if (dec < -90.5 || dec > 90.5 || ra < 0 || ra >= 24) {
		fprintf(stderr, "    the mount reports RA %g h, DEC %g deg, which is not a position to move from\n", ra, dec);
		return false;
	}
	return true;
}

static void request_equatorial(double ra, double dec) {
	static const char *items[] = { MOUNT_EQUATORIAL_COORDINATES_RA_ITEM_NAME, MOUNT_EQUATORIAL_COORDINATES_DEC_ITEM_NAME };
	double values[2];
	values[0] = ra;
	values[1] = dec;
	indigo_change_number_property(&hw_client, MOUNT_DEVICE_NAME, MOUNT_EQUATORIAL_COORDINATES_PROPERTY_NAME, 2, items, values);
}

static bool on_coordinates_set(const char *item) {
	return hw_set_switch(mount, MOUNT_ON_COORDINATES_SET_PROPERTY_NAME, item, INDIGO_OK_STATE, SHORT_TIMEOUT);
}

static bool sync_to(double ra, double dec) {
	if (!on_coordinates_set(MOUNT_ON_COORDINATES_SET_SYNC_ITEM_NAME)) {
		return false;
	}
	unsigned before = hw_revision(mount, MOUNT_EQUATORIAL_COORDINATES_PROPERTY_NAME);
	request_equatorial(ra, dec);
	if (!hw_wait_state(mount, MOUNT_EQUATORIAL_COORDINATES_PROPERTY_NAME, before, INDIGO_OK_STATE, SHORT_TIMEOUT)) {
		return false;
	}
	return fresh_coordinates();
}

static bool wait_for_busy(const char *property, double timeout) {
	double deadline = indigo_monotonic_time() + timeout;
	while (indigo_monotonic_time() < deadline) {
		if (hw_states_seen(mount, property) & (1u << INDIGO_BUSY_STATE)) {
			return true;
		}
		indigo_usleep(5000);
	}
	fprintf(stderr, "    %s was never reported busy\n", property);
	return false;
}

// A GOTO has to be seen as BUSY before it is waited out, otherwise the OK the last poll published
// would satisfy the wait before the mount has even started.
static bool slew_to(double ra, double dec, double timeout) {
	if (dec < -90 || dec > 90 || ra < 0 || ra >= 24) {
		fprintf(stderr, "    refusing to slew to RA %g h, DEC %g deg\n", ra, dec);
		return false;
	}
	if (!on_coordinates_set(MOUNT_ON_COORDINATES_SET_TRACK_ITEM_NAME)) {
		return false;
	}
	hw_forget_states();
	request_equatorial(ra, dec);
	if (!wait_for_busy(MOUNT_EQUATORIAL_COORDINATES_PROPERTY_NAME, POLL_TIMEOUT)) {
		return false;
	}
	return hw_wait_settled(mount, MOUNT_EQUATORIAL_COORDINATES_PROPERTY_NAME, INDIGO_OK_STATE, timeout);
}

static bool slew_to_work_position(void) {
	if (!fresh_coordinates()) {
		return false;
	}
	double ra = normalized_ra(current_lst() - WORK_HOUR_ANGLE);
	if (!slew_to(ra, WORK_DEC, MOTION_TIMEOUT)) {
		return false;
	}
	if (!fresh_coordinates()) {
		return false;
	}
	double off = separation(current_ra(), current_dec(), ra, WORK_DEC);
	if (off > 0.5) {
		fprintf(stderr, "    the mount stopped %.3f deg from the work position (RA %.5f DEC %.4f)\n", off, current_ra(), current_dec());
		return false;
	}
	return true;
}

// A target a few degrees from wherever the mount is pointing now, towards the equator, so both
// axes have to turn and the mount stays on its side of the pier.
static void nearby_target(double dec_offset, double *ra, double *dec) {
	*dec = current_dec() - dec_offset;
	*ra = normalized_ra(current_ra() + RA_OFFSET);
}

static bool set_tracking(bool on) {
	return hw_set_switch(mount, MOUNT_TRACKING_PROPERTY_NAME, on ? MOUNT_TRACKING_ON_ITEM_NAME : MOUNT_TRACKING_OFF_ITEM_NAME, INDIGO_OK_STATE, SHORT_TIMEOUT);
}

static bool tracking_is_on(void) {
	bool on = false;
	return hw_switch_item(mount, MOUNT_TRACKING_PROPERTY_NAME, MOUNT_TRACKING_ON_ITEM_NAME, &on) && on;
}

static bool switch_is_on(int device, const char *property, const char *item) {
	bool on = false;
	return hw_switch_item(device, property, item, &on) && on;
}

static bool right_ascension_drift(double seconds, double *drift) {
	if (!fresh_coordinates()) {
		return false;
	}
	double start = current_ra();
	double until = indigo_monotonic_time() + seconds;
	while (indigo_monotonic_time() < until) {
		indigo_usleep(200000);
	}
	if (!fresh_coordinates()) {
		return false;
	}
	*drift = fabs(ra_difference(current_ra(), start));
	return true;
}

static double sidereal_loss(double seconds) {
	return seconds / 3600.0 * 1.0027379;
}

static indigo_property_perm property_perm(int device, const char *name) {
	pthread_mutex_lock(&hw_mutex);
	int p = device < 0 ? -1 : hw_slot(device, name);
	indigo_property_perm perm = p < 0 ? INDIGO_RO_PERM : hw_devices[device].properties[p]->perm;
	pthread_mutex_unlock(&hw_mutex);
	return perm;
}

static const char *guide_directions[] = { GUIDER_GUIDE_NORTH_ITEM_NAME, GUIDER_GUIDE_SOUTH_ITEM_NAME, GUIDER_GUIDE_EAST_ITEM_NAME, GUIDER_GUIDE_WEST_ITEM_NAME };

static const char *guide_axis_of(int direction) {
	return direction < 2 ? GUIDER_GUIDE_DEC_PROPERTY_NAME : GUIDER_GUIDE_RA_PROPERTY_NAME;
}

// One pulse, measured from the request to the completion the driver publishes. This is software
// completion timing over the serial transport, not the motor timing of the mount.
static bool guide_pulse(int direction, double milliseconds, double *elapsed) {
	const char *axis = guide_axis_of(direction);
	unsigned before = hw_revision(guider, axis);
	double started = indigo_monotonic_time();
	indigo_change_number_property_1(&hw_client, GUIDER_DEVICE_NAME, axis, guide_directions[direction], milliseconds);
	if (!hw_wait_state(guider, axis, before, INDIGO_OK_STATE, PULSE_TIMEOUT)) {
		return false;
	}
	*elapsed = (indigo_monotonic_time() - started) * 1000;
	double value = 0;
	if (!hw_number_item(guider, axis, guide_directions[direction], &value)) {
		return false;
	}
	if (value != 0) {
		fprintf(stderr, "    %s.%s was left at %g instead of 0\n", axis, guide_directions[direction], value);
		return false;
	}
	return true;
}

static int compare_doubles(const void *a, const void *b) {
	double left = *(const double *)a, right = *(const double *)b;
	return left < right ? -1 : left > right ? 1 : 0;
}

static double percentile(double *sorted, int count, double fraction) {
	int index = (int)(fraction * (count - 1) + 0.5);
	if (index < 0) {
		index = 0;
	}
	if (index >= count) {
		index = count - 1;
	}
	return sorted[index];
}

static bool establish_site(void) {
	static const char *items[] = { GEOGRAPHIC_COORDINATES_LATITUDE_ITEM_NAME, GEOGRAPHIC_COORDINATES_LONGITUDE_ITEM_NAME };
	double values[2];
	values[0] = site_latitude;
	values[1] = site_longitude;
	unsigned before = hw_revision(mount, GEOGRAPHIC_COORDINATES_PROPERTY_NAME);
	indigo_change_number_property(&hw_client, MOUNT_DEVICE_NAME, GEOGRAPHIC_COORDINATES_PROPERTY_NAME, 2, items, values);
	return hw_wait_state(mount, GEOGRAPHIC_COORDINATES_PROPERTY_NAME, before, INDIGO_OK_STATE, SHORT_TIMEOUT);
}

// The driver starts in UDP mode with the default WiFi address, so a serial session has to select
// the serial mode first and the port second: selecting the mode rewrites the port.
static bool select_serial_port(void) {
	if (!hw_set_switch(mount, CONNECTION_MODE_PROPERTY_NAME, CONNECTION_MODE_SERIAL_ITEM_NAME, INDIGO_OK_STATE, SHORT_TIMEOUT)) {
		return false;
	}
	return hw_set_text(mount, DEVICE_PORT_PROPERTY_NAME, DEVICE_PORT_ITEM_NAME, serial_port, INDIGO_OK_STATE, SHORT_TIMEOUT);
}

static bool connect_both(void) {
	return hw_connect(mount, CONNECT_TIMEOUT) && establish_site() && hw_connect(guider, CONNECT_TIMEOUT) && hw_wait_settled(mount, MOUNT_EQUATORIAL_COORDINATES_PROPERTY_NAME, INDIGO_OK_STATE, POLL_TIMEOUT);
}

static bool disconnect_both(void) {
	return hw_disconnect(guider, SHORT_TIMEOUT) && hw_disconnect(mount, CONNECT_TIMEOUT);
}

// ------------------------------------------------------------ identity

static void pmc8_reports_its_identity(void) {
	indigo_driver_info info = { 0 };
	ASSERT_EQ_INT(INDIGO_OK, indigo_mount_pmc8(INDIGO_DRIVER_INFO, &info));
	ASSERT_STREQ("indigo_mount_pmc8", info.name);
	ASSERT_EQ_INT(INDIGO_DRIVER_API_3, INDIGO_DRIVER_API_GENERATION(info.version));
	ASSERT_EQ_INT(INDIGO_INTERFACE_MOUNT, (int)(hw_device_interface(mount) & INDIGO_INTERFACE_MOUNT));
	ASSERT_EQ_INT(INDIGO_INTERFACE_GUIDER, (int)(hw_device_interface(guider) & INDIGO_INTERFACE_GUIDER));
}

// ESGv answers with the hardware and firmware version followed, on the 20A01 firmware, by the
// release date, the board and the WiFi module; the model comes from the ESGi information block.
static void pmc8_detects_the_model_and_firmware(void) {
	char vendor[INDIGO_VALUE_SIZE] = "", model[INDIGO_VALUE_SIZE] = "", firmware[INDIGO_VALUE_SIZE] = "";
	ASSERT_TRUE(hw_text_item(mount, MOUNT_INFO_PROPERTY_NAME, MOUNT_INFO_VENDOR_ITEM_NAME, vendor, sizeof(vendor)));
	ASSERT_TRUE(hw_text_item(mount, MOUNT_INFO_PROPERTY_NAME, MOUNT_INFO_MODEL_ITEM_NAME, model, sizeof(model)));
	ASSERT_TRUE(hw_text_item(mount, MOUNT_INFO_PROPERTY_NAME, MOUNT_INFO_FIRMWARE_ITEM_NAME, firmware, sizeof(firmware)));
	printf("    %s / %s / firmware '%s'\n", vendor, model, firmware);
	ASSERT_STREQ("Explore Scientific", vendor);
	ASSERT_STREQ("Explore Scientific iEXOS-100", model);
	ASSERT_TRUE(!strncmp(firmware, "20A01", 5));
	// The model is detected, not selected, and cannot be changed under a live session.
	ASSERT_TRUE(switch_is_on(mount, MOUNT_TYPE_PROPERTY_NAME, MOUNT_TYPE_AUTO_ITEM_NAME));
	ASSERT_EQ_INT(INDIGO_RO_PERM, property_perm(mount, MOUNT_TYPE_PROPERTY_NAME));
}

static void pmc8_publishes_the_mount_property_contract(void) {
	static const char *expected[] = {
		MOUNT_INFO_PROPERTY_NAME,
		GEOGRAPHIC_COORDINATES_PROPERTY_NAME,
		MOUNT_LST_TIME_PROPERTY_NAME,
		MOUNT_PARK_PROPERTY_NAME,
		MOUNT_SLEW_RATE_PROPERTY_NAME,
		MOUNT_MOTION_DEC_PROPERTY_NAME,
		MOUNT_MOTION_RA_PROPERTY_NAME,
		MOUNT_TRACK_RATE_PROPERTY_NAME,
		MOUNT_TRACKING_PROPERTY_NAME,
		MOUNT_ON_COORDINATES_SET_PROPERTY_NAME,
		MOUNT_EQUATORIAL_COORDINATES_PROPERTY_NAME,
		MOUNT_HORIZONTAL_COORDINATES_PROPERTY_NAME,
		MOUNT_ABORT_MOTION_PROPERTY_NAME,
		MOUNT_EPOCH_PROPERTY_NAME,
		MOUNT_SIDE_OF_PIER_PROPERTY_NAME,
		CONNECTION_MODE_PROPERTY_NAME,
		MOUNT_TYPE_PROPERTY_NAME,
		DEVICE_PORT_PROPERTY_NAME,
		DEVICE_PORTS_PROPERTY_NAME
	};
	for (unsigned i = 0; i < ARRAY_SIZE(expected); i++) {
		if (!hw_property_defined(mount, expected[i])) {
			fprintf(stderr, "    %s is not published\n", expected[i]);
			ASSERT_TRUE(false);
		}
	}
	ASSERT_TRUE(hw_item_defined(mount, MOUNT_TRACK_RATE_PROPERTY_NAME, MOUNT_TRACK_RATE_SIDEREAL_ITEM_NAME));
	ASSERT_TRUE(hw_item_defined(mount, MOUNT_TRACK_RATE_PROPERTY_NAME, MOUNT_TRACK_RATE_LUNAR_ITEM_NAME));
	ASSERT_TRUE(hw_item_defined(mount, MOUNT_TRACK_RATE_PROPERTY_NAME, MOUNT_TRACK_RATE_SOLAR_ITEM_NAME));
	// The controller slews and syncs; there is no slew-without-tracking mode.
	ASSERT_TRUE(hw_item_defined(mount, MOUNT_ON_COORDINATES_SET_PROPERTY_NAME, MOUNT_ON_COORDINATES_SET_TRACK_ITEM_NAME));
	ASSERT_TRUE(hw_item_defined(mount, MOUNT_ON_COORDINATES_SET_PROPERTY_NAME, MOUNT_ON_COORDINATES_SET_SYNC_ITEM_NAME));
	ASSERT_TRUE(!hw_item_defined(mount, MOUNT_ON_COORDINATES_SET_PROPERTY_NAME, MOUNT_ON_COORDINATES_SET_SLEW_ITEM_NAME));
	// The controller has no guide rate command of its own; the guider device owns the rate.
	ASSERT_TRUE(hw_property_hidden(mount, MOUNT_GUIDE_RATE_PROPERTY_NAME));
	ASSERT_TRUE(hw_property_hidden(mount, MOUNT_HOME_PROPERTY_NAME));
	ASSERT_TRUE(hw_property_hidden(mount, MOUNT_PARK_SET_PROPERTY_NAME));
	ASSERT_TRUE(hw_property_hidden(mount, MOUNT_CUSTOM_TRACKING_RATE_PROPERTY_NAME));
}

static void pmc8_publishes_the_guider_property_contract(void) {
	ASSERT_TRUE(hw_property_defined(guider, GUIDER_GUIDE_RA_PROPERTY_NAME));
	ASSERT_TRUE(hw_property_defined(guider, GUIDER_GUIDE_DEC_PROPERTY_NAME));
	ASSERT_TRUE(hw_property_defined(guider, GUIDER_RATE_PROPERTY_NAME));
	ASSERT_TRUE(hw_item_defined(guider, GUIDER_GUIDE_RA_PROPERTY_NAME, GUIDER_GUIDE_EAST_ITEM_NAME));
	ASSERT_TRUE(hw_item_defined(guider, GUIDER_GUIDE_RA_PROPERTY_NAME, GUIDER_GUIDE_WEST_ITEM_NAME));
	ASSERT_TRUE(hw_item_defined(guider, GUIDER_GUIDE_DEC_PROPERTY_NAME, GUIDER_GUIDE_NORTH_ITEM_NAME));
	ASSERT_TRUE(hw_item_defined(guider, GUIDER_GUIDE_DEC_PROPERTY_NAME, GUIDER_GUIDE_SOUTH_ITEM_NAME));
	ASSERT_TRUE(hw_property_hidden(guider, DEVICE_PORT_PROPERTY_NAME));
}

// ------------------------------------------------------------------- readback

// The session starts in the park position, where both axes count zero: the telescope stands at
// the pole of the configured hemisphere.
static void pmc8_polls_the_park_position(void) {
	ASSERT_TRUE(fresh_coordinates());
	double ra = current_ra(), dec = current_dec();
	printf("    the mount reports RA %.5f h, DEC %.4f deg, hour angle %.4f h\n", ra, dec, current_hour_angle());
	ASSERT_TRUE(ra >= 0 && ra < 24);
	ASSERT_NEAR(site_latitude >= 0 ? 90 : -90, dec, 0.1);
	// The counterweight down position is six hours from the meridian.
	ASSERT_NEAR(-6, current_hour_angle(), 0.05);
	double altitude = number_of(mount, MOUNT_HORIZONTAL_COORDINATES_PROPERTY_NAME, MOUNT_HORIZONTAL_COORDINATES_ALT_ITEM_NAME);
	ASSERT_NEAR(fabs(site_latitude), altitude, 0.2);
}

static void pmc8_publishes_the_sidereal_time(void) {
	double first = current_lst();
	ASSERT_TRUE(first >= 0 && first < 24);
	double deadline = indigo_monotonic_time() + 20.0;
	while (indigo_monotonic_time() < deadline) {
		if (fabs(ra_difference(current_lst(), first)) > 0.001) {
			return;
		}
		indigo_usleep(200000);
	}
	fprintf(stderr, "    the sidereal time stayed at %.6f\n", first);
	ASSERT_TRUE(false);
}

// ------------------------------------------------------------------ GOTO

static void pmc8_slews_to_the_work_position(void) {
	ASSERT_TRUE(pointing_is_usable());
	ASSERT_TRUE(slew_to_work_position());
	printf("    at RA %.5f h, DEC %.4f deg, hour angle %.4f h\n", current_ra(), current_dec(), current_hour_angle());
	// A completed GOTO leaves the mount tracking the target.
	ASSERT_TRUE(tracking_is_on());
	// East of the meridian with the counterweight down, the telescope is west of the pier.
	ASSERT_TRUE(switch_is_on(mount, MOUNT_SIDE_OF_PIER_PROPERTY_NAME, MOUNT_SIDE_OF_PIER_WEST_ITEM_NAME));
}

static void pmc8_tracks_after_a_slew(void) {
	double drift = 0, idle = 0;
	ASSERT_TRUE(tracking_is_on());
	ASSERT_TRUE(right_ascension_drift(TRACKING_SECONDS, &drift));
	ASSERT_TRUE(set_tracking(false));
	ASSERT_TRUE(right_ascension_drift(TRACKING_SECONDS, &idle));
	printf("    the mount lost %.5f h tracking and %.5f h standing over %.0f s\n", drift, idle, TRACKING_SECONDS);
	ASSERT_TRUE(drift < TRACKING_HELD_RA);
	ASSERT_TRUE(idle > 0.9 * sidereal_loss(TRACKING_SECONDS));
	ASSERT_TRUE(set_tracking(true));
}

static void pmc8_slews_to_a_nearby_target(void) {
	double target_ra = 0, target_dec = 0;
	ASSERT_TRUE(pointing_is_usable());
	ASSERT_TRUE(fresh_coordinates());
	double start_ra = current_ra(), start_dec = current_dec();
	nearby_target(DEC_OFFSET, &target_ra, &target_dec);
	ASSERT_TRUE(slew_to(target_ra, target_dec, MOTION_TIMEOUT));
	ASSERT_TRUE(fresh_coordinates());
	double arrived = separation(current_ra(), current_dec(), target_ra, target_dec);
	printf("    slewed %.3f deg and arrived %.4f deg from the target\n", separation(start_ra, start_dec, target_ra, target_dec), arrived);
	ASSERT_TRUE(arrived < 0.1);
	ASSERT_TRUE(tracking_is_on());
	ASSERT_TRUE(slew_to_work_position());
}

// The abort has to reach the mount while the GOTO is still running, not after it arrived.
static void pmc8_aborts_a_slew_and_accepts_a_fresh_one(void) {
	double target_ra = 0, target_dec = 0;
	ASSERT_TRUE(pointing_is_usable());
	ASSERT_TRUE(fresh_coordinates());
	double start_ra = current_ra(), start_dec = current_dec();
	nearby_target(ABORT_DEC_OFFSET, &target_ra, &target_dec);
	ASSERT_TRUE(on_coordinates_set(MOUNT_ON_COORDINATES_SET_TRACK_ITEM_NAME));
	hw_forget_states();
	request_equatorial(target_ra, target_dec);
	ASSERT_TRUE(wait_for_busy(MOUNT_EQUATORIAL_COORDINATES_PROPERTY_NAME, POLL_TIMEOUT));
	indigo_usleep(2000000);
	double requested = indigo_monotonic_time();
	ASSERT_TRUE(hw_set_switch(mount, MOUNT_ABORT_MOTION_PROPERTY_NAME, MOUNT_ABORT_MOTION_ITEM_NAME, INDIGO_OK_STATE, SHORT_TIMEOUT));
	printf("    the abort was answered after %.2f s\n", indigo_monotonic_time() - requested);
	ASSERT_TRUE(hw_wait_settled(mount, MOUNT_EQUATORIAL_COORDINATES_PROPERTY_NAME, INDIGO_ALERT_STATE, SHORT_TIMEOUT));
	ASSERT_TRUE(fresh_coordinates());
	double first = current_dec();
	ASSERT_TRUE(fresh_coordinates());
	ASSERT_TRUE(fresh_coordinates());
	double stopped = separation(current_ra(), current_dec(), target_ra, target_dec);
	printf("    the abort left the mount %.3f deg short of the target\n", stopped);
	ASSERT_TRUE(stopped > 1.0);
	ASSERT_NEAR(first, current_dec(), 0.02);
	// A fresh GOTO is accepted straight after the abort.
	ASSERT_TRUE(slew_to(start_ra, start_dec, MOTION_TIMEOUT));
	ASSERT_TRUE(fresh_coordinates());
	ASSERT_TRUE(separation(current_ra(), current_dec(), start_ra, start_dec) < 0.1);
}

// ---------------------------------------------------------------- tracking

static void pmc8_toggles_tracking(void) {
	ASSERT_TRUE(set_tracking(false));
	ASSERT_TRUE(!tracking_is_on());
	ASSERT_TRUE(set_tracking(true));
	ASSERT_TRUE(tracking_is_on());
}

// Closing the serial port drops DTR, and the controller reboots on it: it stops both axes and clears
// its position counters, so it reports the park position wherever the telescope stands. The driver
// gives it back the position the closed session last read, so the coordinates survive a reconnect.
// The drive does not: a reconnected controller honestly reports tracking off.
static void pmc8_keeps_the_position_across_a_reconnect(void) {
	ASSERT_TRUE(pointing_is_usable());
	ASSERT_TRUE(set_tracking(false));
	ASSERT_TRUE(fresh_coordinates());
	double hour_angle = current_hour_angle(), dec = current_dec();
	ASSERT_TRUE(disconnect_both());
	ASSERT_TRUE(connect_both());
	ASSERT_TRUE(fresh_coordinates());
	printf("    before the reconnect hour angle %.5f h DEC %.4f, after it %.5f h DEC %.4f\n", hour_angle, dec, current_hour_angle(), current_dec());
	ASSERT_NEAR(dec, current_dec(), 0.01);
	ASSERT_NEAR(hour_angle, current_hour_angle(), 0.002);
	ASSERT_TRUE(!tracking_is_on());
	ASSERT_TRUE(set_tracking(true));
}

// Selecting a rate while tracking is off must not start the drive.
static void pmc8_selects_a_rate_without_starting_the_drive(void) {
	double idle = 0;
	ASSERT_TRUE(set_tracking(false));
	ASSERT_TRUE(hw_set_switch(mount, MOUNT_TRACK_RATE_PROPERTY_NAME, MOUNT_TRACK_RATE_LUNAR_ITEM_NAME, INDIGO_OK_STATE, SHORT_TIMEOUT));
	ASSERT_TRUE(!tracking_is_on());
	ASSERT_TRUE(right_ascension_drift(10, &idle));
	ASSERT_TRUE(idle > 0.9 * sidereal_loss(10));
	ASSERT_TRUE(hw_set_switch(mount, MOUNT_TRACK_RATE_PROPERTY_NAME, MOUNT_TRACK_RATE_SIDEREAL_ITEM_NAME, INDIGO_OK_STATE, SHORT_TIMEOUT));
	ASSERT_TRUE(set_tracking(true));
}

// --------------------------------------------------------------- manual motion

static bool select_slew_rate(const char *item) {
	return hw_set_switch(mount, MOUNT_SLEW_RATE_PROPERTY_NAME, item, INDIGO_OK_STATE, SHORT_TIMEOUT);
}

static bool manual_motion(const char *property, const char *item, double *moved_ha, double *moved_dec) {
	if (!fresh_coordinates()) {
		return false;
	}
	double start_ha = current_hour_angle(), start_dec = current_dec();
	unsigned before = hw_revision(mount, property);
	indigo_change_switch_property_1(&hw_client, MOUNT_DEVICE_NAME, property, item, true);
	if (!hw_wait_state(mount, property, before, INDIGO_BUSY_STATE, SHORT_TIMEOUT)) {
		return false;
	}
	double until = indigo_monotonic_time() + MANUAL_MOTION_SECONDS;
	while (indigo_monotonic_time() < until) {
		indigo_usleep(100000);
	}
	before = hw_revision(mount, property);
	indigo_change_switch_property_1(&hw_client, MOUNT_DEVICE_NAME, property, item, false);
	if (!hw_wait_state(mount, property, before, INDIGO_OK_STATE, SHORT_TIMEOUT)) {
		return false;
	}
	if (!fresh_coordinates() || !fresh_coordinates()) {
		return false;
	}
	*moved_ha = ra_difference(current_hour_angle(), start_ha);
	*moved_dec = current_dec() - start_dec;
	return true;
}

static void pmc8_selects_the_slew_rates(void) {
	ASSERT_TRUE(select_slew_rate(MOUNT_SLEW_RATE_GUIDE_ITEM_NAME));
	ASSERT_TRUE(select_slew_rate(MOUNT_SLEW_RATE_CENTERING_ITEM_NAME));
	ASSERT_TRUE(select_slew_rate(MOUNT_SLEW_RATE_FIND_ITEM_NAME));
	ASSERT_TRUE(select_slew_rate(MOUNT_SLEW_RATE_MAX_ITEM_NAME));
	ASSERT_TRUE(select_slew_rate(MOUNT_SLEW_RATE_CENTERING_ITEM_NAME));
}

static void pmc8_moves_the_dec_axis_manually(void) {
	double moved_ha = 0, moved_dec = 0;
	ASSERT_TRUE(pointing_is_usable());
	ASSERT_TRUE(set_tracking(false));
	ASSERT_TRUE(select_slew_rate(MOUNT_SLEW_RATE_CENTERING_ITEM_NAME));
	ASSERT_TRUE(manual_motion(MOUNT_MOTION_DEC_PROPERTY_NAME, MOUNT_MOTION_NORTH_ITEM_NAME, &moved_ha, &moved_dec));
	printf("    north moved the declination by %+.4f deg\n", moved_dec);
	ASSERT_TRUE(moved_dec > MOTION_EPSILON);
	ASSERT_TRUE(manual_motion(MOUNT_MOTION_DEC_PROPERTY_NAME, MOUNT_MOTION_SOUTH_ITEM_NAME, &moved_ha, &moved_dec));
	printf("    south moved the declination by %+.4f deg\n", moved_dec);
	ASSERT_TRUE(moved_dec < -MOTION_EPSILON);
}

static void pmc8_moves_the_ra_axis_manually(void) {
	double moved_ha = 0, moved_dec = 0;
	ASSERT_TRUE(pointing_is_usable());
	ASSERT_TRUE(set_tracking(false));
	ASSERT_TRUE(select_slew_rate(MOUNT_SLEW_RATE_CENTERING_ITEM_NAME));
	ASSERT_TRUE(manual_motion(MOUNT_MOTION_RA_PROPERTY_NAME, MOUNT_MOTION_WEST_ITEM_NAME, &moved_ha, &moved_dec));
	printf("    west moved the hour angle by %+.5f h\n", moved_ha);
	// Moving the telescope west increases its hour angle.
	ASSERT_TRUE(moved_ha > MOTION_EPSILON / 15);
	ASSERT_TRUE(manual_motion(MOUNT_MOTION_RA_PROPERTY_NAME, MOUNT_MOTION_EAST_ITEM_NAME, &moved_ha, &moved_dec));
	printf("    east moved the hour angle by %+.5f h\n", moved_ha);
	ASSERT_TRUE(moved_ha < -MOTION_EPSILON / 15);
}

static void pmc8_moves_faster_at_a_higher_rate(void) {
	double moved_ha = 0, slow = 0, fast = 0;
	ASSERT_TRUE(pointing_is_usable());
	ASSERT_TRUE(set_tracking(false));
	ASSERT_TRUE(select_slew_rate(MOUNT_SLEW_RATE_CENTERING_ITEM_NAME));
	ASSERT_TRUE(manual_motion(MOUNT_MOTION_DEC_PROPERTY_NAME, MOUNT_MOTION_SOUTH_ITEM_NAME, &moved_ha, &slow));
	ASSERT_TRUE(select_slew_rate(MOUNT_SLEW_RATE_FIND_ITEM_NAME));
	ASSERT_TRUE(manual_motion(MOUNT_MOTION_DEC_PROPERTY_NAME, MOUNT_MOTION_NORTH_ITEM_NAME, &moved_ha, &fast));
	printf("    centering moved %+.4f deg and find moved %+.4f deg in %.0f s each\n", slow, fast, MANUAL_MOTION_SECONDS);
	ASSERT_TRUE(fabs(slow) > MOTION_EPSILON);
	ASSERT_TRUE(fabs(fast) > 2 * fabs(slow));
	ASSERT_TRUE(select_slew_rate(MOUNT_SLEW_RATE_CENTERING_ITEM_NAME));
}

// The guide slew rate is the slowest one a hand controller offers, and it moves the axis at the
// sidereal rate: 15 arc seconds a second.
static void pmc8_moves_slowly_at_the_guide_rate(void) {
	double moved_ha = 0, guide = 0, centering = 0;
	ASSERT_TRUE(pointing_is_usable());
	ASSERT_TRUE(set_tracking(false));
	ASSERT_TRUE(select_slew_rate(MOUNT_SLEW_RATE_GUIDE_ITEM_NAME));
	ASSERT_TRUE(manual_motion(MOUNT_MOTION_DEC_PROPERTY_NAME, MOUNT_MOTION_SOUTH_ITEM_NAME, &moved_ha, &guide));
	ASSERT_TRUE(select_slew_rate(MOUNT_SLEW_RATE_CENTERING_ITEM_NAME));
	ASSERT_TRUE(manual_motion(MOUNT_MOTION_DEC_PROPERTY_NAME, MOUNT_MOTION_NORTH_ITEM_NAME, &moved_ha, &centering));
	printf("    guide moved %+.4f deg and centering moved %+.4f deg in %.0f s each\n", guide, centering, MANUAL_MOTION_SECONDS);
	double sidereal = MANUAL_MOTION_SECONDS * 15.041 / 3600;
	ASSERT_TRUE(fabs(guide) > 0.5 * sidereal && fabs(guide) < 2 * sidereal);
	ASSERT_TRUE(fabs(guide) < fabs(centering));
}

// Releasing a manual right ascension motion has to give the axis back to the sidereal drive.
static void pmc8_keeps_tracking_after_manual_motion(void) {
	double moved_ha = 0, moved_dec = 0, drift = 0;
	ASSERT_TRUE(pointing_is_usable());
	ASSERT_TRUE(set_tracking(true));
	ASSERT_TRUE(select_slew_rate(MOUNT_SLEW_RATE_CENTERING_ITEM_NAME));
	ASSERT_TRUE(manual_motion(MOUNT_MOTION_RA_PROPERTY_NAME, MOUNT_MOTION_EAST_ITEM_NAME, &moved_ha, &moved_dec));
	ASSERT_TRUE(tracking_is_on());
	ASSERT_TRUE(right_ascension_drift(TRACKING_SECONDS, &drift));
	printf("    after manual motion the mount lost %.5f h over %.0f s\n", drift, TRACKING_SECONDS);
	ASSERT_TRUE(drift < TRACKING_HELD_RA);
}

static void pmc8_aborts_manual_motion(void) {
	ASSERT_TRUE(pointing_is_usable());
	ASSERT_TRUE(set_tracking(false));
	ASSERT_TRUE(select_slew_rate(MOUNT_SLEW_RATE_CENTERING_ITEM_NAME));
	unsigned before = hw_revision(mount, MOUNT_MOTION_DEC_PROPERTY_NAME);
	hw_request_switch(mount, MOUNT_MOTION_DEC_PROPERTY_NAME, MOUNT_MOTION_SOUTH_ITEM_NAME, true);
	ASSERT_TRUE(hw_wait_state(mount, MOUNT_MOTION_DEC_PROPERTY_NAME, before, INDIGO_BUSY_STATE, SHORT_TIMEOUT));
	indigo_usleep(1000000);
	ASSERT_TRUE(hw_set_switch(mount, MOUNT_ABORT_MOTION_PROPERTY_NAME, MOUNT_ABORT_MOTION_ITEM_NAME, INDIGO_OK_STATE, SHORT_TIMEOUT));
	ASSERT_TRUE(hw_property_state(mount, MOUNT_MOTION_DEC_PROPERTY_NAME) != INDIGO_BUSY_STATE);
	ASSERT_TRUE(!switch_is_on(mount, MOUNT_MOTION_DEC_PROPERTY_NAME, MOUNT_MOTION_SOUTH_ITEM_NAME));
	// The axis really stopped.
	ASSERT_TRUE(fresh_coordinates());
	double first = current_dec();
	ASSERT_TRUE(fresh_coordinates());
	ASSERT_TRUE(fresh_coordinates());
	ASSERT_NEAR(first, current_dec(), 0.002);
	ASSERT_TRUE(set_tracking(true));
}

// ----------------------------------------------------------------- SYNC

static bool sync_readback(double target_ra, double target_dec, double *read_ra, double *read_dec) {
	if (!fresh_coordinates()) {
		return false;
	}
	double base_ra = current_ra(), base_dec = current_dec();
	if (!sync_to(target_ra, target_dec)) {
		return false;
	}
	*read_ra = current_ra();
	*read_dec = current_dec();
	printf("    synced to RA %.5f DEC %.4f, the mount reports RA %.5f DEC %.4f\n", target_ra, target_dec, *read_ra, *read_dec);
	if (!sync_to(base_ra, base_dec)) {
		fprintf(stderr, "    the mount's own position could not be synced back\n");
		return false;
	}
	if (separation(current_ra(), current_dec(), base_ra, base_dec) > 0.05) {
		fprintf(stderr, "    the sync back left the mount at RA %.5f DEC %.4f instead of RA %.5f DEC %.4f\n", current_ra(), current_dec(), base_ra, base_dec);
		return false;
	}
	return true;
}

static void pmc8_syncs_to_a_nearby_position(void) {
	double read_ra = 0, read_dec = 0;
	ASSERT_TRUE(pointing_is_usable());
	ASSERT_TRUE(set_tracking(true));
	ASSERT_TRUE(fresh_coordinates());
	double target_ra = normalized_ra(current_ra() + 0.2), target_dec = current_dec() - 2;
	ASSERT_TRUE(sync_readback(target_ra, target_dec, &read_ra, &read_dec));
	ASSERT_NEAR(target_dec, read_dec, 0.01);
	ASSERT_NEAR(0, ra_difference(read_ra, target_ra), 0.002);
}

// A declination south of the equator is the range the signed 24 bit position has to carry.
static void pmc8_syncs_to_a_southern_declination(void) {
	double read_ra = 0, read_dec = 0;
	ASSERT_TRUE(pointing_is_usable());
	ASSERT_TRUE(fresh_coordinates());
	ASSERT_TRUE(sync_readback(current_ra(), -20.0, &read_ra, &read_dec));
	ASSERT_NEAR(-20.0, read_dec, 0.01);
}

// A SYNC only rewrites the position registers; the axes must not move.
static void pmc8_syncs_without_moving(void) {
	ASSERT_TRUE(pointing_is_usable());
	ASSERT_TRUE(fresh_coordinates());
	double base_ra = current_ra(), base_dec = current_dec();
	ASSERT_TRUE(sync_to(base_ra, base_dec - 1));
	hw_forget_states();
	ASSERT_TRUE(fresh_coordinates());
	ASSERT_TRUE(fresh_coordinates());
	ASSERT_NEAR(base_dec - 1, current_dec(), 0.01);
	ASSERT_TRUE(!(hw_states_seen(mount, MOUNT_EQUATORIAL_COORDINATES_PROPERTY_NAME) & (1u << INDIGO_BUSY_STATE)));
	ASSERT_TRUE(sync_to(base_ra, base_dec));
	ASSERT_NEAR(base_dec, current_dec(), 0.01);
}

// ------------------------------------------------------------------- park

static bool park(double timeout) {
	hw_forget_states();
	unsigned before = hw_revision(mount, MOUNT_PARK_PROPERTY_NAME);
	hw_request_switch(mount, MOUNT_PARK_PROPERTY_NAME, MOUNT_PARK_PARKED_ITEM_NAME, true);
	if (!hw_wait_state(mount, MOUNT_PARK_PROPERTY_NAME, before, INDIGO_BUSY_STATE, POLL_TIMEOUT)) {
		return false;
	}
	return hw_wait_settled(mount, MOUNT_PARK_PROPERTY_NAME, INDIGO_OK_STATE, timeout) && switch_is_on(mount, MOUNT_PARK_PROPERTY_NAME, MOUNT_PARK_PARKED_ITEM_NAME);
}

static void pmc8_parks_and_unparks(void) {
	ASSERT_TRUE(pointing_is_usable());
	ASSERT_TRUE(park(MOTION_TIMEOUT));
	ASSERT_TRUE(fresh_coordinates());
	printf("    parked at RA %.5f DEC %.4f, hour angle %.4f h\n", current_ra(), current_dec(), current_hour_angle());
	ASSERT_NEAR(site_latitude >= 0 ? 90 : -90, current_dec(), 0.05);
	ASSERT_NEAR(-6, current_hour_angle(), 0.01);
	ASSERT_TRUE(!tracking_is_on());
	// A parked mount refuses a GOTO.
	ASSERT_TRUE(on_coordinates_set(MOUNT_ON_COORDINATES_SET_TRACK_ITEM_NAME));
	unsigned before = hw_revision(mount, MOUNT_EQUATORIAL_COORDINATES_PROPERTY_NAME);
	request_equatorial(normalized_ra(current_lst() - WORK_HOUR_ANGLE), WORK_DEC);
	ASSERT_TRUE(hw_wait_state(mount, MOUNT_EQUATORIAL_COORDINATES_PROPERTY_NAME, before, INDIGO_ALERT_STATE, SHORT_TIMEOUT));
	// Unparking only releases the mount; nothing moves.
	hw_forget_states();
	ASSERT_TRUE(hw_set_switch(mount, MOUNT_PARK_PROPERTY_NAME, MOUNT_PARK_UNPARKED_ITEM_NAME, INDIGO_OK_STATE, SHORT_TIMEOUT));
	ASSERT_TRUE(switch_is_on(mount, MOUNT_PARK_PROPERTY_NAME, MOUNT_PARK_UNPARKED_ITEM_NAME));
	ASSERT_TRUE(fresh_coordinates());
	ASSERT_TRUE(fresh_coordinates());
	ASSERT_NEAR(-6, current_hour_angle(), 0.01);
	// And the park is not reported again once the unparked mount has been polled at home.
	ASSERT_TRUE(switch_is_on(mount, MOUNT_PARK_PROPERTY_NAME, MOUNT_PARK_UNPARKED_ITEM_NAME));
	ASSERT_TRUE(slew_to_work_position());
}

static void pmc8_aborts_a_park(void) {
	ASSERT_TRUE(pointing_is_usable());
	unsigned before = hw_revision(mount, MOUNT_PARK_PROPERTY_NAME);
	hw_request_switch(mount, MOUNT_PARK_PROPERTY_NAME, MOUNT_PARK_PARKED_ITEM_NAME, true);
	ASSERT_TRUE(hw_wait_state(mount, MOUNT_PARK_PROPERTY_NAME, before, INDIGO_BUSY_STATE, POLL_TIMEOUT));
	indigo_usleep(2000000);
	ASSERT_TRUE(hw_set_switch(mount, MOUNT_ABORT_MOTION_PROPERTY_NAME, MOUNT_ABORT_MOTION_ITEM_NAME, INDIGO_OK_STATE, SHORT_TIMEOUT));
	ASSERT_TRUE(hw_wait_settled(mount, MOUNT_PARK_PROPERTY_NAME, INDIGO_ALERT_STATE, SHORT_TIMEOUT));
	ASSERT_TRUE(switch_is_on(mount, MOUNT_PARK_PROPERTY_NAME, MOUNT_PARK_UNPARKED_ITEM_NAME));
	// The axes stopped short of the park position and stay there.
	ASSERT_TRUE(fresh_coordinates());
	double first = current_dec();
	ASSERT_TRUE(fresh_coordinates());
	ASSERT_TRUE(fresh_coordinates());
	printf("    the abort stopped the park at DEC %.4f\n", current_dec());
	ASSERT_NEAR(first, current_dec(), 0.02);
	ASSERT_TRUE(current_dec() < 89.5);
	ASSERT_TRUE(slew_to_work_position());
}

// -------------------------------------------------------------------- guiding

static void pmc8_guides_in_all_four_directions(void) {
	double elapsed = 0;
	ASSERT_TRUE(set_tracking(true));
	for (int direction = 0; direction < 4; direction++) {
		hw_forget_states();
		ASSERT_TRUE(guide_pulse(direction, 300, &elapsed));
		ASSERT_TRUE(hw_states_seen(guider, guide_axis_of(direction)) & (1u << INDIGO_BUSY_STATE));
	}
}

static void pmc8_guides_both_axes_at_once(void) {
	unsigned ra_before = hw_revision(guider, GUIDER_GUIDE_RA_PROPERTY_NAME);
	unsigned dec_before = hw_revision(guider, GUIDER_GUIDE_DEC_PROPERTY_NAME);
	double started = indigo_monotonic_time();
	indigo_change_number_property_1(&hw_client, GUIDER_DEVICE_NAME, GUIDER_GUIDE_DEC_PROPERTY_NAME, GUIDER_GUIDE_NORTH_ITEM_NAME, 2000);
	indigo_change_number_property_1(&hw_client, GUIDER_DEVICE_NAME, GUIDER_GUIDE_RA_PROPERTY_NAME, GUIDER_GUIDE_EAST_ITEM_NAME, 500);
	ASSERT_TRUE(hw_wait_state(guider, GUIDER_GUIDE_RA_PROPERTY_NAME, ra_before, INDIGO_OK_STATE, PULSE_TIMEOUT));
	double ra_done = (indigo_monotonic_time() - started) * 1000;
	ASSERT_EQ_INT(INDIGO_BUSY_STATE, hw_property_state(guider, GUIDER_GUIDE_DEC_PROPERTY_NAME));
	ASSERT_TRUE(hw_wait_state(guider, GUIDER_GUIDE_DEC_PROPERTY_NAME, dec_before, INDIGO_OK_STATE, PULSE_TIMEOUT));
	double dec_done = (indigo_monotonic_time() - started) * 1000;
	printf("    the 500 ms pulse finished after %.0f ms, the 2000 ms pulse after %.0f ms\n", ra_done, dec_done);
	ASSERT_TRUE(dec_done > ra_done + 1000);
}

static void pmc8_replaces_a_guide_pulse_on_the_same_axis(void) {
	unsigned before = hw_revision(guider, GUIDER_GUIDE_DEC_PROPERTY_NAME);
	double started = indigo_monotonic_time();
	indigo_change_number_property_1(&hw_client, GUIDER_DEVICE_NAME, GUIDER_GUIDE_DEC_PROPERTY_NAME, GUIDER_GUIDE_NORTH_ITEM_NAME, 2000);
	indigo_usleep(500000);
	indigo_change_number_property_1(&hw_client, GUIDER_DEVICE_NAME, GUIDER_GUIDE_DEC_PROPERTY_NAME, GUIDER_GUIDE_SOUTH_ITEM_NAME, 600);
	ASSERT_TRUE(hw_wait_state(guider, GUIDER_GUIDE_DEC_PROPERTY_NAME, before, INDIGO_OK_STATE, PULSE_TIMEOUT));
	double elapsed = (indigo_monotonic_time() - started) * 1000;
	printf("    a 2000 ms pulse replaced after 500 ms by a 600 ms one finished after %.0f ms\n", elapsed);
	ASSERT_TRUE(elapsed > 900 && elapsed < 1600);
	double north = 1, south = 1;
	ASSERT_TRUE(hw_number_item(guider, GUIDER_GUIDE_DEC_PROPERTY_NAME, GUIDER_GUIDE_NORTH_ITEM_NAME, &north));
	ASSERT_TRUE(hw_number_item(guider, GUIDER_GUIDE_DEC_PROPERTY_NAME, GUIDER_GUIDE_SOUTH_ITEM_NAME, &south));
	ASSERT_EQ_INT(0, (int)north);
	ASSERT_EQ_INT(0, (int)south);
}

// A zero request ends a running pulse at once.
static void pmc8_stops_a_guide_pulse_with_a_zero_request(void) {
	unsigned before = hw_revision(guider, GUIDER_GUIDE_RA_PROPERTY_NAME);
	double started = indigo_monotonic_time();
	indigo_change_number_property_1(&hw_client, GUIDER_DEVICE_NAME, GUIDER_GUIDE_RA_PROPERTY_NAME, GUIDER_GUIDE_WEST_ITEM_NAME, 3000);
	indigo_usleep(300000);
	indigo_change_number_property_1(&hw_client, GUIDER_DEVICE_NAME, GUIDER_GUIDE_RA_PROPERTY_NAME, GUIDER_GUIDE_WEST_ITEM_NAME, 0);
	ASSERT_TRUE(hw_wait_state(guider, GUIDER_GUIDE_RA_PROPERTY_NAME, before, INDIGO_OK_STATE, PULSE_TIMEOUT));
	double elapsed = (indigo_monotonic_time() - started) * 1000;
	printf("    a 3000 ms pulse stopped after 300 ms finished after %.0f ms\n", elapsed);
	ASSERT_TRUE(elapsed < 1500);
}

// A guide pulse has to turn the declination axis, in the direction it was asked for.
static void pmc8_moves_the_dec_axis_while_guiding(void) {
	double elapsed = 0;
	ASSERT_TRUE(set_tracking(false));
	ASSERT_TRUE(fresh_coordinates());
	double before = current_dec();
	ASSERT_TRUE(guide_pulse(0, 5000, &elapsed));
	ASSERT_TRUE(fresh_coordinates());
	ASSERT_TRUE(fresh_coordinates());
	double north = current_dec() - before;
	before = current_dec();
	ASSERT_TRUE(guide_pulse(1, 5000, &elapsed));
	ASSERT_TRUE(fresh_coordinates());
	ASSERT_TRUE(fresh_coordinates());
	double south = current_dec() - before;
	double rate = 0;
	ASSERT_TRUE(hw_number_item(guider, GUIDER_RATE_PROPERTY_NAME, GUIDER_RATE_ITEM_NAME, &rate));
	double expected = 5.0 * 15.041 / 3600 * rate / 100;
	printf("    5000 ms pulses at %.0f%% moved the declination by %+.5f deg north and %+.5f deg south, %.5f deg expected\n", rate, north, south, expected);
	ASSERT_TRUE(north > 0.5 * expected && north < 2 * expected);
	ASSERT_TRUE(south < -0.5 * expected && south > -2 * expected);
	ASSERT_TRUE(set_tracking(true));
}

// Guiding corrects a tracking mount, so the sidereal drive has to survive the pulse, and the pulse
// has to move the axis by the guide rate in the requested direction.
static void pmc8_moves_the_ra_axis_while_guiding(void) {
	double elapsed = 0, drift = 0;
	ASSERT_TRUE(set_tracking(true));
	ASSERT_TRUE(fresh_coordinates());
	double before = current_ra();
	ASSERT_TRUE(guide_pulse(3, 5000, &elapsed));
	ASSERT_TRUE(fresh_coordinates());
	ASSERT_TRUE(fresh_coordinates());
	double west = ra_difference(current_ra(), before) * 15;
	before = current_ra();
	ASSERT_TRUE(guide_pulse(2, 5000, &elapsed));
	ASSERT_TRUE(fresh_coordinates());
	ASSERT_TRUE(fresh_coordinates());
	double east = ra_difference(current_ra(), before) * 15;
	double rate = 0;
	ASSERT_TRUE(hw_number_item(guider, GUIDER_RATE_PROPERTY_NAME, GUIDER_RATE_ITEM_NAME, &rate));
	double expected = 5.0 * 15.041 / 3600 * rate / 100;
	printf("    5000 ms pulses at %.0f%% moved the right ascension by %+.5f deg west and %+.5f deg east, %.5f deg expected\n", rate, west, east, expected);
	// A west correction moves the telescope west, towards lower right ascension.
	ASSERT_TRUE(west < -0.5 * expected && west > -2 * expected);
	ASSERT_TRUE(east > 0.5 * expected && east < 2 * expected);
	ASSERT_TRUE(right_ascension_drift(TRACKING_SECONDS, &drift));
	printf("    after the pulses the mount lost %.5f h over %.0f s\n", drift, TRACKING_SECONDS);
	ASSERT_TRUE(drift < TRACKING_HELD_RA);
}

static void pmc8_writes_the_guider_rate(void) {
	double rate = 0;
	ASSERT_TRUE(hw_set_number(guider, GUIDER_RATE_PROPERTY_NAME, GUIDER_RATE_ITEM_NAME, 80, INDIGO_OK_STATE, SHORT_TIMEOUT));
	ASSERT_TRUE(hw_number_item(guider, GUIDER_RATE_PROPERTY_NAME, GUIDER_RATE_ITEM_NAME, &rate));
	ASSERT_NEAR(80, rate, 0.01);
	ASSERT_TRUE(hw_set_number(guider, GUIDER_RATE_PROPERTY_NAME, GUIDER_RATE_ITEM_NAME, 50, INDIGO_OK_STATE, SHORT_TIMEOUT));
}

// Software completion timing over the serial transport, measured from the public request to the
// completion the driver publishes. It is not the motor timing of the mount.
static void pmc8_measures_the_guide_pulse_duration(void) {
	static const double durations[] = { 20, 50, 100, 200, 500 };
	double samples[ARRAY_SIZE(durations) * 4 * GUIDE_SAMPLES];
	int count = 0;
	double elapsed = 0;
	ASSERT_TRUE(set_tracking(true));
	for (int warmup = 0; warmup < GUIDE_WARMUP; warmup++) {
		ASSERT_TRUE(guide_pulse(0, 200, &elapsed));
	}
	for (unsigned d = 0; d < ARRAY_SIZE(durations); d++) {
		for (int direction = 0; direction < 4; direction++) {
			for (int sample = 0; sample < GUIDE_SAMPLES; sample++) {
				ASSERT_TRUE(guide_pulse(direction, durations[d], &elapsed));
				samples[count++] = elapsed - durations[d];
			}
		}
	}
	double sum = 0, maximum_absolute = 0;
	for (int i = 0; i < count; i++) {
		sum += samples[i];
		if (fabs(samples[i]) > maximum_absolute) {
			maximum_absolute = fabs(samples[i]);
		}
	}
	double mean = sum / count, variance = 0;
	for (int i = 0; i < count; i++) {
		variance += (samples[i] - mean) * (samples[i] - mean);
	}
	double deviation = sqrt(variance / count);
	qsort(samples, count, sizeof(double), compare_doubles);
	printf("    %d pulses of 20/50/100/200/500 ms in all four directions, request to published completion, mount tracking and polled\n", count);
	printf("    signed error ms: min %.1f mean %.1f median %.1f p95 %.1f p99 %.1f max %.1f sd %.1f, max absolute %.1f\n", samples[0], mean, percentile(samples, count, 0.5), percentile(samples, count, 0.95), percentile(samples, count, 0.99), samples[count - 1], deviation, maximum_absolute);
	ASSERT_TRUE(samples[0] > -20);
	ASSERT_TRUE(percentile(samples, count, 0.95) < 500);
}

// A disconnect with a pulse pending has to end it, and the next session guides again.
static void pmc8_disconnects_the_guider_during_a_pulse(void) {
	double elapsed = 0;
	unsigned before = hw_revision(guider, GUIDER_GUIDE_DEC_PROPERTY_NAME);
	indigo_change_number_property_1(&hw_client, GUIDER_DEVICE_NAME, GUIDER_GUIDE_DEC_PROPERTY_NAME, GUIDER_GUIDE_NORTH_ITEM_NAME, 3000);
	ASSERT_TRUE(hw_wait_state(guider, GUIDER_GUIDE_DEC_PROPERTY_NAME, before, INDIGO_BUSY_STATE, SHORT_TIMEOUT));
	ASSERT_TRUE(hw_disconnect(guider, SHORT_TIMEOUT));
	// The declination axis has to stop although the pulse was cut.
	ASSERT_TRUE(fresh_coordinates());
	double first = current_dec();
	indigo_usleep(4000000);
	ASSERT_TRUE(fresh_coordinates());
	printf("    after the cut pulse the declination moved %+.5f deg in 4 s\n", current_dec() - first);
	ASSERT_NEAR(first, current_dec(), 0.001);
	ASSERT_TRUE(hw_connect(guider, CONNECT_TIMEOUT));
	ASSERT_TRUE(guide_pulse(1, 200, &elapsed));
}

// ------------------------------------------------------------------ lifecycle

static void pmc8_shares_the_connection_with_the_guider(void) {
	double elapsed = 0;
	ASSERT_TRUE(set_tracking(false));
	ASSERT_TRUE(disconnect_both());
	// The guider first, which has to open the session through its master. The controller stands
	// idle, and a right ascension pulse must not leave its drive running afterwards.
	ASSERT_TRUE(hw_connect(guider, CONNECT_TIMEOUT));
	ASSERT_TRUE(guide_pulse(0, 200, &elapsed));
	ASSERT_TRUE(guide_pulse(2, 200, &elapsed));
	ASSERT_TRUE(hw_connect(mount, CONNECT_TIMEOUT));
	ASSERT_TRUE(hw_wait_settled(mount, MOUNT_EQUATORIAL_COORDINATES_PROPERTY_NAME, INDIGO_OK_STATE, POLL_TIMEOUT));
	ASSERT_TRUE(fresh_coordinates());
	ASSERT_TRUE(!tracking_is_on());
	// The master leaves and the guider keeps its own live session.
	ASSERT_TRUE(hw_disconnect(mount, CONNECT_TIMEOUT));
	ASSERT_TRUE(hw_connected(guider));
	ASSERT_TRUE(guide_pulse(1, 200, &elapsed));
	ASSERT_TRUE(hw_disconnect(guider, SHORT_TIMEOUT));
	ASSERT_TRUE(connect_both());
	ASSERT_TRUE(fresh_coordinates());
}

// A port that is not a serial line has to fail the connection and withdraw everything a connected
// mount publishes, and the real port has to work again straight afterwards. The framework itself
// refuses a path that does not exist, so the refused port is one that exists but is no terminal.
static void pmc8_refuses_a_port_that_is_not_a_serial_line(void) {
	ASSERT_TRUE(disconnect_both());
	bool refused = hw_set_text(mount, DEVICE_PORT_PROPERTY_NAME, DEVICE_PORT_ITEM_NAME, "/dev/null", INDIGO_OK_STATE, SHORT_TIMEOUT) && hw_set_switch(mount, CONNECTION_PROPERTY_NAME, CONNECTION_CONNECTED_ITEM_NAME, INDIGO_ALERT_STATE, CONNECT_TIMEOUT) && !hw_connected(mount) && hw_property_hidden(mount, MOUNT_EQUATORIAL_COORDINATES_PROPERTY_NAME);
	// The real port is given back before anything is judged, so a failure here cannot leave the rest
	// of the session without its mount.
	ASSERT_TRUE(hw_set_text(mount, DEVICE_PORT_PROPERTY_NAME, DEVICE_PORT_ITEM_NAME, serial_port, INDIGO_OK_STATE, SHORT_TIMEOUT));
	ASSERT_TRUE(refused);
	ASSERT_TRUE(connect_both());
	ASSERT_TRUE(fresh_coordinates());
}

static void pmc8_reconnects(void) {
	double elapsed = 0;
	ASSERT_TRUE(disconnect_both());
	ASSERT_TRUE(hw_property_hidden(mount, MOUNT_EQUATORIAL_COORDINATES_PROPERTY_NAME));
	ASSERT_TRUE(hw_property_hidden(guider, GUIDER_GUIDE_RA_PROPERTY_NAME));
	ASSERT_EQ_INT(INDIGO_RW_PERM, property_perm(mount, MOUNT_TYPE_PROPERTY_NAME));
	ASSERT_TRUE(connect_both());
	ASSERT_TRUE(fresh_coordinates());
	ASSERT_TRUE(guide_pulse(2, 200, &elapsed));
}

static void pmc8_reinitializes(void) {
	ASSERT_TRUE(disconnect_both());
	ASSERT_EQ_INT(INDIGO_OK, indigo_mount_pmc8(INDIGO_DRIVER_SHUTDOWN, NULL));
	ASSERT_EQ_INT(-1, hw_device_index(MOUNT_DEVICE_NAME));
	ASSERT_EQ_INT(-1, hw_device_index(GUIDER_DEVICE_NAME));
	ASSERT_EQ_INT(INDIGO_OK, indigo_mount_pmc8(INDIGO_DRIVER_INIT, NULL));
	mount = hw_wait_for_device(MOUNT_DEVICE_NAME, SHORT_TIMEOUT);
	guider = hw_wait_for_device(GUIDER_DEVICE_NAME, SHORT_TIMEOUT);
	ASSERT_TRUE(mount >= 0 && guider >= 0);
	ASSERT_TRUE(select_serial_port());
	ASSERT_TRUE(connect_both());
	ASSERT_TRUE(fresh_coordinates());
}

// ----------------------------------------------------------------------- main

static void capture_initial_state(void) {
	initial_tracking = tracking_is_on();
	initial_captured = true;
	printf("Found the mount at RA %.5f h, DEC %.4f deg, hour angle %.4f h, tracking %s\n", current_ra(), current_dec(), current_hour_angle(), initial_tracking ? "on" : "off");
}

// The session was started in the park position, so a park gives the mount back where it was found.
static void restore_initial_state(void) {
	if (!initial_captured || mount < 0 || !hw_connected(mount)) {
		return;
	}
	hw_set_switch(mount, MOUNT_SLEW_RATE_PROPERTY_NAME, MOUNT_SLEW_RATE_CENTERING_ITEM_NAME, INDIGO_OK_STATE, SHORT_TIMEOUT);
	hw_set_switch(mount, MOUNT_TRACK_RATE_PROPERTY_NAME, MOUNT_TRACK_RATE_SIDEREAL_ITEM_NAME, INDIGO_OK_STATE, SHORT_TIMEOUT);
	if (!switch_is_on(mount, MOUNT_PARK_PROPERTY_NAME, MOUNT_PARK_PARKED_ITEM_NAME) && !park(MOTION_TIMEOUT)) {
		fresh_coordinates();
		printf("    the mount could not be parked, it stands at RA %.5f DEC %.4f\n", current_ra(), current_dec());
		indigo_test_failures++;
		return;
	}
	hw_set_switch(mount, MOUNT_PARK_PROPERTY_NAME, MOUNT_PARK_UNPARKED_ITEM_NAME, INDIGO_OK_STATE, SHORT_TIMEOUT);
	set_tracking(initial_tracking);
}

int main(int argc, char **argv) {
	if (argc < 2 || strcmp(argv[1], "--run")) {
		fprintf(stderr, "Physical PMC-Eight mount test: run explicitly with --run (or make test-mount-pmc8-hw).\n");
		fprintf(stderr, "THE MOUNT MOVES. Start it in the park position; MOUNT_PMC8_HW_PORT names the serial port.\n");
		return 2;
	}
	setvbuf(stdout, NULL, _IONBF, 0);
	for (int i = 2; i < argc; i++) {
		if (!strcmp(argv[i], "--debug")) {
			indigo_set_log_level(INDIGO_LOG_DEBUG);
		}
	}
	serial_port = getenv("MOUNT_PMC8_HW_PORT");
	if (serial_port == NULL || !*serial_port) {
		fprintf(stderr, "MOUNT_PMC8_HW_PORT is not set\n");
		return 2;
	}
	const char *latitude = getenv("MOUNT_PMC8_HW_LATITUDE");
	const char *longitude = getenv("MOUNT_PMC8_HW_LONGITUDE");
	if (latitude != NULL && *latitude) {
		site_latitude = atof(latitude);
	}
	if (longitude != NULL && *longitude) {
		site_longitude = atof(longitude);
	}
	if (!indigo_test_use_private_home()) {
		return 1;
	}
	const indigo_test_case tests[] = {
		{ "pmc8_reports_its_identity", pmc8_reports_its_identity },
		{ "pmc8_detects_the_model_and_firmware", pmc8_detects_the_model_and_firmware },
		{ "pmc8_publishes_the_mount_property_contract", pmc8_publishes_the_mount_property_contract },
		{ "pmc8_publishes_the_guider_property_contract", pmc8_publishes_the_guider_property_contract },
		{ "pmc8_polls_the_park_position", pmc8_polls_the_park_position },
		{ "pmc8_publishes_the_sidereal_time", pmc8_publishes_the_sidereal_time },
		{ "pmc8_slews_to_the_work_position", pmc8_slews_to_the_work_position },
		{ "pmc8_tracks_after_a_slew", pmc8_tracks_after_a_slew },
		{ "pmc8_toggles_tracking", pmc8_toggles_tracking },
		{ "pmc8_keeps_the_position_across_a_reconnect", pmc8_keeps_the_position_across_a_reconnect },
		{ "pmc8_selects_a_rate_without_starting_the_drive", pmc8_selects_a_rate_without_starting_the_drive },
		{ "pmc8_selects_the_slew_rates", pmc8_selects_the_slew_rates },
		{ "pmc8_moves_the_dec_axis_manually", pmc8_moves_the_dec_axis_manually },
		{ "pmc8_moves_the_ra_axis_manually", pmc8_moves_the_ra_axis_manually },
		{ "pmc8_moves_faster_at_a_higher_rate", pmc8_moves_faster_at_a_higher_rate },
		{ "pmc8_moves_slowly_at_the_guide_rate", pmc8_moves_slowly_at_the_guide_rate },
		{ "pmc8_keeps_tracking_after_manual_motion", pmc8_keeps_tracking_after_manual_motion },
		{ "pmc8_aborts_manual_motion", pmc8_aborts_manual_motion },
		{ "pmc8_syncs_to_a_nearby_position", pmc8_syncs_to_a_nearby_position },
		{ "pmc8_syncs_to_a_southern_declination", pmc8_syncs_to_a_southern_declination },
		{ "pmc8_syncs_without_moving", pmc8_syncs_without_moving },
		{ "pmc8_slews_to_a_nearby_target", pmc8_slews_to_a_nearby_target },
		{ "pmc8_aborts_a_slew_and_accepts_a_fresh_one", pmc8_aborts_a_slew_and_accepts_a_fresh_one },
		{ "pmc8_parks_and_unparks", pmc8_parks_and_unparks },
		{ "pmc8_aborts_a_park", pmc8_aborts_a_park },
		{ "pmc8_guides_in_all_four_directions", pmc8_guides_in_all_four_directions },
		{ "pmc8_guides_both_axes_at_once", pmc8_guides_both_axes_at_once },
		{ "pmc8_replaces_a_guide_pulse_on_the_same_axis", pmc8_replaces_a_guide_pulse_on_the_same_axis },
		{ "pmc8_stops_a_guide_pulse_with_a_zero_request", pmc8_stops_a_guide_pulse_with_a_zero_request },
		{ "pmc8_moves_the_dec_axis_while_guiding", pmc8_moves_the_dec_axis_while_guiding },
		{ "pmc8_moves_the_ra_axis_while_guiding", pmc8_moves_the_ra_axis_while_guiding },
		{ "pmc8_writes_the_guider_rate", pmc8_writes_the_guider_rate },
		{ "pmc8_measures_the_guide_pulse_duration", pmc8_measures_the_guide_pulse_duration },
		{ "pmc8_disconnects_the_guider_during_a_pulse", pmc8_disconnects_the_guider_during_a_pulse },
		{ "pmc8_shares_the_connection_with_the_guider", pmc8_shares_the_connection_with_the_guider },
		{ "pmc8_refuses_a_port_that_is_not_a_serial_line", pmc8_refuses_a_port_that_is_not_a_serial_line },
		{ "pmc8_reconnects", pmc8_reconnects },
		{ "pmc8_reinitializes", pmc8_reinitializes }
	};
	int result = 1;
	bool started = false, initialized = false;
	HW_CHECK(indigo_start() == INDIGO_OK);
	started = true;
	HW_CHECK(hw_attach_client("PMC-Eight mount hardware test") == INDIGO_OK);
	HW_CHECK(indigo_mount_pmc8(INDIGO_DRIVER_INIT, NULL) == INDIGO_OK);
	initialized = true;
	mount = hw_wait_for_device(MOUNT_DEVICE_NAME, SHORT_TIMEOUT);
	guider = hw_wait_for_device(GUIDER_DEVICE_NAME, SHORT_TIMEOUT);
	HW_CHECK(mount >= 0 && guider >= 0);
	HW_CHECK(select_serial_port());
	HW_CHECK(connect_both());
	HW_CHECK(fresh_coordinates());
	capture_initial_state();
	result = indigo_run_tests("PMC-Eight mount hardware", tests, ARRAY_SIZE(tests));
cleanup:
	restore_initial_state();
	if (guider >= 0 && !hw_disconnect(guider, SHORT_TIMEOUT)) {
		indigo_test_failures++;
	}
	if (mount >= 0 && !hw_disconnect(mount, CONNECT_TIMEOUT)) {
		indigo_test_failures++;
	}
	if (initialized && indigo_mount_pmc8(INDIGO_DRIVER_SHUTDOWN, NULL) != INDIGO_OK) {
		indigo_test_failures++;
	}
	indigo_detach_client(&hw_client);
	if (started) {
		indigo_stop();
	}
	hw_release_properties();
	indigo_test_remove_private_home();
	return indigo_test_failures ? 1 : result;
}
