// Copyright (c) 2026 INDIGO initiative
// All rights reserved.
//
// You may use this software under the terms of 'INDIGO Astronomy
// open-source license' (see LICENSE.md).
//
// THIS SOFTWARE IS PROVIDED BY THE AUTHORS 'AS IS' AND ANY EXPRESS
// OR IMPLIED WARRANTIES, INCLUDING, BUT NOT LIMITED TO, THE IMPLIED
// WARRANTIES OF MERCHANTABILITY AND FITNESS FOR A PARTICULAR PURPOSE
// ARE DISCLAIMED. IN NO EVENT SHALL THE AUTHOR BE LIABLE FOR ANY
// DIRECT, INDIRECT, INCIDENTAL, SPECIAL, EXEMPLARY, OR CONSEQUENTIAL
// DAMAGES (INCLUDING, BUT NOT LIMITED TO, PROCUREMENT OF SUBSTITUTE
// GOODS OR SERVICES; LOSS OF USE, DATA, OR PROFITS; OR BUSINESS
// INTERRUPTION) HOWEVER CAUSED AND ON ANY THEORY OF LIABILITY,
// WHETHER IN CONTRACT, STRICT LIABILITY, OR TORT (INCLUDING
// NEGLIGENCE OR OTHERWISE) ARISING IN ANY WAY OUT OF THE USE OF THIS
// SOFTWARE, EVEN IF ADVISED OF THE POSSIBILITY OF SUCH DAMAGE.

// Code is generated by AI

// Opt-in acceptance test for a physically connected PrimaluceLab focuser (SESTO SENSO 2, SESTO
// SENSO 3 or ESATTO), optionally with an ARCO rotator. It implements the focuser hardware
// acceptance checklist of DRIVER_TESTING_RULES.md against the real controller: connection,
// identity and capability readback, controller state and polling, absolute and relative motion,
// abort followed by a fresh command, the overlapping-request refusal, backlash, hold current, run
// presets, LED modes, WiFi readback, the rotator logical device, reconnect and driver
// reinitialization.
//
// The draw tube physically moves. Every move is relative to the position the focuser had when the
// test started and the session returns the focuser to that position, so no mechanical end stop is
// approached. The longest move is PRIMALUCE_HW_TRAVEL steps outward (default 3000), so that much
// free outward travel must be available.
//
// The focuser calibration procedure is deliberately not exercised here: it drives the draw tube to
// both end stops and rewrites the stored travel limits. Set PRIMALUCE_HW_CALIBRATE=1 to include it
// on a controller that may be recalibrated.
//
// The serial port comes from PRIMALUCE_HW_PORT. When it is not set the port the driver itself
// detected through its CP2102N match pattern is used.

#include <limits.h>
#include <math.h>
#include <pthread.h>
#include <stdlib.h>
#include <string.h>
#include <unistd.h>
#include <indigo/indigo_bus.h>
#include <indigo/indigo_client.h>
#include <indigo/indigo_driver.h>
#include <indigo/indigo_names.h>
#include <indigo/indigo_timer.h>
#include <indigo_drivers/focuser_primaluce/indigo_focuser_primaluce.h>
#include "../test_runner.h"

#define ARRAY_SIZE(a) (sizeof(a) / sizeof((a)[0]))
#define MAX_DEVICES 4
#define MAX_PROPERTIES 64

#define FOCUSER_DEVICE_NAME "PrimaluceLab Focuser"
#define ROTATOR_DEVICE_NAME "PrimaluceLab Rotator"

// The driver-defined properties are declared in the generated source, not in the public header, so
// the test names them the same way the simulator integration test does.
#define X_CONFIG_PROPERTY_NAME "X_CONFIG"
#define X_CONFIG_M1ACC_ITEM_NAME "M1ACC"
#define X_CONFIG_M1SPD_ITEM_NAME "M1SPD"
#define X_CONFIG_M1DEC_ITEM_NAME "M1DEC"
#define X_CONFIG_M1CACC_ITEM_NAME "M1CACC"
#define X_CONFIG_M1CSPD_ITEM_NAME "M1CSPD"
#define X_CONFIG_M1CDEC_ITEM_NAME "M1CDEC"
#define X_CONFIG_M1HOLD_ITEM_NAME "M1HOLD"
#define X_STATE_PROPERTY_NAME "X_STATE"
#define X_STATE_MOTOR_TEMP_ITEM_NAME "MOTOR_TEMP"
#define X_STATE_VIN_12V_ITEM_NAME "VIN_12V"
#define X_STATE_VIN_USB_ITEM_NAME "VIN_USB"
#define X_WIFI_PROPERTY_NAME "X_WIFI"
#define X_WIFI_OFF_ITEM_NAME "OFF"
#define X_WIFI_AP_ITEM_NAME "AP"
#define X_WIFI_STA_ITEM_NAME "STA"
#define X_WIFI_AP_PROPERTY_NAME "X_WIFI_AP"
#define X_WIFI_STA_PROPERTY_NAME "X_WIFI_STA"
#define X_WIFI_AP_SSID_ITEM_NAME "AP_SSID"
#define X_WIFI_AP_PASSWORD_ITEM_NAME "AP_PASSWORD"
#define X_LEDS_PROPERTY_NAME "X_LEDS"
#define X_LEDS_OFF_ITEM_NAME "OFF"
#define X_LEDS_DIM_ITEM_NAME "DIM"
#define X_LEDS_ON_ITEM_NAME "ON"
#define X_RUNPRESET_PROPERTY_NAME "X_RUNPRESET"
#define X_RUNPRESET_L_ITEM_NAME "L"
#define X_RUNPRESET_M_ITEM_NAME "M"
#define X_RUNPRESET_S_ITEM_NAME "S"
#define X_RUNPRESET_L_PROPERTY_NAME "X_RUNPRESET_L"
#define X_RUNPRESET_M_PROPERTY_NAME "X_RUNPRESET_M"
#define X_RUNPRESET_S_PROPERTY_NAME "X_RUNPRESET_S"
#define X_RUNPRESET_1_PROPERTY_NAME "X_RUNPRESET_1"
#define X_RUNPRESET_2_PROPERTY_NAME "X_RUNPRESET_2"
#define X_RUNPRESET_3_PROPERTY_NAME "X_RUNPRESET_3"
#define X_HOLD_CURR_PROPERTY_NAME "X_HOLD_CURR"
#define X_HOLD_CURR_OFF_ITEM_NAME "OFF"
#define X_HOLD_CURR_ON_ITEM_NAME "ON"
#define X_CALIBRATE_F_PROPERTY_NAME "X_CALIBRATE"
#define X_CALIBRATE_F_START_ITEM_NAME "START"
#define X_CALIBRATE_F_END_ITEM_NAME "END"
#define X_CALIBRATE_R_PROPERTY_NAME "X_CALIBRATE_A"
#define X_CALIBRATE_R_START_ITEM_NAME "START"

// One serialized request over the 115200 baud link plus the controller's own reply latency.
#define SHORT_TIMEOUT 15.0
// A move of PRIMALUCE_HW_TRAVEL steps at the slowest run preset plus the driver's settle polling.
#define MOTION_TIMEOUT 180.0
// The status handler runs every 10 s, so two periods are enough to observe a fresh publication.
#define POLL_TIMEOUT 25.0

#define CHECK(condition) do { if (!(condition)) { fprintf(stderr, "%s:%d: %s\n", __FILE__, __LINE__, #condition); indigo_test_failures++; goto cleanup; } } while (0)

typedef struct {
	char name[INDIGO_NAME_SIZE];
	indigo_device *device;
	unsigned interface;
	bool present;
	indigo_property *properties[MAX_PROPERTIES];
	unsigned revisions[MAX_PROPERTIES];
} observed_device;

static observed_device devices[MAX_DEVICES];
static pthread_mutex_t mutex = PTHREAD_MUTEX_INITIALIZER;
static int focuser = -1, rotator = -1;
static char last_message_text[INDIGO_VALUE_SIZE];
static indigo_client client;
static const char *serial_port = NULL;

// The controller state captured once the focuser is connected. Every scenario works relative to
// these values and the session restores them before it disconnects.
static double initial_position, initial_backlash, initial_config[7];
static char initial_hold_current[INDIGO_NAME_SIZE], initial_leds[INDIGO_NAME_SIZE];
static bool settings_captured;
// How far the motion scenarios travel from the starting position, and the short move used where
// the exact distance does not matter.
static double long_travel = 3000, short_travel = 300;
static bool run_calibration = false;

static int slot(int d, const char *name) {
	for (int p = 0; p < MAX_PROPERTIES; p++) {
		if (devices[d].properties[p] && !strcmp(devices[d].properties[p]->name, name)) {
			return p;
		}
	}
	return -1;
}

static indigo_result observe(indigo_device *device, indigo_property *property, const char *message) {
	pthread_mutex_lock(&mutex);
	int d;
	for (d = 0; d < MAX_DEVICES; d++) {
		if (!*devices[d].name || !strcmp(devices[d].name, property->device)) {
			break;
		}
	}
	if (d < MAX_DEVICES) {
		snprintf(devices[d].name, INDIGO_NAME_SIZE, "%s", property->device);
		devices[d].device = device;
		devices[d].present = true;
		if (!strcmp(property->name, INFO_PROPERTY_NAME)) {
			for (int i = 0; i < property->count; i++) {
				if (!strcmp(property->items[i].name, INFO_DEVICE_INTERFACE_ITEM_NAME)) {
					devices[d].interface = (unsigned)strtoul(property->items[i].text.value, NULL, 10);
				}
			}
		}
		int p = slot(d, property->name);
		if (p < 0) {
			for (p = 0; p < MAX_PROPERTIES && devices[d].properties[p]; p++) { }
		}
		if (p < MAX_PROPERTIES) {
			indigo_release_property(devices[d].properties[p]);
			devices[d].properties[p] = indigo_copy_property(NULL, property);
			devices[d].revisions[p]++;
		}
	}
	pthread_mutex_unlock(&mutex);
	if (message && *message) {
		fprintf(stderr, "    %s %s: %s\n", property->device, property->name, message);
	}
	return INDIGO_OK;
}

static indigo_result define_property(indigo_client *client, indigo_device *device, indigo_property *property, const char *message) {
	return observe(device, property, message);
}

static indigo_result update_property(indigo_client *client, indigo_device *device, indigo_property *property, const char *message) {
	return observe(device, property, message);
}

static indigo_result report_message(indigo_client *client, indigo_device *device, indigo_property *property, const char *message) {
	if (message && *message) {
		pthread_mutex_lock(&mutex);
		snprintf(last_message_text, INDIGO_VALUE_SIZE, "%s", message);
		pthread_mutex_unlock(&mutex);
		fprintf(stderr, "    message: %s\n", message);
	}
	return INDIGO_OK;
}

static indigo_result delete_property(indigo_client *client, indigo_device *device, indigo_property *property, const char *message) {
	pthread_mutex_lock(&mutex);
	for (int d = 0; d < MAX_DEVICES; d++) {
		if (strcmp(devices[d].name, property->device)) {
			continue;
		}
		if (*property->name) {
			int p = slot(d, property->name);
			if (p >= 0) {
				indigo_release_property(devices[d].properties[p]);
				devices[d].properties[p] = NULL;
				devices[d].revisions[p] = 0;
			}
		} else {
			devices[d].present = false;
			for (int p = 0; p < MAX_PROPERTIES; p++) {
				indigo_release_property(devices[d].properties[p]);
				devices[d].properties[p] = NULL;
				devices[d].revisions[p] = 0;
			}
		}
	}
	pthread_mutex_unlock(&mutex);
	return INDIGO_OK;
}

static int device_index(const char *name) {
	pthread_mutex_lock(&mutex);
	int result = -1;
	for (int d = 0; d < MAX_DEVICES; d++) {
		if (!strcmp(devices[d].name, name)) {
			result = d;
		}
	}
	pthread_mutex_unlock(&mutex);
	return result;
}

static unsigned revision(int d, const char *name) {
	pthread_mutex_lock(&mutex);
	int p = slot(d, name);
	unsigned result = p < 0 ? 0 : devices[d].revisions[p];
	pthread_mutex_unlock(&mutex);
	return result;
}

static bool property_defined(int d, const char *name) {
	pthread_mutex_lock(&mutex);
	bool found = slot(d, name) >= 0;
	pthread_mutex_unlock(&mutex);
	return found;
}

static bool property_hidden(int d, const char *name) {
	if (property_defined(d, name)) {
		fprintf(stderr, "    %s is published but should stay hidden\n", name);
		return false;
	}
	return true;
}

static bool number_item(int d, const char *name, const char *item, double *value) {
	pthread_mutex_lock(&mutex);
	int p = slot(d, name);
	bool found = false;
	if (p >= 0) {
		indigo_property *property = devices[d].properties[p];
		for (int i = 0; i < property->count && !found; i++) {
			if (!strcmp(property->items[i].name, item)) {
				*value = property->items[i].number.value;
				found = true;
			}
		}
	}
	pthread_mutex_unlock(&mutex);
	if (!found) {
		fprintf(stderr, "    missing number item %s.%s\n", name, item);
	}
	return found;
}

static bool switch_item(int d, const char *name, const char *item, bool *value) {
	pthread_mutex_lock(&mutex);
	int p = slot(d, name);
	bool found = false;
	if (p >= 0) {
		indigo_property *property = devices[d].properties[p];
		for (int i = 0; i < property->count && !found; i++) {
			if (!strcmp(property->items[i].name, item)) {
				*value = property->items[i].sw.value;
				found = true;
			}
		}
	}
	pthread_mutex_unlock(&mutex);
	if (!found) {
		fprintf(stderr, "    missing switch item %s.%s\n", name, item);
	}
	return found;
}

// Reports the name of the switch item that is currently on, so a scenario can restore whatever the
// controller was set to when the session started.
static bool selected_switch(int d, const char *name, char *item, size_t size) {
	pthread_mutex_lock(&mutex);
	int p = slot(d, name);
	bool found = false;
	if (p >= 0) {
		indigo_property *property = devices[d].properties[p];
		for (int i = 0; i < property->count && !found; i++) {
			if (property->items[i].sw.value) {
				snprintf(item, size, "%s", property->items[i].name);
				found = true;
			}
		}
	}
	pthread_mutex_unlock(&mutex);
	if (!found) {
		fprintf(stderr, "    no item selected in %s\n", name);
	}
	return found;
}

static bool text_item(int d, const char *name, const char *item, char *value, size_t size) {
	pthread_mutex_lock(&mutex);
	int p = slot(d, name);
	bool found = false;
	if (p >= 0) {
		indigo_property *property = devices[d].properties[p];
		for (int i = 0; i < property->count && !found; i++) {
			if (!strcmp(property->items[i].name, item)) {
				snprintf(value, size, "%s", property->items[i].text.value);
				found = true;
			}
		}
	}
	pthread_mutex_unlock(&mutex);
	if (!found) {
		fprintf(stderr, "    missing text item %s.%s\n", name, item);
	}
	return found;
}

static indigo_property_state property_state(int d, const char *name) {
	pthread_mutex_lock(&mutex);
	int p = slot(d, name);
	indigo_property_state state = p < 0 ? INDIGO_IDLE_STATE : devices[d].properties[p]->state;
	pthread_mutex_unlock(&mutex);
	return state;
}

// Waits for a newer revision of the property in the requested state. The revision gate is required
// because the driver republishes the position property from its movement finalizer, so a state the
// property already had before the request must not satisfy the wait.
static bool wait_state(int d, const char *name, unsigned after, indigo_property_state state, double timeout) {
	double deadline = indigo_monotonic_time() + timeout;
	while (indigo_monotonic_time() < deadline) {
		pthread_mutex_lock(&mutex);
		int p = slot(d, name);
		bool ready = p >= 0 && devices[d].revisions[p] > after && devices[d].properties[p]->state == state;
		pthread_mutex_unlock(&mutex);
		if (ready) {
			return true;
		}
		indigo_usleep(20000);
	}
	fprintf(stderr, "    timeout: %s %s expected state %d, last published state %d\n", devices[d].name, name, state, property_state(d, name));
	return false;
}

// Waits for the property to settle in the requested state regardless of how many revisions it took
// to get there. Used where the driver publishes BUSY first and the scenario only cares about the
// terminal state.
static bool wait_settled(int d, const char *name, indigo_property_state state, double timeout) {
	double deadline = indigo_monotonic_time() + timeout;
	while (indigo_monotonic_time() < deadline) {
		if (property_state(d, name) == state) {
			return true;
		}
		indigo_usleep(20000);
	}
	fprintf(stderr, "    timeout: %s %s did not settle in state %d (state %d)\n", devices[d].name, name, state, property_state(d, name));
	return false;
}

static bool wait_revision(int d, const char *name, unsigned after, double timeout) {
	double deadline = indigo_monotonic_time() + timeout;
	while (indigo_monotonic_time() < deadline) {
		if (revision(d, name) > after) {
			return true;
		}
		indigo_usleep(20000);
	}
	fprintf(stderr, "    timeout: %s %s was not republished\n", devices[d].name, name);
	return false;
}

static bool wait_for_message(const char *fragment, double timeout) {
	double deadline = indigo_monotonic_time() + timeout;
	while (indigo_monotonic_time() < deadline) {
		pthread_mutex_lock(&mutex);
		bool found = strstr(last_message_text, fragment) != NULL;
		pthread_mutex_unlock(&mutex);
		if (found) {
			return true;
		}
		indigo_usleep(20000);
	}
	fprintf(stderr, "    timeout: no message containing \"%s\", last message \"%s\"\n", fragment, last_message_text);
	return false;
}

static void forget_messages(void) {
	pthread_mutex_lock(&mutex);
	*last_message_text = 0;
	pthread_mutex_unlock(&mutex);
}

static bool set_switch(int d, const char *name, const char *item, indigo_property_state expected, double timeout) {
	unsigned before = revision(d, name);
	indigo_change_switch_property_1(&client, devices[d].name, name, item, true);
	return wait_state(d, name, before, expected, timeout);
}

static bool set_number(int d, const char *name, const char *item, double value, indigo_property_state expected, double timeout) {
	unsigned before = revision(d, name);
	indigo_change_number_property_1(&client, devices[d].name, name, item, value);
	return wait_state(d, name, before, expected, timeout);
}

static bool connect_device(int d, double timeout) {
	if (d < 0) {
		fprintf(stderr, "    device not present\n");
		return false;
	}
	if (!set_switch(d, CONNECTION_PROPERTY_NAME, CONNECTION_CONNECTED_ITEM_NAME, INDIGO_OK_STATE, timeout)) {
		return false;
	}
	bool connected = false;
	return switch_item(d, CONNECTION_PROPERTY_NAME, CONNECTION_CONNECTED_ITEM_NAME, &connected) && connected;
}

static bool disconnect_device(int d) {
	if (d < 0 || !devices[d].present) {
		return true;
	}
	bool connected = false;
	if (!switch_item(d, CONNECTION_PROPERTY_NAME, CONNECTION_CONNECTED_ITEM_NAME, &connected) || !connected) {
		return true;
	}
	return set_switch(d, CONNECTION_PROPERTY_NAME, CONNECTION_DISCONNECTED_ITEM_NAME, INDIGO_OK_STATE, SHORT_TIMEOUT);
}

static bool wait_presence(double timeout) {
	double deadline = indigo_monotonic_time() + timeout;
	while (indigo_monotonic_time() < deadline) {
		focuser = device_index(FOCUSER_DEVICE_NAME);
		rotator = device_index(ROTATOR_DEVICE_NAME);
		if (focuser >= 0 && rotator >= 0 && property_defined(focuser, CONNECTION_PROPERTY_NAME) && property_defined(rotator, CONNECTION_PROPERTY_NAME)) {
			return true;
		}
		indigo_usleep(20000);
	}
	fprintf(stderr, "    the driver did not publish both logical devices\n");
	return false;
}

// Points the focuser at the requested port. Without an explicit port the driver's own CP2102N match
// pattern selection is kept, which is what a normal client sees.
static bool select_port(void) {
	if (serial_port == NULL || !*serial_port) {
		char detected[INDIGO_VALUE_SIZE] = "";
		if (text_item(focuser, DEVICE_PORT_PROPERTY_NAME, DEVICE_PORT_ITEM_NAME, detected, sizeof(detected)) && *detected) {
			printf("Using the port the driver detected: %s\n", detected);
			return true;
		}
		fprintf(stderr, "    no serial port was detected, set PRIMALUCE_HW_PORT\n");
		return false;
	}
	printf("Using port %s\n", serial_port);
	unsigned before = revision(focuser, DEVICE_PORT_PROPERTY_NAME);
	indigo_change_text_property_1(&client, FOCUSER_DEVICE_NAME, DEVICE_PORT_PROPERTY_NAME, DEVICE_PORT_ITEM_NAME, serial_port);
	return wait_state(focuser, DEVICE_PORT_PROPERTY_NAME, before, INDIGO_OK_STATE, SHORT_TIMEOUT);
}

// Moves the focuser to an absolute position and waits until the driver reports it arrived there.
static bool move_to(double position, double timeout) {
	unsigned before = revision(focuser, FOCUSER_POSITION_PROPERTY_NAME);
	indigo_change_number_property_1(&client, FOCUSER_DEVICE_NAME, FOCUSER_POSITION_PROPERTY_NAME, FOCUSER_POSITION_ITEM_NAME, position);
	if (!wait_state(focuser, FOCUSER_POSITION_PROPERTY_NAME, before, INDIGO_OK_STATE, timeout)) {
		return false;
	}
	double reached = 0;
	if (!number_item(focuser, FOCUSER_POSITION_PROPERTY_NAME, FOCUSER_POSITION_ITEM_NAME, &reached)) {
		return false;
	}
	if (fabs(reached - position) > 0.5) {
		fprintf(stderr, "    focuser reported OK at %.0f but %.0f was requested\n", reached, position);
		return false;
	}
	return true;
}

// Brings the focuser back to the position the session started from, waiting out a motion an earlier
// scenario may have left running. Keeps one failing scenario from cascading into the next.
static double cached_position(void) {
	double position = 0;
	number_item(focuser, FOCUSER_POSITION_PROPERTY_NAME, FOCUSER_POSITION_ITEM_NAME, &position);
	return position;
}

static bool settle_at_start(void) {
	double deadline = indigo_monotonic_time() + MOTION_TIMEOUT;
	while (indigo_monotonic_time() < deadline && (property_state(focuser, FOCUSER_POSITION_PROPERTY_NAME) == INDIGO_BUSY_STATE || property_state(focuser, FOCUSER_STEPS_PROPERTY_NAME) == INDIGO_BUSY_STATE)) {
		indigo_usleep(20000);
	}
	forget_messages();
	double position = 0;
	if (number_item(focuser, FOCUSER_POSITION_PROPERTY_NAME, FOCUSER_POSITION_ITEM_NAME, &position) && fabs(position - initial_position) < 0.5) {
		return true;
	}
	return move_to(initial_position, MOTION_TIMEOUT);
}

static bool capture_initial_settings(void) {
	static const char *config_items[] = { X_CONFIG_M1ACC_ITEM_NAME, X_CONFIG_M1SPD_ITEM_NAME, X_CONFIG_M1DEC_ITEM_NAME, X_CONFIG_M1CACC_ITEM_NAME, X_CONFIG_M1CSPD_ITEM_NAME, X_CONFIG_M1CDEC_ITEM_NAME, X_CONFIG_M1HOLD_ITEM_NAME };
	if (!number_item(focuser, FOCUSER_POSITION_PROPERTY_NAME, FOCUSER_POSITION_ITEM_NAME, &initial_position)) {
		return false;
	}
	if (!number_item(focuser, FOCUSER_BACKLASH_PROPERTY_NAME, FOCUSER_BACKLASH_ITEM_NAME, &initial_backlash)) {
		return false;
	}
	for (unsigned i = 0; i < ARRAY_SIZE(config_items); i++) {
		if (!number_item(focuser, X_CONFIG_PROPERTY_NAME, config_items[i], initial_config + i)) {
			return false;
		}
	}
	if (!selected_switch(focuser, X_HOLD_CURR_PROPERTY_NAME, initial_hold_current, sizeof(initial_hold_current))) {
		return false;
	}
	if (!selected_switch(focuser, X_LEDS_PROPERTY_NAME, initial_leds, sizeof(initial_leds))) {
		return false;
	}
	settings_captured = true;
	return true;
}

// Restores the controller settings the session changed. The run configuration is restored through
// the preset whose stored values match the configuration found at startup, because X_CONFIG itself
// is read-only.
static void restore_initial_settings(void) {
	static const char *config_items[] = { X_CONFIG_M1ACC_ITEM_NAME, X_CONFIG_M1SPD_ITEM_NAME, X_CONFIG_M1DEC_ITEM_NAME, X_CONFIG_M1CACC_ITEM_NAME, X_CONFIG_M1CSPD_ITEM_NAME, X_CONFIG_M1CDEC_ITEM_NAME, X_CONFIG_M1HOLD_ITEM_NAME };
	if (!settings_captured) {
		return;
	}
	set_number(focuser, FOCUSER_BACKLASH_PROPERTY_NAME, FOCUSER_BACKLASH_ITEM_NAME, initial_backlash, INDIGO_OK_STATE, SHORT_TIMEOUT);
	set_switch(focuser, X_HOLD_CURR_PROPERTY_NAME, initial_hold_current, INDIGO_OK_STATE, SHORT_TIMEOUT);
	set_switch(focuser, X_LEDS_PROPERTY_NAME, initial_leds, INDIGO_OK_STATE, SHORT_TIMEOUT);
	bool restored = true;
	for (unsigned i = 0; i < ARRAY_SIZE(config_items); i++) {
		double value = 0;
		if (!number_item(focuser, X_CONFIG_PROPERTY_NAME, config_items[i], &value) || fabs(value - initial_config[i]) > 0.001) {
			restored = false;
		}
	}
	if (restored) {
		return;
	}
	static const struct { const char *property, *item; } presets[] = {
		{ X_RUNPRESET_L_PROPERTY_NAME, X_RUNPRESET_L_ITEM_NAME },
		{ X_RUNPRESET_M_PROPERTY_NAME, X_RUNPRESET_M_ITEM_NAME },
		{ X_RUNPRESET_S_PROPERTY_NAME, X_RUNPRESET_S_ITEM_NAME }
	};
	for (unsigned p = 0; p < ARRAY_SIZE(presets); p++) {
		bool match = true;
		for (unsigned i = 0; i < ARRAY_SIZE(config_items) && match; i++) {
			double value = 0;
			if (!number_item(focuser, presets[p].property, config_items[i], &value) || fabs(value - initial_config[i]) > 0.001) {
				match = false;
			}
		}
		if (match) {
			if (set_switch(focuser, X_RUNPRESET_PROPERTY_NAME, presets[p].item, INDIGO_OK_STATE, SHORT_TIMEOUT)) {
				printf("Restored the run configuration through preset %s\n", presets[p].property);
			}
			return;
		}
	}
	fprintf(stderr, "    no stored preset matches the run configuration found at startup, it was left as the test set it\n");
}

static void primaluce_reports_identity_and_capabilities(void) {
	char model[INDIGO_VALUE_SIZE] = "", serial_number[INDIGO_VALUE_SIZE] = "", firmware[INDIGO_VALUE_SIZE] = "";
	ASSERT_TRUE((devices[focuser].interface & INDIGO_INTERFACE_FOCUSER) != 0);
	ASSERT_TRUE(text_item(focuser, INFO_PROPERTY_NAME, INFO_DEVICE_MODEL_ITEM_NAME, model, sizeof(model)));
	ASSERT_TRUE(!strncmp(model, "SESTOSENSO", 10) || !strncmp(model, "ESATTO", 6));
	ASSERT_TRUE(text_item(focuser, INFO_PROPERTY_NAME, INFO_DEVICE_SERIAL_NUM_ITEM_NAME, serial_number, sizeof(serial_number)));
	ASSERT_TRUE(*serial_number && strcmp(serial_number, "N/A"));
	ASSERT_TRUE(text_item(focuser, INFO_PROPERTY_NAME, INFO_DEVICE_FW_REVISION_ITEM_NAME, firmware, sizeof(firmware)));
	ASSERT_TRUE(*firmware && strcmp(firmware, "N/A"));
	printf("    model %s, serial number %s, firmware %s\n", model, serial_number, firmware);
}

static void primaluce_publishes_the_property_contract(void) {
	ASSERT_TRUE(property_defined(focuser, FOCUSER_POSITION_PROPERTY_NAME));
	ASSERT_TRUE(property_defined(focuser, FOCUSER_STEPS_PROPERTY_NAME));
	ASSERT_TRUE(property_defined(focuser, FOCUSER_DIRECTION_PROPERTY_NAME));
	ASSERT_TRUE(property_defined(focuser, FOCUSER_ABORT_MOTION_PROPERTY_NAME));
	ASSERT_TRUE(property_defined(focuser, FOCUSER_TEMPERATURE_PROPERTY_NAME));
	ASSERT_TRUE(property_defined(focuser, FOCUSER_BACKLASH_PROPERTY_NAME));
	ASSERT_TRUE(property_defined(focuser, X_STATE_PROPERTY_NAME));
	ASSERT_TRUE(property_defined(focuser, X_WIFI_PROPERTY_NAME));
	ASSERT_TRUE(property_defined(focuser, X_WIFI_AP_PROPERTY_NAME));
	ASSERT_TRUE(property_defined(focuser, X_LEDS_PROPERTY_NAME));
	// The controller has no temperature compensation, no reverse switch, no travel limits of its
	// own and no coordinate sync, so these stay hidden.
	ASSERT_TRUE(property_hidden(focuser, FOCUSER_MODE_PROPERTY_NAME));
	ASSERT_TRUE(property_hidden(focuser, FOCUSER_COMPENSATION_PROPERTY_NAME));
	ASSERT_TRUE(property_hidden(focuser, FOCUSER_REVERSE_MOTION_PROPERTY_NAME));
	ASSERT_TRUE(property_hidden(focuser, FOCUSER_LIMITS_PROPERTY_NAME));
	ASSERT_TRUE(property_hidden(focuser, FOCUSER_ON_POSITION_SET_PROPERTY_NAME));
	ASSERT_TRUE(property_hidden(focuser, X_WIFI_STA_PROPERTY_NAME));
	char model[INDIGO_VALUE_SIZE] = "";
	ASSERT_TRUE(text_item(focuser, INFO_PROPERTY_NAME, INFO_DEVICE_MODEL_ITEM_NAME, model, sizeof(model)));
	// SESTO SENSO exposes the stepper configuration and the run presets, ESATTO does not.
	bool sestosenso = !strncmp(model, "SESTOSENSO", 10);
	ASSERT_TRUE(property_defined(focuser, X_CONFIG_PROPERTY_NAME) == sestosenso);
	ASSERT_TRUE(property_defined(focuser, X_RUNPRESET_PROPERTY_NAME) == sestosenso);
	ASSERT_TRUE(property_defined(focuser, X_RUNPRESET_L_PROPERTY_NAME) == sestosenso);
	ASSERT_TRUE(property_defined(focuser, X_RUNPRESET_1_PROPERTY_NAME) == sestosenso);
	ASSERT_TRUE(property_defined(focuser, X_HOLD_CURR_PROPERTY_NAME) == sestosenso);
	ASSERT_TRUE(property_defined(focuser, X_CALIBRATE_F_PROPERTY_NAME));
	// FOCUSER_SPEED is published only when the controller reports a MOT1 speed setting, which this
	// firmware does not do in its aggregate get reply.
	printf("    FOCUSER_SPEED is %s\n", property_defined(focuser, FOCUSER_SPEED_PROPERTY_NAME) ? "published" : "hidden");
}

static void primaluce_reads_controller_state(void) {
	double motor_temperature = 0, vin_12v = 0, vin_usb = 0, temperature = 0;
	ASSERT_TRUE(number_item(focuser, X_STATE_PROPERTY_NAME, X_STATE_MOTOR_TEMP_ITEM_NAME, &motor_temperature));
	ASSERT_TRUE(motor_temperature > -50 && motor_temperature < 100);
	ASSERT_TRUE(number_item(focuser, X_STATE_PROPERTY_NAME, X_STATE_VIN_12V_ITEM_NAME, &vin_12v));
	ASSERT_TRUE(vin_12v >= 0 && vin_12v < 50);
	// The USB rail reading is published only by the models that report it; SESTO SENSO answers
	// "invalid command" for VIN_USB, so the driver publishes X_STATE without that item.
	bool has_vin_usb = number_item(focuser, X_STATE_PROPERTY_NAME, X_STATE_VIN_USB_ITEM_NAME, &vin_usb);
	if (has_vin_usb) {
		ASSERT_TRUE(vin_usb >= 0 && vin_usb < 10);
	}
	// -127 is what the controller reports when no external probe is fitted; both cases are valid.
	ASSERT_TRUE(number_item(focuser, FOCUSER_TEMPERATURE_PROPERTY_NAME, FOCUSER_TEMPERATURE_ITEM_NAME, &temperature));
	printf("    motor %.2f C, 12V rail %.2f V, USB rail %s, external probe %.2f C\n", motor_temperature, vin_12v, has_vin_usb ? "reported" : "not reported", temperature);
}

static void primaluce_polls_controller_state(void) {
	unsigned before = revision(focuser, X_STATE_PROPERTY_NAME);
	// The status handler only republishes when a reading actually changed, so this observes either
	// a fresh publication or a stable reading across two poll periods.
	if (wait_revision(focuser, X_STATE_PROPERTY_NAME, before, POLL_TIMEOUT)) {
		ASSERT_TRUE(property_state(focuser, X_STATE_PROPERTY_NAME) == INDIGO_OK_STATE);
	} else {
		printf("    the controller readings did not change within %.0f s\n", POLL_TIMEOUT);
	}
	// Whatever the status handler did, the link must still answer.
	ASSERT_TRUE(move_to(initial_position, MOTION_TIMEOUT));
}

static void primaluce_moves_to_an_absolute_position(void) {
	ASSERT_TRUE(settle_at_start());
	double target = initial_position + short_travel, reached = 0;
	unsigned before = revision(focuser, FOCUSER_POSITION_PROPERTY_NAME);
	indigo_change_number_property_1(&client, FOCUSER_DEVICE_NAME, FOCUSER_POSITION_PROPERTY_NAME, FOCUSER_POSITION_ITEM_NAME, target);
	// The move must be advertised as in progress before it is reported finished.
	ASSERT_TRUE(wait_state(focuser, FOCUSER_POSITION_PROPERTY_NAME, before, INDIGO_BUSY_STATE, SHORT_TIMEOUT));
	ASSERT_TRUE(wait_settled(focuser, FOCUSER_POSITION_PROPERTY_NAME, INDIGO_OK_STATE, MOTION_TIMEOUT));
	ASSERT_TRUE(number_item(focuser, FOCUSER_POSITION_PROPERTY_NAME, FOCUSER_POSITION_ITEM_NAME, &reached));
	ASSERT_TRUE(fabs(reached - target) < 0.5);
	ASSERT_TRUE(move_to(initial_position, MOTION_TIMEOUT));
}

static void primaluce_moves_by_relative_steps(void) {
	ASSERT_TRUE(settle_at_start());
	double reached = 0;
	ASSERT_TRUE(set_switch(focuser, FOCUSER_DIRECTION_PROPERTY_NAME, FOCUSER_DIRECTION_MOVE_OUTWARD_ITEM_NAME, INDIGO_OK_STATE, SHORT_TIMEOUT));
	unsigned before = revision(focuser, FOCUSER_STEPS_PROPERTY_NAME);
	indigo_change_number_property_1(&client, FOCUSER_DEVICE_NAME, FOCUSER_STEPS_PROPERTY_NAME, FOCUSER_STEPS_ITEM_NAME, short_travel);
	ASSERT_TRUE(wait_state(focuser, FOCUSER_STEPS_PROPERTY_NAME, before, INDIGO_BUSY_STATE, SHORT_TIMEOUT));
	// A relative move is carried out as an absolute move, so the position property has to report
	// the motion too instead of staying at the state it had before the request.
	ASSERT_TRUE(wait_settled(focuser, FOCUSER_POSITION_PROPERTY_NAME, INDIGO_BUSY_STATE, SHORT_TIMEOUT));
	ASSERT_TRUE(wait_settled(focuser, FOCUSER_STEPS_PROPERTY_NAME, INDIGO_OK_STATE, MOTION_TIMEOUT));
	ASSERT_TRUE(number_item(focuser, FOCUSER_POSITION_PROPERTY_NAME, FOCUSER_POSITION_ITEM_NAME, &reached));
	ASSERT_TRUE(fabs(reached - (initial_position + short_travel)) < 0.5);
	ASSERT_TRUE(set_switch(focuser, FOCUSER_DIRECTION_PROPERTY_NAME, FOCUSER_DIRECTION_MOVE_INWARD_ITEM_NAME, INDIGO_OK_STATE, SHORT_TIMEOUT));
	before = revision(focuser, FOCUSER_STEPS_PROPERTY_NAME);
	indigo_change_number_property_1(&client, FOCUSER_DEVICE_NAME, FOCUSER_STEPS_PROPERTY_NAME, FOCUSER_STEPS_ITEM_NAME, short_travel);
	ASSERT_TRUE(wait_settled(focuser, FOCUSER_STEPS_PROPERTY_NAME, INDIGO_OK_STATE, MOTION_TIMEOUT));
	ASSERT_TRUE(number_item(focuser, FOCUSER_POSITION_PROPERTY_NAME, FOCUSER_POSITION_ITEM_NAME, &reached));
	ASSERT_TRUE(fabs(reached - initial_position) < 0.5);
}

static void primaluce_refuses_an_overlapping_request(void) {
	ASSERT_TRUE(settle_at_start());
	double target = initial_position + long_travel;
	forget_messages();
	unsigned before = revision(focuser, FOCUSER_POSITION_PROPERTY_NAME);
	indigo_change_number_property_1(&client, FOCUSER_DEVICE_NAME, FOCUSER_POSITION_PROPERTY_NAME, FOCUSER_POSITION_ITEM_NAME, target);
	ASSERT_TRUE(wait_state(focuser, FOCUSER_POSITION_PROPERTY_NAME, before, INDIGO_BUSY_STATE, SHORT_TIMEOUT));
	// A relative move requested while the absolute move runs must be refused explicitly, and the
	// refusal must carry the driver's own values rather than the rejected request.
	unsigned steps_before = revision(focuser, FOCUSER_STEPS_PROPERTY_NAME);
	indigo_change_number_property_1(&client, FOCUSER_DEVICE_NAME, FOCUSER_STEPS_PROPERTY_NAME, FOCUSER_STEPS_ITEM_NAME, 100);
	ASSERT_TRUE(wait_state(focuser, FOCUSER_STEPS_PROPERTY_NAME, steps_before, INDIGO_ALERT_STATE, SHORT_TIMEOUT));
	ASSERT_TRUE(wait_for_message("Another motion operation is pending", SHORT_TIMEOUT));
	// A second absolute move must be refused the same way instead of being dropped without a word.
	forget_messages();
	unsigned again_before = revision(focuser, FOCUSER_POSITION_PROPERTY_NAME);
	indigo_change_number_property_1(&client, FOCUSER_DEVICE_NAME, FOCUSER_POSITION_PROPERTY_NAME, FOCUSER_POSITION_ITEM_NAME, initial_position);
	ASSERT_TRUE(wait_state(focuser, FOCUSER_POSITION_PROPERTY_NAME, again_before, INDIGO_ALERT_STATE, SHORT_TIMEOUT));
	ASSERT_TRUE(wait_for_message("Another motion operation is pending", SHORT_TIMEOUT));
	ASSERT_TRUE(wait_settled(focuser, FOCUSER_POSITION_PROPERTY_NAME, INDIGO_OK_STATE, MOTION_TIMEOUT));
	// The same refusal has to protect a running relative move, which needs the position property to
	// carry the motion state of that move.
	forget_messages();
	ASSERT_TRUE(set_switch(focuser, FOCUSER_DIRECTION_PROPERTY_NAME, FOCUSER_DIRECTION_MOVE_OUTWARD_ITEM_NAME, INDIGO_OK_STATE, SHORT_TIMEOUT));
	unsigned steps_started = revision(focuser, FOCUSER_STEPS_PROPERTY_NAME);
	indigo_change_number_property_1(&client, FOCUSER_DEVICE_NAME, FOCUSER_STEPS_PROPERTY_NAME, FOCUSER_STEPS_ITEM_NAME, long_travel);
	ASSERT_TRUE(wait_state(focuser, FOCUSER_STEPS_PROPERTY_NAME, steps_started, INDIGO_BUSY_STATE, SHORT_TIMEOUT));
	ASSERT_TRUE(wait_settled(focuser, FOCUSER_POSITION_PROPERTY_NAME, INDIGO_BUSY_STATE, SHORT_TIMEOUT));
	unsigned position_before = revision(focuser, FOCUSER_POSITION_PROPERTY_NAME);
	indigo_change_number_property_1(&client, FOCUSER_DEVICE_NAME, FOCUSER_POSITION_PROPERTY_NAME, FOCUSER_POSITION_ITEM_NAME, initial_position);
	ASSERT_TRUE(wait_state(focuser, FOCUSER_POSITION_PROPERTY_NAME, position_before, INDIGO_ALERT_STATE, SHORT_TIMEOUT));
	ASSERT_TRUE(wait_for_message("Another motion operation is pending", SHORT_TIMEOUT));
	// Refusing the position property must not disarm the guard of the relative move that is still
	// running, so a second relative request has to be refused as well.
	forget_messages();
	unsigned steps_again = revision(focuser, FOCUSER_STEPS_PROPERTY_NAME);
	fprintf(stderr, "    before the second relative request: FOCUSER_POSITION state %d, FOCUSER_STEPS state %d\n", property_state(focuser, FOCUSER_POSITION_PROPERTY_NAME), property_state(focuser, FOCUSER_STEPS_PROPERTY_NAME));
	indigo_change_number_property_1(&client, FOCUSER_DEVICE_NAME, FOCUSER_STEPS_PROPERTY_NAME, FOCUSER_STEPS_ITEM_NAME, 100);
	ASSERT_TRUE(wait_state(focuser, FOCUSER_STEPS_PROPERTY_NAME, steps_again, INDIGO_ALERT_STATE, SHORT_TIMEOUT));
	fprintf(stderr, "    after the second relative request: FOCUSER_POSITION state %d value %g, FOCUSER_STEPS state %d, revisions %u -> %u\n", property_state(focuser, FOCUSER_POSITION_PROPERTY_NAME), cached_position(), property_state(focuser, FOCUSER_STEPS_PROPERTY_NAME), steps_again, revision(focuser, FOCUSER_STEPS_PROPERTY_NAME));
	ASSERT_TRUE(wait_for_message("Another motion operation is pending", SHORT_TIMEOUT));
	ASSERT_TRUE(wait_settled(focuser, FOCUSER_STEPS_PROPERTY_NAME, INDIGO_OK_STATE, MOTION_TIMEOUT));
	ASSERT_TRUE(move_to(initial_position, MOTION_TIMEOUT));
}

static void primaluce_aborts_a_move_and_recovers(void) {
	ASSERT_TRUE(settle_at_start());
	double target = initial_position + long_travel, stopped = 0, reread = 0;
	unsigned before = revision(focuser, FOCUSER_POSITION_PROPERTY_NAME);
	indigo_change_number_property_1(&client, FOCUSER_DEVICE_NAME, FOCUSER_POSITION_PROPERTY_NAME, FOCUSER_POSITION_ITEM_NAME, target);
	ASSERT_TRUE(wait_state(focuser, FOCUSER_POSITION_PROPERTY_NAME, before, INDIGO_BUSY_STATE, SHORT_TIMEOUT));
	indigo_usleep(1500000);
	ASSERT_TRUE(set_switch(focuser, FOCUSER_ABORT_MOTION_PROPERTY_NAME, FOCUSER_ABORT_MOTION_ITEM_NAME, INDIGO_OK_STATE, SHORT_TIMEOUT));
	// The abort must end the motion, so neither motion property may stay BUSY. An interrupted move
	// did not reach its target, so the terminal state is ALERT.
	ASSERT_TRUE(wait_settled(focuser, FOCUSER_POSITION_PROPERTY_NAME, INDIGO_ALERT_STATE, SHORT_TIMEOUT));
	ASSERT_TRUE(property_state(focuser, FOCUSER_STEPS_PROPERTY_NAME) != INDIGO_BUSY_STATE);
	ASSERT_TRUE(number_item(focuser, FOCUSER_POSITION_PROPERTY_NAME, FOCUSER_POSITION_ITEM_NAME, &stopped));
	printf("    aborted at %.0f of a move from %.0f to %.0f\n", stopped, initial_position, target);
	// The draw tube moved, and it stopped short of the requested target.
	ASSERT_TRUE(stopped > initial_position + 0.5);
	ASSERT_TRUE(stopped < target - 0.5);
	// The position published after the abort must be the one the controller actually holds, which a
	// reconnect reads straight from the hardware.
	ASSERT_TRUE(disconnect_device(focuser));
	ASSERT_TRUE(connect_device(focuser, SHORT_TIMEOUT));
	ASSERT_TRUE(number_item(focuser, FOCUSER_POSITION_PROPERTY_NAME, FOCUSER_POSITION_ITEM_NAME, &reread));
	if (fabs(reread - stopped) > 0.5) {
		fprintf(stderr, "    the abort published %.0f but the controller is at %.0f\n", stopped, reread);
	}
	ASSERT_TRUE(fabs(reread - stopped) < 0.5);
	// A fresh command must be accepted after the abort.
	ASSERT_TRUE(move_to(initial_position, MOTION_TIMEOUT));
}

static void primaluce_accepts_an_abort_while_idle(void) {
	ASSERT_TRUE(settle_at_start());
	ASSERT_TRUE(set_switch(focuser, FOCUSER_ABORT_MOTION_PROPERTY_NAME, FOCUSER_ABORT_MOTION_ITEM_NAME, INDIGO_OK_STATE, SHORT_TIMEOUT));
	ASSERT_TRUE(move_to(initial_position + short_travel, MOTION_TIMEOUT));
	ASSERT_TRUE(move_to(initial_position, MOTION_TIMEOUT));
}

static void primaluce_sets_backlash(void) {
	double value = 0;
	double requested = initial_backlash == 50 ? 25 : 50;
	ASSERT_TRUE(set_number(focuser, FOCUSER_BACKLASH_PROPERTY_NAME, FOCUSER_BACKLASH_ITEM_NAME, requested, INDIGO_OK_STATE, SHORT_TIMEOUT));
	ASSERT_TRUE(number_item(focuser, FOCUSER_BACKLASH_PROPERTY_NAME, FOCUSER_BACKLASH_ITEM_NAME, &value));
	ASSERT_TRUE(fabs(value - requested) < 0.001);
	// The controller must keep the setting across a reconnect, which is what makes it a controller
	// setting rather than a driver-side value.
	ASSERT_TRUE(disconnect_device(focuser));
	ASSERT_TRUE(connect_device(focuser, SHORT_TIMEOUT));
	ASSERT_TRUE(number_item(focuser, FOCUSER_BACKLASH_PROPERTY_NAME, FOCUSER_BACKLASH_ITEM_NAME, &value));
	ASSERT_TRUE(fabs(value - requested) < 0.001);
	ASSERT_TRUE(set_number(focuser, FOCUSER_BACKLASH_PROPERTY_NAME, FOCUSER_BACKLASH_ITEM_NAME, initial_backlash, INDIGO_OK_STATE, SHORT_TIMEOUT));
}

static void primaluce_sets_hold_current(void) {
	if (!property_defined(focuser, X_HOLD_CURR_PROPERTY_NAME)) {
		printf("    the controller has no hold current setting\n");
		return;
	}
	bool on = false;
	const char *other = strcmp(initial_hold_current, X_HOLD_CURR_ON_ITEM_NAME) ? X_HOLD_CURR_ON_ITEM_NAME : X_HOLD_CURR_OFF_ITEM_NAME;
	ASSERT_TRUE(set_switch(focuser, X_HOLD_CURR_PROPERTY_NAME, other, INDIGO_OK_STATE, SHORT_TIMEOUT));
	ASSERT_TRUE(switch_item(focuser, X_HOLD_CURR_PROPERTY_NAME, other, &on) && on);
	ASSERT_TRUE(set_switch(focuser, X_HOLD_CURR_PROPERTY_NAME, initial_hold_current, INDIGO_OK_STATE, SHORT_TIMEOUT));
	ASSERT_TRUE(switch_item(focuser, X_HOLD_CURR_PROPERTY_NAME, initial_hold_current, &on) && on);
}

static void primaluce_applies_a_run_preset(void) {
	if (!property_defined(focuser, X_RUNPRESET_PROPERTY_NAME)) {
		printf("    the controller has no run presets\n");
		return;
	}
	static const char *config_items[] = { X_CONFIG_M1ACC_ITEM_NAME, X_CONFIG_M1SPD_ITEM_NAME, X_CONFIG_M1DEC_ITEM_NAME, X_CONFIG_M1CACC_ITEM_NAME, X_CONFIG_M1CSPD_ITEM_NAME, X_CONFIG_M1CDEC_ITEM_NAME, X_CONFIG_M1HOLD_ITEM_NAME };
	unsigned config_before = revision(focuser, X_CONFIG_PROPERTY_NAME);
	ASSERT_TRUE(set_switch(focuser, X_RUNPRESET_PROPERTY_NAME, X_RUNPRESET_M_ITEM_NAME, INDIGO_OK_STATE, SHORT_TIMEOUT));
	// Applying a preset copies its stored values into the live run configuration, so X_CONFIG must
	// be republished with exactly the values X_RUNPRESET_M reports.
	ASSERT_TRUE(wait_revision(focuser, X_CONFIG_PROPERTY_NAME, config_before, SHORT_TIMEOUT));
	ASSERT_TRUE(property_state(focuser, X_CONFIG_PROPERTY_NAME) == INDIGO_OK_STATE);
	for (unsigned i = 0; i < ARRAY_SIZE(config_items); i++) {
		double stored = 0, live = 0;
		ASSERT_TRUE(number_item(focuser, X_RUNPRESET_M_PROPERTY_NAME, config_items[i], &stored));
		ASSERT_TRUE(number_item(focuser, X_CONFIG_PROPERTY_NAME, config_items[i], &live));
		if (fabs(stored - live) > 0.001) {
			fprintf(stderr, "    X_CONFIG.%s is %.0f but the medium preset stores %.0f\n", config_items[i], live, stored);
		}
		ASSERT_TRUE(fabs(stored - live) < 0.001);
	}
	// A move must still work with the preset applied.
	ASSERT_TRUE(move_to(initial_position + short_travel, MOTION_TIMEOUT));
	ASSERT_TRUE(move_to(initial_position, MOTION_TIMEOUT));
	restore_initial_settings();
	for (unsigned i = 0; i < ARRAY_SIZE(config_items); i++) {
		double live = 0;
		ASSERT_TRUE(number_item(focuser, X_CONFIG_PROPERTY_NAME, config_items[i], &live));
		ASSERT_TRUE(fabs(live - initial_config[i]) < 0.001);
	}
}

static void primaluce_sets_led_modes(void) {
	static const char *modes[] = { X_LEDS_OFF_ITEM_NAME, X_LEDS_DIM_ITEM_NAME, X_LEDS_ON_ITEM_NAME };
	for (unsigned i = 0; i < ARRAY_SIZE(modes); i++) {
		bool on = false;
		ASSERT_TRUE(set_switch(focuser, X_LEDS_PROPERTY_NAME, modes[i], INDIGO_OK_STATE, SHORT_TIMEOUT));
		ASSERT_TRUE(switch_item(focuser, X_LEDS_PROPERTY_NAME, modes[i], &on) && on);
	}
	ASSERT_TRUE(set_switch(focuser, X_LEDS_PROPERTY_NAME, initial_leds, INDIGO_OK_STATE, SHORT_TIMEOUT));
}

static void primaluce_reads_wifi_settings(void) {
	char ssid[INDIGO_VALUE_SIZE] = "", password[INDIGO_VALUE_SIZE] = "", selected[INDIGO_NAME_SIZE] = "";
	// Read-only on hardware: switching the access point off would drop the unit's own network
	// service and cannot be restored through the serial link alone on every firmware.
	ASSERT_TRUE(text_item(focuser, X_WIFI_AP_PROPERTY_NAME, X_WIFI_AP_SSID_ITEM_NAME, ssid, sizeof(ssid)));
	ASSERT_TRUE(*ssid);
	ASSERT_TRUE(text_item(focuser, X_WIFI_AP_PROPERTY_NAME, X_WIFI_AP_PASSWORD_ITEM_NAME, password, sizeof(password)));
	ASSERT_TRUE(selected_switch(focuser, X_WIFI_PROPERTY_NAME, selected, sizeof(selected)));
	printf("    access point %s, mode %s\n", ssid, selected);
}

static void primaluce_calibrates_the_focuser(void) {
	if (!run_calibration) {
		printf("    skipped, set PRIMALUCE_HW_CALIBRATE=1 to drive the draw tube to both end stops\n");
		return;
	}
	ASSERT_TRUE(set_switch(focuser, X_CALIBRATE_F_PROPERTY_NAME, X_CALIBRATE_F_START_ITEM_NAME, INDIGO_OK_STATE, MOTION_TIMEOUT));
	ASSERT_TRUE(set_switch(focuser, X_CALIBRATE_F_PROPERTY_NAME, X_CALIBRATE_F_END_ITEM_NAME, INDIGO_OK_STATE, MOTION_TIMEOUT));
	ASSERT_TRUE(disconnect_device(focuser));
	ASSERT_TRUE(connect_device(focuser, SHORT_TIMEOUT));
}

// The rotator is a separate logical device sharing the focuser's connection. Connecting it enables
// the controller's ARCO port, and disconnecting it must disable that port again; otherwise the
// controller is left in a different state than the session found it in.
static void primaluce_connects_the_rotator(void) {
	ASSERT_TRUE(settle_at_start());
	double position = 0;
	ASSERT_TRUE(property_defined(rotator, CONNECTION_PROPERTY_NAME));
	ASSERT_TRUE(connect_device(rotator, SHORT_TIMEOUT));
	ASSERT_TRUE((devices[rotator].interface & INDIGO_INTERFACE_ROTATOR) != 0);
	ASSERT_TRUE(property_defined(rotator, ROTATOR_POSITION_PROPERTY_NAME));
	ASSERT_TRUE(property_defined(rotator, ROTATOR_ABORT_MOTION_PROPERTY_NAME));
	ASSERT_TRUE(property_defined(rotator, X_CALIBRATE_R_PROPERTY_NAME));
	ASSERT_TRUE(property_hidden(rotator, ROTATOR_ON_POSITION_SET_PROPERTY_NAME));
	ASSERT_TRUE(number_item(rotator, ROTATOR_POSITION_PROPERTY_NAME, ROTATOR_POSITION_ITEM_NAME, &position));
	printf("    rotator reports %.2f degrees\n", position);
	ASSERT_TRUE(disconnect_device(rotator));
	// The focuser must be unaffected by the rotator session: the shared connection stays open and
	// the focuser position code path must still be the one the focuser motor needs.
	ASSERT_TRUE(property_state(focuser, CONNECTION_PROPERTY_NAME) == INDIGO_OK_STATE);
	ASSERT_TRUE(move_to(initial_position + short_travel, MOTION_TIMEOUT));
	ASSERT_TRUE(move_to(initial_position, MOTION_TIMEOUT));
}

static void primaluce_reconnects(void) {
	ASSERT_TRUE(settle_at_start());
	double position = 0;
	ASSERT_TRUE(disconnect_device(focuser));
	ASSERT_TRUE(connect_device(focuser, SHORT_TIMEOUT));
	ASSERT_TRUE(number_item(focuser, FOCUSER_POSITION_PROPERTY_NAME, FOCUSER_POSITION_ITEM_NAME, &position));
	ASSERT_TRUE(fabs(position - initial_position) < 0.5);
	ASSERT_TRUE(move_to(initial_position + short_travel, MOTION_TIMEOUT));
	ASSERT_TRUE(move_to(initial_position, MOTION_TIMEOUT));
}

static void primaluce_reinitializes(void) {
	ASSERT_TRUE(disconnect_device(focuser));
	ASSERT_TRUE(indigo_focuser_primaluce(INDIGO_DRIVER_SHUTDOWN, NULL) == INDIGO_OK);
	ASSERT_TRUE(indigo_focuser_primaluce(INDIGO_DRIVER_INIT, NULL) == INDIGO_OK);
	ASSERT_TRUE(wait_presence(SHORT_TIMEOUT));
	ASSERT_TRUE(select_port());
	ASSERT_TRUE(connect_device(focuser, SHORT_TIMEOUT));
}

int main(int argc, char **argv) {
	if (argc < 2 || strcmp(argv[1], "--run")) {
		fprintf(stderr, "Physical PrimaluceLab focuser test: run explicitly with --run (or make test-focuser-primaluce-hw).\n");
		return 2;
	}
	setvbuf(stdout, NULL, _IONBF, 0);
	if (getenv("PRIMALUCE_HW_DEBUG")) {
		indigo_set_log_level(INDIGO_LOG_DEBUG);
	}
	serial_port = getenv("PRIMALUCE_HW_PORT");
	const char *travel = getenv("PRIMALUCE_HW_TRAVEL");
	if (travel && *travel) {
		long_travel = atof(travel);
		short_travel = long_travel / 10 < 10 ? 10 : long_travel / 10;
	}
	run_calibration = getenv("PRIMALUCE_HW_CALIBRATE") != NULL;
	client = (indigo_client){ .name = "PrimaluceLab hardware test", .version = INDIGO_VERSION_CURRENT, .define_property = define_property, .update_property = update_property, .delete_property = delete_property, .send_message = report_message };
	const indigo_test_case tests[] = {
		{ "primaluce_reports_identity_and_capabilities", primaluce_reports_identity_and_capabilities },
		{ "primaluce_publishes_the_property_contract", primaluce_publishes_the_property_contract },
		{ "primaluce_reads_controller_state", primaluce_reads_controller_state },
		{ "primaluce_polls_controller_state", primaluce_polls_controller_state },
		{ "primaluce_moves_to_an_absolute_position", primaluce_moves_to_an_absolute_position },
		{ "primaluce_moves_by_relative_steps", primaluce_moves_by_relative_steps },
		{ "primaluce_refuses_an_overlapping_request", primaluce_refuses_an_overlapping_request },
		{ "primaluce_aborts_a_move_and_recovers", primaluce_aborts_a_move_and_recovers },
		{ "primaluce_accepts_an_abort_while_idle", primaluce_accepts_an_abort_while_idle },
		{ "primaluce_sets_backlash", primaluce_sets_backlash },
		{ "primaluce_sets_hold_current", primaluce_sets_hold_current },
		{ "primaluce_applies_a_run_preset", primaluce_applies_a_run_preset },
		{ "primaluce_sets_led_modes", primaluce_sets_led_modes },
		{ "primaluce_reads_wifi_settings", primaluce_reads_wifi_settings },
		{ "primaluce_calibrates_the_focuser", primaluce_calibrates_the_focuser },
		{ "primaluce_connects_the_rotator", primaluce_connects_the_rotator },
		{ "primaluce_reconnects", primaluce_reconnects },
		{ "primaluce_reinitializes", primaluce_reinitializes }
	};
	int result = 1;
	bool started = false, initialized = false;
	CHECK(indigo_start() == INDIGO_OK);
	started = true;
	CHECK(indigo_attach_client(&client) == INDIGO_OK);
	CHECK(indigo_focuser_primaluce(INDIGO_DRIVER_INIT, NULL) == INDIGO_OK);
	initialized = true;
	CHECK(wait_presence(SHORT_TIMEOUT));
	CHECK(select_port());
	CHECK(connect_device(focuser, SHORT_TIMEOUT));
	CHECK(capture_initial_settings());
	printf("Starting position %.0f, backlash %.0f, hold current %s, LEDs %s\n", initial_position, initial_backlash, initial_hold_current, initial_leds);
	result = indigo_run_tests("PrimaluceLab focuser hardware", tests, ARRAY_SIZE(tests));
cleanup:
	if (focuser >= 0 && devices[focuser].present) {
		set_switch(focuser, FOCUSER_ABORT_MOTION_PROPERTY_NAME, FOCUSER_ABORT_MOTION_ITEM_NAME, INDIGO_OK_STATE, SHORT_TIMEOUT);
		restore_initial_settings();
		// Put the draw tube back where the session found it.
		if (settings_captured && move_to(initial_position, MOTION_TIMEOUT)) {
			printf("Restored the starting position %.0f\n", initial_position);
		}
	}
	if (!disconnect_device(rotator) || !disconnect_device(focuser)) {
		indigo_test_failures++;
	}
	if (initialized && indigo_focuser_primaluce(INDIGO_DRIVER_SHUTDOWN, NULL) != INDIGO_OK) {
		indigo_test_failures++;
	}
	indigo_detach_client(&client);
	if (started) {
		indigo_stop();
	}
	for (int d = 0; d < MAX_DEVICES; d++) {
		for (int p = 0; p < MAX_PROPERTIES; p++) {
			indigo_release_property(devices[d].properties[p]);
		}
	}
	return indigo_test_failures ? 1 : result;
}
