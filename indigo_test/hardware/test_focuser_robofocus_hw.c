// Copyright (c) 2026 INDIGO initiative
// All rights reserved.
//
// You may use this software under the terms of 'INDIGO Astronomy
// open-source license' (see LICENSE.md).
//
// THIS SOFTWARE IS PROVIDED BY THE AUTHORS 'AS IS' AND ANY EXPRESS
// OR IMPLIED WARRANTIES, INCLUDING, BUT NOT LIMITED TO, THE IMPLIED
// WARRANTIES OF MERCHANTABILITY AND FITNESS FOR A PARTICULAR PURPOSE
// ARE DISCLAIMED. IN NO EVENT SHALL THE AUTHOR BE LIABLE FOR ANY
// DIRECT, INDIRECT, INCIDENTAL, SPECIAL, EXEMPLARY, OR CONSEQUENTIAL
// DAMAGES (INCLUDING, BUT NOT LIMITED TO, PROCUREMENT OF SUBSTITUTE
// GOODS OR SERVICES; LOSS OF USE, DATA, OR PROFITS; OR BUSINESS
// INTERRUPTION) HOWEVER CAUSED AND ON ANY THEORY OF LIABILITY,
// WHETHER IN CONTRACT, STRICT LIABILITY, OR TORT (INCLUDING
// NEGLIGENCE OR OTHERWISE) ARISING IN ANY WAY OUT OF THE USE OF THIS
// SOFTWARE, EVEN IF ADVISED OF THE POSSIBILITY OF SUCH DAMAGE.

// Code is generated by AI

// Opt-in acceptance test for a physically connected RoboFocus, or for the Arduino sketch focuser_robofocus_simulator.ino
// running on a board. It checks the values read at the connection, moves to absolute positions and by steps both
// ways, applies the reversed direction, aborts a move, syncs, writes the maximum travel, switches the four power
// channels, writes and reads back the motor configuration and backlash (kept over a reconnect), reconnects and runs
// driver INIT/SHUTDOWN.
//
// THE FOCUSER MOVES AND THE POWER CHANNELS SWITCH. The session writes back the settings it found and returns to the
// position it found.
//
// The port comes from ROBOFOCUS_HW_PORT.

#include <math.h>
#include <stdlib.h>
#include <indigo_drivers/focuser_robofocus/indigo_focuser_robofocus.h>
#include "focuser_hw_common.h"

#define DEVICE_NAME "RoboFocus"
#define POWER "X_FOCUSER_POWER_CHANNELS"
#define CONFIG "X_FOCUSER_CONFIG"

#define SHORT_TIMEOUT 15.0
#define MOVE_TIMEOUT 120.0
#define TRAVEL 300

static int focuser = -1;
static const char *serial_port = NULL;
static bool state_captured = false;
static double initial_position = 0, initial_maximum = 0, initial_config[4], base = 0;
static bool initial_power[4];
static const char *channel[4] = { "1", "2", "3", "4" };
static const char *config_item[4] = { "DUTY_CYCLE", "STEP_DELAY", "STEP_SIZE", "BACKLASH" };

static bool select_port(void) {
	if (serial_port == NULL || !*serial_port) {
		fprintf(stderr, "    set ROBOFOCUS_HW_PORT to the focuser's port\n");
		return false;
	}
	printf("Using port %s\n", serial_port);
	return hw_set_text(focuser, DEVICE_PORT_PROPERTY_NAME, DEVICE_PORT_ITEM_NAME, serial_port, INDIGO_OK_STATE, SHORT_TIMEOUT);
}

static double value(const char *property, const char *item) {
	return focuser_hw_value(focuser, property, item);
}

static bool channel_is(int index) {
	return focuser_hw_switch_is(focuser, POWER, channel[index]);
}

static bool set_channel(int index, bool on) {
	return hw_set_switch_value(focuser, POWER, channel[index], on, INDIGO_OK_STATE, SHORT_TIMEOUT) && channel_is(index) == on;
}

static bool set_config(const double values[4]) {
	if (!focuser_hw_idle(focuser, CONFIG, SHORT_TIMEOUT)) {
		return false;
	}
	unsigned before = hw_revision(focuser, CONFIG);
	indigo_change_number_property(&hw_client, hw_device_name(focuser), CONFIG, 4, config_item, values);
	if (!focuser_hw_settles(focuser, CONFIG, before, INDIGO_OK_STATE, SHORT_TIMEOUT)) {
		return false;
	}
	for (int i = 0; i < 4; i++) {
		if (value(CONFIG, config_item[i]) != values[i]) {
			fprintf(stderr, "    %s %g, expected %g\n", config_item[i], value(CONFIG, config_item[i]), values[i]);
			return false;
		}
	}
	return true;
}

static bool set_maximum(double maximum) {
	unsigned before = hw_revision(focuser, FOCUSER_LIMITS_PROPERTY_NAME);
	static const char *items[] = { FOCUSER_LIMITS_MIN_POSITION_ITEM_NAME, FOCUSER_LIMITS_MAX_POSITION_ITEM_NAME };
	double values[] = { value(FOCUSER_LIMITS_PROPERTY_NAME, FOCUSER_LIMITS_MIN_POSITION_ITEM_NAME), maximum };
	indigo_change_number_property(&hw_client, hw_device_name(focuser), FOCUSER_LIMITS_PROPERTY_NAME, 2, items, values);
	return focuser_hw_settles(focuser, FOCUSER_LIMITS_PROPERTY_NAME, before, INDIGO_OK_STATE, SHORT_TIMEOUT) && value(FOCUSER_LIMITS_PROPERTY_NAME, FOCUSER_LIMITS_MAX_POSITION_ITEM_NAME) == maximum;
}

static void restore_initial_state(void) {
	if (focuser < 0 || !state_captured || !hw_connected(focuser)) {
		return;
	}
	focuser_hw_idle(focuser, FOCUSER_POSITION_PROPERTY_NAME, MOVE_TIMEOUT);
	focuser_hw_set_switch(focuser, FOCUSER_ON_POSITION_SET_PROPERTY_NAME, FOCUSER_ON_POSITION_SET_GOTO_ITEM_NAME, SHORT_TIMEOUT);
	focuser_hw_set_switch(focuser, FOCUSER_REVERSE_MOTION_PROPERTY_NAME, FOCUSER_REVERSE_MOTION_DISABLED_ITEM_NAME, SHORT_TIMEOUT);
	for (int i = 0; i < 4; i++) {
		if (channel_is(i) != initial_power[i]) {
			set_channel(i, initial_power[i]);
		}
	}
	set_config(initial_config);
	if (value(FOCUSER_LIMITS_PROPERTY_NAME, FOCUSER_LIMITS_MAX_POSITION_ITEM_NAME) != initial_maximum) {
		set_maximum(initial_maximum);
	}
	focuser_hw_goto(focuser, initial_position, INDIGO_OK_STATE, MOVE_TIMEOUT);
}

static void robofocus_publishes_the_values(void) {
	char firmware[INDIGO_VALUE_SIZE] = "";
	ASSERT_TRUE((hw_device_interface(focuser) & INDIGO_INTERFACE_FOCUSER) != 0);
	ASSERT_TRUE(hw_text_item(focuser, INFO_PROPERTY_NAME, INFO_DEVICE_FW_REVISION_ITEM_NAME, firmware, sizeof(firmware)));
	double temperature = value(FOCUSER_TEMPERATURE_PROPERTY_NAME, FOCUSER_TEMPERATURE_ITEM_NAME);
	printf("    firmware %s, position %g, maximum %g, duty %g, delay %g, size %g, backlash %g, power %d%d%d%d, %.1f C (state %d)\n", firmware, initial_position, initial_maximum, initial_config[0], initial_config[1], initial_config[2], initial_config[3], initial_power[0], initial_power[1], initial_power[2], initial_power[3], temperature, hw_property_state(focuser, FOCUSER_TEMPERATURE_PROPERTY_NAME));
	ASSERT_EQ_INT(6, (int)strlen(firmware));
	ASSERT_TRUE(initial_position >= 1 && initial_position <= initial_maximum);
	ASSERT_TRUE(initial_config[1] >= 1 && initial_config[1] <= 64 && initial_config[2] >= 1 && initial_config[2] <= 64);
	if (hw_property_state(focuser, FOCUSER_TEMPERATURE_PROPERTY_NAME) == INDIGO_OK_STATE) {
		ASSERT_TRUE(temperature > -50 && temperature < 50);
	}
}

static void robofocus_moves_to_absolute_positions(void) {
	ASSERT_TRUE(focuser_hw_goto(focuser, base + TRAVEL, INDIGO_OK_STATE, MOVE_TIMEOUT));
	ASSERT_TRUE(focuser_hw_goto(focuser, base + 11, INDIGO_OK_STATE, MOVE_TIMEOUT));
	ASSERT_TRUE(focuser_hw_goto(focuser, base, INDIGO_OK_STATE, MOVE_TIMEOUT));
	ASSERT_TRUE(focuser_hw_goto(focuser, base, INDIGO_OK_STATE, SHORT_TIMEOUT));
}

// An outward move increases the position; the reversed direction swaps the steps.
static void robofocus_moves_by_steps(void) {
	ASSERT_TRUE(focuser_hw_steps(focuser, true, 120, INDIGO_OK_STATE, MOVE_TIMEOUT));
	ASSERT_EQ_INT((int)base + 120, (int)focuser_hw_position(focuser));
	ASSERT_TRUE(focuser_hw_steps(focuser, false, 120, INDIGO_OK_STATE, MOVE_TIMEOUT));
	ASSERT_EQ_INT((int)base, (int)focuser_hw_position(focuser));
	ASSERT_TRUE(focuser_hw_set_switch(focuser, FOCUSER_REVERSE_MOTION_PROPERTY_NAME, FOCUSER_REVERSE_MOTION_ENABLED_ITEM_NAME, SHORT_TIMEOUT));
	ASSERT_TRUE(focuser_hw_steps(focuser, false, 50, INDIGO_OK_STATE, MOVE_TIMEOUT));
	ASSERT_EQ_INT((int)base + 50, (int)focuser_hw_position(focuser));
	ASSERT_TRUE(focuser_hw_steps(focuser, true, 50, INDIGO_OK_STATE, MOVE_TIMEOUT));
	ASSERT_TRUE(focuser_hw_set_switch(focuser, FOCUSER_REVERSE_MOTION_PROPERTY_NAME, FOCUSER_REVERSE_MOTION_DISABLED_ITEM_NAME, SHORT_TIMEOUT));
	ASSERT_EQ_INT((int)base, (int)focuser_hw_position(focuser));
}

// An aborted move ends ALERT at the position where it stopped, keeps the requested target, and the motor stays there.
static void robofocus_aborts_a_move(void) {
	ASSERT_TRUE(focuser_hw_start_goto(focuser, base + TRAVEL, SHORT_TIMEOUT));
	indigo_usleep(2000000);
	ASSERT_TRUE(focuser_hw_abort(focuser, SHORT_TIMEOUT));
	ASSERT_TRUE(focuser_hw_idle(focuser, FOCUSER_POSITION_PROPERTY_NAME, SHORT_TIMEOUT));
	ASSERT_EQ_INT(INDIGO_ALERT_STATE, hw_property_state(focuser, FOCUSER_POSITION_PROPERTY_NAME));
	double stopped = focuser_hw_position(focuser);
	printf("    stopped at %g on the way from %g to %g\n", stopped, base, base + TRAVEL);
	ASSERT_TRUE(stopped > base && stopped < base + TRAVEL);
	indigo_usleep(2000000);
	ASSERT_EQ_INT((int)stopped, (int)focuser_hw_position(focuser));
	// the idle polls since the abort have not rewritten the target
	double target = NAN;
	ASSERT_TRUE(hw_number_item_target(focuser, FOCUSER_POSITION_PROPERTY_NAME, FOCUSER_POSITION_ITEM_NAME, &target));
	ASSERT_EQ_INT((int)(base + TRAVEL), (int)target);
	ASSERT_TRUE(focuser_hw_goto(focuser, base, INDIGO_OK_STATE, MOVE_TIMEOUT));
}

// A sync sets the coordinate without moving; syncing back restores it.
static void robofocus_syncs(void) {
	ASSERT_TRUE(focuser_hw_set_switch(focuser, FOCUSER_ON_POSITION_SET_PROPERTY_NAME, FOCUSER_ON_POSITION_SET_SYNC_ITEM_NAME, SHORT_TIMEOUT));
	ASSERT_TRUE(focuser_hw_goto(focuser, base + 1234, INDIGO_OK_STATE, SHORT_TIMEOUT));
	indigo_usleep(1500000);
	ASSERT_EQ_INT((int)base + 1234, (int)focuser_hw_position(focuser));
	ASSERT_TRUE(focuser_hw_goto(focuser, base, INDIGO_OK_STATE, SHORT_TIMEOUT));
	ASSERT_TRUE(focuser_hw_set_switch(focuser, FOCUSER_ON_POSITION_SET_PROPERTY_NAME, FOCUSER_ON_POSITION_SET_GOTO_ITEM_NAME, SHORT_TIMEOUT));
	ASSERT_EQ_INT((int)base, (int)focuser_hw_position(focuser));
}

// The maximum travel is written to the controller, which keeps a move below it.
static void robofocus_keeps_below_the_maximum(void) {
	ASSERT_TRUE(set_maximum(base + 100));
	ASSERT_TRUE(hw_disconnect(focuser, SHORT_TIMEOUT));
	ASSERT_TRUE(hw_connect(focuser, SHORT_TIMEOUT));
	ASSERT_EQ_INT((int)base + 100, (int)value(FOCUSER_LIMITS_PROPERTY_NAME, FOCUSER_LIMITS_MAX_POSITION_ITEM_NAME));
	ASSERT_TRUE(focuser_hw_start_goto(focuser, base + 200, SHORT_TIMEOUT) || focuser_hw_position(focuser) == base);
	ASSERT_TRUE(focuser_hw_idle(focuser, FOCUSER_POSITION_PROPERTY_NAME, MOVE_TIMEOUT));
	ASSERT_EQ_INT((int)base + 100, (int)focuser_hw_position(focuser));
	ASSERT_TRUE(set_maximum(initial_maximum));
	ASSERT_TRUE(focuser_hw_goto(focuser, base, INDIGO_OK_STATE, MOVE_TIMEOUT));
}

// Every power channel switches both ways, confirmed by the controller, and keeps its state over a reconnect.
static void robofocus_switches_the_power_channels(void) {
	for (int i = 0; i < 4; i++) {
		ASSERT_TRUE(set_channel(i, !initial_power[i]));
	}
	ASSERT_TRUE(hw_disconnect(focuser, SHORT_TIMEOUT));
	ASSERT_TRUE(hw_connect(focuser, SHORT_TIMEOUT));
	for (int i = 0; i < 4; i++) {
		ASSERT_EQ_INT(!initial_power[i], channel_is(i));
		ASSERT_TRUE(set_channel(i, initial_power[i]));
	}
}

// The motor configuration and backlash are confirmed by the controller and kept over a reconnect.
static void robofocus_changes_the_configuration(void) {
	double changed[4] = { initial_config[0] == 200 ? 150 : 200, initial_config[1] == 12 ? 13 : 12, initial_config[2] == 8 ? 6 : 8, -35 };
	ASSERT_TRUE(set_config(changed));
	ASSERT_TRUE(hw_disconnect(focuser, SHORT_TIMEOUT));
	ASSERT_TRUE(hw_connect(focuser, SHORT_TIMEOUT));
	for (int i = 0; i < 4; i++) {
		ASSERT_EQ_INT((int)changed[i], (int)value(CONFIG, config_item[i]));
	}
	changed[3] = 44;
	ASSERT_TRUE(set_config(changed));
	ASSERT_TRUE(set_config(initial_config));
}

static void robofocus_reconnects(void) {
	ASSERT_TRUE(hw_disconnect(focuser, SHORT_TIMEOUT));
	ASSERT_TRUE(hw_property_hidden(focuser, FOCUSER_POSITION_PROPERTY_NAME));
	ASSERT_TRUE(hw_connect(focuser, SHORT_TIMEOUT));
	ASSERT_EQ_INT((int)base, (int)focuser_hw_position(focuser));
	ASSERT_EQ_INT(INDIGO_OK_STATE, hw_property_state(focuser, FOCUSER_POSITION_PROPERTY_NAME));
}

static void robofocus_rejects_shutdown_while_connected(void) {
	ASSERT_EQ_INT(INDIGO_BUSY, indigo_focuser_robofocus(INDIGO_DRIVER_SHUTDOWN, NULL));
	ASSERT_TRUE(hw_connected(focuser));
}

static void robofocus_reinitializes(void) {
	ASSERT_TRUE(hw_disconnect(focuser, SHORT_TIMEOUT));
	ASSERT_EQ_INT(INDIGO_OK, indigo_focuser_robofocus(INDIGO_DRIVER_SHUTDOWN, NULL));
	ASSERT_EQ_INT(-1, hw_device_index(DEVICE_NAME));
	ASSERT_EQ_INT(INDIGO_OK, indigo_focuser_robofocus(INDIGO_DRIVER_INIT, NULL));
	focuser = hw_wait_for_device(DEVICE_NAME, SHORT_TIMEOUT);
	ASSERT_TRUE(focuser >= 0);
	ASSERT_TRUE(select_port());
	ASSERT_TRUE(hw_connect(focuser, SHORT_TIMEOUT));
	ASSERT_EQ_INT((int)base, (int)focuser_hw_position(focuser));
}

int main(int argc, char **argv) {
	if (argc < 2 || strcmp(argv[1], "--run")) {
		fprintf(stderr, "Physical RoboFocus test: run explicitly with --run (or make test-focuser-robofocus-hw).\n");
		return 2;
	}
	setvbuf(stdout, NULL, _IONBF, 0);
	for (int i = 2; i < argc; i++) {
		if (!strcmp(argv[i], "--debug")) {
			indigo_set_log_level(INDIGO_LOG_DEBUG);
		}
	}
	if (!indigo_test_use_private_home()) {
		return 1;
	}
	serial_port = hw_port("ROBOFOCUS_HW_PORT");
	const indigo_test_case tests[] = {
		{ "robofocus_publishes_the_values", robofocus_publishes_the_values },
		{ "robofocus_moves_to_absolute_positions", robofocus_moves_to_absolute_positions },
		{ "robofocus_moves_by_steps", robofocus_moves_by_steps },
		{ "robofocus_aborts_a_move", robofocus_aborts_a_move },
		{ "robofocus_syncs", robofocus_syncs },
		{ "robofocus_keeps_below_the_maximum", robofocus_keeps_below_the_maximum },
		{ "robofocus_switches_the_power_channels", robofocus_switches_the_power_channels },
		{ "robofocus_changes_the_configuration", robofocus_changes_the_configuration },
		{ "robofocus_reconnects", robofocus_reconnects },
		{ "robofocus_rejects_shutdown_while_connected", robofocus_rejects_shutdown_while_connected },
		{ "robofocus_reinitializes", robofocus_reinitializes }
	};
	int result = 1;
	bool started = false, initialized = false;
	HW_CHECK(hw_start() == INDIGO_OK);
	started = true;
	HW_CHECK(hw_attach_client("RoboFocus hardware test") == INDIGO_OK);
	HW_CHECK(indigo_focuser_robofocus(INDIGO_DRIVER_INIT, NULL) == INDIGO_OK);
	initialized = true;
	focuser = hw_wait_for_device(DEVICE_NAME, SHORT_TIMEOUT);
	HW_CHECK(focuser >= 0);
	HW_CHECK(select_port());
	HW_CHECK(hw_connect(focuser, SHORT_TIMEOUT));
	HW_CHECK(focuser_hw_idle(focuser, FOCUSER_POSITION_PROPERTY_NAME, MOVE_TIMEOUT));
	initial_position = focuser_hw_position(focuser);
	initial_maximum = value(FOCUSER_LIMITS_PROPERTY_NAME, FOCUSER_LIMITS_MAX_POSITION_ITEM_NAME);
	for (int i = 0; i < 4; i++) {
		initial_config[i] = value(CONFIG, config_item[i]);
		initial_power[i] = channel_is(i);
	}
	base = initial_position + TRAVEL + 1500 > initial_maximum ? initial_maximum - TRAVEL - 1500 : initial_position < 200 ? 200 : initial_position;
	state_captured = true;
	result = indigo_run_tests("RoboFocus hardware", tests, ARRAY_SIZE(tests));
cleanup:
	restore_initial_state();
	if (!hw_disconnect(focuser, SHORT_TIMEOUT)) {
		indigo_test_failures++;
	}
	if (initialized && indigo_focuser_robofocus(INDIGO_DRIVER_SHUTDOWN, NULL) != INDIGO_OK) {
		indigo_test_failures++;
	}
	indigo_detach_client(&hw_client);
	if (started) {
		indigo_stop();
	}
	hw_release_properties();
	indigo_test_remove_private_home();
	return indigo_test_failures ? 1 : result;
}
