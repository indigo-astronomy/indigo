// Copyright (c) 2026 INDIGO initiative
// All rights reserved.
//
// You may use this software under the terms of 'INDIGO Astronomy
// open-source license' (see LICENSE.md).
//
// THIS SOFTWARE IS PROVIDED BY THE AUTHORS 'AS IS' AND ANY EXPRESS
// OR IMPLIED WARRANTIES, INCLUDING, BUT NOT LIMITED TO, THE IMPLIED
// WARRANTIES OF MERCHANTABILITY AND FITNESS FOR A PARTICULAR PURPOSE
// ARE DISCLAIMED. IN NO EVENT SHALL THE AUTHOR BE LIABLE FOR ANY
// DIRECT, INDIRECT, INCIDENTAL, SPECIAL, EXEMPLARY, OR CONSEQUENTIAL
// DAMAGES (INCLUDING, BUT NOT LIMITED TO, PROCUREMENT OF SUBSTITUTE
// GOODS OR SERVICES; LOSS OF USE, DATA, OR PROFITS; OR BUSINESS
// INTERRUPTION) HOWEVER CAUSED AND ON ANY THEORY OF LIABILITY,
// WHETHER IN CONTRACT, STRICT LIABILITY, OR TORT (INCLUDING
// NEGLIGENCE OR OTHERWISE) ARISING IN ANY WAY OUT OF THE USE OF THIS
// SOFTWARE, EVEN IF ADVISED OF THE POSSIBILITY OF SUCH DAMAGE.

// Code is generated by AI

// Opt-in acceptance test for a physically connected Starlight Xpress AO unit (AO, AO-LF or
// AO-LF USB). It implements the AO hardware acceptance checklist of DRIVER_TESTING_RULES.md against
// the real unit: discovery and connection, identity readback, the published property contract, the
// initial limit status, corrections in all four directions, the step boundaries and the zero
// request, the BUSY/OK publication of a correction, the request the framework drops while another
// one runs, a correction queued behind a reset, centre, the supported unjam, the embedded ST4
// guider on its own and alongside the AO, both connection orders, last-close ownership, reconnect
// and driver INIT/SHUTDOWN.
//
// The optical element physically moves. Every correction stays inside the step range the driver
// itself advertises and every scenario centres the unit afterwards, so the mechanism is never
// driven into a jam or an end stop. The travel-limit reply is therefore not exercised here; it is
// covered by the simulator and the faked-transport suites.
//
// sx_ao_measures_guide_pulse_duration is the guiding-pulse measurement required by
// indigo_drivers/AGENTS.override.md. The AO acknowledges the guide command immediately and times
// the relay pulse in its own firmware, so this measures the driver command path, not the physical
// ST4 output. See indigo_drivers/ao_sx/REFACTOR.md.
//
// The serial port comes from AO_SX_HW_PORT. When it is not set the port the driver itself detected
// is used.

#include <math.h>
#include <pthread.h>
#include <stdlib.h>
#include <string.h>
#include <unistd.h>
#include <indigo/indigo_bus.h>
#include <indigo/indigo_client.h>
#include <indigo/indigo_driver.h>
#include <indigo/indigo_names.h>
#include <indigo/indigo_timer.h>
#include <indigo_drivers/ao_sx/indigo_ao_sx.h>
#include "../test_runner.h"

#define ARRAY_SIZE(a) (sizeof(a) / sizeof((a)[0]))
#define MAX_DEVICES 4
#define MAX_PROPERTIES 32

#define AO_DEVICE_NAME "SX AO"
#define GUIDER_DEVICE_NAME "SX AO (guider)"

// One character-framed transaction over the 9600 baud link plus the driver's own connection work.
#define SHORT_TIMEOUT 15.0
// Centre and unjam move the mechanism through its whole range; the unit answers K after up to 7 s
// and the driver gives it 15 s, so a queued reset needs more than that.
#define RESET_TIMEOUT 40.0
// A correction takes about 60 ms at 10 steps and about 220 ms at the item maximum on an AO-L.
#define CORRECTION_TIMEOUT 15.0

// The correction magnitudes used by the scenarios, in steps, and the item maximum the driver
// advertises. A full 50 step correction from centre sits exactly on the AO-L travel limit and is
// answered with L every so often, so the largest correction the scenarios make is deliberately
// inside it; the limit reply itself is covered by the simulator and faked-transport suites.
#define SMALL_CORRECTION 10
#define BOUNDARY_CORRECTION 40
#define ITEM_MAXIMUM 50

#define CHECK(condition) do { if (!(condition)) { fprintf(stderr, "%s:%d: %s\n", __FILE__, __LINE__, #condition); indigo_test_failures++; goto cleanup; } } while (0)

typedef struct {
	char name[INDIGO_NAME_SIZE];
	indigo_device *device;
	unsigned interface;
	bool present;
	indigo_property *properties[MAX_PROPERTIES];
	unsigned revisions[MAX_PROPERTIES];
	unsigned states[MAX_PROPERTIES];
} observed_device;

static observed_device devices[MAX_DEVICES];
static pthread_mutex_t mutex = PTHREAD_MUTEX_INITIALIZER;
static int ao = -1, guider = -1;
static char last_message_text[INDIGO_VALUE_SIZE];
static indigo_client client;
static const char *serial_port = NULL;
// The firmware the unit reported when the session connected for the first time. A reconnect has to
// report the same one.
static char initial_firmware[INDIGO_VALUE_SIZE];

static int slot(int d, const char *name) {
	for (int p = 0; p < MAX_PROPERTIES; p++) {
		if (devices[d].properties[p] && !strcmp(devices[d].properties[p]->name, name)) {
			return p;
		}
	}
	return -1;
}

static indigo_result observe(indigo_device *device, indigo_property *property, const char *message) {
	pthread_mutex_lock(&mutex);
	int d;
	for (d = 0; d < MAX_DEVICES; d++) {
		if (!*devices[d].name || !strcmp(devices[d].name, property->device)) {
			break;
		}
	}
	if (d < MAX_DEVICES) {
		snprintf(devices[d].name, INDIGO_NAME_SIZE, "%s", property->device);
		devices[d].device = device;
		devices[d].present = true;
		if (!strcmp(property->name, INFO_PROPERTY_NAME)) {
			for (int i = 0; i < property->count; i++) {
				if (!strcmp(property->items[i].name, INFO_DEVICE_INTERFACE_ITEM_NAME)) {
					devices[d].interface = (unsigned)strtoul(property->items[i].text.value, NULL, 10);
				}
			}
		}
		int p = slot(d, property->name);
		if (p < 0) {
			for (p = 0; p < MAX_PROPERTIES && devices[d].properties[p]; p++) { }
		}
		if (p < MAX_PROPERTIES) {
			indigo_release_property(devices[d].properties[p]);
			devices[d].properties[p] = indigo_copy_property(NULL, property);
			devices[d].revisions[p]++;
			devices[d].states[p] |= 1u << property->state;
		}
	}
	pthread_mutex_unlock(&mutex);
	if (message && *message) {
		fprintf(stderr, "    %s %s: %s\n", property->device, property->name, message);
	}
	return INDIGO_OK;
}

static indigo_result define_property(indigo_client *client, indigo_device *device, indigo_property *property, const char *message) {
	return observe(device, property, message);
}

static indigo_result update_property(indigo_client *client, indigo_device *device, indigo_property *property, const char *message) {
	return observe(device, property, message);
}

static indigo_result report_message(indigo_client *client, indigo_device *device, indigo_property *property, const char *message) {
	if (message && *message) {
		pthread_mutex_lock(&mutex);
		snprintf(last_message_text, INDIGO_VALUE_SIZE, "%s", message);
		pthread_mutex_unlock(&mutex);
		fprintf(stderr, "    message: %s\n", message);
	}
	return INDIGO_OK;
}

static indigo_result delete_property(indigo_client *client, indigo_device *device, indigo_property *property, const char *message) {
	pthread_mutex_lock(&mutex);
	for (int d = 0; d < MAX_DEVICES; d++) {
		if (strcmp(devices[d].name, property->device)) {
			continue;
		}
		if (*property->name) {
			int p = slot(d, property->name);
			if (p >= 0) {
				indigo_release_property(devices[d].properties[p]);
				devices[d].properties[p] = NULL;
				devices[d].revisions[p] = 0;
				devices[d].states[p] = 0;
			}
		} else {
			devices[d].present = false;
			for (int p = 0; p < MAX_PROPERTIES; p++) {
				indigo_release_property(devices[d].properties[p]);
				devices[d].properties[p] = NULL;
				devices[d].revisions[p] = 0;
				devices[d].states[p] = 0;
			}
		}
	}
	pthread_mutex_unlock(&mutex);
	return INDIGO_OK;
}

static int device_index(const char *name) {
	pthread_mutex_lock(&mutex);
	int result = -1;
	for (int d = 0; d < MAX_DEVICES; d++) {
		if (!strcmp(devices[d].name, name)) {
			result = d;
		}
	}
	pthread_mutex_unlock(&mutex);
	return result;
}

static unsigned revision(int d, const char *name) {
	pthread_mutex_lock(&mutex);
	int p = slot(d, name);
	unsigned result = p < 0 ? 0 : devices[d].revisions[p];
	pthread_mutex_unlock(&mutex);
	return result;
}

// Every state the property has been published in since the last forget_states(). The BUSY a
// correction is advertised with is gone again in well under a second, so it can only be asserted
// through this mask and not by polling for it.
static unsigned states_seen(int d, const char *name) {
	pthread_mutex_lock(&mutex);
	int p = slot(d, name);
	unsigned result = p < 0 ? 0 : devices[d].states[p];
	pthread_mutex_unlock(&mutex);
	return result;
}

static void forget_states(void) {
	pthread_mutex_lock(&mutex);
	for (int d = 0; d < MAX_DEVICES; d++) {
		for (int p = 0; p < MAX_PROPERTIES; p++) {
			devices[d].states[p] = 0;
		}
	}
	*last_message_text = 0;
	pthread_mutex_unlock(&mutex);
}

static bool property_defined(int d, const char *name) {
	pthread_mutex_lock(&mutex);
	bool found = slot(d, name) >= 0;
	pthread_mutex_unlock(&mutex);
	return found;
}

static bool property_hidden(int d, const char *name) {
	if (property_defined(d, name)) {
		fprintf(stderr, "    %s is published but should stay hidden\n", name);
		return false;
	}
	return true;
}

static bool number_item(int d, const char *name, const char *item, double *value) {
	pthread_mutex_lock(&mutex);
	int p = slot(d, name);
	bool found = false;
	if (p >= 0) {
		indigo_property *property = devices[d].properties[p];
		for (int i = 0; i < property->count && !found; i++) {
			if (!strcmp(property->items[i].name, item)) {
				*value = property->items[i].number.value;
				found = true;
			}
		}
	}
	pthread_mutex_unlock(&mutex);
	if (!found) {
		fprintf(stderr, "    missing number item %s.%s\n", name, item);
	}
	return found;
}

static bool number_item_max(int d, const char *name, const char *item, double *value) {
	pthread_mutex_lock(&mutex);
	int p = slot(d, name);
	bool found = false;
	if (p >= 0) {
		indigo_property *property = devices[d].properties[p];
		for (int i = 0; i < property->count && !found; i++) {
			if (!strcmp(property->items[i].name, item)) {
				*value = property->items[i].number.max;
				found = true;
			}
		}
	}
	pthread_mutex_unlock(&mutex);
	if (!found) {
		fprintf(stderr, "    missing number item %s.%s\n", name, item);
	}
	return found;
}

static bool switch_item(int d, const char *name, const char *item, bool *value) {
	pthread_mutex_lock(&mutex);
	int p = slot(d, name);
	bool found = false;
	if (p >= 0) {
		indigo_property *property = devices[d].properties[p];
		for (int i = 0; i < property->count && !found; i++) {
			if (!strcmp(property->items[i].name, item)) {
				*value = property->items[i].sw.value;
				found = true;
			}
		}
	}
	pthread_mutex_unlock(&mutex);
	if (!found) {
		fprintf(stderr, "    missing switch item %s.%s\n", name, item);
	}
	return found;
}

static bool text_item(int d, const char *name, const char *item, char *value, size_t size) {
	pthread_mutex_lock(&mutex);
	int p = slot(d, name);
	bool found = false;
	if (p >= 0) {
		indigo_property *property = devices[d].properties[p];
		for (int i = 0; i < property->count && !found; i++) {
			if (!strcmp(property->items[i].name, item)) {
				snprintf(value, size, "%s", property->items[i].text.value);
				found = true;
			}
		}
	}
	pthread_mutex_unlock(&mutex);
	if (!found) {
		fprintf(stderr, "    missing text item %s.%s\n", name, item);
	}
	return found;
}

static indigo_property_state property_state(int d, const char *name) {
	pthread_mutex_lock(&mutex);
	int p = slot(d, name);
	indigo_property_state state = p < 0 ? INDIGO_IDLE_STATE : devices[d].properties[p]->state;
	pthread_mutex_unlock(&mutex);
	return state;
}

// Waits for a newer revision of the property in the requested state. The revision gate is required
// because a correction leaves its property in the same OK state it had before the request, so a
// state that was already published must not satisfy the wait.
static bool wait_state(int d, const char *name, unsigned after, indigo_property_state state, double timeout) {
	double deadline = indigo_monotonic_time() + timeout;
	while (indigo_monotonic_time() < deadline) {
		pthread_mutex_lock(&mutex);
		int p = slot(d, name);
		bool ready = p >= 0 && devices[d].revisions[p] > after && devices[d].properties[p]->state == state;
		pthread_mutex_unlock(&mutex);
		if (ready) {
			return true;
		}
		indigo_usleep(2000);
	}
	fprintf(stderr, "    timeout: %s %s expected state %d, last published state %d\n", devices[d].name, name, state, property_state(d, name));
	return false;
}

static bool wait_settled(int d, const char *name, indigo_property_state state, double timeout) {
	double deadline = indigo_monotonic_time() + timeout;
	while (indigo_monotonic_time() < deadline) {
		if (property_state(d, name) == state) {
			return true;
		}
		indigo_usleep(2000);
	}
	fprintf(stderr, "    timeout: %s %s did not settle in state %d (state %d)\n", devices[d].name, name, state, property_state(d, name));
	return false;
}

static bool set_switch(int d, const char *name, const char *item, indigo_property_state expected, double timeout) {
	unsigned before = revision(d, name);
	indigo_change_switch_property_1(&client, devices[d].name, name, item, true);
	return wait_state(d, name, before, expected, timeout);
}

static bool set_number(int d, const char *name, const char *item, double value, indigo_property_state expected, double timeout) {
	unsigned before = revision(d, name);
	indigo_change_number_property_1(&client, devices[d].name, name, item, value);
	return wait_state(d, name, before, expected, timeout);
}

static bool connect_device(int d, double timeout) {
	if (d < 0) {
		fprintf(stderr, "    device not present\n");
		return false;
	}
	bool connected = false;
	if (switch_item(d, CONNECTION_PROPERTY_NAME, CONNECTION_CONNECTED_ITEM_NAME, &connected) && connected) {
		return true;
	}
	if (!set_switch(d, CONNECTION_PROPERTY_NAME, CONNECTION_CONNECTED_ITEM_NAME, INDIGO_OK_STATE, timeout)) {
		return false;
	}
	return switch_item(d, CONNECTION_PROPERTY_NAME, CONNECTION_CONNECTED_ITEM_NAME, &connected) && connected;
}

static bool disconnect_device(int d) {
	if (d < 0 || !devices[d].present) {
		return true;
	}
	bool connected = false;
	if (!switch_item(d, CONNECTION_PROPERTY_NAME, CONNECTION_CONNECTED_ITEM_NAME, &connected) || !connected) {
		return true;
	}
	return set_switch(d, CONNECTION_PROPERTY_NAME, CONNECTION_DISCONNECTED_ITEM_NAME, INDIGO_OK_STATE, SHORT_TIMEOUT);
}

static bool wait_presence(double timeout) {
	double deadline = indigo_monotonic_time() + timeout;
	while (indigo_monotonic_time() < deadline) {
		ao = device_index(AO_DEVICE_NAME);
		guider = device_index(GUIDER_DEVICE_NAME);
		if (ao >= 0 && guider >= 0 && property_defined(ao, CONNECTION_PROPERTY_NAME) && property_defined(guider, CONNECTION_PROPERTY_NAME)) {
			return true;
		}
		indigo_usleep(20000);
	}
	fprintf(stderr, "    the driver did not publish both logical devices\n");
	return false;
}

// Points the AO at the requested port. Without an explicit port the port the driver enumerated is
// kept, which is what a normal client sees.
static bool select_port(void) {
	if (serial_port == NULL || !*serial_port) {
		char detected[INDIGO_VALUE_SIZE] = "";
		if (text_item(ao, DEVICE_PORT_PROPERTY_NAME, DEVICE_PORT_ITEM_NAME, detected, sizeof(detected)) && *detected) {
			printf("Using the port the driver detected: %s\n", detected);
			return true;
		}
		fprintf(stderr, "    no serial port was detected, set AO_SX_HW_PORT\n");
		return false;
	}
	printf("Using port %s\n", serial_port);
	unsigned before = revision(ao, DEVICE_PORT_PROPERTY_NAME);
	indigo_change_text_property_1(&client, AO_DEVICE_NAME, DEVICE_PORT_PROPERTY_NAME, DEVICE_PORT_ITEM_NAME, serial_port);
	return wait_state(ao, DEVICE_PORT_PROPERTY_NAME, before, INDIGO_OK_STATE, SHORT_TIMEOUT);
}

static bool center(void) {
	return set_switch(ao, AO_RESET_PROPERTY_NAME, AO_CENTER_ITEM_NAME, INDIGO_OK_STATE, RESET_TIMEOUT);
}

// Brings the AO back to a known starting point for a scenario: connected, centred and with no
// leftover state from a scenario that failed halfway through.
static bool ready(void) {
	if (!connect_device(ao, SHORT_TIMEOUT)) {
		return false;
	}
	if (!wait_settled(ao, AO_RESET_PROPERTY_NAME, INDIGO_OK_STATE, RESET_TIMEOUT)) {
		return false;
	}
	forget_states();
	return center();
}

static bool correct(const char *property, const char *item, double steps) {
	return set_number(ao, property, item, steps, INDIGO_OK_STATE, CORRECTION_TIMEOUT);
}

// A correction leaves the handled item at zero, so the next request for the same item is a genuine
// change and not a repeat of the value the property already holds.
static bool corrected_item_is_cleared(const char *property, const char *item) {
	double value = -1;
	if (!number_item(ao, property, item, &value)) {
		return false;
	}
	if (value != 0) {
		fprintf(stderr, "    %s.%s is %g after the correction, expected 0\n", property, item, value);
		return false;
	}
	return true;
}

static void sx_ao_reports_identity_and_capabilities(void) {
	char model[INDIGO_VALUE_SIZE] = "", firmware[INDIGO_VALUE_SIZE] = "";
	ASSERT_TRUE((devices[ao].interface & INDIGO_INTERFACE_AO) != 0);
	ASSERT_TRUE(text_item(ao, INFO_PROPERTY_NAME, INFO_DEVICE_MODEL_ITEM_NAME, model, sizeof(model)));
	ASSERT_TRUE(!strcmp(model, "StarlightXpress AO"));
	ASSERT_TRUE(text_item(ao, INFO_PROPERTY_NAME, INFO_DEVICE_FW_REVISION_ITEM_NAME, firmware, sizeof(firmware)));
	// The handshake reply is V followed by three firmware digits; anything still at the attach-time
	// placeholder means the identity was never read from the unit.
	ASSERT_TRUE(*firmware && strcmp(firmware, "Unknown"));
	ASSERT_EQ_INT(3, (int)strlen(firmware));
	snprintf(initial_firmware, sizeof(initial_firmware), "%s", firmware);
	printf("    model %s, firmware %s\n", model, firmware);
}

static void sx_ao_publishes_the_property_contract(void) {
	static const struct { const char *property, *item; } corrections[] = {
		{ AO_GUIDE_DEC_PROPERTY_NAME, AO_GUIDE_NORTH_ITEM_NAME },
		{ AO_GUIDE_DEC_PROPERTY_NAME, AO_GUIDE_SOUTH_ITEM_NAME },
		{ AO_GUIDE_RA_PROPERTY_NAME, AO_GUIDE_EAST_ITEM_NAME },
		{ AO_GUIDE_RA_PROPERTY_NAME, AO_GUIDE_WEST_ITEM_NAME }
	};
	ASSERT_TRUE(property_defined(ao, AO_GUIDE_RA_PROPERTY_NAME));
	ASSERT_TRUE(property_defined(ao, AO_GUIDE_DEC_PROPERTY_NAME));
	ASSERT_TRUE(property_defined(ao, AO_RESET_PROPERTY_NAME));
	ASSERT_TRUE(property_defined(ao, DEVICE_PORT_PROPERTY_NAME));
	ASSERT_TRUE(property_defined(ao, DEVICE_PORTS_PROPERTY_NAME));
	// The unit is not a simulator and has no authentication of its own.
	ASSERT_TRUE(property_hidden(ao, SIMULATION_PROPERTY_NAME));
	ASSERT_TRUE(property_hidden(ao, AUTHENTICATION_PROPERTY_NAME));
	for (unsigned i = 0; i < ARRAY_SIZE(corrections); i++) {
		double value = -1, max = -1;
		ASSERT_TRUE(number_item(ao, corrections[i].property, corrections[i].item, &value));
		ASSERT_TRUE(value == 0);
		// The AO base driver allows 100 steps, the SX mechanism only 50, and the driver narrows the
		// range at attach time so a client cannot request a correction the unit cannot make.
		ASSERT_TRUE(number_item_max(ao, corrections[i].property, corrections[i].item, &max));
		ASSERT_TRUE(max == ITEM_MAXIMUM);
	}
	bool center_on = true, unjam_on = true;
	ASSERT_TRUE(switch_item(ao, AO_RESET_PROPERTY_NAME, AO_CENTER_ITEM_NAME, &center_on));
	ASSERT_TRUE(!center_on);
	ASSERT_TRUE(switch_item(ao, AO_RESET_PROPERTY_NAME, AO_UNJAM_ITEM_NAME, &unjam_on));
	ASSERT_TRUE(!unjam_on);
	// The guider is a separate logical device of the same driver and must be published before it is
	// connected, with its own connection property.
	ASSERT_TRUE(property_defined(guider, CONNECTION_PROPERTY_NAME));
}

static void sx_ao_reports_initial_limit_status(void) {
	// The connection handler reads the L status byte and marks the axis that sits at its travel
	// limit. A centred unit has to come up with both axes in OK.
	ASSERT_TRUE(center());
	ASSERT_TRUE(disconnect_device(ao));
	ASSERT_TRUE(connect_device(ao, SHORT_TIMEOUT));
	ASSERT_EQ_INT(INDIGO_OK_STATE, property_state(ao, AO_GUIDE_RA_PROPERTY_NAME));
	ASSERT_EQ_INT(INDIGO_OK_STATE, property_state(ao, AO_GUIDE_DEC_PROPERTY_NAME));
}

static void sx_ao_corrects_in_all_four_directions(void) {
	static const struct { const char *property, *item, *back; } directions[] = {
		{ AO_GUIDE_DEC_PROPERTY_NAME, AO_GUIDE_NORTH_ITEM_NAME, AO_GUIDE_SOUTH_ITEM_NAME },
		{ AO_GUIDE_DEC_PROPERTY_NAME, AO_GUIDE_SOUTH_ITEM_NAME, AO_GUIDE_NORTH_ITEM_NAME },
		{ AO_GUIDE_RA_PROPERTY_NAME, AO_GUIDE_EAST_ITEM_NAME, AO_GUIDE_WEST_ITEM_NAME },
		{ AO_GUIDE_RA_PROPERTY_NAME, AO_GUIDE_WEST_ITEM_NAME, AO_GUIDE_EAST_ITEM_NAME }
	};
	ASSERT_TRUE(ready());
	for (unsigned i = 0; i < ARRAY_SIZE(directions); i++) {
		// Each direction is walked out and back, so the element ends up where it started and the
		// opposite item of the same property is exercised from a non-centre position.
		ASSERT_TRUE(correct(directions[i].property, directions[i].item, SMALL_CORRECTION));
		ASSERT_TRUE(corrected_item_is_cleared(directions[i].property, directions[i].item));
		ASSERT_TRUE(correct(directions[i].property, directions[i].back, SMALL_CORRECTION));
		ASSERT_TRUE(corrected_item_is_cleared(directions[i].property, directions[i].back));
	}
	ASSERT_TRUE(center());
}

static void sx_ao_accepts_boundary_and_zero_corrections(void) {
	ASSERT_TRUE(ready());
	// The smallest correction the item range allows, and the largest one the mechanism makes without
	// reaching its travel limit, each followed by a centre so the next one starts from the same
	// place.
	ASSERT_TRUE(correct(AO_GUIDE_DEC_PROPERTY_NAME, AO_GUIDE_NORTH_ITEM_NAME, 1));
	ASSERT_TRUE(correct(AO_GUIDE_DEC_PROPERTY_NAME, AO_GUIDE_SOUTH_ITEM_NAME, 1));
	ASSERT_TRUE(center());
	ASSERT_TRUE(correct(AO_GUIDE_RA_PROPERTY_NAME, AO_GUIDE_EAST_ITEM_NAME, BOUNDARY_CORRECTION));
	ASSERT_TRUE(center());
	ASSERT_TRUE(correct(AO_GUIDE_DEC_PROPERTY_NAME, AO_GUIDE_NORTH_ITEM_NAME, BOUNDARY_CORRECTION));
	ASSERT_TRUE(center());
	// A request with every item at zero is a no-op the driver still has to accept and complete; that
	// it sends no command to the unit is asserted by the faked-transport suite, which can count
	// commands.
	ASSERT_TRUE(correct(AO_GUIDE_RA_PROPERTY_NAME, AO_GUIDE_WEST_ITEM_NAME, 0));
	ASSERT_TRUE(correct(AO_GUIDE_DEC_PROPERTY_NAME, AO_GUIDE_SOUTH_ITEM_NAME, 0));
	ASSERT_EQ_INT(INDIGO_OK_STATE, property_state(ao, AO_GUIDE_RA_PROPERTY_NAME));
	ASSERT_EQ_INT(INDIGO_OK_STATE, property_state(ao, AO_GUIDE_DEC_PROPERTY_NAME));
}

static void sx_ao_publishes_busy_then_ok(void) {
	ASSERT_TRUE(ready());
	forget_states();
	ASSERT_TRUE(correct(AO_GUIDE_DEC_PROPERTY_NAME, AO_GUIDE_NORTH_ITEM_NAME, BOUNDARY_CORRECTION));
	// A correction has to be advertised as in progress and then completed, never reported OK
	// straight away and never left in ALERT by a unit that answered correctly.
	ASSERT_TRUE(states_seen(ao, AO_GUIDE_DEC_PROPERTY_NAME) & (1u << INDIGO_BUSY_STATE));
	ASSERT_TRUE(!(states_seen(ao, AO_GUIDE_DEC_PROPERTY_NAME) & (1u << INDIGO_ALERT_STATE)));
	ASSERT_TRUE(corrected_item_is_cleared(AO_GUIDE_DEC_PROPERTY_NAME, AO_GUIDE_NORTH_ITEM_NAME));
	forget_states();
	ASSERT_TRUE(center());
	ASSERT_TRUE(states_seen(ao, AO_RESET_PROPERTY_NAME) & (1u << INDIGO_BUSY_STATE));
	bool on = true;
	ASSERT_TRUE(switch_item(ao, AO_RESET_PROPERTY_NAME, AO_CENTER_ITEM_NAME, &on));
	ASSERT_TRUE(!on);
}

static void sx_ao_drops_an_overlapping_request(void) {
	ASSERT_TRUE(ready());
	// Centring occupies the queue for seconds, which is long enough to observe what happens to a
	// second request for the same property.
	unsigned before = revision(ao, AO_RESET_PROPERTY_NAME);
	indigo_change_switch_property_1(&client, AO_DEVICE_NAME, AO_RESET_PROPERTY_NAME, AO_CENTER_ITEM_NAME, true);
	ASSERT_TRUE(wait_state(ao, AO_RESET_PROPERTY_NAME, before, INDIGO_BUSY_STATE, SHORT_TIMEOUT));
	unsigned busy = revision(ao, AO_RESET_PROPERTY_NAME);
	indigo_change_switch_property_1(&client, AO_DEVICE_NAME, AO_RESET_PROPERTY_NAME, AO_UNJAM_ITEM_NAME, true);
	// The framework guard drops the second request without copying its values, so nothing new is
	// published while the first one is still running.
	indigo_usleep(300000);
	ASSERT_EQ_INT(busy, revision(ao, AO_RESET_PROPERTY_NAME));
	ASSERT_EQ_INT(INDIGO_BUSY_STATE, property_state(ao, AO_RESET_PROPERTY_NAME));
	ASSERT_TRUE(wait_state(ao, AO_RESET_PROPERTY_NAME, busy, INDIGO_OK_STATE, RESET_TIMEOUT));
	// The dropped request must not have left its item set, otherwise the next centre would unjam.
	bool unjam = true;
	ASSERT_TRUE(switch_item(ao, AO_RESET_PROPERTY_NAME, AO_UNJAM_ITEM_NAME, &unjam));
	ASSERT_TRUE(!unjam);
	// The unit is still usable after the dropped request.
	ASSERT_TRUE(correct(AO_GUIDE_RA_PROPERTY_NAME, AO_GUIDE_EAST_ITEM_NAME, SMALL_CORRECTION));
	ASSERT_TRUE(center());
}

static void sx_ao_queues_a_correction_behind_a_reset(void) {
	ASSERT_TRUE(ready());
	unsigned reset_before = revision(ao, AO_RESET_PROPERTY_NAME);
	indigo_change_switch_property_1(&client, AO_DEVICE_NAME, AO_RESET_PROPERTY_NAME, AO_CENTER_ITEM_NAME, true);
	ASSERT_TRUE(wait_state(ao, AO_RESET_PROPERTY_NAME, reset_before, INDIGO_BUSY_STATE, SHORT_TIMEOUT));
	// A different property is not covered by the busy guard, so this request is accepted and has to
	// wait its turn on the device queue instead of being interleaved with the reset transaction.
	unsigned correction_before = revision(ao, AO_GUIDE_RA_PROPERTY_NAME);
	indigo_change_number_property_1(&client, AO_DEVICE_NAME, AO_GUIDE_RA_PROPERTY_NAME, AO_GUIDE_WEST_ITEM_NAME, SMALL_CORRECTION);
	ASSERT_TRUE(wait_state(ao, AO_GUIDE_RA_PROPERTY_NAME, correction_before, INDIGO_BUSY_STATE, SHORT_TIMEOUT));
	unsigned correction_busy = revision(ao, AO_GUIDE_RA_PROPERTY_NAME);
	bool serialized = true;
	double deadline = indigo_monotonic_time() + RESET_TIMEOUT;
	while (property_state(ao, AO_RESET_PROPERTY_NAME) == INDIGO_BUSY_STATE && indigo_monotonic_time() < deadline) {
		// While the reset owns the queue the correction cannot have been carried out. The reset
		// publishes OK for both guide properties when it completes, so only a revision newer than
		// the correction's own BUSY publication would mean the two transactions overlapped.
		if (revision(ao, AO_GUIDE_RA_PROPERTY_NAME) != correction_busy) {
			serialized = false;
			break;
		}
		indigo_usleep(2000);
	}
	ASSERT_TRUE(serialized);
	ASSERT_TRUE(wait_settled(ao, AO_RESET_PROPERTY_NAME, INDIGO_OK_STATE, RESET_TIMEOUT));
	ASSERT_TRUE(wait_settled(ao, AO_GUIDE_RA_PROPERTY_NAME, INDIGO_OK_STATE, CORRECTION_TIMEOUT));
	ASSERT_TRUE(corrected_item_is_cleared(AO_GUIDE_RA_PROPERTY_NAME, AO_GUIDE_WEST_ITEM_NAME));
	ASSERT_TRUE(center());
}

static void sx_ao_centers_and_corrects_again(void) {
	ASSERT_TRUE(ready());
	ASSERT_TRUE(correct(AO_GUIDE_DEC_PROPERTY_NAME, AO_GUIDE_SOUTH_ITEM_NAME, SMALL_CORRECTION * 2));
	ASSERT_TRUE(center());
	// The guide properties are republished as OK by a completed reset, which is how a client learns
	// that an axis that was reported at its limit has been recovered.
	ASSERT_EQ_INT(INDIGO_OK_STATE, property_state(ao, AO_GUIDE_RA_PROPERTY_NAME));
	ASSERT_EQ_INT(INDIGO_OK_STATE, property_state(ao, AO_GUIDE_DEC_PROPERTY_NAME));
	ASSERT_TRUE(correct(AO_GUIDE_DEC_PROPERTY_NAME, AO_GUIDE_NORTH_ITEM_NAME, SMALL_CORRECTION * 2));
	ASSERT_TRUE(center());
}

static void sx_ao_unjams_and_corrects_again(void) {
	ASSERT_TRUE(ready());
	// Unjam is the unit's own recovery sweep; it is run from a centred, unjammed mechanism, which is
	// the only way the class standard allows it to be exercised.
	ASSERT_TRUE(set_switch(ao, AO_RESET_PROPERTY_NAME, AO_UNJAM_ITEM_NAME, INDIGO_OK_STATE, RESET_TIMEOUT));
	ASSERT_EQ_INT(INDIGO_OK_STATE, property_state(ao, AO_GUIDE_RA_PROPERTY_NAME));
	ASSERT_EQ_INT(INDIGO_OK_STATE, property_state(ao, AO_GUIDE_DEC_PROPERTY_NAME));
	ASSERT_TRUE(correct(AO_GUIDE_RA_PROPERTY_NAME, AO_GUIDE_WEST_ITEM_NAME, SMALL_CORRECTION));
	ASSERT_TRUE(center());
}

static void sx_guider_pulses_in_all_four_directions(void) {
	static const struct { const char *property, *item; } pulses[] = {
		{ GUIDER_GUIDE_DEC_PROPERTY_NAME, GUIDER_GUIDE_NORTH_ITEM_NAME },
		{ GUIDER_GUIDE_DEC_PROPERTY_NAME, GUIDER_GUIDE_SOUTH_ITEM_NAME },
		{ GUIDER_GUIDE_RA_PROPERTY_NAME, GUIDER_GUIDE_EAST_ITEM_NAME },
		{ GUIDER_GUIDE_RA_PROPERTY_NAME, GUIDER_GUIDE_WEST_ITEM_NAME }
	};
	ASSERT_TRUE(ready());
	ASSERT_TRUE(connect_device(guider, SHORT_TIMEOUT));
	ASSERT_TRUE((devices[guider].interface & INDIGO_INTERFACE_GUIDER) != 0);
	ASSERT_TRUE(property_defined(guider, GUIDER_GUIDE_RA_PROPERTY_NAME));
	ASSERT_TRUE(property_defined(guider, GUIDER_GUIDE_DEC_PROPERTY_NAME));
	// The guider opens the port through its master, so it has no port of its own to offer.
	ASSERT_TRUE(property_hidden(guider, DEVICE_PORT_PROPERTY_NAME));
	for (unsigned i = 0; i < ARRAY_SIZE(pulses); i++) {
		double value = -1;
		ASSERT_TRUE(set_number(guider, pulses[i].property, pulses[i].item, 200, INDIGO_OK_STATE, SHORT_TIMEOUT));
		ASSERT_TRUE(number_item(guider, pulses[i].property, pulses[i].item, &value));
		ASSERT_TRUE(value == 0);
	}
	// A pulse shorter than the unit's 10 ms resolution is still a request the driver has to accept
	// and complete rather than fail.
	ASSERT_TRUE(set_number(guider, GUIDER_GUIDE_RA_PROPERTY_NAME, GUIDER_GUIDE_EAST_ITEM_NAME, 5, INDIGO_OK_STATE, SHORT_TIMEOUT));
	// The AO half of the shared connection keeps working while the guider is connected.
	ASSERT_TRUE(correct(AO_GUIDE_RA_PROPERTY_NAME, AO_GUIDE_EAST_ITEM_NAME, SMALL_CORRECTION));
	ASSERT_TRUE(center());
	ASSERT_TRUE(disconnect_device(guider));
	// Disconnecting the guider must not take the shared port away from the AO.
	ASSERT_EQ_INT(INDIGO_OK_STATE, property_state(ao, CONNECTION_PROPERTY_NAME));
	ASSERT_TRUE(correct(AO_GUIDE_RA_PROPERTY_NAME, AO_GUIDE_WEST_ITEM_NAME, SMALL_CORRECTION));
	ASSERT_TRUE(center());
}

// The guiding-pulse duration measurement required by indigo_drivers/AGENTS.override.md. The unit
// acknowledges the M command in about 15 ms and times the relay pulse itself, so what is measured
// here is the driver command path from the bus request to the public completion, reported both as
// the raw latency and as the signed error against the requested duration. It is explicitly not
// physical ST4 relay-output accuracy, which needs an instrument on the port.
static void sx_ao_measures_guide_pulse_duration(void) {
	static const double durations[] = { 100, 250, 500, 1000 };
	static const struct { const char *property, *item; } axes[] = {
		{ GUIDER_GUIDE_RA_PROPERTY_NAME, GUIDER_GUIDE_EAST_ITEM_NAME },
		{ GUIDER_GUIDE_DEC_PROPERTY_NAME, GUIDER_GUIDE_NORTH_ITEM_NAME }
	};
	const int repeats = 5;
	double signed_sum = 0, absolute_sum = 0, worst = 0, latency_sum = 0, latency_worst = 0;
	int samples = 0;
	ASSERT_TRUE(ready());
	ASSERT_TRUE(connect_device(guider, SHORT_TIMEOUT));
	for (unsigned d = 0; d < ARRAY_SIZE(durations); d++) {
		for (unsigned a = 0; a < ARRAY_SIZE(axes); a++) {
			for (int r = 0; r < repeats; r++) {
				unsigned before = revision(guider, axes[a].property);
				double started = indigo_monotonic_time();
				indigo_change_number_property_1(&client, GUIDER_DEVICE_NAME, axes[a].property, axes[a].item, durations[d]);
				ASSERT_TRUE(wait_state(guider, axes[a].property, before, INDIGO_OK_STATE, SHORT_TIMEOUT));
				double latency = (indigo_monotonic_time() - started) * 1000;
				double error = latency - durations[d];
				signed_sum += error;
				absolute_sum += fabs(error);
				latency_sum += latency;
				if (fabs(error) > fabs(worst)) {
					worst = error;
				}
				if (latency > latency_worst) {
					latency_worst = latency;
				}
				samples++;
			}
		}
	}
	ASSERT_EQ_INT((int)(ARRAY_SIZE(durations) * ARRAY_SIZE(axes) * repeats), samples);
	printf("    %d samples over 100, 250, 500 and 1000 ms on both axes\n", samples);
	printf("    command path latency: mean %.1f ms, max %.1f ms\n", latency_sum / samples, latency_worst);
	printf("    against the requested duration: signed mean %.1f ms, absolute mean %.1f ms, worst %.1f ms\n", signed_sum / samples, absolute_sum / samples, worst);
	printf("    the AO acknowledges immediately and times the pulse in firmware, so this is driver command path timing, not ST4 relay output timing\n");
	// The driver must return as soon as the unit acknowledges; a completion that tracked the pulse
	// would mean it was blocking its queue for the whole guide exposure.
	ASSERT_TRUE(latency_worst < durations[0]);
	ASSERT_TRUE(disconnect_device(guider));
}

static void sx_ao_shares_the_connection_in_both_orders(void) {
	// Guider first: the slave opens the port through its master, and the AO joining afterwards must
	// reuse the same handle rather than open a second one.
	ASSERT_TRUE(disconnect_device(guider));
	ASSERT_TRUE(disconnect_device(ao));
	ASSERT_TRUE(connect_device(guider, SHORT_TIMEOUT));
	ASSERT_TRUE(set_number(guider, GUIDER_GUIDE_DEC_PROPERTY_NAME, GUIDER_GUIDE_SOUTH_ITEM_NAME, 200, INDIGO_OK_STATE, SHORT_TIMEOUT));
	ASSERT_TRUE(connect_device(ao, SHORT_TIMEOUT));
	ASSERT_TRUE(correct(AO_GUIDE_DEC_PROPERTY_NAME, AO_GUIDE_NORTH_ITEM_NAME, SMALL_CORRECTION));
	// The sibling that is left behind keeps the port open and keeps working.
	ASSERT_TRUE(disconnect_device(guider));
	ASSERT_TRUE(correct(AO_GUIDE_DEC_PROPERTY_NAME, AO_GUIDE_SOUTH_ITEM_NAME, SMALL_CORRECTION));
	ASSERT_TRUE(center());
	// AO first, guider second, and this time the AO is the one that leaves.
	ASSERT_TRUE(connect_device(guider, SHORT_TIMEOUT));
	ASSERT_TRUE(disconnect_device(ao));
	ASSERT_TRUE(set_number(guider, GUIDER_GUIDE_RA_PROPERTY_NAME, GUIDER_GUIDE_WEST_ITEM_NAME, 200, INDIGO_OK_STATE, SHORT_TIMEOUT));
	ASSERT_TRUE(connect_device(ao, SHORT_TIMEOUT));
	ASSERT_TRUE(correct(AO_GUIDE_RA_PROPERTY_NAME, AO_GUIDE_EAST_ITEM_NAME, SMALL_CORRECTION));
	ASSERT_TRUE(center());
	ASSERT_TRUE(disconnect_device(guider));
}

static void sx_ao_clears_identity_on_last_close(void) {
	char model[INDIGO_VALUE_SIZE] = "", firmware[INDIGO_VALUE_SIZE] = "";
	ASSERT_TRUE(connect_device(ao, SHORT_TIMEOUT));
	ASSERT_TRUE(connect_device(guider, SHORT_TIMEOUT));
	// The AO leaves first, so the last reference on the shared port is released by the guider. The
	// identity belongs to the connection, so whichever logical device closes it, the AO has to stop
	// advertising the unit it is no longer talking to.
	ASSERT_TRUE(disconnect_device(ao));
	ASSERT_TRUE(text_item(ao, INFO_PROPERTY_NAME, INFO_DEVICE_MODEL_ITEM_NAME, model, sizeof(model)));
	ASSERT_TRUE(disconnect_device(guider));
	ASSERT_TRUE(text_item(ao, INFO_PROPERTY_NAME, INFO_DEVICE_MODEL_ITEM_NAME, model, sizeof(model)));
	ASSERT_TRUE(text_item(ao, INFO_PROPERTY_NAME, INFO_DEVICE_FW_REVISION_ITEM_NAME, firmware, sizeof(firmware)));
	if (strcmp(model, "Unknown") || strcmp(firmware, "Unknown")) {
		fprintf(stderr, "    after the last close SX AO still reports model \"%s\", firmware \"%s\"\n", model, firmware);
	}
	ASSERT_TRUE(!strcmp(model, "Unknown"));
	ASSERT_TRUE(!strcmp(firmware, "Unknown"));
	// Connecting again has to read the identity back from the unit.
	ASSERT_TRUE(connect_device(ao, SHORT_TIMEOUT));
	ASSERT_TRUE(text_item(ao, INFO_PROPERTY_NAME, INFO_DEVICE_FW_REVISION_ITEM_NAME, firmware, sizeof(firmware)));
	ASSERT_TRUE(!strcmp(firmware, initial_firmware));
}

static void sx_ao_reconnects(void) {
	char firmware[INDIGO_VALUE_SIZE] = "";
	ASSERT_TRUE(ready());
	ASSERT_TRUE(disconnect_device(ao));
	ASSERT_TRUE(connect_device(ao, SHORT_TIMEOUT));
	ASSERT_TRUE(text_item(ao, INFO_PROPERTY_NAME, INFO_DEVICE_FW_REVISION_ITEM_NAME, firmware, sizeof(firmware)));
	ASSERT_TRUE(!strcmp(firmware, initial_firmware));
	ASSERT_TRUE(correct(AO_GUIDE_DEC_PROPERTY_NAME, AO_GUIDE_NORTH_ITEM_NAME, SMALL_CORRECTION));
	ASSERT_TRUE(center());
}

static void sx_ao_reinitializes(void) {
	ASSERT_TRUE(ready());
	// A driver with a connected device must refuse to shut down instead of pulling the port out from
	// under its client.
	ASSERT_EQ_INT(INDIGO_BUSY, indigo_ao_sx(INDIGO_DRIVER_SHUTDOWN, NULL));
	ASSERT_TRUE(disconnect_device(ao));
	ASSERT_EQ_INT(INDIGO_OK, indigo_ao_sx(INDIGO_DRIVER_SHUTDOWN, NULL));
	ASSERT_EQ_INT(INDIGO_OK, indigo_ao_sx(INDIGO_DRIVER_INIT, NULL));
	ASSERT_TRUE(wait_presence(SHORT_TIMEOUT));
	ASSERT_TRUE(select_port());
	ASSERT_TRUE(connect_device(ao, SHORT_TIMEOUT));
	ASSERT_TRUE(correct(AO_GUIDE_RA_PROPERTY_NAME, AO_GUIDE_EAST_ITEM_NAME, SMALL_CORRECTION));
	ASSERT_TRUE(center());
}

int main(int argc, char **argv) {
	if (argc < 2 || strcmp(argv[1], "--run")) {
		fprintf(stderr, "Physical Starlight Xpress AO test: run explicitly with --run (or make test-ao-sx-hw).\n");
		return 2;
	}
	setvbuf(stdout, NULL, _IONBF, 0);
	for (int i = 2; i < argc; i++) {
		if (!strcmp(argv[i], "--debug")) {
			indigo_set_log_level(INDIGO_LOG_DEBUG);
		}
	}
	serial_port = getenv("AO_SX_HW_PORT");
	client = (indigo_client){ .name = "Starlight Xpress AO hardware test", .version = INDIGO_VERSION_CURRENT, .define_property = define_property, .update_property = update_property, .delete_property = delete_property, .send_message = report_message };
	const indigo_test_case tests[] = {
		{ "sx_ao_reports_identity_and_capabilities", sx_ao_reports_identity_and_capabilities },
		{ "sx_ao_publishes_the_property_contract", sx_ao_publishes_the_property_contract },
		{ "sx_ao_reports_initial_limit_status", sx_ao_reports_initial_limit_status },
		{ "sx_ao_corrects_in_all_four_directions", sx_ao_corrects_in_all_four_directions },
		{ "sx_ao_accepts_boundary_and_zero_corrections", sx_ao_accepts_boundary_and_zero_corrections },
		{ "sx_ao_publishes_busy_then_ok", sx_ao_publishes_busy_then_ok },
		{ "sx_ao_drops_an_overlapping_request", sx_ao_drops_an_overlapping_request },
		{ "sx_ao_queues_a_correction_behind_a_reset", sx_ao_queues_a_correction_behind_a_reset },
		{ "sx_ao_centers_and_corrects_again", sx_ao_centers_and_corrects_again },
		{ "sx_ao_unjams_and_corrects_again", sx_ao_unjams_and_corrects_again },
		{ "sx_guider_pulses_in_all_four_directions", sx_guider_pulses_in_all_four_directions },
		{ "sx_ao_measures_guide_pulse_duration", sx_ao_measures_guide_pulse_duration },
		{ "sx_ao_shares_the_connection_in_both_orders", sx_ao_shares_the_connection_in_both_orders },
		{ "sx_ao_clears_identity_on_last_close", sx_ao_clears_identity_on_last_close },
		{ "sx_ao_reconnects", sx_ao_reconnects },
		{ "sx_ao_reinitializes", sx_ao_reinitializes }
	};
	int result = 1;
	bool started = false, initialized = false;
	CHECK(indigo_start() == INDIGO_OK);
	started = true;
	CHECK(indigo_attach_client(&client) == INDIGO_OK);
	CHECK(indigo_ao_sx(INDIGO_DRIVER_INIT, NULL) == INDIGO_OK);
	initialized = true;
	CHECK(wait_presence(SHORT_TIMEOUT));
	CHECK(select_port());
	CHECK(connect_device(ao, SHORT_TIMEOUT));
	CHECK(center());
	result = indigo_run_tests("Starlight Xpress AO hardware", tests, ARRAY_SIZE(tests));
cleanup:
	// Leave the optical element centred whatever happened above.
	if (ao >= 0 && devices[ao].present && connect_device(ao, SHORT_TIMEOUT) && center()) {
		printf("Centred the AO\n");
	}
	if (!disconnect_device(guider) || !disconnect_device(ao)) {
		indigo_test_failures++;
	}
	if (initialized && indigo_ao_sx(INDIGO_DRIVER_SHUTDOWN, NULL) != INDIGO_OK) {
		indigo_test_failures++;
	}
	indigo_detach_client(&client);
	if (started) {
		indigo_stop();
	}
	for (int d = 0; d < MAX_DEVICES; d++) {
		for (int p = 0; p < MAX_PROPERTIES; p++) {
			indigo_release_property(devices[d].properties[p]);
		}
	}
	return indigo_test_failures ? 1 : result;
}
