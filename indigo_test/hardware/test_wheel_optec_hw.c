// Copyright (c) 2026 INDIGO initiative
// All rights reserved.
//
// You may use this software under the terms of 'INDIGO Astronomy
// open-source license' (see LICENSE.md).
//
// THIS SOFTWARE IS PROVIDED BY THE AUTHORS 'AS IS' AND ANY EXPRESS
// OR IMPLIED WARRANTIES, INCLUDING, BUT NOT LIMITED TO, THE IMPLIED
// WARRANTIES OF MERCHANTABILITY AND FITNESS FOR A PARTICULAR PURPOSE
// ARE DISCLAIMED. IN NO EVENT SHALL THE AUTHOR BE LIABLE FOR ANY
// DIRECT, INDIRECT, INCIDENTAL, SPECIAL, EXEMPLARY, OR CONSEQUENTIAL
// DAMAGES (INCLUDING, BUT NOT LIMITED TO, PROCUREMENT OF SUBSTITUTE
// GOODS OR SERVICES; LOSS OF USE, DATA, OR PROFITS; OR BUSINESS
// INTERRUPTION) HOWEVER CAUSED AND ON ANY THEORY OF LIABILITY,
// WHETHER IN CONTRACT, STRICT LIABILITY, OR TORT (INCLUDING
// NEGLIGENCE OR OTHERWISE) ARISING IN ANY WAY OUT OF THE USE OF THIS
// SOFTWARE, EVEN IF ADVISED OF THE POSSIBILITY OF SUCH DAMAGE.

// Code is generated by AI

// Opt-in acceptance test for a physically connected Optec IFW filter wheel, or for the Arduino sketch
// wheel_optec_simulator.ino running on a board. It runs the wheel hardware acceptance checklist of
// DRIVER_TESTING_RULES.md: the WSMODE handshake, the slot count from the wheel ID, every slot, the
// boundaries, a repeated selection, BUSY while turning, the overlapping request, a disconnect while
// turning, reconnect and driver INIT/SHUTDOWN. The driver offers no calibration.
//
// THE WHEEL TURNS. The session restores the slot it found the wheel on.
//
// The port comes from OPTEC_HW_PORT.

#include <math.h>
#include <stdlib.h>
#include <indigo_drivers/wheel_optec/indigo_wheel_optec.h>
#include "hardware_test_common.h"

#define DEVICE_NAME "Optec Filter Wheel"

#define SHORT_TIMEOUT 15.0
// The driver turns the wheel synchronously and waits up to 20 s for the answer, as the manual allows.
#define MOTION_TIMEOUT 40.0

static int wheel = -1;
static const char *serial_port = NULL;
static int slot_count = 0, initial_slot = 0;

static bool select_port(void) {
	if (serial_port == NULL || !*serial_port) {
		fprintf(stderr, "    set OPTEC_HW_PORT to the wheel's serial port\n");
		return false;
	}
	printf("Using port %s\n", serial_port);
	return hw_set_text(wheel, DEVICE_PORT_PROPERTY_NAME, DEVICE_PORT_ITEM_NAME, serial_port, INDIGO_OK_STATE, SHORT_TIMEOUT);
}

static int current_slot(void) {
	double value = 0;
	return hw_number_item(wheel, WHEEL_SLOT_PROPERTY_NAME, WHEEL_SLOT_ITEM_NAME, &value) ? (int)lround(value) : -1;
}

static bool select_slot(int target) {
	unsigned before = hw_revision(wheel, WHEEL_SLOT_PROPERTY_NAME);
	hw_request_number(wheel, WHEEL_SLOT_PROPERTY_NAME, WHEEL_SLOT_ITEM_NAME, target);
	if (!hw_wait_state(wheel, WHEEL_SLOT_PROPERTY_NAME, before, INDIGO_OK_STATE, MOTION_TIMEOUT)) {
		return false;
	}
	if (current_slot() != target) {
		fprintf(stderr, "    wheel reported OK at slot %d but slot %d was requested\n", current_slot(), target);
		return false;
	}
	return true;
}

static bool settle_at(int target) {
	hw_wait_settled(wheel, WHEEL_SLOT_PROPERTY_NAME, INDIGO_OK_STATE, MOTION_TIMEOUT);
	return current_slot() == target || select_slot(target);
}

static void optec_reports_identity_and_capabilities(void) {
	ASSERT_TRUE((hw_device_interface(wheel) & INDIGO_INTERFACE_WHEEL) != 0);
	ASSERT_STREQ(DEVICE_NAME, hw_device_name(wheel));
	// The wheel ID tells a 5-position wheel from an 8-position one.
	printf("    %d slots, on slot %d\n", slot_count, initial_slot);
	ASSERT_TRUE(slot_count == 5 || slot_count == 8);
	ASSERT_TRUE(initial_slot >= 1 && initial_slot <= slot_count);
}

static void optec_publishes_the_property_contract(void) {
	double min = 0, max = 0;
	ASSERT_TRUE(hw_property_defined(wheel, WHEEL_SLOT_PROPERTY_NAME));
	ASSERT_TRUE(hw_property_defined(wheel, WHEEL_SLOT_NAME_PROPERTY_NAME));
	ASSERT_TRUE(hw_property_defined(wheel, WHEEL_SLOT_OFFSET_PROPERTY_NAME));
	ASSERT_TRUE(hw_property_defined(wheel, DEVICE_PORT_PROPERTY_NAME));
	// The slot count the wheel reported bounds the selector.
	ASSERT_TRUE(hw_number_item_range(wheel, WHEEL_SLOT_PROPERTY_NAME, WHEEL_SLOT_ITEM_NAME, &min, &max));
	ASSERT_EQ_INT(1, (int)min);
	ASSERT_EQ_INT(slot_count, (int)max);
	ASSERT_EQ_INT(INDIGO_OK_STATE, hw_property_state(wheel, WHEEL_SLOT_PROPERTY_NAME));
}

static void optec_selects_every_slot(void) {
	for (int target = 1; target <= slot_count; target++) {
		ASSERT_TRUE(select_slot(target));
	}
}

static void optec_selects_the_slot_boundaries(void) {
	ASSERT_TRUE(settle_at(1));
	ASSERT_TRUE(select_slot(slot_count));
	ASSERT_TRUE(select_slot(1));
}

// A request for the slot the wheel sits on is sent to the wheel, which answers with its position.
static void optec_reselects_the_current_slot(void) {
	ASSERT_TRUE(settle_at(1));
	ASSERT_TRUE(select_slot(1));
}

static void optec_repeats_a_selection(void) {
	int other = slot_count > 1 ? 2 : 1;
	ASSERT_TRUE(settle_at(1));
	ASSERT_TRUE(select_slot(other));
	ASSERT_TRUE(select_slot(1));
	ASSERT_TRUE(select_slot(other));
}

static void optec_publishes_busy_while_turning(void) {
	if (slot_count < 3) {
		printf("    fewer than three slots, the turn is too short to observe\n");
		return;
	}
	int target = (slot_count + 1) / 2 + 1;
	ASSERT_TRUE(settle_at(1));
	unsigned before = hw_revision(wheel, WHEEL_SLOT_PROPERTY_NAME);
	hw_request_number(wheel, WHEEL_SLOT_PROPERTY_NAME, WHEEL_SLOT_ITEM_NAME, target);
	ASSERT_TRUE(hw_wait_state(wheel, WHEEL_SLOT_PROPERTY_NAME, before, INDIGO_BUSY_STATE, SHORT_TIMEOUT));
	ASSERT_TRUE(hw_wait_settled(wheel, WHEEL_SLOT_PROPERTY_NAME, INDIGO_OK_STATE, MOTION_TIMEOUT));
	ASSERT_EQ_INT(target, current_slot());
}

// The framework drops a request for a property that is still BUSY, so the wheel finishes the first
// turn and the second slot never reaches it.
static void optec_ignores_an_overlapping_request(void) {
	if (slot_count < 3) {
		printf("    fewer than three slots, no overlapping request to place\n");
		return;
	}
	int target = (slot_count + 1) / 2 + 1;
	ASSERT_TRUE(settle_at(1));
	unsigned before = hw_revision(wheel, WHEEL_SLOT_PROPERTY_NAME);
	hw_request_number(wheel, WHEEL_SLOT_PROPERTY_NAME, WHEEL_SLOT_ITEM_NAME, target);
	ASSERT_TRUE(hw_wait_state(wheel, WHEEL_SLOT_PROPERTY_NAME, before, INDIGO_BUSY_STATE, SHORT_TIMEOUT));
	hw_request_number(wheel, WHEEL_SLOT_PROPERTY_NAME, WHEEL_SLOT_ITEM_NAME, 2);
	ASSERT_TRUE(hw_wait_settled(wheel, WHEEL_SLOT_PROPERTY_NAME, INDIGO_OK_STATE, MOTION_TIMEOUT));
	ASSERT_EQ_INT(target, current_slot());
	indigo_usleep(2000000);
	ASSERT_EQ_INT(target, current_slot());
	ASSERT_EQ_INT(INDIGO_OK_STATE, hw_property_state(wheel, WHEEL_SLOT_PROPERTY_NAME));
}

// The driver turns the wheel inside the request handler, so a disconnect requested while the wheel
// turns is served once the turn is over. The reconnect reads the slot the wheel reached.
static void optec_disconnects_while_turning(void) {
	int target = (slot_count + 1) / 2 + 1;
	ASSERT_TRUE(settle_at(1));
	unsigned before = hw_revision(wheel, WHEEL_SLOT_PROPERTY_NAME);
	hw_request_number(wheel, WHEEL_SLOT_PROPERTY_NAME, WHEEL_SLOT_ITEM_NAME, target);
	ASSERT_TRUE(hw_wait_state(wheel, WHEEL_SLOT_PROPERTY_NAME, before, INDIGO_BUSY_STATE, SHORT_TIMEOUT));
	ASSERT_TRUE(hw_disconnect(wheel, MOTION_TIMEOUT));
	ASSERT_TRUE(hw_property_state(wheel, WHEEL_SLOT_PROPERTY_NAME) != INDIGO_BUSY_STATE);
	ASSERT_TRUE(hw_connect(wheel, MOTION_TIMEOUT));
	ASSERT_EQ_INT(INDIGO_OK_STATE, hw_property_state(wheel, WHEEL_SLOT_PROPERTY_NAME));
	ASSERT_EQ_INT(target, current_slot());
	ASSERT_TRUE(select_slot(2));
	ASSERT_TRUE(select_slot(1));
}

// WEXITS at disconnect and WSMODE at connect: the wheel is found on the slot it was left on.
static void optec_reconnects(void) {
	ASSERT_TRUE(settle_at(3));
	ASSERT_TRUE(hw_disconnect(wheel, SHORT_TIMEOUT));
	ASSERT_TRUE(hw_connect(wheel, MOTION_TIMEOUT));
	ASSERT_EQ_INT(3, current_slot());
	double min = 0, max = 0;
	ASSERT_TRUE(hw_number_item_range(wheel, WHEEL_SLOT_PROPERTY_NAME, WHEEL_SLOT_ITEM_NAME, &min, &max));
	ASSERT_EQ_INT(slot_count, (int)max);
	ASSERT_TRUE(select_slot(1));
}

static void optec_reinitializes(void) {
	ASSERT_TRUE(hw_disconnect(wheel, SHORT_TIMEOUT));
	ASSERT_EQ_INT(INDIGO_OK, indigo_wheel_optec(INDIGO_DRIVER_SHUTDOWN, NULL));
	ASSERT_EQ_INT(-1, hw_device_index(DEVICE_NAME));
	ASSERT_EQ_INT(INDIGO_OK, indigo_wheel_optec(INDIGO_DRIVER_INIT, NULL));
	wheel = hw_wait_for_device(DEVICE_NAME, SHORT_TIMEOUT);
	ASSERT_TRUE(wheel >= 0);
	ASSERT_TRUE(select_port());
	ASSERT_TRUE(hw_connect(wheel, MOTION_TIMEOUT));
	ASSERT_TRUE(select_slot(slot_count));
	ASSERT_TRUE(select_slot(1));
}

int main(int argc, char **argv) {
	if (argc < 2 || strcmp(argv[1], "--run")) {
		fprintf(stderr, "Physical Optec IFW test: run explicitly with --run (or make test-wheel-optec-hw).\n");
		return 2;
	}
	setvbuf(stdout, NULL, _IONBF, 0);
	for (int i = 2; i < argc; i++) {
		if (!strcmp(argv[i], "--debug")) {
			indigo_set_log_level(INDIGO_LOG_DEBUG);
		}
	}
	if (!indigo_test_use_private_home()) {
		return 1;
	}
	serial_port = hw_port("OPTEC_HW_PORT");
	const indigo_test_case tests[] = {
		{ "optec_reports_identity_and_capabilities", optec_reports_identity_and_capabilities },
		{ "optec_publishes_the_property_contract", optec_publishes_the_property_contract },
		{ "optec_selects_every_slot", optec_selects_every_slot },
		{ "optec_selects_the_slot_boundaries", optec_selects_the_slot_boundaries },
		{ "optec_reselects_the_current_slot", optec_reselects_the_current_slot },
		{ "optec_repeats_a_selection", optec_repeats_a_selection },
		{ "optec_publishes_busy_while_turning", optec_publishes_busy_while_turning },
		{ "optec_ignores_an_overlapping_request", optec_ignores_an_overlapping_request },
		{ "optec_disconnects_while_turning", optec_disconnects_while_turning },
		{ "optec_reconnects", optec_reconnects },
		{ "optec_reinitializes", optec_reinitializes }
	};
	int result = 1;
	bool started = false, initialized = false;
	double max = 0, min = 0;
	HW_CHECK(hw_start() == INDIGO_OK);
	started = true;
	HW_CHECK(hw_attach_client("Optec IFW hardware test") == INDIGO_OK);
	HW_CHECK(indigo_wheel_optec(INDIGO_DRIVER_INIT, NULL) == INDIGO_OK);
	initialized = true;
	wheel = hw_wait_for_device(DEVICE_NAME, SHORT_TIMEOUT);
	HW_CHECK(wheel >= 0);
	HW_CHECK(select_port());
	HW_CHECK(hw_connect(wheel, MOTION_TIMEOUT));
	HW_CHECK(hw_number_item_range(wheel, WHEEL_SLOT_PROPERTY_NAME, WHEEL_SLOT_ITEM_NAME, &min, &max));
	slot_count = (int)max;
	initial_slot = current_slot();
	printf("%d slots, on slot %d\n", slot_count, initial_slot);
	result = indigo_run_tests("Optec IFW hardware", tests, ARRAY_SIZE(tests));
cleanup:
	if (wheel >= 0 && hw_connected(wheel) && initial_slot >= 1) {
		settle_at(initial_slot);
	}
	if (!hw_disconnect(wheel, SHORT_TIMEOUT)) {
		indigo_test_failures++;
	}
	if (initialized && indigo_wheel_optec(INDIGO_DRIVER_SHUTDOWN, NULL) != INDIGO_OK) {
		indigo_test_failures++;
	}
	indigo_detach_client(&hw_client);
	if (started) {
		indigo_stop();
	}
	hw_release_properties();
	indigo_test_remove_private_home();
	return indigo_test_failures ? 1 : result;
}
