// Copyright (c) 2026 INDIGO initiative
// All rights reserved.
//
// You may use this software under the terms of 'INDIGO Astronomy
// open-source license' (see LICENSE.md).
//
// THIS SOFTWARE IS PROVIDED BY THE AUTHORS 'AS IS' AND ANY EXPRESS
// OR IMPLIED WARRANTIES, INCLUDING, BUT NOT LIMITED TO, THE IMPLIED
// WARRANTIES OF MERCHANTABILITY AND FITNESS FOR A PARTICULAR PURPOSE
// ARE DISCLAIMED. IN NO EVENT SHALL THE AUTHOR BE LIABLE FOR ANY
// DIRECT, INDIRECT, INCIDENTAL, SPECIAL, EXEMPLARY, OR CONSEQUENTIAL
// DAMAGES (INCLUDING, BUT NOT LIMITED TO, PROCUREMENT OF SUBSTITUTE
// GOODS OR SERVICES; LOSS OF USE, DATA, OR PROFITS; OR BUSINESS
// INTERRUPTION) HOWEVER CAUSED AND ON ANY THEORY OF LIABILITY,
// WHETHER IN CONTRACT, STRICT LIABILITY, OR TORT (INCLUDING
// NEGLIGENCE OR OTHERWISE) ARISING IN ANY WAY OUT OF THE USE OF THIS
// SOFTWARE, EVEN IF ADVISED OF THE POSSIBILITY OF SUCH DAMAGE.

// Code is generated by AI

// Opt-in acceptance test for a physically connected PlaneWave EFA or Celestron Focus Motor, or for the Arduino
// sketch focuser_efa_simulator.ino running on a board (built as either). It checks the identified model and the
// properties it publishes, moves to absolute positions (on an EFA also a long move, which goes as a coarse slew
// followed by a goto), moves by steps both ways, aborts a move, and per model: syncs the encoder, changes the
// maximum limit and switches the fans (EFA), or calibrates the travel (Celestron); then it reconnects and runs
// driver INIT/SHUTDOWN.
//
// THE FOCUSER MOVES. The session returns it to the position it found and restores the encoder, the limits and
// the fans; a Celestron calibration replaces the stored travel with a fresh measurement.
//
// The port comes from EFA_HW_PORT.

#include <math.h>
#include <stdlib.h>
#include <indigo_drivers/focuser_efa/indigo_focuser_efa.h>
#include "focuser_hw_common.h"

#define DEVICE_NAME "EFA Focuser"

#define SHORT_TIMEOUT 15.0
#define MOVE_TIMEOUT 300.0

static int focuser = -1;
static const char *serial_port = NULL;
static bool state_captured = false, celestron = false, fans_were_on = false;
static double initial_position = 0, initial_max = 0, minimum = 0, maximum = 0, base = 0;

// The moves scale with the travel: the EFA has millions of ticks, a calibrated Celestron far fewer.
static double span(double fraction, double cap) {
	double value = floor((maximum - minimum) * fraction);
	return value < cap ? value : cap;
}

static void choose_base(void) {
	base = minimum + span(0.1, 20000);
}

static bool select_port(void) {
	if (serial_port == NULL || !*serial_port) {
		fprintf(stderr, "    set EFA_HW_PORT to the focuser's port\n");
		return false;
	}
	printf("Using port %s\n", serial_port);
	return hw_set_text(focuser, DEVICE_PORT_PROPERTY_NAME, DEVICE_PORT_ITEM_NAME, serial_port, INDIGO_OK_STATE, SHORT_TIMEOUT);
}

static bool set_max_limit(double value) {
	return focuser_hw_set_number(focuser, FOCUSER_LIMITS_PROPERTY_NAME, FOCUSER_LIMITS_MAX_POSITION_ITEM_NAME, value, INDIGO_OK_STATE, SHORT_TIMEOUT) && focuser_hw_value(focuser, FOCUSER_LIMITS_PROPERTY_NAME, FOCUSER_LIMITS_MAX_POSITION_ITEM_NAME) == value;
}

static bool sync_to(double value) {
	return focuser_hw_set_switch(focuser, FOCUSER_ON_POSITION_SET_PROPERTY_NAME, FOCUSER_ON_POSITION_SET_SYNC_ITEM_NAME, SHORT_TIMEOUT) && focuser_hw_goto(focuser, value, INDIGO_OK_STATE, SHORT_TIMEOUT) && focuser_hw_set_switch(focuser, FOCUSER_ON_POSITION_SET_PROPERTY_NAME, FOCUSER_ON_POSITION_SET_GOTO_ITEM_NAME, SHORT_TIMEOUT);
}

static void restore_initial_state(void) {
	if (focuser < 0 || !state_captured || !hw_connected(focuser)) {
		return;
	}
	focuser_hw_idle(focuser, FOCUSER_POSITION_PROPERTY_NAME, MOVE_TIMEOUT);
	if (!celestron) {
		if (focuser_hw_switch_is(focuser, FOCUSER_ON_POSITION_SET_PROPERTY_NAME, FOCUSER_ON_POSITION_SET_SYNC_ITEM_NAME)) {
			focuser_hw_set_switch(focuser, FOCUSER_ON_POSITION_SET_PROPERTY_NAME, FOCUSER_ON_POSITION_SET_GOTO_ITEM_NAME, SHORT_TIMEOUT);
		}
		if (focuser_hw_value(focuser, FOCUSER_LIMITS_PROPERTY_NAME, FOCUSER_LIMITS_MAX_POSITION_ITEM_NAME) != initial_max) {
			set_max_limit(initial_max);
		}
		focuser_hw_set_switch(focuser, "X_FOCUSER_FANS", fans_were_on ? "ON" : "OFF", SHORT_TIMEOUT);
	}
	focuser_hw_goto(focuser, initial_position, INDIGO_OK_STATE, MOVE_TIMEOUT);
}

static void efa_publishes_the_model_and_its_properties(void) {
	char model[INDIGO_VALUE_SIZE] = "", firmware[INDIGO_VALUE_SIZE] = "";
	ASSERT_TRUE((hw_device_interface(focuser) & INDIGO_INTERFACE_FOCUSER) != 0);
	ASSERT_TRUE(hw_text_item(focuser, INFO_PROPERTY_NAME, INFO_DEVICE_MODEL_ITEM_NAME, model, sizeof(model)));
	ASSERT_TRUE(hw_text_item(focuser, INFO_PROPERTY_NAME, INFO_DEVICE_FW_REVISION_ITEM_NAME, firmware, sizeof(firmware)));
	printf("    %s firmware %s, position %g, limits %g..%g\n", model, firmware, initial_position, minimum, maximum);
	ASSERT_TRUE(!strcmp(model, celestron ? "Celestron Focus Motor" : "PlaneWave EFA"));
	ASSERT_TRUE(maximum > minimum);
	ASSERT_EQ_INT(!celestron, hw_property_defined(focuser, "X_FOCUSER_FANS"));
	ASSERT_EQ_INT(!celestron, hw_property_defined(focuser, FOCUSER_TEMPERATURE_PROPERTY_NAME));
	ASSERT_EQ_INT(!celestron, hw_property_defined(focuser, FOCUSER_ON_POSITION_SET_PROPERTY_NAME));
	ASSERT_EQ_INT(celestron, hw_property_defined(focuser, "X_FOCUSER_CALIBRATION"));
	if (!celestron) {
		// The temperature comes with the status poll after the connection.
		double temperature = 0;
		for (int i = 0; i < 1000 && (temperature = focuser_hw_value(focuser, FOCUSER_TEMPERATURE_PROPERTY_NAME, FOCUSER_TEMPERATURE_ITEM_NAME)) == 0 && hw_property_state(focuser, FOCUSER_TEMPERATURE_PROPERTY_NAME) == INDIGO_OK_STATE; i++) {
			indigo_usleep(10000);
		}
		printf("    temperature %.2f C, state %d\n", temperature, hw_property_state(focuser, FOCUSER_TEMPERATURE_PROPERTY_NAME));
		// 7F7F (no sensor) leaves the property idle; a reading has to be plausible and published OK.
		ASSERT_TRUE(hw_property_state(focuser, FOCUSER_TEMPERATURE_PROPERTY_NAME) != INDIGO_ALERT_STATE);
		ASSERT_TRUE(temperature > -40 && temperature < 60);
	}
}

static void efa_moves_to_absolute_positions(void) {
	ASSERT_TRUE(focuser_hw_goto(focuser, base + span(0.05, 5000), INDIGO_OK_STATE, MOVE_TIMEOUT));
	ASSERT_TRUE(focuser_hw_goto(focuser, base + 17, INDIGO_OK_STATE, MOVE_TIMEOUT));
	// Longer than 50000 ticks on an EFA: it slews coarsely first, then finishes with a goto.
	ASSERT_TRUE(focuser_hw_goto(focuser, base + span(0.6, 120000), INDIGO_OK_STATE, MOVE_TIMEOUT));
	ASSERT_TRUE(focuser_hw_goto(focuser, base, INDIGO_OK_STATE, MOVE_TIMEOUT));
}

static void efa_moves_by_steps(void) {
	double steps = span(0.05, 3000);
	ASSERT_TRUE(focuser_hw_steps(focuser, true, steps, INDIGO_OK_STATE, MOVE_TIMEOUT));
	ASSERT_EQ_INT((int)(base + steps), (int)focuser_hw_position(focuser));
	ASSERT_TRUE(focuser_hw_steps(focuser, false, steps, INDIGO_OK_STATE, MOVE_TIMEOUT));
	ASSERT_EQ_INT((int)base, (int)focuser_hw_position(focuser));
}

static void efa_aborts_a_move(void) {
	double target = base + span(0.8, 200000);
	ASSERT_TRUE(focuser_hw_start_goto(focuser, target, SHORT_TIMEOUT));
	indigo_usleep(2000000);
	ASSERT_TRUE(focuser_hw_abort(focuser, SHORT_TIMEOUT));
	ASSERT_TRUE(focuser_hw_idle(focuser, FOCUSER_POSITION_PROPERTY_NAME, SHORT_TIMEOUT));
	double stopped = focuser_hw_position(focuser);
	printf("    stopped at %g on the way from %g to %g, state %d\n", stopped, base, target, hw_property_state(focuser, FOCUSER_POSITION_PROPERTY_NAME));
	ASSERT_TRUE(stopped > base && stopped < target);
	// the aborted move keeps the requested target, also across idle polls
	double requested = 0;
	ASSERT_TRUE(hw_number_item_target(focuser, FOCUSER_POSITION_PROPERTY_NAME, FOCUSER_POSITION_ITEM_NAME, &requested));
	ASSERT_EQ_INT((int)target, (int)requested);
	indigo_usleep(2500000);
	ASSERT_TRUE(hw_number_item_target(focuser, FOCUSER_POSITION_PROPERTY_NAME, FOCUSER_POSITION_ITEM_NAME, &requested));
	ASSERT_EQ_INT((int)target, (int)requested);
	ASSERT_TRUE(focuser_hw_goto(focuser, base, INDIGO_OK_STATE, MOVE_TIMEOUT));
}

static void efa_syncs_the_encoder(void) {
	if (celestron) {
		printf("    no encoder sync on a Celestron Focus Motor\n");
		return;
	}
	ASSERT_TRUE(sync_to(base + 1000));
	ASSERT_EQ_INT((int)base + 1000, (int)focuser_hw_position(focuser));
	indigo_usleep(1000000);
	ASSERT_EQ_INT((int)base + 1000, (int)focuser_hw_position(focuser));
	ASSERT_TRUE(sync_to(base));
	ASSERT_EQ_INT((int)base, (int)focuser_hw_position(focuser));
}

static void efa_changes_the_maximum_limit(void) {
	if (celestron) {
		ASSERT_TRUE(focuser_hw_set_number(focuser, FOCUSER_LIMITS_PROPERTY_NAME, FOCUSER_LIMITS_MAX_POSITION_ITEM_NAME, maximum - 1000, INDIGO_ALERT_STATE, SHORT_TIMEOUT) || hw_property_state(focuser, FOCUSER_LIMITS_PROPERTY_NAME) != INDIGO_BUSY_STATE);
		ASSERT_EQ_INT((int)maximum, (int)focuser_hw_value(focuser, FOCUSER_LIMITS_PROPERTY_NAME, FOCUSER_LIMITS_MAX_POSITION_ITEM_NAME));
		return;
	}
	ASSERT_TRUE(set_max_limit(initial_max - 1000));
	ASSERT_TRUE(hw_disconnect(focuser, SHORT_TIMEOUT));
	ASSERT_TRUE(hw_connect(focuser, SHORT_TIMEOUT));
	ASSERT_EQ_INT((int)initial_max - 1000, (int)focuser_hw_value(focuser, FOCUSER_LIMITS_PROPERTY_NAME, FOCUSER_LIMITS_MAX_POSITION_ITEM_NAME));
	ASSERT_TRUE(set_max_limit(initial_max));
}

static void efa_switches_the_fans(void) {
	if (celestron) {
		printf("    no fans on a Celestron Focus Motor\n");
		return;
	}
	ASSERT_TRUE(focuser_hw_set_switch(focuser, "X_FOCUSER_FANS", "ON", SHORT_TIMEOUT));
	ASSERT_TRUE(focuser_hw_set_switch(focuser, "X_FOCUSER_FANS", "OFF", SHORT_TIMEOUT));
	ASSERT_TRUE(focuser_hw_set_switch(focuser, "X_FOCUSER_FANS", fans_were_on ? "ON" : "OFF", SHORT_TIMEOUT));
}

static void efa_calibrates(void) {
	if (!celestron) {
		printf("    calibration is a Celestron Focus Motor function\n");
		return;
	}
	ASSERT_TRUE(focuser_hw_set_switch(focuser, "X_FOCUSER_CALIBRATION", "CALIBRATE", MOVE_TIMEOUT) || hw_property_state(focuser, "X_FOCUSER_CALIBRATION") == INDIGO_OK_STATE);
	ASSERT_TRUE(focuser_hw_idle(focuser, "X_FOCUSER_CALIBRATION", 200));
	ASSERT_EQ_INT(INDIGO_OK_STATE, hw_property_state(focuser, "X_FOCUSER_CALIBRATION"));
	minimum = focuser_hw_value(focuser, FOCUSER_LIMITS_PROPERTY_NAME, FOCUSER_LIMITS_MIN_POSITION_ITEM_NAME);
	maximum = focuser_hw_value(focuser, FOCUSER_LIMITS_PROPERTY_NAME, FOCUSER_LIMITS_MAX_POSITION_ITEM_NAME);
	printf("    calibrated travel %g..%g\n", minimum, maximum);
	ASSERT_TRUE(maximum > minimum);
	if (initial_position < minimum || initial_position > maximum) {
		initial_position = minimum;
	}
	choose_base();
}

static void efa_reconnects(void) {
	double position = focuser_hw_position(focuser);
	ASSERT_TRUE(hw_disconnect(focuser, SHORT_TIMEOUT));
	ASSERT_TRUE(hw_property_hidden(focuser, FOCUSER_POSITION_PROPERTY_NAME));
	ASSERT_TRUE(hw_connect(focuser, SHORT_TIMEOUT));
	ASSERT_EQ_INT((int)position, (int)focuser_hw_position(focuser));
	ASSERT_EQ_INT(INDIGO_OK_STATE, hw_property_state(focuser, FOCUSER_POSITION_PROPERTY_NAME));
}

static void efa_rejects_shutdown_while_connected(void) {
	ASSERT_EQ_INT(INDIGO_BUSY, indigo_focuser_efa(INDIGO_DRIVER_SHUTDOWN, NULL));
	ASSERT_TRUE(hw_connected(focuser));
}

static void efa_reinitializes(void) {
	ASSERT_TRUE(hw_disconnect(focuser, SHORT_TIMEOUT));
	ASSERT_EQ_INT(INDIGO_OK, indigo_focuser_efa(INDIGO_DRIVER_SHUTDOWN, NULL));
	ASSERT_EQ_INT(-1, hw_device_index(DEVICE_NAME));
	ASSERT_EQ_INT(INDIGO_OK, indigo_focuser_efa(INDIGO_DRIVER_INIT, NULL));
	focuser = hw_wait_for_device(DEVICE_NAME, SHORT_TIMEOUT);
	ASSERT_TRUE(focuser >= 0);
	ASSERT_TRUE(select_port());
	ASSERT_TRUE(hw_connect(focuser, SHORT_TIMEOUT));
	ASSERT_TRUE(hw_property_defined(focuser, FOCUSER_POSITION_PROPERTY_NAME));
}

int main(int argc, char **argv) {
	if (argc < 2 || strcmp(argv[1], "--run")) {
		fprintf(stderr, "Physical EFA test: run explicitly with --run (or make test-focuser-efa-hw).\n");
		return 2;
	}
	setvbuf(stdout, NULL, _IONBF, 0);
	for (int i = 2; i < argc; i++) {
		if (!strcmp(argv[i], "--debug")) {
			indigo_set_log_level(INDIGO_LOG_DEBUG);
		}
	}
	if (!indigo_test_use_private_home()) {
		return 1;
	}
	serial_port = hw_port("EFA_HW_PORT");
	const indigo_test_case tests[] = {
		{ "efa_publishes_the_model_and_its_properties", efa_publishes_the_model_and_its_properties },
		{ "efa_calibrates", efa_calibrates },
		{ "efa_moves_to_absolute_positions", efa_moves_to_absolute_positions },
		{ "efa_moves_by_steps", efa_moves_by_steps },
		{ "efa_aborts_a_move", efa_aborts_a_move },
		{ "efa_syncs_the_encoder", efa_syncs_the_encoder },
		{ "efa_changes_the_maximum_limit", efa_changes_the_maximum_limit },
		{ "efa_switches_the_fans", efa_switches_the_fans },
		{ "efa_reconnects", efa_reconnects },
		{ "efa_rejects_shutdown_while_connected", efa_rejects_shutdown_while_connected },
		{ "efa_reinitializes", efa_reinitializes }
	};
	int result = 1;
	bool started = false, initialized = false;
	HW_CHECK(hw_start() == INDIGO_OK);
	started = true;
	HW_CHECK(hw_attach_client("EFA hardware test") == INDIGO_OK);
	HW_CHECK(indigo_focuser_efa(INDIGO_DRIVER_INIT, NULL) == INDIGO_OK);
	initialized = true;
	focuser = hw_wait_for_device(DEVICE_NAME, SHORT_TIMEOUT);
	HW_CHECK(focuser >= 0);
	HW_CHECK(select_port());
	HW_CHECK(hw_connect(focuser, SHORT_TIMEOUT));
	HW_CHECK(focuser_hw_idle(focuser, FOCUSER_POSITION_PROPERTY_NAME, MOVE_TIMEOUT));
	celestron = hw_property_defined(focuser, "X_FOCUSER_CALIBRATION");
	initial_position = focuser_hw_position(focuser);
	minimum = focuser_hw_value(focuser, FOCUSER_LIMITS_PROPERTY_NAME, FOCUSER_LIMITS_MIN_POSITION_ITEM_NAME);
	maximum = initial_max = focuser_hw_value(focuser, FOCUSER_LIMITS_PROPERTY_NAME, FOCUSER_LIMITS_MAX_POSITION_ITEM_NAME);
	fans_were_on = !celestron && focuser_hw_switch_is(focuser, "X_FOCUSER_FANS", "ON");
	choose_base();
	state_captured = true;
	result = indigo_run_tests("EFA hardware", tests, ARRAY_SIZE(tests));
cleanup:
	restore_initial_state();
	if (!hw_disconnect(focuser, SHORT_TIMEOUT)) {
		indigo_test_failures++;
	}
	if (initialized && indigo_focuser_efa(INDIGO_DRIVER_SHUTDOWN, NULL) != INDIGO_OK) {
		indigo_test_failures++;
	}
	indigo_detach_client(&hw_client);
	if (started) {
		indigo_stop();
	}
	hw_release_properties();
	indigo_test_remove_private_home();
	return indigo_test_failures ? 1 : result;
}
