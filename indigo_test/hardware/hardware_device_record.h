// Copyright (c) 2026 INDIGO initiative
// All rights reserved.
//
// You may use this software under the terms of 'INDIGO Astronomy
// open-source license' (see LICENSE.md).
//
// THIS SOFTWARE IS PROVIDED BY THE AUTHORS 'AS IS' AND ANY EXPRESS
// OR IMPLIED WARRANTIES, INCLUDING, BUT NOT LIMITED TO, THE IMPLIED
// WARRANTIES OF MERCHANTABILITY AND FITNESS FOR A PARTICULAR PURPOSE
// ARE DISCLAIMED. IN NO EVENT SHALL THE AUTHOR BE LIABLE FOR ANY
// DIRECT, INDIRECT, INCIDENTAL, SPECIAL, EXEMPLARY, OR CONSEQUENTIAL
// DAMAGES (INCLUDING, BUT NOT LIMITED TO, PROCUREMENT OF SUBSTITUTE
// GOODS OR SERVICES; LOSS OF USE, DATA, OR PROFITS; OR BUSINESS
// INTERRUPTION) HOWEVER CAUSED AND ON ANY THEORY OF LIABILITY,
// WHETHER IN CONTRACT, STRICT LIABILITY, OR TORT (INCLUDING
// NEGLIGENCE OR OTHERWISE) ARISING IN ANY WAY OUT OF THE USE OF THIS
// SOFTWARE, EVEN IF ADVISED OF THE POSSIBILITY OF SUCH DAMAGE.

// Code is generated by AI

// Records the devices a hardware suite actually connected to, so a recorded test
// run names the hardware it ran against without anyone typing it in.
//
// Every hardware suite starts the bus with hw_start() instead of indigo_start().
// When INDIGO_TEST_RESULTS is set, hw_start() also attaches a passive client that
// watches INFO, MOUNT_INFO and CONNECTION of every device and appends a record
//
//   device  <driver>  <interface>  <device name>  <model>
//
// through indigo_test_record() whenever a connected device reports its INFO. The
// model is the one the driver detected on connection: MOUNT_INFO_MODEL for a mount,
// where mount drivers publish it, and INFO_DEVICE_MODEL otherwise. The framework
// publishes only the first four INFO items unless the driver asks for more, so a
// device with neither is recorded under its device name. A reader takes the last
// record of each device. Without INDIGO_TEST_RESULTS no client is attached, so an
// ordinary run is not changed in any way.

#ifndef hardware_device_record_h
#define hardware_device_record_h

#include <pthread.h>
#include <stdio.h>
#include <stdlib.h>
#include <string.h>
#include <indigo/indigo_bus.h>
#include <indigo/indigo_client.h>
#include <indigo/indigo_names.h>
#include "../test_runner.h"

#define HW_RECORD_MAX_DEVICES 32

typedef struct {
	char name[INDIGO_NAME_SIZE];
	char driver[INDIGO_VALUE_SIZE];
	char interface[INDIGO_VALUE_SIZE];
	char model[INDIGO_VALUE_SIZE];
	char mount_model[INDIGO_VALUE_SIZE];
	bool connected;
	char recorded[4 * INDIGO_VALUE_SIZE];
} hw_record_device;

static hw_record_device hw_record_devices[HW_RECORD_MAX_DEVICES];
static pthread_mutex_t hw_record_mutex = PTHREAD_MUTEX_INITIALIZER;
static indigo_client hw_record_client;

static hw_record_device *hw_record_find(const char *name) {
	hw_record_device *empty = NULL;
	for (int i = 0; i < HW_RECORD_MAX_DEVICES; i++) {
		if (!strcmp(hw_record_devices[i].name, name)) {
			return hw_record_devices + i;
		}
		if (empty == NULL && !*hw_record_devices[i].name) {
			empty = hw_record_devices + i;
		}
	}
	if (empty != NULL) {
		snprintf(empty->name, sizeof(empty->name), "%s", name);
	}
	return empty;
}

// Writes the device's record once it is connected and whenever its INFO changes
// afterwards, but never the same record twice in a row.
static void hw_record_emit(hw_record_device *entry) {
	if (!entry->connected) {
		return;
	}
	char line[sizeof(entry->recorded)];
	const char *model = *entry->mount_model ? entry->mount_model : *entry->model ? entry->model : entry->name;
	snprintf(line, sizeof(line), "%s\t%s\t%s\t%s", entry->driver, entry->interface, entry->name, model);
	if (strcmp(line, entry->recorded)) {
		snprintf(entry->recorded, sizeof(entry->recorded), "%s", line);
		indigo_test_record("device\t%s", line);
	}
}

static indigo_result hw_record_property(indigo_client *client, indigo_device *device, indigo_property *property, const char *message) {
	(void)client;
	(void)device;
	(void)message;
	bool info = !strcmp(property->name, INFO_PROPERTY_NAME);
	bool mount_info = !strcmp(property->name, MOUNT_INFO_PROPERTY_NAME);
	bool connection = !strcmp(property->name, CONNECTION_PROPERTY_NAME);
	if (!info && !mount_info && !connection) {
		return INDIGO_OK;
	}
	pthread_mutex_lock(&hw_record_mutex);
	hw_record_device *entry = hw_record_find(property->device);
	if (entry != NULL) {
		for (int i = 0; i < property->count; i++) {
			indigo_item *item = property->items + i;
			if (info && !strcmp(item->name, INFO_DEVICE_DRIVER_ITEM_NAME)) {
				snprintf(entry->driver, sizeof(entry->driver), "%s", item->text.value);
			} else if (info && !strcmp(item->name, INFO_DEVICE_INTERFACE_ITEM_NAME)) {
				snprintf(entry->interface, sizeof(entry->interface), "%s", item->text.value);
			} else if (info && !strcmp(item->name, INFO_DEVICE_MODEL_ITEM_NAME)) {
				snprintf(entry->model, sizeof(entry->model), "%s", item->text.value);
			} else if (mount_info && !strcmp(item->name, MOUNT_INFO_MODEL_ITEM_NAME)) {
				snprintf(entry->mount_model, sizeof(entry->mount_model), "%s", item->text.value);
			} else if (connection && !strcmp(item->name, CONNECTION_CONNECTED_ITEM_NAME)) {
				entry->connected = item->sw.value && property->state == INDIGO_OK_STATE;
			}
		}
		hw_record_emit(entry);
	}
	pthread_mutex_unlock(&hw_record_mutex);
	return INDIGO_OK;
}

static indigo_result hw_record_attach(indigo_client *client) {
	indigo_enumerate_properties(client, &INDIGO_ALL_PROPERTIES);
	return INDIGO_OK;
}

// indigo_stop() drops only the clients that have a detach handler, so the
// recorder needs one to be attached again by a suite that restarts the bus.
static indigo_result hw_record_detach(indigo_client *client) {
	(void)client;
	return INDIGO_OK;
}

// The port or URL a hardware suite connects to: the suite's own variable, such as
// MOUNT_PMC8_HW_PORT, or INDIGO_TEST_PORT, which 'run_driver_test.py --port' sets for any suite.
// The suite's own variable wins, so existing commands keep working. NULL when neither is set.
static const char *hw_port(const char *variable) {
	const char *port = getenv(variable);
	if (port == NULL || !*port) {
		port = getenv("INDIGO_TEST_PORT");
	}
	return port != NULL && *port ? port : NULL;
}

// Tags a case with the device it tests, for a hardware suite that tests several devices in one run:
//
//   case_device  <suite>  <case>  <driver>  <device name>
//
// <suite> and <case> are the names the case is run and reported under by indigo_run_tests(). Call it for every
// case before the cases run, so a case that crashes still counts as planned for its device. When a run of the
// driver has such tags, tools/run_driver_test.py records one line per tagged device instead of one per run: the
// model of the device (from its device record, the device name without one) with the counts of its own cases.
static void hw_record_case_device(const char *suite, const char *test_case, const char *driver, const char *device) {
	indigo_test_record("case_device\t%s\t%s\t%s\t%s", suite, test_case, driver, device);
}

// Starts the bus like indigo_start() and, when the run is being recorded,
// attaches the device recorder to it.
static indigo_result hw_start(void) {
	indigo_result result = indigo_start();
	const char *path = getenv("INDIGO_TEST_RESULTS");
	if (result == INDIGO_OK && path != NULL && *path) {
		hw_record_client = (indigo_client){ .version = INDIGO_VERSION_CURRENT, .attach = hw_record_attach, .define_property = hw_record_property, .update_property = hw_record_property, .detach = hw_record_detach };
		snprintf(hw_record_client.name, sizeof(hw_record_client.name), "Test run recorder");
		indigo_attach_client(&hw_record_client);
	}
	return result;
}

#endif /* hardware_device_record_h */
