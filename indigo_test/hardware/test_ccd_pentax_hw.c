// Copyright (c) 2026 INDIGO initiative
// All rights reserved.
//
// You may use this software under the terms of 'INDIGO Astronomy
// open-source license' (see LICENSE.md).
//
// THIS SOFTWARE IS PROVIDED BY THE AUTHORS 'AS IS' AND ANY EXPRESS
// OR IMPLIED WARRANTIES, INCLUDING, BUT NOT LIMITED TO, THE IMPLIED
// WARRANTIES OF MERCHANTABILITY AND FITNESS FOR A PARTICULAR PURPOSE
// ARE DISCLAIMED. IN NO EVENT SHALL THE AUTHOR BE LIABLE FOR ANY
// DIRECT, INDIRECT, INCIDENTAL, SPECIAL, EXEMPLARY, OR CONSEQUENTIAL
// DAMAGES (INCLUDING, BUT NOT LIMITED TO, PROCUREMENT OF SUBSTITUTE
// GOODS OR SERVICES; LOSS OF USE, DATA, OR PROFITS; OR BUSINESS
// INTERRUPTION) HOWEVER CAUSED AND ON ANY THEORY OF LIABILITY,
// WHETHER IN CONTRACT, STRICT LIABILITY, OR TORT (INCLUDING
// NEGLIGENCE OR OTHERWISE) ARISING IN ANY WAY OUT OF THE USE OF THIS
// SOFTWARE, EVEN IF ADVISED OF THE POSSIBILITY OF SUCH DAMAGE.

// Code is generated by AI

// Physical Pentax K-m acceptance; one short session preserves battery and camera settings.

#include <stdio.h>
#include <math.h>
#include <pthread.h>
#include <signal.h>
#include <setjmp.h>
#include <jpeglib.h>
#include <libraw.h>
#include <unistd.h>
#include <indigo/indigo_driver.h>
#include <indigo_drivers/ccd_pentax/indigo_ccd_pentax.h>
#include "../test_runner.h"
#include "hardware_device_record.h"

#define MAX_PROPERTIES 64
#define CHECK(condition) do { if (!(condition)) { fprintf(stderr, "%s:%d: %s\n", __FILE__, __LINE__, #condition); indigo_test_failures++; goto cleanup; } } while (0)

static pthread_mutex_t mutex = PTHREAD_MUTEX_INITIALIZER;
static char camera[INDIGO_NAME_SIZE];
static indigo_property *properties[MAX_PROPERTIES];
static unsigned revisions[MAX_PROPERTIES];
static unsigned image_count, invalid_images;
static bool baseline_only;

static unsigned frames(void) {
	pthread_mutex_lock(&mutex);
	unsigned count = image_count;
	pthread_mutex_unlock(&mutex);
	return count;
}

static bool images_valid(void) {
	pthread_mutex_lock(&mutex);
	bool valid = invalid_images == 0;
	pthread_mutex_unlock(&mutex);
	return valid;
}
static indigo_client client;

static int slot(const char *name) {
	for (int i = 0; i < MAX_PROPERTIES; i++) {
		if (properties[i] && !strcmp(properties[i]->name, name)) {
			return i;
		}
	}
	return -1;
}

typedef struct {
	struct jpeg_error_mgr base;
	jmp_buf jump;
} jpeg_test_error;

static void jpeg_failed(j_common_ptr decoder) {
	jpeg_test_error *error = (jpeg_test_error *)decoder->err;
	longjmp(error->jump, 1);
}

static bool valid_jpeg(const unsigned char *bytes, long size) {
	struct jpeg_decompress_struct decoder = { 0 };
	jpeg_test_error error;
	decoder.err = jpeg_std_error(&error.base);
	error.base.error_exit = jpeg_failed;
	if (setjmp(error.jump)) {
		jpeg_destroy_decompress(&decoder);
		return false;
	}
	jpeg_create_decompress(&decoder);
	jpeg_mem_src(&decoder, bytes, size);
	bool valid = jpeg_read_header(&decoder, TRUE) == JPEG_HEADER_OK;
	decoder.out_color_space = JCS_GRAYSCALE;
	decoder.scale_num = 1;
	decoder.scale_denom = 8;
	if (valid) {
		jpeg_start_decompress(&decoder);
		valid = decoder.image_width > 0 && decoder.image_height > 0 && decoder.image_width <= 3872 && decoder.image_height <= 2592;
		JSAMPARRAY row = (*decoder.mem->alloc_sarray)((j_common_ptr)&decoder, JPOOL_IMAGE, decoder.output_width, 1);
		while (decoder.output_scanline < decoder.output_height) {
			jpeg_read_scanlines(&decoder, row, 1);
		}
		valid = jpeg_finish_decompress(&decoder) && valid;
	}
	jpeg_destroy_decompress(&decoder);
	return valid;
}

static bool valid_raw(const unsigned char *bytes, long size) {
	libraw_data_t *raw = libraw_init(0);
	if (!raw) {
		return false;
	}
	bool valid = libraw_open_buffer(raw, bytes, size) == LIBRAW_SUCCESS && libraw_unpack(raw) == LIBRAW_SUCCESS && raw->sizes.width > 3000 && raw->sizes.height > 2000;
	libraw_close(raw);
	return valid;
}

static indigo_result observe(indigo_client *client, indigo_device *device, indigo_property *property, const char *message) {
	(void)client;
	(void)device;
	(void)message;
	if (!strstr(property->device, "K-m")) {
		return INDIGO_OK;
	}
	pthread_mutex_lock(&mutex);
	if (!*camera) {
		snprintf(camera, sizeof(camera), "%s", property->device);
	}
	int index = slot(property->name);
	if (index < 0) {
		for (int i = 0; i < MAX_PROPERTIES; i++) {
			if (!properties[i]) {
				index = i;
				break;
			}
		}
	}
	if (!strcmp(property->name, CCD_IMAGE_PROPERTY_NAME) && property->state == INDIGO_OK_STATE && property->count && property->items[0].blob.value) {
		indigo_item *item = property->items;
		const unsigned char *bytes = item->blob.value;
		bool jpeg = item->blob.size > 4 && bytes[0] == 0xff && bytes[1] == 0xd8 && bytes[item->blob.size - 2] == 0xff && bytes[item->blob.size - 1] == 0xd9;
		bool tiff = item->blob.size > 1024 && ((!memcmp(bytes, "II*\0", 4)) || (!memcmp(bytes, "MM\0*", 4)));
		image_count++;
		invalid_images += !((jpeg && valid_jpeg(bytes, item->blob.size)) || (tiff && valid_raw(bytes, item->blob.size)));
		printf("Captured %s payload: %ld bytes, container=%s\n", item->blob.format, item->blob.size, jpeg ? "JPEG" : tiff ? "TIFF RAW" : "invalid");
	}
	if (index >= 0) {
		properties[index] = indigo_copy_property(properties[index], property);
		revisions[index]++;
	}
	pthread_mutex_unlock(&mutex);
	return INDIGO_OK;
}

static indigo_result deleted(indigo_client *client, indigo_device *device, indigo_property *property, const char *message) {
	(void)client;
	(void)device;
	(void)message;
	pthread_mutex_lock(&mutex);
	for (int i = 0; i < MAX_PROPERTIES; i++) {
		if (properties[i] && !strcmp(properties[i]->device, property->device) && (!*property->name || !strcmp(properties[i]->name, property->name))) {
			indigo_release_property(properties[i]);
			properties[i] = NULL;
			revisions[i]++;
		}
	}
	pthread_mutex_unlock(&mutex);
	return INDIGO_OK;
}

static indigo_client client = {
	.name = "Pentax short hardware acceptance",
	.version = INDIGO_VERSION_CURRENT,
	.define_property = observe,
	.update_property = observe,
	.delete_property = deleted
};

static indigo_property *snapshot(const char *name) {
	pthread_mutex_lock(&mutex);
	int index = slot(name);
	indigo_property *result = index >= 0 ? indigo_copy_property(NULL, properties[index]) : NULL;
	pthread_mutex_unlock(&mutex);
	return result;
}

static unsigned revision(const char *name) {
	pthread_mutex_lock(&mutex);
	int index = slot(name);
	unsigned result = index >= 0 ? revisions[index] : 0;
	pthread_mutex_unlock(&mutex);
	return result;
}

static bool wait_state(const char *name, unsigned before, indigo_property_state state, double timeout) {
	double end = indigo_monotonic_time() + timeout;
	while (indigo_monotonic_time() < end) {
		pthread_mutex_lock(&mutex);
		int index = slot(name);
		bool done = index >= 0 && revisions[index] > before && properties[index]->state == state;
		bool failed = index >= 0 && revisions[index] > before && properties[index]->state == INDIGO_ALERT_STATE && state != INDIGO_ALERT_STATE;
		pthread_mutex_unlock(&mutex);
		if (done || failed) {
			return done;
		}
		indigo_usleep(10000);
	}
	return false;
}

static bool change_switch(const char *name, const char *item) {
	unsigned before = revision(name);
	return indigo_change_switch_property_1(&client, camera, name, item, true) == INDIGO_OK && wait_state(name, before, INDIGO_OK_STATE, 8);
}

static bool expose(double duration, bool finish) {
	unsigned before = revision(CCD_EXPOSURE_PROPERTY_NAME);
	return indigo_change_number_property_1(&client, camera, CCD_EXPOSURE_PROPERTY_NAME, CCD_EXPOSURE_ITEM_NAME, duration) == INDIGO_OK && wait_state(CCD_EXPOSURE_PROPERTY_NAME, before, finish ? INDIGO_OK_STATE : INDIGO_BUSY_STATE, 15);
}

static bool restore_switch(indigo_property *saved) {
	if (!saved || saved->perm == INDIGO_RO_PERM) {
		return true;
	}
	for (int i = 0; i < saved->count; i++) {
		if (saved->items[i].sw.value) {
			return change_switch(saved->name, saved->items[i].name);
		}
	}
	return false;
}

static bool exercise_control(indigo_property *saved) {
	if (!saved || saved->perm != INDIGO_RW_PERM || saved->count < 2) {
		return true;
	}
	for (int i = 0; i < saved->count; i++) {
		if (!saved->items[i].sw.value) {
			printf("Exercise %s -> %s\n", saved->name, saved->items[i].label);
			bool changed = change_switch(saved->name, saved->items[i].name);
			return restore_switch(saved) && changed;
		}
	}
	return false;
}

static void show_control(indigo_property *property) {
	if (!property) {
		return;
	}
	for (int i = 0; i < property->count; i++) {
		if (property->items[i].sw.value) {
			printf("Original %s=%s (%s)\n", property->name, property->items[i].name, property->items[i].label);
		}
	}
}

static void acceptance(void) {
	bool initialized = false, connected = false;
	indigo_property *saved_iso = NULL, *saved_shutter = NULL, *saved_aperture = NULL, *saved_program = NULL, *saved_compression = NULL;
	CHECK(hw_start() == INDIGO_OK);
	CHECK(indigo_attach_client(&client) == INDIGO_OK);
	CHECK(indigo_ccd_pentax(INDIGO_DRIVER_INIT, NULL) == INDIGO_OK);
	initialized = true;
	double end = indigo_monotonic_time() + 5;
	while (!*camera && indigo_monotonic_time() < end) {
		indigo_usleep(10000);
	}
	CHECK(*camera);
	printf("Discovered %s\n", camera);
	if (!change_switch(CONNECTION_PROPERTY_NAME, CONNECTION_CONNECTED_ITEM_NAME)) {
		fprintf(stderr, "Pentax connection failed\n");
		CHECK(false);
	}
	connected = true;
	indigo_property *info = snapshot(INFO_PROPERTY_NAME);
	CHECK(info != NULL);
	for (int i = 0; i < info->count; i++) {
		if (!strcmp(info->items[i].name, INFO_DEVICE_MODEL_ITEM_NAME) || !strcmp(info->items[i].name, INFO_DEVICE_FW_REVISION_ITEM_NAME)) {
			printf("%s=%s\n", info->items[i].name, info->items[i].text.value);
		}
	}
	indigo_release_property(info);
	saved_iso = snapshot(DSLR_ISO_PROPERTY_NAME);
	saved_shutter = snapshot(DSLR_SHUTTER_PROPERTY_NAME);
	saved_aperture = snapshot(DSLR_APERTURE_PROPERTY_NAME);
	saved_program = snapshot(DSLR_PROGRAM_PROPERTY_NAME);
	saved_compression = snapshot(DSLR_COMPRESSION_PROPERTY_NAME);
	CHECK(saved_iso != NULL);
	show_control(saved_iso);
	show_control(saved_shutter);
	show_control(saved_aperture);
	show_control(saved_program);
	show_control(saved_compression);
	if (!baseline_only) {
		CHECK(exercise_control(saved_iso));
		CHECK(exercise_control(saved_aperture));
		CHECK(exercise_control(saved_shutter));
		CHECK(change_switch(CCD_UPLOAD_MODE_PROPERTY_NAME, CCD_UPLOAD_MODE_CLIENT_ITEM_NAME));
		CHECK(change_switch(CCD_IMAGE_FORMAT_PROPERTY_NAME, CCD_IMAGE_FORMAT_NATIVE_ITEM_NAME));
		unsigned before = frames();
		CHECK(expose(0.1, true));
		CHECK(frames() == before + 1 && images_valid());
		before = frames();
		CHECK(expose(1.2, true));
		CHECK(frames() == before + 1 && images_valid());
		CHECK(expose(2, false));
		indigo_usleep(100000);
		CHECK(change_switch(CCD_ABORT_EXPOSURE_PROPERTY_NAME, CCD_ABORT_EXPOSURE_ITEM_NAME));
		before = frames();
		CHECK(expose(0.1, true));
		CHECK(frames() == before + 1 && images_valid());
	}
cleanup:
	if (connected) {
		if (!baseline_only) {
			bool restored = restore_switch(saved_iso);
			restored = restore_switch(saved_shutter) && restored;
			restored = restore_switch(saved_aperture) && restored;
			restored = restore_switch(saved_program) && restored;
			restored = restore_switch(saved_compression) && restored;
			if (!restored) {
				fprintf(stderr, "Failed to restore one or more camera controls\n");
				indigo_test_failures++;
			}
		}
		if (!change_switch(CONNECTION_PROPERTY_NAME, CONNECTION_DISCONNECTED_ITEM_NAME)) {
			indigo_test_failures++;
		}
	}
	indigo_release_property(saved_iso);
	indigo_release_property(saved_shutter);
	indigo_release_property(saved_aperture);
	indigo_release_property(saved_program);
	indigo_release_property(saved_compression);
	if (initialized) {
		indigo_ccd_pentax(INDIGO_DRIVER_SHUTDOWN, NULL);
	}
	indigo_detach_client(&client);
	indigo_stop();
}

int main(int argc, char **argv) {
	if (argc != 2 || (strcmp(argv[1], "--run") && strcmp(argv[1], "--baseline"))) {
		fprintf(stderr, "Physical Pentax K-m test requires --run or --baseline. No physical hotplug.\n");
		return 2;
	}
	baseline_only = !strcmp(argv[1], "--baseline");
	setvbuf(stdout, NULL, _IONBF, 0);
	alarm(60);
	const indigo_test_case tests[] = { { baseline_only ? "K-m connection and status baseline" : "K-m short grouped hardware acceptance", acceptance } };
	int result = indigo_run_tests("ccd_pentax hardware", tests, 1);
	alarm(0);
	for (int i = 0; i < MAX_PROPERTIES; i++) {
		indigo_release_property(properties[i]);
	}
	return result;
}
