// Copyright (c) 2026 INDIGO initiative
// All rights reserved.
//
// You may use this software under the terms of 'INDIGO Astronomy
// open-source license' (see LICENSE.md).
//
// THIS SOFTWARE IS PROVIDED BY THE AUTHORS 'AS IS' AND ANY EXPRESS
// OR IMPLIED WARRANTIES, INCLUDING, BUT NOT LIMITED TO, THE IMPLIED
// WARRANTIES OF MERCHANTABILITY AND FITNESS FOR A PARTICULAR PURPOSE
// ARE DISCLAIMED. IN NO EVENT SHALL THE AUTHOR BE LIABLE FOR ANY
// DIRECT, INDIRECT, INCIDENTAL, SPECIAL, EXEMPLARY, OR CONSEQUENTIAL
// DAMAGES (INCLUDING, BUT NOT LIMITED TO, PROCUREMENT OF SUBSTITUTE
// GOODS OR SERVICES; LOSS OF USE, DATA, OR PROFITS; OR BUSINESS
// INTERRUPTION) HOWEVER CAUSED AND ON ANY THEORY OF LIABILITY,
// WHETHER IN CONTRACT, STRICT LIABILITY, OR TORT (INCLUDING
// NEGLIGENCE OR OTHERWISE) ARISING IN ANY WAY OUT OF THE USE OF THIS
// SOFTWARE, EVEN IF ADVISED OF THE POSSIBILITY OF SUCH DAMAGE.

// Code is generated by AI

// Opt-in acceptance test for a physically connected Baader Classic dome controller, or for the Arduino
// sketch dome_baader_simulator.ino running on a board. It reads the serial number and the azimuth, slews
// to an azimuth and back, moves by steps both ways, aborts a rotation, opens and closes the shutter and the
// flap (refused while the shutter is closed), parks and refuses a slew while parked, reconnects and runs
// driver INIT/SHUTDOWN.
//
// THE DOME ROTATES AND THE SHUTTER AND FLAP OPEN. The session returns the dome to the azimuth, shutter, flap
// and park state it found.
//
// The port comes from BAADER_HW_PORT (a serial port, or baader://host for the network controller).

#include <math.h>
#include <stdlib.h>
#include <indigo_drivers/dome_baader/indigo_dome_baader.h>
#include "dome_hw_common.h"

#define DEVICE_NAME "Baader Classic Dome"

#define SHORT_TIMEOUT 15.0
// A full turn and a full shutter travel take minutes on a real dome.
#define MOTION_TIMEOUT 240.0

static int dome = -1;
static const char *serial_port = NULL;
static bool state_captured = false, shutter_was_open = false, flap_was_open = false, was_parked = false;
static double initial_azimuth = 0;

static bool select_port(void) {
	if (serial_port == NULL || !*serial_port) {
		fprintf(stderr, "    set BAADER_HW_PORT to the dome controller's port\n");
		return false;
	}
	printf("Using port %s\n", serial_port);
	return hw_set_text(dome, DEVICE_PORT_PROPERTY_NAME, DEVICE_PORT_ITEM_NAME, serial_port, INDIGO_OK_STATE, SHORT_TIMEOUT);
}

// The first status poll runs 0.5 s after the connection and reads the shutter and flap.
static bool wait_for_first_poll(void) {
	double deadline = indigo_monotonic_time() + SHORT_TIMEOUT;
	while (indigo_monotonic_time() < deadline) {
		if ((dome_hw_switch_is(dome, DOME_SHUTTER_PROPERTY_NAME, DOME_SHUTTER_OPENED_ITEM_NAME) || dome_hw_switch_is(dome, DOME_SHUTTER_PROPERTY_NAME, DOME_SHUTTER_CLOSED_ITEM_NAME)) && hw_property_state(dome, DOME_SHUTTER_PROPERTY_NAME) == INDIGO_OK_STATE) {
			indigo_usleep(1500000);
			return true;
		}
		indigo_usleep(10000);
	}
	fprintf(stderr, "    the shutter state was never read\n");
	return false;
}

static bool capture_state(void) {
	if (!wait_for_first_poll() || !hw_wait_settled(dome, DOME_SHUTTER_PROPERTY_NAME, INDIGO_OK_STATE, MOTION_TIMEOUT) || !hw_wait_settled(dome, DOME_FLAP_PROPERTY_NAME, INDIGO_OK_STATE, MOTION_TIMEOUT)) {
		return false;
	}
	initial_azimuth = dome_hw_azimuth(dome);
	shutter_was_open = dome_hw_switch_is(dome, DOME_SHUTTER_PROPERTY_NAME, DOME_SHUTTER_OPENED_ITEM_NAME);
	flap_was_open = dome_hw_switch_is(dome, DOME_FLAP_PROPERTY_NAME, DOME_FLAP_OPENED_ITEM_NAME);
	was_parked = dome_hw_switch_is(dome, DOME_PARK_PROPERTY_NAME, DOME_PARK_PARKED_ITEM_NAME);
	printf("    azimuth %.1f, shutter %s, flap %s, %s\n", initial_azimuth, shutter_was_open ? "open" : "closed", flap_was_open ? "open" : "closed", was_parked ? "parked" : "unparked");
	return !isnan(initial_azimuth);
}

static void restore_initial_state(void) {
	if (dome < 0 || !state_captured || !hw_connected(dome)) {
		return;
	}
	if (dome_hw_switch_is(dome, DOME_PARK_PROPERTY_NAME, DOME_PARK_PARKED_ITEM_NAME)) {
		dome_hw_park(dome, false, SHORT_TIMEOUT);
	}
	if (dome_hw_switch_is(dome, DOME_FLAP_PROPERTY_NAME, DOME_FLAP_OPENED_ITEM_NAME) != flap_was_open) {
		if (flap_was_open && !dome_hw_switch_is(dome, DOME_SHUTTER_PROPERTY_NAME, DOME_SHUTTER_OPENED_ITEM_NAME)) {
			dome_hw_open_close(dome, DOME_SHUTTER_PROPERTY_NAME, true, INDIGO_OK_STATE, MOTION_TIMEOUT);
		}
		dome_hw_open_close(dome, DOME_FLAP_PROPERTY_NAME, flap_was_open, INDIGO_OK_STATE, MOTION_TIMEOUT);
	}
	if (dome_hw_switch_is(dome, DOME_SHUTTER_PROPERTY_NAME, DOME_SHUTTER_OPENED_ITEM_NAME) != shutter_was_open) {
		dome_hw_open_close(dome, DOME_SHUTTER_PROPERTY_NAME, shutter_was_open, INDIGO_OK_STATE, MOTION_TIMEOUT);
	}
	if (was_parked) {
		dome_hw_park(dome, true, MOTION_TIMEOUT);
	} else {
		dome_hw_goto(dome, initial_azimuth, INDIGO_OK_STATE, MOTION_TIMEOUT);
	}
}

static void baader_publishes_the_property_contract(void) {
	char serial[INDIGO_VALUE_SIZE] = "";
	ASSERT_TRUE((hw_device_interface(dome) & INDIGO_INTERFACE_DOME) != 0);
	ASSERT_TRUE(hw_text_item(dome, INFO_PROPERTY_NAME, INFO_DEVICE_SERIAL_NUM_ITEM_NAME, serial, sizeof(serial)));
	printf("    serial number %s\n", serial);
	ASSERT_TRUE(*serial && strcmp(serial, "N/A"));
	ASSERT_TRUE(hw_property_defined(dome, DOME_HORIZONTAL_COORDINATES_PROPERTY_NAME));
	ASSERT_TRUE(hw_property_defined(dome, DOME_SHUTTER_PROPERTY_NAME));
	ASSERT_TRUE(hw_property_defined(dome, DOME_FLAP_PROPERTY_NAME));
	ASSERT_TRUE(hw_property_defined(dome, DOME_PARK_PROPERTY_NAME));
	ASSERT_TRUE(hw_property_defined(dome, DOME_STEPS_PROPERTY_NAME));
	ASSERT_TRUE(hw_property_defined(dome, "X_EMERGENCY_CLOSE"));
	ASSERT_TRUE(initial_azimuth >= 0 && initial_azimuth < 360);
}

static void baader_slews_to_an_azimuth(void) {
	if (was_parked) {
		ASSERT_TRUE(dome_hw_park(dome, false, SHORT_TIMEOUT));
	}
	double target = dome_hw_normalize(floor(initial_azimuth) + 40.3);
	ASSERT_TRUE(dome_hw_goto(dome, target, INDIGO_OK_STATE, MOTION_TIMEOUT));
	ASSERT_TRUE(dome_hw_at(dome, target, 0.15));
	// The protocol resolution is a tenth of a degree.
	ASSERT_TRUE(dome_hw_goto(dome, dome_hw_normalize(target - 25), INDIGO_OK_STATE, MOTION_TIMEOUT));
	ASSERT_TRUE(dome_hw_at(dome, dome_hw_normalize(target - 25), 0.15));
	// A request for the azimuth the dome is at ends at once.
	ASSERT_TRUE(dome_hw_goto(dome, dome_hw_normalize(target - 25), INDIGO_OK_STATE, MOTION_TIMEOUT));
}

static void baader_moves_by_steps(void) {
	double start = dome_hw_azimuth(dome);
	ASSERT_TRUE(dome_hw_steps(dome, true, 15, MOTION_TIMEOUT));
	ASSERT_TRUE(dome_hw_at(dome, dome_hw_normalize(start + 15), 0.15));
	ASSERT_TRUE(dome_hw_steps(dome, false, 15, MOTION_TIMEOUT));
	ASSERT_TRUE(dome_hw_at(dome, start, 0.15));
}

static void baader_aborts_a_rotation(void) {
	double start = dome_hw_azimuth(dome);
	double target = dome_hw_normalize(start + 120);
	ASSERT_TRUE(hw_wait_settled(dome, DOME_HORIZONTAL_COORDINATES_PROPERTY_NAME, INDIGO_OK_STATE, SHORT_TIMEOUT));
	unsigned before = hw_revision(dome, DOME_HORIZONTAL_COORDINATES_PROPERTY_NAME);
	indigo_change_number_property_1(&hw_client, DEVICE_NAME, DOME_HORIZONTAL_COORDINATES_PROPERTY_NAME, DOME_HORIZONTAL_COORDINATES_AZ_ITEM_NAME, target);
	ASSERT_TRUE(hw_wait_state(dome, DOME_HORIZONTAL_COORDINATES_PROPERTY_NAME, before, INDIGO_BUSY_STATE, SHORT_TIMEOUT));
	indigo_usleep(3000000);
	ASSERT_TRUE(dome_hw_abort(dome, SHORT_TIMEOUT));
	ASSERT_TRUE(hw_wait_settled(dome, DOME_HORIZONTAL_COORDINATES_PROPERTY_NAME, INDIGO_OK_STATE, SHORT_TIMEOUT));
	// Two polls later the dome stands where it stopped, short of the target.
	indigo_usleep(2500000);
	double stopped = dome_hw_azimuth(dome);
	printf("    stopped at %.1f on the way from %.1f to %.1f\n", stopped, start, target);
	ASSERT_TRUE(dome_hw_azimuth_distance(stopped, target) > 1);
	indigo_usleep(2500000);
	ASSERT_TRUE(dome_hw_at(dome, stopped, 0.15));
	ASSERT_EQ_INT(INDIGO_OK_STATE, hw_property_state(dome, DOME_HORIZONTAL_COORDINATES_PROPERTY_NAME));
}

// The flap needs the shutter open; with the shutter closed the controller refuses it.
static void baader_moves_the_shutter_and_the_flap(void) {
	if (dome_hw_switch_is(dome, DOME_FLAP_PROPERTY_NAME, DOME_FLAP_OPENED_ITEM_NAME)) {
		ASSERT_TRUE(dome_hw_open_close(dome, DOME_FLAP_PROPERTY_NAME, false, INDIGO_OK_STATE, MOTION_TIMEOUT));
	}
	if (dome_hw_switch_is(dome, DOME_SHUTTER_PROPERTY_NAME, DOME_SHUTTER_OPENED_ITEM_NAME)) {
		ASSERT_TRUE(dome_hw_open_close(dome, DOME_SHUTTER_PROPERTY_NAME, false, INDIGO_OK_STATE, MOTION_TIMEOUT));
	}
	ASSERT_TRUE(dome_hw_open_close(dome, DOME_FLAP_PROPERTY_NAME, true, INDIGO_ALERT_STATE, SHORT_TIMEOUT));
	ASSERT_TRUE(dome_hw_open_close(dome, DOME_SHUTTER_PROPERTY_NAME, true, INDIGO_OK_STATE, MOTION_TIMEOUT));
	ASSERT_TRUE(dome_hw_open_close(dome, DOME_FLAP_PROPERTY_NAME, true, INDIGO_OK_STATE, MOTION_TIMEOUT));
	ASSERT_TRUE(dome_hw_open_close(dome, DOME_FLAP_PROPERTY_NAME, false, INDIGO_OK_STATE, MOTION_TIMEOUT));
	ASSERT_TRUE(dome_hw_open_close(dome, DOME_SHUTTER_PROPERTY_NAME, false, INDIGO_OK_STATE, MOTION_TIMEOUT));
	// Two polls later the shutter still reads closed.
	indigo_usleep(2500000);
	ASSERT_TRUE(dome_hw_switch_is(dome, DOME_SHUTTER_PROPERTY_NAME, DOME_SHUTTER_CLOSED_ITEM_NAME));
}

static void baader_parks(void) {
	ASSERT_TRUE(dome_hw_park(dome, true, MOTION_TIMEOUT));
	ASSERT_TRUE(dome_hw_at(dome, 0, 0.15));
	// A slew is refused while parked.
	ASSERT_TRUE(dome_hw_goto(dome, 90, INDIGO_ALERT_STATE, SHORT_TIMEOUT));
	ASSERT_TRUE(dome_hw_at(dome, 0, 0.15));
	ASSERT_TRUE(dome_hw_park(dome, false, SHORT_TIMEOUT));
	ASSERT_TRUE(dome_hw_goto(dome, 10, INDIGO_OK_STATE, MOTION_TIMEOUT));
	ASSERT_TRUE(dome_hw_at(dome, 10, 0.15));
}

static void baader_reconnects(void) {
	double azimuth = dome_hw_azimuth(dome);
	ASSERT_TRUE(hw_disconnect(dome, SHORT_TIMEOUT));
	ASSERT_TRUE(hw_property_hidden(dome, DOME_SHUTTER_PROPERTY_NAME));
	ASSERT_TRUE(hw_connect(dome, SHORT_TIMEOUT));
	ASSERT_TRUE(wait_for_first_poll());
	ASSERT_TRUE(dome_hw_at(dome, azimuth, 0.15));
	ASSERT_TRUE(dome_hw_switch_is(dome, DOME_PARK_PROPERTY_NAME, DOME_PARK_UNPARKED_ITEM_NAME));
}

static void baader_rejects_shutdown_while_connected(void) {
	ASSERT_EQ_INT(INDIGO_BUSY, indigo_dome_baader(INDIGO_DRIVER_SHUTDOWN, NULL));
	ASSERT_TRUE(hw_connected(dome));
}

static void baader_reinitializes(void) {
	ASSERT_TRUE(hw_disconnect(dome, SHORT_TIMEOUT));
	ASSERT_EQ_INT(INDIGO_OK, indigo_dome_baader(INDIGO_DRIVER_SHUTDOWN, NULL));
	ASSERT_EQ_INT(-1, hw_device_index(DEVICE_NAME));
	ASSERT_EQ_INT(INDIGO_OK, indigo_dome_baader(INDIGO_DRIVER_INIT, NULL));
	dome = hw_wait_for_device(DEVICE_NAME, SHORT_TIMEOUT);
	ASSERT_TRUE(dome >= 0);
	ASSERT_TRUE(select_port());
	ASSERT_TRUE(hw_connect(dome, SHORT_TIMEOUT));
	ASSERT_TRUE(wait_for_first_poll());
}

int main(int argc, char **argv) {
	if (argc < 2 || strcmp(argv[1], "--run")) {
		fprintf(stderr, "Physical Baader dome test: run explicitly with --run (or make test-dome-baader-hw).\n");
		return 2;
	}
	setvbuf(stdout, NULL, _IONBF, 0);
	for (int i = 2; i < argc; i++) {
		if (!strcmp(argv[i], "--debug")) {
			indigo_set_log_level(INDIGO_LOG_DEBUG);
		}
	}
	if (!indigo_test_use_private_home()) {
		return 1;
	}
	serial_port = hw_port("BAADER_HW_PORT");
	const indigo_test_case tests[] = {
		{ "baader_publishes_the_property_contract", baader_publishes_the_property_contract },
		{ "baader_slews_to_an_azimuth", baader_slews_to_an_azimuth },
		{ "baader_moves_by_steps", baader_moves_by_steps },
		{ "baader_aborts_a_rotation", baader_aborts_a_rotation },
		{ "baader_moves_the_shutter_and_the_flap", baader_moves_the_shutter_and_the_flap },
		{ "baader_parks", baader_parks },
		{ "baader_reconnects", baader_reconnects },
		{ "baader_rejects_shutdown_while_connected", baader_rejects_shutdown_while_connected },
		{ "baader_reinitializes", baader_reinitializes }
	};
	int result = 1;
	bool started = false, initialized = false;
	HW_CHECK(hw_start() == INDIGO_OK);
	started = true;
	HW_CHECK(hw_attach_client("Baader dome hardware test") == INDIGO_OK);
	HW_CHECK(indigo_dome_baader(INDIGO_DRIVER_INIT, NULL) == INDIGO_OK);
	initialized = true;
	dome = hw_wait_for_device(DEVICE_NAME, SHORT_TIMEOUT);
	HW_CHECK(dome >= 0);
	HW_CHECK(select_port());
	HW_CHECK(hw_connect(dome, SHORT_TIMEOUT));
	HW_CHECK(capture_state());
	state_captured = true;
	result = indigo_run_tests("Baader dome hardware", tests, ARRAY_SIZE(tests));
cleanup:
	restore_initial_state();
	if (!hw_disconnect(dome, SHORT_TIMEOUT)) {
		indigo_test_failures++;
	}
	if (initialized && indigo_dome_baader(INDIGO_DRIVER_SHUTDOWN, NULL) != INDIGO_OK) {
		indigo_test_failures++;
	}
	indigo_detach_client(&hw_client);
	if (started) {
		indigo_stop();
	}
	hw_release_properties();
	indigo_test_remove_private_home();
	return indigo_test_failures ? 1 : result;
}
