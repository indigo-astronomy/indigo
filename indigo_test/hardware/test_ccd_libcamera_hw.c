// Copyright (c) 2026 INDIGO initiative
// All rights reserved.
//
// You may use this software under the terms of 'INDIGO Astronomy
// open-source license' (see LICENSE.md).
//
// THIS SOFTWARE IS PROVIDED BY THE AUTHORS 'AS IS' AND ANY EXPRESS
// OR IMPLIED WARRANTIES, INCLUDING, BUT NOT LIMITED TO, THE IMPLIED
// WARRANTIES OF MERCHANTABILITY AND FITNESS FOR A PARTICULAR PURPOSE
// ARE DISCLAIMED. IN NO EVENT SHALL THE AUTHOR BE LIABLE FOR ANY
// DIRECT, INDIRECT, INCIDENTAL, SPECIAL, EXEMPLARY, OR CONSEQUENTIAL
// DAMAGES (INCLUDING, BUT NOT LIMITED TO, PROCUREMENT OF SUBSTITUTE
// GOODS OR SERVICES; LOSS OF USE, DATA, OR PROFITS; OR BUSINESS
// INTERRUPTION) HOWEVER CAUSED AND ON ANY THEORY OF LIABILITY,
// WHETHER IN CONTRACT, STRICT LIABILITY, OR TORT (INCLUDING
// NEGLIGENCE OR OTHERWISE) ARISING IN ANY WAY OUT OF THE USE OF THIS
// SOFTWARE, EVEN IF ADVISED OF THE POSSIBILITY OF SUCH DAMAGE.

// Code is generated by AI

// Physical libcamera camera acceptance test (Raspberry Pi CSI cameras). CSI cameras cannot be
// unplugged while the system runs, so there is no hot-plug case.

#include <pthread.h>
#include <math.h>
#include <stdlib.h>

#include <indigo/indigo_driver.h>
#include <indigo_linux_drivers/ccd_libcamera/indigo_ccd_libcamera.h>

#include "../test_runner.h"
#include "hardware_device_record.h"

#define MAX_DEVICES 16
#define MAX_PROPERTIES 128
#define CHECK(condition) do { if (!(condition)) { fprintf(stderr, "%s:%d: %s\n", __FILE__, __LINE__, #condition); indigo_test_failures++; goto cleanup; } } while (0)

typedef struct {
	char name[INDIGO_NAME_SIZE];
	unsigned interface;
	bool present;
	indigo_property *properties[MAX_PROPERTIES];
	unsigned revisions[MAX_PROPERTIES];
	unsigned frames;
	unsigned invalid_frames;
	unsigned last_width, last_height, last_min, last_max;
	double last_mean, last_deviation;
} observed_device;

static observed_device devices[MAX_DEVICES];
static pthread_mutex_t mutex = PTHREAD_MUTEX_INITIALIZER;
static indigo_client client;
static int camera = -1;
static bool initialized;
static double short_exposure = 0.01;

static int property_slot(int device_index, const char *name) {
	for (int property_index = 0; property_index < MAX_PROPERTIES; property_index++) {
		if (devices[device_index].properties[property_index] && !strcmp(devices[device_index].properties[property_index]->name, name)) {
			return property_index;
		}
	}
	return -1;
}

static void inspect_frame(observed_device *device, indigo_item *item) {
	indigo_raw_header header = { 0 };
	if (item->blob.size >= (long)sizeof(header)) {
		memcpy(&header, item->blob.value, sizeof(header));
	}
	if (strcmp(item->blob.format, ".raw") || header.signature != INDIGO_RAW_MONO16 || !header.width || !header.height || (uint64_t)header.width * header.height * 2 + sizeof(header) > (uint64_t)item->blob.size) {
		device->invalid_frames++;
		return;
	}
	const uint16_t *pixels = (const uint16_t *)((const char *)item->blob.value + sizeof(header));
	size_t count = (size_t)header.width * header.height;
	unsigned minimum = 65535, maximum = 0;
	double sum = 0, squares = 0;
	for (size_t i = 0; i < count; i++) {
		minimum = pixels[i] < minimum ? pixels[i] : minimum;
		maximum = pixels[i] > maximum ? pixels[i] : maximum;
		sum += pixels[i];
		squares += (double)pixels[i] * pixels[i];
	}
	device->last_width = header.width;
	device->last_height = header.height;
	device->last_min = minimum;
	device->last_max = maximum;
	device->last_mean = sum / count;
	device->last_deviation = sqrt(fmax(0, squares / count - device->last_mean * device->last_mean));
}

static indigo_result observe(indigo_device *device, indigo_property *property, const char *message, bool image_update) {
	pthread_mutex_lock(&mutex);
	int device_index;
	for (device_index = 0; device_index < MAX_DEVICES; device_index++) {
		if (!*devices[device_index].name || !strcmp(devices[device_index].name, property->device)) {
			break;
		}
	}
	if (device_index < MAX_DEVICES) {
		snprintf(devices[device_index].name, INDIGO_NAME_SIZE, "%s", property->device);
		if (!image_update && !strcmp(property->name, INFO_PROPERTY_NAME)) {
			devices[device_index].present = true;
			for (int item_index = 0; item_index < property->count; item_index++) {
				if (!strcmp(property->items[item_index].name, INFO_DEVICE_INTERFACE_ITEM_NAME)) {
					devices[device_index].interface = strtoul(property->items[item_index].text.value, NULL, 10);
				}
			}
		}
		int property_index = property_slot(device_index, property->name);
		if (property_index < 0) {
			for (property_index = 0; property_index < MAX_PROPERTIES && devices[device_index].properties[property_index]; property_index++) { }
		}
		if (property_index < MAX_PROPERTIES) {
			indigo_release_property(devices[device_index].properties[property_index]);
			devices[device_index].properties[property_index] = indigo_copy_property(NULL, property);
			devices[device_index].revisions[property_index]++;
		}
		if (image_update && !strcmp(property->name, CCD_IMAGE_PROPERTY_NAME) && property->state == INDIGO_OK_STATE && property->count && property->items[0].blob.value) {
			inspect_frame(devices + device_index, property->items);
			devices[device_index].frames++;
			if (devices[device_index].frames <= 40 || devices[device_index].frames % 100 == 0) {
				printf("    frame %u: %u x %u, min %u, max %u, mean %.1f, deviation %.2f\n", devices[device_index].frames, devices[device_index].last_width, devices[device_index].last_height, devices[device_index].last_min, devices[device_index].last_max, devices[device_index].last_mean, devices[device_index].last_deviation);
			}
		}
	}
	pthread_mutex_unlock(&mutex);
	if (message && *message) {
		fprintf(stderr, "    %s %s: %s\n", property->device, property->name, message);
	}
	return INDIGO_OK;
}

static indigo_result define_property(indigo_client *client, indigo_device *device, indigo_property *property, const char *message) {
	return observe(device, property, message, false);
}

static indigo_result update_property(indigo_client *client, indigo_device *device, indigo_property *property, const char *message) {
	return observe(device, property, message, true);
}

static indigo_result report_message(indigo_client *client, indigo_device *device, indigo_property *property, const char *message) {
	fprintf(stderr, "    message: %s\n", message ? message : "");
	return INDIGO_OK;
}

static indigo_result delete_property(indigo_client *client, indigo_device *device, indigo_property *property, const char *message) {
	pthread_mutex_lock(&mutex);
	for (int device_index = 0; device_index < MAX_DEVICES; device_index++) {
		if (!strcmp(devices[device_index].name, property->device)) {
			if (!*property->name) {
				devices[device_index].present = false;
			}
			for (int property_index = 0; property_index < MAX_PROPERTIES; property_index++) {
				if (devices[device_index].properties[property_index] && (!*property->name || !strcmp(devices[device_index].properties[property_index]->name, property->name))) {
					indigo_release_property(devices[device_index].properties[property_index]);
					devices[device_index].properties[property_index] = NULL;
				}
			}
		}
	}
	pthread_mutex_unlock(&mutex);
	return INDIGO_OK;
}

static unsigned property_revision(const char *name) {
	pthread_mutex_lock(&mutex);
	int property_index = property_slot(camera, name);
	unsigned result = property_index < 0 ? 0 : devices[camera].revisions[property_index];
	pthread_mutex_unlock(&mutex);
	return result;
}

static indigo_property *snapshot(const char *name) {
	pthread_mutex_lock(&mutex);
	int property_index = property_slot(camera, name);
	indigo_property *result = property_index < 0 ? NULL : indigo_copy_property(NULL, devices[camera].properties[property_index]);
	pthread_mutex_unlock(&mutex);
	return result;
}

static bool same_values(indigo_property *before, indigo_property *after) {
	if (!before || !after || before->type != after->type || before->count != after->count) {
		return false;
	}
	for (int item_index = 0; item_index < before->count; item_index++) {
		indigo_item *before_item = before->items + item_index, *after_item = after->items + item_index;
		if (strcmp(before_item->name, after_item->name)) {
			return false;
		}
		if (before->type == INDIGO_NUMBER_VECTOR && (before_item->number.value != after_item->number.value || before_item->number.target != after_item->number.target)) {
			return false;
		}
		if (before->type == INDIGO_SWITCH_VECTOR && before_item->sw.value != after_item->sw.value) {
			return false;
		}
	}
	return true;
}

static bool wait_state(const char *name, unsigned after, indigo_property_state state, double timeout) {
	for (int iteration = 0; iteration < timeout * 100; iteration++) {
		pthread_mutex_lock(&mutex);
		int property_index = property_slot(camera, name);
		bool ready = property_index >= 0 && devices[camera].revisions[property_index] > after && devices[camera].properties[property_index]->state == state;
		bool failed = property_index >= 0 && devices[camera].revisions[property_index] > after && devices[camera].properties[property_index]->state == INDIGO_ALERT_STATE && state != INDIGO_ALERT_STATE;
		indigo_property_state actual = property_index < 0 ? INDIGO_IDLE_STATE : devices[camera].properties[property_index]->state;
		pthread_mutex_unlock(&mutex);
		if (ready) {
			return true;
		}
		if (failed) {
			fprintf(stderr, "Failed: %s %s entered state %d while waiting for %d\n", devices[camera].name, name, actual, state);
			return false;
		}
		indigo_usleep(10000);
	}
	fprintf(stderr, "Timeout: %s %s expected state %d\n", devices[camera].name, name, state);
	return false;
}

static bool change_switch(const char *name, const char *item, indigo_property_state state) {
	unsigned before = property_revision(name);
	indigo_change_switch_property_1(&client, devices[camera].name, name, item, true);
	return wait_state(name, before, state, 60);
}

static bool change_number(const char *name, const char *item, double value, indigo_property_state state) {
	unsigned before = property_revision(name);
	indigo_change_number_property_1(&client, devices[camera].name, name, item, value);
	return wait_state(name, before, state, 60 + value);
}

static bool reject_number_change(const char *name, const char *item, double value) {
	indigo_property *before = snapshot(name);
	unsigned revision = property_revision(name);
	indigo_change_number_property_1(&client, devices[camera].name, name, item, value);
	bool result = wait_state(name, revision, INDIGO_ALERT_STATE, 10);
	indigo_property *after = snapshot(name);
	result = result && same_values(before, after);
	indigo_release_property(before);
	indigo_release_property(after);
	return result;
}

static bool reject_switch_change(const char *name, const char *item) {
	indigo_property *before = snapshot(name);
	unsigned revision = property_revision(name);
	indigo_change_switch_property_1(&client, devices[camera].name, name, item, true);
	bool result = wait_state(name, revision, INDIGO_ALERT_STATE, 10);
	indigo_property *after = snapshot(name);
	result = result && same_values(before, after);
	indigo_release_property(before);
	indigo_release_property(after);
	return result;
}

static unsigned frame_count(void) {
	pthread_mutex_lock(&mutex);
	unsigned result = devices[camera].frames;
	pthread_mutex_unlock(&mutex);
	return result;
}

static observed_device last_frame(void) {
	pthread_mutex_lock(&mutex);
	observed_device result = devices[camera];
	pthread_mutex_unlock(&mutex);
	memset(result.properties, 0, sizeof(result.properties));
	return result;
}

static double number_value(const char *property_name, int item_index) {
	indigo_property *property = snapshot(property_name);
	double result = property && property->count > item_index ? property->items[item_index].number.value : NAN;
	indigo_release_property(property);
	return result;
}

static bool acquire(double duration) {
	unsigned before = frame_count();
	if (!change_number(CCD_EXPOSURE_PROPERTY_NAME, CCD_EXPOSURE_ITEM_NAME, duration, INDIGO_OK_STATE)) {
		return false;
	}
	observed_device frame = last_frame();
	if (frame_count() != before + 1 || frame.invalid_frames) {
		fprintf(stderr, "Expected one valid frame, got %u (%u invalid)\n", frame_count() - before, frame.invalid_frames);
		return false;
	}
	return true;
}

// The frame must have the geometry of CCD_FRAME and real sensor content: samples inside the bit
// depth of the mode and not one constant value.
static bool check_frame(unsigned bit_depth) {
	observed_device frame = last_frame();
	unsigned width = (unsigned)number_value(CCD_FRAME_PROPERTY_NAME, 2);
	unsigned height = (unsigned)number_value(CCD_FRAME_PROPERTY_NAME, 3);
	if (frame.last_width != width || frame.last_height != height) {
		fprintf(stderr, "Frame is %u x %u, CCD_FRAME is %u x %u\n", frame.last_width, frame.last_height, width, height);
		return false;
	}
	if (bit_depth < 16 && frame.last_max >= (1u << bit_depth)) {
		fprintf(stderr, "Sample %u exceeds %u bits\n", frame.last_max, bit_depth);
		return false;
	}
	if (frame.last_max == frame.last_min) {
		fprintf(stderr, "Frame is constant (%u)\n", frame.last_min);
		return false;
	}
	return true;
}

// Light and dark current raise the mean and the noise grows with them, so the sum of both grows with
// the exposure whether the camera sees a scene or is covered.
static double frame_signal(void) {
	observed_device frame = last_frame();
	return frame.last_mean + frame.last_deviation;
}

static bool connect_camera(void) {
	return change_switch(CONNECTION_PROPERTY_NAME, CONNECTION_CONNECTED_ITEM_NAME, INDIGO_OK_STATE) && change_switch(CCD_UPLOAD_MODE_PROPERTY_NAME, CCD_UPLOAD_MODE_CLIENT_ITEM_NAME, INDIGO_OK_STATE) && change_switch(CCD_IMAGE_FORMAT_PROPERTY_NAME, CCD_IMAGE_FORMAT_RAW_ITEM_NAME, INDIGO_OK_STATE);
}

static bool disconnect_camera(void) {
	pthread_mutex_lock(&mutex);
	bool present = camera >= 0 && devices[camera].present;
	int property_index = camera < 0 ? -1 : property_slot(camera, CONNECTION_PROPERTY_NAME);
	bool disconnected = property_index >= 0 && indigo_get_switch(devices[camera].properties[property_index], CONNECTION_DISCONNECTED_ITEM_NAME);
	pthread_mutex_unlock(&mutex);
	if (!present || disconnected) {
		return true;
	}
	return change_switch(CONNECTION_PROPERTY_NAME, CONNECTION_DISCONNECTED_ITEM_NAME, INDIGO_OK_STATE);
}

static bool wait_presence(void) {
	for (int iteration = 0; iteration < 1000; iteration++) {
		pthread_mutex_lock(&mutex);
		bool ready = camera >= 0 && devices[camera].present && property_slot(camera, CONNECTION_PROPERTY_NAME) >= 0;
		pthread_mutex_unlock(&mutex);
		if (ready) {
			return true;
		}
		indigo_usleep(10000);
	}
	return false;
}

static bool select_camera(void) {
	const char *requested = getenv("INDIGO_TEST_DEVICE");
	int matches = 0;
	pthread_mutex_lock(&mutex);
	for (int device_index = 0; device_index < MAX_DEVICES; device_index++) {
		if (devices[device_index].present && (devices[device_index].interface & INDIGO_INTERFACE_CCD)) {
			printf("    discovered camera: %s\n", devices[device_index].name);
			if (!requested || !strcmp(requested, devices[device_index].name)) {
				camera = device_index;
				matches++;
			}
		}
	}
	pthread_mutex_unlock(&mutex);
	if (matches != 1) {
		fprintf(stderr, "Expected one matching libcamera camera, found %d. Set INDIGO_TEST_DEVICE to an exact discovered name when needed.\n", matches);
		camera = -1;
		return false;
	}
	printf("    selected: %s\n", devices[camera].name);
	return true;
}

static int mode_bit_depth(const char *label) {
	int depth = 16;
	sscanf(label, "RAW %d", &depth);
	return depth;
}

static void discovery_and_identity(void) {
	CHECK(select_camera());
	CHECK(connect_camera());
	indigo_property *info = snapshot(INFO_PROPERTY_NAME);
	CHECK(info != NULL);
	const char *model = indigo_get_text_item_value(indigo_get_item(info, INFO_DEVICE_MODEL_ITEM_NAME));
	const char *serial = indigo_get_text_item_value(indigo_get_item(info, INFO_DEVICE_SERIAL_NUM_ITEM_NAME));
	printf("    model: %s, libcamera id: %s\n", model ? model : "", serial ? serial : "");
	bool named_after_sensor = model && *model && !strncasecmp(devices[camera].name, model, strlen(model));
	indigo_release_property(info);
	CHECK(named_after_sensor);
	double width = number_value(CCD_INFO_PROPERTY_NAME, 0), height = number_value(CCD_INFO_PROPERTY_NAME, 1), pixel = number_value(CCD_INFO_PROPERTY_NAME, 4);
	printf("    sensor: %g x %g, pixel %g um\n", width, height, pixel);
	CHECK(width > 0 && height > 0);
	indigo_property *exposure = snapshot(CCD_EXPOSURE_PROPERTY_NAME);
	CHECK(exposure != NULL);
	double minimum = exposure->items[0].number.min, maximum = exposure->items[0].number.max;
	indigo_release_property(exposure);
	printf("    exposure range: %g .. %g s\n", minimum, maximum);
	CHECK(minimum > 0 && maximum > minimum);
	short_exposure = fmax(minimum, 0.01);
	CHECK(snapshot(CCD_BIN_PROPERTY_NAME) == NULL);
cleanup:
	return;
}

static void every_mode_full_frame(void) {
	char names[16][INDIGO_NAME_SIZE], labels[16][INDIGO_VALUE_SIZE];
	int count = 0;
	indigo_property *mode = snapshot(CCD_MODE_PROPERTY_NAME);
	CHECK(mode != NULL && mode->count > 0);
	count = mode->count < 16 ? mode->count : 16;
	for (int i = 0; i < count; i++) {
		snprintf(names[i], INDIGO_NAME_SIZE, "%s", mode->items[i].name);
		snprintf(labels[i], INDIGO_VALUE_SIZE, "%s", mode->items[i].label);
	}
	indigo_release_property(mode);
	for (int i = 0; i < count; i++) {
		printf("    mode %s: %s\n", names[i], labels[i]);
		CHECK(change_switch(CCD_MODE_PROPERTY_NAME, names[i], INDIGO_OK_STATE));
		CHECK(acquire(short_exposure));
		CHECK(check_frame(mode_bit_depth(labels[i])));
	}
	CHECK(change_switch(CCD_MODE_PROPERTY_NAME, names[0], INDIGO_OK_STATE));
cleanup:
	return;
}

static void subframe(void) {
	double width = number_value(CCD_FRAME_PROPERTY_NAME, 2), height = number_value(CCD_FRAME_PROPERTY_NAME, 3);
	indigo_change_number_property(&client, devices[camera].name, CCD_FRAME_PROPERTY_NAME, 4, (const char *[]){ CCD_FRAME_LEFT_ITEM_NAME, CCD_FRAME_TOP_ITEM_NAME, CCD_FRAME_WIDTH_ITEM_NAME, CCD_FRAME_HEIGHT_ITEM_NAME }, (double []){ 101, 51, 301, 201 });
	indigo_usleep(200000);
	printf("    subframe: %g, %g, %g x %g\n", number_value(CCD_FRAME_PROPERTY_NAME, 0), number_value(CCD_FRAME_PROPERTY_NAME, 1), number_value(CCD_FRAME_PROPERTY_NAME, 2), number_value(CCD_FRAME_PROPERTY_NAME, 3));
	CHECK(((int)number_value(CCD_FRAME_PROPERTY_NAME, 0)) % 2 == 0);
	CHECK(number_value(CCD_FRAME_PROPERTY_NAME, 2) == 300);
	CHECK(acquire(short_exposure));
	CHECK(check_frame(16));
	indigo_change_number_property(&client, devices[camera].name, CCD_FRAME_PROPERTY_NAME, 4, (const char *[]){ CCD_FRAME_LEFT_ITEM_NAME, CCD_FRAME_TOP_ITEM_NAME, CCD_FRAME_WIDTH_ITEM_NAME, CCD_FRAME_HEIGHT_ITEM_NAME }, (double []){ 0, 0, width, height });
	indigo_usleep(200000);
	CHECK(number_value(CCD_FRAME_PROPERTY_NAME, 2) == width);
cleanup:
	return;
}

// A long exposure must not complete before its duration and must deliver more signal than a short
// one. The sensor starts with a short exposure, so the unusable frames after start do not each last
// the whole exposure: a 2 s exposure took 7.6 s on an OV5647 before, about 2.7 s since.
static void long_exposure(void) {
	double duration = 2;
	CHECK(acquire(short_exposure));
	double short_signal = frame_signal();
	unsigned short_max = last_frame().last_max;
	double started = indigo_monotonic_time();
	CHECK(acquire(duration));
	double elapsed = indigo_monotonic_time() - started;
	double long_signal = frame_signal();
	unsigned long_max = last_frame().last_max;
	printf("    %g s exposure took %.3f s, signal %.2f max %u (short %.2f max %u)\n", duration, elapsed, long_signal, long_max, short_signal, short_max);
	CHECK(elapsed >= duration);
	CHECK(elapsed < duration + 2);
	// In the dark only hot pixels grow with the exposure, so either more signal or a higher maximum counts.
	CHECK(long_signal > short_signal || long_max > short_max);
cleanup:
	return;
}

static void gain_control(void) {
	indigo_property *gain = snapshot(CCD_GAIN_PROPERTY_NAME);
	if (gain == NULL) {
		printf("    gain is not available\n");
		return;
	}
	double original = gain->items[0].number.value, minimum = gain->items[0].number.min, maximum = gain->items[0].number.max;
	indigo_release_property(gain);
	// On a covered OV5647 the mean even drops with gain (noise is clipped at zero below the black
	// level) while the noise grows five times between the extreme gains, so either counts.
	double low = minimum, high = maximum;
	CHECK(change_number(CCD_GAIN_PROPERTY_NAME, CCD_GAIN_ITEM_NAME, low, INDIGO_OK_STATE));
	CHECK(acquire(short_exposure));
	observed_device low_frame = last_frame();
	CHECK(change_number(CCD_GAIN_PROPERTY_NAME, CCD_GAIN_ITEM_NAME, high, INDIGO_OK_STATE));
	CHECK(acquire(short_exposure));
	observed_device high_frame = last_frame();
	printf("    gain %g mean %.2f deviation %.2f, gain %g mean %.2f deviation %.2f\n", low, low_frame.last_mean, low_frame.last_deviation, high, high_frame.last_mean, high_frame.last_deviation);
	CHECK(high_frame.last_mean > low_frame.last_mean * 1.5 || high_frame.last_deviation > low_frame.last_deviation * 1.5);
	CHECK(change_number(CCD_GAIN_PROPERTY_NAME, CCD_GAIN_ITEM_NAME, original, INDIGO_OK_STATE));
cleanup:
	return;
}

static void abort_and_reacquire(void) {
	unsigned before = frame_count();
	unsigned revision = property_revision(CCD_EXPOSURE_PROPERTY_NAME);
	double started = indigo_monotonic_time();
	indigo_change_number_property_1(&client, devices[camera].name, CCD_EXPOSURE_PROPERTY_NAME, CCD_EXPOSURE_ITEM_NAME, 3);
	CHECK(wait_state(CCD_EXPOSURE_PROPERTY_NAME, revision, INDIGO_BUSY_STATE, 10));
	indigo_usleep(500000);
	revision = property_revision(CCD_EXPOSURE_PROPERTY_NAME);
	indigo_change_switch_property_1(&client, devices[camera].name, CCD_ABORT_EXPOSURE_PROPERTY_NAME, CCD_ABORT_EXPOSURE_ITEM_NAME, true);
	CHECK(wait_state(CCD_EXPOSURE_PROPERTY_NAME, revision, INDIGO_ALERT_STATE, 10));
	printf("    aborted after %.3f s\n", indigo_monotonic_time() - started);
	indigo_usleep(3000000);
	CHECK(frame_count() == before);
	CHECK(acquire(short_exposure));
	CHECK(check_frame(16));
cleanup:
	return;
}

static void finite_streaming(void) {
	unsigned before = frame_count();
	unsigned revision = property_revision(CCD_STREAMING_PROPERTY_NAME);
	double started = indigo_monotonic_time();
	indigo_change_number_property(&client, devices[camera].name, CCD_STREAMING_PROPERTY_NAME, 2, (const char *[]){ CCD_STREAMING_EXPOSURE_ITEM_NAME, CCD_STREAMING_COUNT_ITEM_NAME }, (double []){ short_exposure, 10 });
	CHECK(wait_state(CCD_STREAMING_PROPERTY_NAME, revision, INDIGO_OK_STATE, 60));
	double elapsed = indigo_monotonic_time() - started;
	printf("    10 frames in %.3f s\n", elapsed);
	CHECK(frame_count() == before + 10);
	// Reading samples straight from the uncached frame buffer took 1.2 s per full frame on a Raspberry Pi 3.
	CHECK(elapsed < 5);
	CHECK(last_frame().invalid_frames == 0);
cleanup:
	return;
}

static void indefinite_streaming_refusals_and_abort(void) {
	unsigned before = frame_count();
	unsigned revision = property_revision(CCD_STREAMING_PROPERTY_NAME);
	indigo_change_number_property(&client, devices[camera].name, CCD_STREAMING_PROPERTY_NAME, 2, (const char *[]){ CCD_STREAMING_EXPOSURE_ITEM_NAME, CCD_STREAMING_COUNT_ITEM_NAME }, (double []){ short_exposure, -1 });
	CHECK(wait_state(CCD_STREAMING_PROPERTY_NAME, revision, INDIGO_BUSY_STATE, 10));
	for (int iteration = 0; iteration < 3000 && frame_count() < before + 20; iteration++) {
		indigo_usleep(10000);
	}
	CHECK(frame_count() >= before + 20);
	double width = number_value(CCD_FRAME_PROPERTY_NAME, 2);
	CHECK(reject_number_change(CCD_FRAME_PROPERTY_NAME, CCD_FRAME_WIDTH_ITEM_NAME, width / 2));
	indigo_property *mode = snapshot(CCD_MODE_PROPERTY_NAME);
	char other[INDIGO_NAME_SIZE] = "";
	for (int i = 0; mode && i < mode->count; i++) {
		if (!mode->items[i].sw.value && !*other) {
			snprintf(other, sizeof(other), "%s", mode->items[i].name);
		}
	}
	indigo_release_property(mode);
	if (*other) {
		CHECK(reject_switch_change(CCD_MODE_PROPERTY_NAME, other));
	}
	CHECK(change_switch(CCD_ABORT_EXPOSURE_PROPERTY_NAME, CCD_ABORT_EXPOSURE_ITEM_NAME, INDIGO_OK_STATE));
	CHECK(wait_state(CCD_STREAMING_PROPERTY_NAME, revision, INDIGO_OK_STATE, 10) || wait_state(CCD_STREAMING_PROPERTY_NAME, revision, INDIGO_ALERT_STATE, 1));
	unsigned stopped = frame_count();
	indigo_usleep(500000);
	printf("    indefinite stream delivered %u frames before abort\n", stopped - before);
	CHECK(frame_count() == stopped);
	CHECK(last_frame().invalid_frames == 0);
	CHECK(acquire(short_exposure));
cleanup:
	return;
}

static void reconnect(void) {
	for (int i = 0; i < 3; i++) {
		CHECK(disconnect_camera());
		CHECK(connect_camera());
		CHECK(acquire(short_exposure));
	}
cleanup:
	return;
}

static void shutdown_and_reinit(void) {
	CHECK(indigo_ccd_libcamera(INDIGO_DRIVER_SHUTDOWN, NULL) == INDIGO_BUSY);
	CHECK(disconnect_camera());
	CHECK(indigo_ccd_libcamera(INDIGO_DRIVER_SHUTDOWN, NULL) == INDIGO_OK);
	initialized = false;
	CHECK(indigo_ccd_libcamera(INDIGO_DRIVER_INIT, NULL) == INDIGO_OK);
	initialized = true;
	CHECK(wait_presence());
	CHECK(connect_camera());
	CHECK(acquire(short_exposure));
	CHECK(check_frame(16));
cleanup:
	return;
}

int main(int argc, char **argv) {
	if (argc != 2 || strcmp(argv[1], "--run")) {
		fprintf(stderr, "Physical libcamera camera test: run explicitly with --run (or make test-ccd-libcamera-hw).\n");
		return 2;
	}
	setvbuf(stdout, NULL, _IONBF, 0);
	indigo_test_use_private_home();
	if (getenv("INDIGO_TEST_DEBUG")) {
		indigo_set_log_level(INDIGO_LOG_DEBUG);
	}
	client = (indigo_client){ .name = "libcamera hardware test", .version = INDIGO_VERSION_CURRENT, .define_property = define_property, .update_property = update_property, .delete_property = delete_property, .send_message = report_message };
	const indigo_test_case tests[] = {
		{ "Discovery and identity", discovery_and_identity },
		{ "Every mode full frame", every_mode_full_frame },
		{ "Subframe", subframe },
		{ "Long exposure", long_exposure },
		{ "Gain control", gain_control },
		{ "Abort and reacquire", abort_and_reacquire },
		{ "Finite streaming", finite_streaming },
		{ "Indefinite streaming, refusals and abort", indefinite_streaming_refusals_and_abort },
		{ "Reconnect", reconnect },
		{ "Shutdown and reinit", shutdown_and_reinit }
	};
	int result = 1;
	if (hw_start() == INDIGO_OK && indigo_attach_client(&client) == INDIGO_OK && indigo_ccd_libcamera(INDIGO_DRIVER_INIT, NULL) == INDIGO_OK) {
		initialized = true;
		// Camera discovery runs on the driver queue; give it time to enumerate.
		for (int iteration = 0; iteration < 300; iteration++) {
			indigo_usleep(10000);
		}
		result = indigo_run_tests("libcamera hardware", tests, (int)(sizeof(tests) / sizeof(tests[0])));
	} else {
		fprintf(stderr, "Driver initialization failed\n");
	}
	if (camera >= 0) {
		indigo_change_switch_property_1(&client, devices[camera].name, CCD_ABORT_EXPOSURE_PROPERTY_NAME, CCD_ABORT_EXPOSURE_ITEM_NAME, true);
		disconnect_camera();
	}
	if (initialized) {
		indigo_ccd_libcamera(INDIGO_DRIVER_SHUTDOWN, NULL);
	}
	indigo_detach_client(&client);
	indigo_stop();
	for (int device_index = 0; device_index < MAX_DEVICES; device_index++) {
		for (int property_index = 0; property_index < MAX_PROPERTIES; property_index++) {
			indigo_release_property(devices[device_index].properties[property_index]);
		}
	}
	indigo_test_remove_private_home();
	return result;
}
