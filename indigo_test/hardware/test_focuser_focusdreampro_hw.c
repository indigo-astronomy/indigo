// Copyright (c) 2026 INDIGO initiative
// All rights reserved.
//
// You may use this software under the terms of 'INDIGO Astronomy
// open-source license' (see LICENSE.md).
//
// THIS SOFTWARE IS PROVIDED BY THE AUTHORS 'AS IS' AND ANY EXPRESS
// OR IMPLIED WARRANTIES, INCLUDING, BUT NOT LIMITED TO, THE IMPLIED
// WARRANTIES OF MERCHANTABILITY AND FITNESS FOR A PARTICULAR PURPOSE
// ARE DISCLAIMED. IN NO EVENT SHALL THE AUTHOR BE LIABLE FOR ANY
// DIRECT, INDIRECT, INCIDENTAL, SPECIAL, EXEMPLARY, OR CONSEQUENTIAL
// DAMAGES (INCLUDING, BUT NOT LIMITED TO, PROCUREMENT OF SUBSTITUTE
// GOODS OR SERVICES; LOSS OF USE, DATA, OR PROFITS; OR BUSINESS
// INTERRUPTION) HOWEVER CAUSED AND ON ANY THEORY OF LIABILITY,
// WHETHER IN CONTRACT, STRICT LIABILITY, OR TORT (INCLUDING
// NEGLIGENCE OR OTHERWISE) ARISING IN ANY WAY OUT OF THE USE OF THIS
// SOFTWARE, EVEN IF ADVISED OF THE POSSIBILITY OF SUCH DAMAGE.

// Code is generated by AI

// Opt-in acceptance test for a physically connected AstroGadget FocusDreamPro controller, or any
// controller sharing its command set such as the Astrojolo focuser. It runs the focuser hardware
// acceptance checklist of DRIVER_TESTING_RULES.md against the real unit: the identity handshake,
// the published property contract, the temperature probe and its polling, absolute and relative
// motion with position readback, SYNC as a coordinate update, the travel limit, the overlapping
// request, abort while moving and while idle, the six speeds, the duty cycle, a disconnect during
// a move, reconnect and driver INIT/SHUTDOWN.
//
// THE MOTOR PHYSICALLY RUNS. Every move is relative to the position the controller reported when
// the session started, the longest single move is FOCUSDREAMPRO_HW_TRAVEL steps outward (default
// 300), every scenario moves back, and the session restores the starting position before it
// disconnects, so the drawtube ends up where it was found and no end stop is approached.
//
// The controller is single threaded and steps at roughly 0.151 ms + 0.044 ms per unit of the S:
// delay, so the slowest speed index needs about 23 ms per step. MOVE_TIMEOUT is sized for the
// default travel at that speed; raise it along with FOCUSDREAMPRO_HW_TRAVEL.
//
// The port comes from FOCUSDREAMPRO_HW_PORT. When it is not set the port the driver itself
// detected through its CP2102 match pattern is used.

#include <math.h>
#include <stdlib.h>
#include <indigo_drivers/focuser_focusdreampro/indigo_focuser_focusdreampro.h>
#include "hardware_test_common.h"

#define DEVICE_NAME "FocusDreamPro"

// One serialized transaction over the 9600 baud link plus the driver's own connection work.
#define SHORT_TIMEOUT 15.0
// The default travel at the slowest speed index, plus the completion poll and a wide margin.
#define MOVE_TIMEOUT 90.0
// The idle polling period is 1 s, so two of them are enough to observe a fresh publication.
#define POLL_TIMEOUT 10.0

// The driver-defined property is declared in the generated source rather than in the header, so
// the test names it the way the simulator integration test does.
#define X_FOCUSER_DUTY_CYCLE_PROPERTY_NAME "X_FOCUSER_DUTY_CYCLE"
#define X_FOCUSER_DUTY_CYCLE_ITEM_NAME "DUTY_CYCLE"

// The controller's speed indices, 0 slowest and 5 fastest.
#define SLOWEST_SPEED 0
#define FASTEST_SPEED 5

static int focuser = -1;
static const char *serial_port = NULL;
static double travel = 300;
// What the controller reported when the session connected. Every scenario restores what it
// changes and the session restores the position at the end.
static double initial_position, initial_speed, initial_duty_cycle, initial_limit_min, initial_limit_max;
static bool state_captured = false;

static bool select_port(void) {
	if (serial_port == NULL || !*serial_port) {
		char detected[INDIGO_VALUE_SIZE] = "";
		if (hw_text_item(focuser, DEVICE_PORT_PROPERTY_NAME, DEVICE_PORT_ITEM_NAME, detected, sizeof(detected)) && *detected) {
			printf("Using the port the driver detected: %s\n", detected);
			return true;
		}
		fprintf(stderr, "    no serial port was detected, set FOCUSDREAMPRO_HW_PORT\n");
		return false;
	}
	printf("Using port %s\n", serial_port);
	return hw_set_text(focuser, DEVICE_PORT_PROPERTY_NAME, DEVICE_PORT_ITEM_NAME, serial_port, INDIGO_OK_STATE, SHORT_TIMEOUT);
}

static double position(void) {
	double value = -1;
	hw_number_item(focuser, FOCUSER_POSITION_PROPERTY_NAME, FOCUSER_POSITION_ITEM_NAME, &value);
	return value;
}

// An absolute move, waited out to its published completion. The controller reports the step count
// it actually executed, so the final position has to match the target exactly.
static bool move_to(double target) {
	unsigned before = hw_revision(focuser, FOCUSER_POSITION_PROPERTY_NAME);
	hw_request_number(focuser, FOCUSER_POSITION_PROPERTY_NAME, FOCUSER_POSITION_ITEM_NAME, target);
	if (!hw_wait_state(focuser, FOCUSER_POSITION_PROPERTY_NAME, before, INDIGO_OK_STATE, MOVE_TIMEOUT)) {
		return false;
	}
	if (!hw_wait_number(focuser, FOCUSER_POSITION_PROPERTY_NAME, FOCUSER_POSITION_ITEM_NAME, target, 0, POLL_TIMEOUT)) {
		return false;
	}
	return true;
}

// A relative move in the given direction, waited out to its published completion.
static bool move_by(const char *direction, double steps) {
	if (!hw_set_switch(focuser, FOCUSER_DIRECTION_PROPERTY_NAME, direction, INDIGO_OK_STATE, SHORT_TIMEOUT)) {
		return false;
	}
	unsigned before = hw_revision(focuser, FOCUSER_STEPS_PROPERTY_NAME);
	hw_request_number(focuser, FOCUSER_STEPS_PROPERTY_NAME, FOCUSER_STEPS_ITEM_NAME, steps);
	return hw_wait_state(focuser, FOCUSER_STEPS_PROPERTY_NAME, before, INDIGO_OK_STATE, MOVE_TIMEOUT);
}

static bool set_speed(double index) {
	return hw_set_number(focuser, FOCUSER_SPEED_PROPERTY_NAME, FOCUSER_SPEED_ITEM_NAME, index, INDIGO_OK_STATE, SHORT_TIMEOUT);
}

static bool capture_initial_state(void) {
	if (!hw_number_item(focuser, FOCUSER_POSITION_PROPERTY_NAME, FOCUSER_POSITION_ITEM_NAME, &initial_position)) {
		return false;
	}
	if (!hw_number_item(focuser, FOCUSER_SPEED_PROPERTY_NAME, FOCUSER_SPEED_ITEM_NAME, &initial_speed)) {
		return false;
	}
	if (!hw_number_item(focuser, X_FOCUSER_DUTY_CYCLE_PROPERTY_NAME, X_FOCUSER_DUTY_CYCLE_ITEM_NAME, &initial_duty_cycle)) {
		return false;
	}
	if (!hw_number_item(focuser, FOCUSER_LIMITS_PROPERTY_NAME, FOCUSER_LIMITS_MIN_POSITION_ITEM_NAME, &initial_limit_min)) {
		return false;
	}
	if (!hw_number_item(focuser, FOCUSER_LIMITS_PROPERTY_NAME, FOCUSER_LIMITS_MAX_POSITION_ITEM_NAME, &initial_limit_max)) {
		return false;
	}
	state_captured = true;
	return true;
}

// Whatever happened above, put the controller back the way the session found it.
static void restore_initial_state(void) {
	if (focuser < 0 || !state_captured || !hw_connected(focuser)) {
		return;
	}
	hw_set_switch(focuser, FOCUSER_ABORT_MOTION_PROPERTY_NAME, FOCUSER_ABORT_MOTION_ITEM_NAME, INDIGO_OK_STATE, SHORT_TIMEOUT);
	hw_set_switch(focuser, FOCUSER_ON_POSITION_SET_PROPERTY_NAME, FOCUSER_ON_POSITION_SET_GOTO_ITEM_NAME, INDIGO_OK_STATE, SHORT_TIMEOUT);
	indigo_change_number_property_1(&hw_client, hw_device_name(focuser), FOCUSER_LIMITS_PROPERTY_NAME, FOCUSER_LIMITS_MIN_POSITION_ITEM_NAME, initial_limit_min);
	hw_set_number(focuser, FOCUSER_LIMITS_PROPERTY_NAME, FOCUSER_LIMITS_MAX_POSITION_ITEM_NAME, initial_limit_max, INDIGO_OK_STATE, SHORT_TIMEOUT);
	set_speed(FASTEST_SPEED);
	if (move_to(initial_position)) {
		printf("Restored the starting position %g\n", initial_position);
	}
	set_speed(initial_speed);
	hw_set_number(focuser, X_FOCUSER_DUTY_CYCLE_PROPERTY_NAME, X_FOCUSER_DUTY_CYCLE_ITEM_NAME, initial_duty_cycle, INDIGO_OK_STATE, SHORT_TIMEOUT);
}

static void focusdreampro_reports_identity_and_capabilities(void) {
	char model[INDIGO_VALUE_SIZE] = "", port[INDIGO_VALUE_SIZE] = "";
	ASSERT_TRUE((hw_device_interface(focuser) & INDIGO_INTERFACE_FOCUSER) != 0);
	ASSERT_STREQ(DEVICE_NAME, hw_device_name(focuser));
	ASSERT_TRUE(hw_text_item(focuser, INFO_PROPERTY_NAME, INFO_DEVICE_MODEL_ITEM_NAME, model, sizeof(model)));
	// The attach-time placeholder means the identity transaction never produced a banner.
	ASSERT_TRUE(*model && strcmp(model, "Unknown"));
	ASSERT_TRUE(hw_text_item(focuser, DEVICE_PORT_PROPERTY_NAME, DEVICE_PORT_ITEM_NAME, port, sizeof(port)));
	printf("    %s on %s, position %g, speed index %g, duty cycle %g%%\n", model, port, initial_position, initial_speed, initial_duty_cycle);
}

static void focusdreampro_publishes_the_property_contract(void) {
	double min = 0, max = 0;
	ASSERT_TRUE(hw_property_defined(focuser, FOCUSER_SPEED_PROPERTY_NAME));
	ASSERT_TRUE(hw_property_defined(focuser, FOCUSER_DIRECTION_PROPERTY_NAME));
	ASSERT_TRUE(hw_property_defined(focuser, FOCUSER_STEPS_PROPERTY_NAME));
	ASSERT_TRUE(hw_property_defined(focuser, FOCUSER_POSITION_PROPERTY_NAME));
	ASSERT_TRUE(hw_property_defined(focuser, FOCUSER_ABORT_MOTION_PROPERTY_NAME));
	ASSERT_TRUE(hw_property_defined(focuser, FOCUSER_ON_POSITION_SET_PROPERTY_NAME));
	ASSERT_TRUE(hw_property_defined(focuser, FOCUSER_LIMITS_PROPERTY_NAME));
	ASSERT_TRUE(hw_property_defined(focuser, X_FOCUSER_DUTY_CYCLE_PROPERTY_NAME));
	// The controller has none of these, so the driver must leave them hidden.
	ASSERT_TRUE(hw_property_hidden(focuser, FOCUSER_REVERSE_MOTION_PROPERTY_NAME));
	ASSERT_TRUE(hw_property_hidden(focuser, FOCUSER_BACKLASH_PROPERTY_NAME));
	ASSERT_TRUE(hw_property_hidden(focuser, FOCUSER_COMPENSATION_PROPERTY_NAME));
	ASSERT_TRUE(hw_property_hidden(focuser, FOCUSER_MODE_PROPERTY_NAME));
	ASSERT_TRUE(hw_number_item_range(focuser, FOCUSER_SPEED_PROPERTY_NAME, FOCUSER_SPEED_ITEM_NAME, &min, &max));
	ASSERT_EQ_INT(SLOWEST_SPEED, (int)min);
	ASSERT_EQ_INT(FASTEST_SPEED, (int)max);
	ASSERT_TRUE(hw_number_item_range(focuser, FOCUSER_POSITION_PROPERTY_NAME, FOCUSER_POSITION_ITEM_NAME, &min, &max));
	ASSERT_EQ_INT(0, (int)min);
	ASSERT_EQ_INT(1000000, (int)max);
	ASSERT_TRUE(hw_number_item_range(focuser, FOCUSER_STEPS_PROPERTY_NAME, FOCUSER_STEPS_ITEM_NAME, &min, &max));
	ASSERT_EQ_INT(0, (int)min);
	ASSERT_EQ_INT(100000, (int)max);
	ASSERT_TRUE(hw_number_item_range(focuser, X_FOCUSER_DUTY_CYCLE_PROPERTY_NAME, X_FOCUSER_DUTY_CYCLE_ITEM_NAME, &min, &max));
	ASSERT_EQ_INT(0, (int)min);
	ASSERT_EQ_INT(100, (int)max);
	ASSERT_EQ_INT(INDIGO_OK_STATE, hw_property_state(focuser, FOCUSER_POSITION_PROPERTY_NAME));
}

// The probe is optional: a controller that answers T:false hides the property, and this run says
// which of the two it is instead of failing on a controller without a probe.
static void focusdreampro_reads_the_temperature(void) {
	double temperature = 0;
	if (!hw_property_defined(focuser, FOCUSER_TEMPERATURE_PROPERTY_NAME)) {
		printf("    the controller reports no temperature probe, FOCUSER_TEMPERATURE stays hidden\n");
		return;
	}
	ASSERT_EQ_INT(INDIGO_OK_STATE, hw_property_state(focuser, FOCUSER_TEMPERATURE_PROPERTY_NAME));
	ASSERT_TRUE(hw_number_item(focuser, FOCUSER_TEMPERATURE_PROPERTY_NAME, FOCUSER_TEMPERATURE_ITEM_NAME, &temperature));
	// A probe that is not wired up reads as a rail value, so require something a room can produce.
	ASSERT_TRUE(temperature > -40 && temperature < 80);
	printf("    temperature %.2f C\n", temperature);
	// The polling callback republishes it every second, which is the only evidence that the timer
	// is running at all.
	unsigned before = hw_revision(focuser, FOCUSER_TEMPERATURE_PROPERTY_NAME);
	ASSERT_TRUE(hw_wait_state(focuser, FOCUSER_TEMPERATURE_PROPERTY_NAME, before, INDIGO_OK_STATE, POLL_TIMEOUT));
}

static void focusdreampro_moves_to_an_absolute_position(void) {
	double target = initial_position + travel;
	ASSERT_TRUE(set_speed(FASTEST_SPEED));
	hw_forget_states();
	ASSERT_TRUE(move_to(target));
	// The move must have been published as BUSY before it settled, otherwise a client has no way
	// to tell a running move from a finished one.
	ASSERT_TRUE((hw_states_seen(focuser, FOCUSER_POSITION_PROPERTY_NAME) & (1u << INDIGO_BUSY_STATE)) != 0);
	ASSERT_TRUE(move_to(initial_position));
	ASSERT_NEAR(initial_position, position(), 0);
}

static void focusdreampro_moves_relative_in_both_directions(void) {
	ASSERT_TRUE(set_speed(FASTEST_SPEED));
	ASSERT_TRUE(move_by(FOCUSER_DIRECTION_MOVE_OUTWARD_ITEM_NAME, travel));
	ASSERT_TRUE(hw_wait_number(focuser, FOCUSER_POSITION_PROPERTY_NAME, FOCUSER_POSITION_ITEM_NAME, initial_position + travel, 0, POLL_TIMEOUT));
	ASSERT_TRUE(move_by(FOCUSER_DIRECTION_MOVE_INWARD_ITEM_NAME, travel));
	ASSERT_TRUE(hw_wait_number(focuser, FOCUSER_POSITION_PROPERTY_NAME, FOCUSER_POSITION_ITEM_NAME, initial_position, 0, POLL_TIMEOUT));
	// A zero step request is a no-op that still has to be answered.
	ASSERT_TRUE(move_by(FOCUSER_DIRECTION_MOVE_OUTWARD_ITEM_NAME, 0));
	ASSERT_NEAR(initial_position, position(), 0);
}

// SYNC redefines the coordinate without moving the motor, so the position has to follow the
// request while the drawtube stays put.
static void focusdreampro_syncs_the_position(void) {
	double synced = initial_position + 12345;
	ASSERT_TRUE(hw_set_switch(focuser, FOCUSER_ON_POSITION_SET_PROPERTY_NAME, FOCUSER_ON_POSITION_SET_SYNC_ITEM_NAME, INDIGO_OK_STATE, SHORT_TIMEOUT));
	unsigned before = hw_revision(focuser, FOCUSER_POSITION_PROPERTY_NAME);
	hw_request_number(focuser, FOCUSER_POSITION_PROPERTY_NAME, FOCUSER_POSITION_ITEM_NAME, synced);
	ASSERT_TRUE(hw_wait_state(focuser, FOCUSER_POSITION_PROPERTY_NAME, before, INDIGO_OK_STATE, SHORT_TIMEOUT));
	ASSERT_TRUE(hw_wait_number(focuser, FOCUSER_POSITION_PROPERTY_NAME, FOCUSER_POSITION_ITEM_NAME, synced, 0, POLL_TIMEOUT));
	// Sync back, so the coordinate means what it meant before and nothing has moved either way.
	before = hw_revision(focuser, FOCUSER_POSITION_PROPERTY_NAME);
	hw_request_number(focuser, FOCUSER_POSITION_PROPERTY_NAME, FOCUSER_POSITION_ITEM_NAME, initial_position);
	ASSERT_TRUE(hw_wait_state(focuser, FOCUSER_POSITION_PROPERTY_NAME, before, INDIGO_OK_STATE, SHORT_TIMEOUT));
	ASSERT_TRUE(hw_wait_number(focuser, FOCUSER_POSITION_PROPERTY_NAME, FOCUSER_POSITION_ITEM_NAME, initial_position, 0, POLL_TIMEOUT));
	ASSERT_TRUE(hw_set_switch(focuser, FOCUSER_ON_POSITION_SET_PROPERTY_NAME, FOCUSER_ON_POSITION_SET_GOTO_ITEM_NAME, INDIGO_OK_STATE, SHORT_TIMEOUT));
}

// The driver clamps an absolute target to FOCUSER_LIMITS before it sends M:, so a target beyond
// the limit has to stop at the limit.
static void focusdreampro_applies_the_travel_limit(void) {
	double limit = initial_position + travel / 2;
	ASSERT_TRUE(set_speed(FASTEST_SPEED));
	indigo_change_number_property_1(&hw_client, hw_device_name(focuser), FOCUSER_LIMITS_PROPERTY_NAME, FOCUSER_LIMITS_MIN_POSITION_ITEM_NAME, initial_limit_min);
	ASSERT_TRUE(hw_set_number(focuser, FOCUSER_LIMITS_PROPERTY_NAME, FOCUSER_LIMITS_MAX_POSITION_ITEM_NAME, limit, INDIGO_OK_STATE, SHORT_TIMEOUT));
	ASSERT_TRUE(move_to(limit));
	// Asking for more than the limit must stop at the limit, not at the requested target.
	unsigned before = hw_revision(focuser, FOCUSER_POSITION_PROPERTY_NAME);
	hw_request_number(focuser, FOCUSER_POSITION_PROPERTY_NAME, FOCUSER_POSITION_ITEM_NAME, initial_position + travel);
	ASSERT_TRUE(hw_wait_state(focuser, FOCUSER_POSITION_PROPERTY_NAME, before, INDIGO_OK_STATE, MOVE_TIMEOUT));
	ASSERT_NEAR(limit, position(), 0);
	indigo_change_number_property_1(&hw_client, hw_device_name(focuser), FOCUSER_LIMITS_PROPERTY_NAME, FOCUSER_LIMITS_MIN_POSITION_ITEM_NAME, initial_limit_min);
	ASSERT_TRUE(hw_set_number(focuser, FOCUSER_LIMITS_PROPERTY_NAME, FOCUSER_LIMITS_MAX_POSITION_ITEM_NAME, initial_limit_max, INDIGO_OK_STATE, SHORT_TIMEOUT));
	ASSERT_TRUE(move_to(initial_position));
}

// The framework refuses a change while the property is BUSY, so the second request is dropped and
// the focuser has to finish the first move instead of the second one.
static void focusdreampro_rejects_an_overlapping_move(void) {
	double first = initial_position + travel;
	double second = initial_position + travel / 3;
	ASSERT_TRUE(set_speed(SLOWEST_SPEED));
	unsigned before = hw_revision(focuser, FOCUSER_POSITION_PROPERTY_NAME);
	hw_request_number(focuser, FOCUSER_POSITION_PROPERTY_NAME, FOCUSER_POSITION_ITEM_NAME, first);
	ASSERT_TRUE(hw_wait_state(focuser, FOCUSER_POSITION_PROPERTY_NAME, before, INDIGO_BUSY_STATE, SHORT_TIMEOUT));
	hw_request_number(focuser, FOCUSER_POSITION_PROPERTY_NAME, FOCUSER_POSITION_ITEM_NAME, second);
	ASSERT_TRUE(hw_wait_settled(focuser, FOCUSER_POSITION_PROPERTY_NAME, INDIGO_OK_STATE, MOVE_TIMEOUT));
	ASSERT_TRUE(hw_wait_number(focuser, FOCUSER_POSITION_PROPERTY_NAME, FOCUSER_POSITION_ITEM_NAME, first, 0, POLL_TIMEOUT));
	ASSERT_TRUE(set_speed(FASTEST_SPEED));
	ASSERT_TRUE(move_to(initial_position));
}

// Abort has to stop the motor where it is, settle both motion properties to OK rather than alert,
// publish the real stop point and leave the driver able to take a fresh move.
static void focusdreampro_aborts_a_move(void) {
	double target = initial_position + travel;
	ASSERT_TRUE(set_speed(SLOWEST_SPEED));
	unsigned before = hw_revision(focuser, FOCUSER_POSITION_PROPERTY_NAME);
	hw_request_number(focuser, FOCUSER_POSITION_PROPERTY_NAME, FOCUSER_POSITION_ITEM_NAME, target);
	ASSERT_TRUE(hw_wait_state(focuser, FOCUSER_POSITION_PROPERTY_NAME, before, INDIGO_BUSY_STATE, SHORT_TIMEOUT));
	// Let the motor get demonstrably under way before the abort, so a stop point strictly inside
	// the travel proves the abort interrupted a running move.
	indigo_usleep(1500000);
	ASSERT_TRUE(hw_set_switch(focuser, FOCUSER_ABORT_MOTION_PROPERTY_NAME, FOCUSER_ABORT_MOTION_ITEM_NAME, INDIGO_OK_STATE, SHORT_TIMEOUT));
	ASSERT_EQ_INT(INDIGO_OK_STATE, hw_property_state(focuser, FOCUSER_POSITION_PROPERTY_NAME));
	ASSERT_EQ_INT(INDIGO_OK_STATE, hw_property_state(focuser, FOCUSER_STEPS_PROPERTY_NAME));
	double stopped = position();
	printf("    aborted at %g, between %g and %g\n", stopped, initial_position, target);
	ASSERT_TRUE(stopped > initial_position && stopped < target);
	// The motor really is stopped: the position must not drift over two polling periods.
	indigo_usleep(2500000);
	ASSERT_NEAR(stopped, position(), 0);
	ASSERT_EQ_INT(INDIGO_OK_STATE, hw_property_state(focuser, FOCUSER_POSITION_PROPERTY_NAME));
	// A fresh move after the abort has to be accepted.
	ASSERT_TRUE(set_speed(FASTEST_SPEED));
	ASSERT_TRUE(move_to(initial_position));
}

static void focusdreampro_accepts_an_abort_while_idle(void) {
	ASSERT_NEAR(initial_position, position(), 0);
	ASSERT_TRUE(hw_set_switch(focuser, FOCUSER_ABORT_MOTION_PROPERTY_NAME, FOCUSER_ABORT_MOTION_ITEM_NAME, INDIGO_OK_STATE, SHORT_TIMEOUT));
	ASSERT_EQ_INT(INDIGO_OK_STATE, hw_property_state(focuser, FOCUSER_POSITION_PROPERTY_NAME));
	ASSERT_EQ_INT(INDIGO_OK_STATE, hw_property_state(focuser, FOCUSER_STEPS_PROPERTY_NAME));
	ASSERT_NEAR(initial_position, position(), 0);
}

// Every speed index has to reach the controller, and the two ends of the table have to differ in
// the time the same move takes, which is the only proof the S: value did anything.
static void focusdreampro_changes_the_speed(void) {
	for (int index = SLOWEST_SPEED; index <= FASTEST_SPEED; index++) {
		ASSERT_TRUE(set_speed(index));
	}
	double distance = travel / 3;
	ASSERT_TRUE(set_speed(FASTEST_SPEED));
	double started = indigo_monotonic_time();
	ASSERT_TRUE(move_to(initial_position + distance));
	double fast = indigo_monotonic_time() - started;
	ASSERT_TRUE(move_to(initial_position));
	ASSERT_TRUE(set_speed(SLOWEST_SPEED));
	started = indigo_monotonic_time();
	ASSERT_TRUE(move_to(initial_position + distance));
	double slow = indigo_monotonic_time() - started;
	printf("    %g steps took %.2f s at index %d and %.2f s at index %d\n", distance, fast, FASTEST_SPEED, slow, SLOWEST_SPEED);
	ASSERT_TRUE(slow > fast);
	ASSERT_TRUE(set_speed(FASTEST_SPEED));
	ASSERT_TRUE(move_to(initial_position));
}

static void focusdreampro_changes_the_duty_cycle(void) {
	double value = 0;
	double changed = initial_duty_cycle >= 50 ? 30 : 70;
	ASSERT_TRUE(hw_set_number(focuser, X_FOCUSER_DUTY_CYCLE_PROPERTY_NAME, X_FOCUSER_DUTY_CYCLE_ITEM_NAME, changed, INDIGO_OK_STATE, SHORT_TIMEOUT));
	ASSERT_TRUE(hw_number_item(focuser, X_FOCUSER_DUTY_CYCLE_PROPERTY_NAME, X_FOCUSER_DUTY_CYCLE_ITEM_NAME, &value));
	ASSERT_NEAR(changed, value, 0);
	// The controller has no readback for D:, so the proof that the value survives is that the
	// focuser still moves with it applied.
	ASSERT_TRUE(set_speed(FASTEST_SPEED));
	ASSERT_TRUE(move_to(initial_position + travel / 3));
	ASSERT_TRUE(move_to(initial_position));
	ASSERT_TRUE(hw_set_number(focuser, X_FOCUSER_DUTY_CYCLE_PROPERTY_NAME, X_FOCUSER_DUTY_CYCLE_ITEM_NAME, initial_duty_cycle, INDIGO_OK_STATE, SHORT_TIMEOUT));
}

// Disconnecting while the motor runs has to halt it and tear the connection down cleanly, and the
// driver has to come back and move again afterwards.
static void focusdreampro_survives_a_disconnect_during_a_move(void) {
	ASSERT_TRUE(set_speed(SLOWEST_SPEED));
	unsigned before = hw_revision(focuser, FOCUSER_POSITION_PROPERTY_NAME);
	hw_request_number(focuser, FOCUSER_POSITION_PROPERTY_NAME, FOCUSER_POSITION_ITEM_NAME, initial_position + travel);
	ASSERT_TRUE(hw_wait_state(focuser, FOCUSER_POSITION_PROPERTY_NAME, before, INDIGO_BUSY_STATE, SHORT_TIMEOUT));
	indigo_usleep(1000000);
	ASSERT_TRUE(hw_disconnect(focuser, MOVE_TIMEOUT));
	// The connection-dependent property has to be withdrawn with the connection.
	ASSERT_TRUE(hw_property_hidden(focuser, X_FOCUSER_DUTY_CYCLE_PROPERTY_NAME));
	ASSERT_TRUE(hw_connect(focuser, SHORT_TIMEOUT));
	ASSERT_TRUE(hw_property_defined(focuser, X_FOCUSER_DUTY_CYCLE_PROPERTY_NAME));
	// The disconnect halted the motor, so the controller is somewhere inside the travel and the
	// driver has to have read that position back at connect.
	double stopped = position();
	printf("    the disconnect stopped the motor at %g\n", stopped);
	ASSERT_TRUE(stopped > initial_position && stopped <= initial_position + travel);
	ASSERT_TRUE(set_speed(FASTEST_SPEED));
	ASSERT_TRUE(move_to(initial_position));
}

static void focusdreampro_reconnects(void) {
	ASSERT_TRUE(hw_disconnect(focuser, SHORT_TIMEOUT));
	ASSERT_TRUE(hw_property_hidden(focuser, X_FOCUSER_DUTY_CYCLE_PROPERTY_NAME));
	ASSERT_TRUE(hw_connect(focuser, SHORT_TIMEOUT));
	ASSERT_TRUE(hw_property_defined(focuser, X_FOCUSER_DUTY_CYCLE_PROPERTY_NAME));
	ASSERT_EQ_INT(INDIGO_OK_STATE, hw_property_state(focuser, FOCUSER_POSITION_PROPERTY_NAME));
	ASSERT_NEAR(initial_position, position(), 0);
	ASSERT_TRUE(set_speed(FASTEST_SPEED));
	ASSERT_TRUE(move_to(initial_position + travel / 3));
	ASSERT_TRUE(move_to(initial_position));
}

// A full driver teardown and bring-up, which is what a server does when the driver is unloaded and
// loaded again. It has to leave no device behind and find the controller a second time.
static void focusdreampro_reinitializes(void) {
	ASSERT_TRUE(hw_disconnect(focuser, SHORT_TIMEOUT));
	ASSERT_EQ_INT(INDIGO_OK, indigo_focuser_focusdreampro(INDIGO_DRIVER_SHUTDOWN, NULL));
	ASSERT_EQ_INT(-1, hw_device_index(DEVICE_NAME));
	ASSERT_EQ_INT(INDIGO_OK, indigo_focuser_focusdreampro(INDIGO_DRIVER_INIT, NULL));
	focuser = hw_wait_for_device(DEVICE_NAME, SHORT_TIMEOUT);
	ASSERT_TRUE(focuser >= 0);
	ASSERT_TRUE(select_port());
	ASSERT_TRUE(hw_connect(focuser, SHORT_TIMEOUT));
	ASSERT_NEAR(initial_position, position(), 0);
}

int main(int argc, char **argv) {
	if (argc < 2 || strcmp(argv[1], "--run")) {
		fprintf(stderr, "Physical AstroGadget FocusDreamPro test: run explicitly with --run (or make test-focuser-focusdreampro-hw).\n");
		return 2;
	}
	setvbuf(stdout, NULL, _IONBF, 0);
	for (int i = 2; i < argc; i++) {
		if (!strcmp(argv[i], "--debug")) {
			indigo_set_log_level(INDIGO_LOG_DEBUG);
		}
	}
	// X_FOCUSER_DUTY_CYCLE is persistent, so the session keeps its configuration out of the user's
	// own folder.
	if (!indigo_test_use_private_home()) {
		return 1;
	}
	serial_port = getenv("FOCUSDREAMPRO_HW_PORT");
	const char *requested_travel = getenv("FOCUSDREAMPRO_HW_TRAVEL");
	if (requested_travel != NULL && atoi(requested_travel) > 0) {
		travel = atoi(requested_travel);
	}
	const indigo_test_case tests[] = {
		{ "focusdreampro_reports_identity_and_capabilities", focusdreampro_reports_identity_and_capabilities },
		{ "focusdreampro_publishes_the_property_contract", focusdreampro_publishes_the_property_contract },
		{ "focusdreampro_reads_the_temperature", focusdreampro_reads_the_temperature },
		{ "focusdreampro_moves_to_an_absolute_position", focusdreampro_moves_to_an_absolute_position },
		{ "focusdreampro_moves_relative_in_both_directions", focusdreampro_moves_relative_in_both_directions },
		{ "focusdreampro_syncs_the_position", focusdreampro_syncs_the_position },
		{ "focusdreampro_applies_the_travel_limit", focusdreampro_applies_the_travel_limit },
		{ "focusdreampro_rejects_an_overlapping_move", focusdreampro_rejects_an_overlapping_move },
		{ "focusdreampro_aborts_a_move", focusdreampro_aborts_a_move },
		{ "focusdreampro_accepts_an_abort_while_idle", focusdreampro_accepts_an_abort_while_idle },
		{ "focusdreampro_changes_the_speed", focusdreampro_changes_the_speed },
		{ "focusdreampro_changes_the_duty_cycle", focusdreampro_changes_the_duty_cycle },
		{ "focusdreampro_survives_a_disconnect_during_a_move", focusdreampro_survives_a_disconnect_during_a_move },
		{ "focusdreampro_reconnects", focusdreampro_reconnects },
		{ "focusdreampro_reinitializes", focusdreampro_reinitializes }
	};
	int result = 1;
	bool started = false, initialized = false;
	HW_CHECK(indigo_start() == INDIGO_OK);
	started = true;
	HW_CHECK(hw_attach_client("FocusDreamPro hardware test") == INDIGO_OK);
	HW_CHECK(indigo_focuser_focusdreampro(INDIGO_DRIVER_INIT, NULL) == INDIGO_OK);
	initialized = true;
	focuser = hw_wait_for_device(DEVICE_NAME, SHORT_TIMEOUT);
	HW_CHECK(focuser >= 0);
	HW_CHECK(select_port());
	HW_CHECK(hw_connect(focuser, SHORT_TIMEOUT));
	HW_CHECK(capture_initial_state());
	printf("Starting position %g, speed index %g, duty cycle %g%%, travel %g steps\n", initial_position, initial_speed, initial_duty_cycle, travel);
	result = indigo_run_tests("AstroGadget FocusDreamPro hardware", tests, ARRAY_SIZE(tests));
cleanup:
	// Leave the controller exactly as the session found it, whatever happened above.
	restore_initial_state();
	if (!hw_disconnect(focuser, MOVE_TIMEOUT)) {
		indigo_test_failures++;
	}
	if (initialized && indigo_focuser_focusdreampro(INDIGO_DRIVER_SHUTDOWN, NULL) != INDIGO_OK) {
		indigo_test_failures++;
	}
	indigo_detach_client(&hw_client);
	if (started) {
		indigo_stop();
	}
	hw_release_properties();
	indigo_test_remove_private_home();
	return indigo_test_failures ? 1 : result;
}
