// Copyright (c) 2026 INDIGO initiative
// All rights reserved.
//
// You may use this software under the terms of 'INDIGO Astronomy
// open-source license' (see LICENSE.md).
//
// THIS SOFTWARE IS PROVIDED BY THE AUTHORS 'AS IS' AND ANY EXPRESS
// OR IMPLIED WARRANTIES, INCLUDING, BUT NOT LIMITED TO, THE IMPLIED
// WARRANTIES OF MERCHANTABILITY AND FITNESS FOR A PARTICULAR PURPOSE
// ARE DISCLAIMED. IN NO EVENT SHALL THE AUTHOR BE LIABLE FOR ANY
// DIRECT, INDIRECT, INCIDENTAL, SPECIAL, EXEMPLARY, OR CONSEQUENTIAL
// DAMAGES (INCLUDING, BUT NOT LIMITED TO, PROCUREMENT OF SUBSTITUTE
// GOODS OR SERVICES; LOSS OF USE, DATA, OR PROFITS; OR BUSINESS
// INTERRUPTION) HOWEVER CAUSED AND ON ANY THEORY OF LIABILITY,
// WHETHER IN CONTRACT, STRICT LIABILITY, OR TORT (INCLUDING
// NEGLIGENCE OR OTHERWISE) ARISING IN ANY WAY OUT OF THE USE OF THIS
// SOFTWARE, EVEN IF ADVISED OF THE POSSIBILITY OF SUCH DAMAGE.

// Code is generated by AI

// Opt-in acceptance test for a physically connected NMEA 0183 receiver. It runs the GPS hardware
// acceptance checklist of DRIVER_TESTING_RULES.md against the real unit: the published property
// contract, the sentences the receiver actually streams, the fix state it reports, the advanced
// status and its visibility, constellation selection including one the receiver does not send, a
// refused port, disconnect and reconnect, and driver INIT/SHUTDOWN.
//
// THE RECEIVER IS ONLY READ. The driver has no command channel, so nothing in this run changes
// anything inside the receiver; every change is to driver-side properties and each scenario
// restores what it changed.
//
// A RECEIVER WITHOUT A FIX IS A VALID RESULT. Acquisition depends on sky view, not on the driver,
// so this test never waits for a fix and never fails for the absence of one: it asserts that the
// driver reports no fix as no fix and keeps a position out of GEOGRAPHIC_COORDINATES and a time out
// of UTC_TIME while there is none. When the receiver does have a fix, the same scenarios assert the
// published position and time instead.
//
// The port comes from GPS_NMEA_HW_PORT. When it is not set the port the driver itself detected
// through its "GPS"/"GNSS" product match is used. GPS_NMEA_HW_SYSTEM names a constellation the
// receiver does send (default GPS, the $GP talker) and GPS_NMEA_HW_ABSENT_SYSTEM one it does not
// (default GLONASS), which is what the selection scenario needs to tell filtering from luck.

#include <math.h>
#include <stdlib.h>
#include <indigo_drivers/gps_nmea/indigo_gps_nmea.h>
#include "hardware_test_common.h"

#define DEVICE_NAME "NMEA GPS"

// One connection attempt over the serial link plus the driver's own connection work.
#define SHORT_TIMEOUT 15.0
// A receiver sends its cycle once per second, and the driver's own read times out after 5 s, so
// two cycles plus that timeout is the longest a fresh publication can honestly take.
#define DATA_TIMEOUT 12.0
// How long a scenario watches a property that must NOT change state, in seconds. Four receiver
// cycles are enough to catch a driver that drifts out of the state it reported.
#define QUIET_WINDOW 4.0
// The read timeout the driver gives one line before it decides the receiver is gone, and a window
// comfortably longer than it.
#define READ_TIMEOUT 5.0
#define SILENCE_WINDOW 8.0

// The driver-defined property is declared in the generated source rather than in the header, so
// the test names it the way the simulator integration test does.
#define X_GPS_SELECTED_SYSTEM_PROPERTY_NAME "X_GPS_SELECTED_SYSTEM"
#define AUTOMATIC_SYSTEM_ITEM_NAME "AUTO"
#define MULTIPLE_SYSTEM_ITEM_NAME "MULTIPLE"

static int gps = -1;
static const char *serial_port = NULL;
static const char *present_system = "GPS";
static const char *absent_system = "GLONASS";
// What the receiver reported in the first scenario, so the later ones can say whether they are
// asserting the fix contract or the no-fix contract.
static bool has_fix = false;

static bool select_port(void) {
	if (serial_port == NULL || !*serial_port) {
		char detected[INDIGO_VALUE_SIZE] = "";
		if (hw_text_item(gps, DEVICE_PORT_PROPERTY_NAME, DEVICE_PORT_ITEM_NAME, detected, sizeof(detected)) && *detected) {
			printf("Using the port the driver detected: %s\n", detected);
			return true;
		}
		fprintf(stderr, "    no serial port was detected, set GPS_NMEA_HW_PORT\n");
		return false;
	}
	printf("Using port %s\n", serial_port);
	return hw_set_text(gps, DEVICE_PORT_PROPERTY_NAME, DEVICE_PORT_ITEM_NAME, serial_port, INDIGO_OK_STATE, SHORT_TIMEOUT);
}

// Waits for the next publication of the property in any state. A receiver without a fix moves
// GEOGRAPHIC_COORDINATES between alert and busy every cycle, so a scenario that only wants to know
// that a sentence arrived must not name a state.
static bool wait_for_publication(const char *name, double timeout) {
	unsigned before = hw_revision(gps, name);
	double deadline = indigo_monotonic_time() + timeout;
	while (indigo_monotonic_time() < deadline) {
		if (hw_revision(gps, name) > before) {
			return true;
		}
		indigo_usleep(2000);
	}
	fprintf(stderr, "    timeout: %s was not published again within %g s\n", name, timeout);
	return false;
}

// Waits until the property has been published in every state of the mask since the last
// hw_forget_states(). A reset that is undone by the next receiver cycle is over before a poll can
// see it, so it can only be asserted through the state history.
static bool wait_for_states(const char *name, unsigned mask, double timeout) {
	double deadline = indigo_monotonic_time() + timeout;
	while (indigo_monotonic_time() < deadline) {
		if ((hw_states_seen(gps, name) & mask) == mask) {
			return true;
		}
		indigo_usleep(2000);
	}
	fprintf(stderr, "    timeout: %s was published in states 0x%x, expected 0x%x\n", name, hw_states_seen(gps, name), mask);
	return false;
}

static indigo_property_state status_light(const char *item) {
	indigo_property_state value = INDIGO_IDLE_STATE;
	hw_light_item(gps, GPS_STATUS_PROPERTY_NAME, item, &value);
	return value;
}

static int active_status_lights(void) {
	static const char *items[] = { GPS_STATUS_NO_FIX_ITEM_NAME, GPS_STATUS_2D_FIX_ITEM_NAME, GPS_STATUS_3D_FIX_ITEM_NAME };
	int active = 0;
	for (unsigned i = 0; i < ARRAY_SIZE(items); i++) {
		if (status_light(items[i]) != INDIGO_IDLE_STATE) {
			active++;
		}
	}
	return active;
}

static double coordinate(const char *item) {
	double value = 0;
	hw_number_item(gps, GEOGRAPHIC_COORDINATES_PROPERTY_NAME, item, &value);
	return value;
}

static void nmea_reports_identity_and_capabilities(void) {
	char port[INDIGO_VALUE_SIZE] = "", name[INDIGO_VALUE_SIZE] = "", driver[INDIGO_VALUE_SIZE] = "";
	ASSERT_TRUE((hw_device_interface(gps) & INDIGO_INTERFACE_GPS) != 0);
	ASSERT_STREQ(DEVICE_NAME, hw_device_name(gps));
	ASSERT_EQ_INT(1, hw_device_count());
	ASSERT_TRUE(hw_text_item(gps, DEVICE_PORT_PROPERTY_NAME, DEVICE_PORT_ITEM_NAME, port, sizeof(port)));
	ASSERT_TRUE(*port);
	// NMEA carries no identity, so the driver publishes the four INFO items every device has and
	// leaves DEVICE_MODEL out of the property.
	ASSERT_TRUE(hw_text_item(gps, INFO_PROPERTY_NAME, INFO_DEVICE_NAME_ITEM_NAME, name, sizeof(name)));
	ASSERT_TRUE(hw_text_item(gps, INFO_PROPERTY_NAME, INFO_DEVICE_DRIVER_ITEM_NAME, driver, sizeof(driver)));
	ASSERT_STREQ("indigo_gps_nmea", driver);
	ASSERT_TRUE(!hw_item_defined(gps, INFO_PROPERTY_NAME, INFO_DEVICE_MODEL_ITEM_NAME));
	ASSERT_TRUE(hw_connected(gps));
	printf("    %s on %s\n", name, port);
}

static void nmea_publishes_the_property_contract(void) {
	ASSERT_TRUE(hw_property_defined(gps, GEOGRAPHIC_COORDINATES_PROPERTY_NAME));
	ASSERT_TRUE(hw_item_defined(gps, GEOGRAPHIC_COORDINATES_PROPERTY_NAME, GEOGRAPHIC_COORDINATES_LATITUDE_ITEM_NAME));
	ASSERT_TRUE(hw_item_defined(gps, GEOGRAPHIC_COORDINATES_PROPERTY_NAME, GEOGRAPHIC_COORDINATES_LONGITUDE_ITEM_NAME));
	ASSERT_TRUE(hw_item_defined(gps, GEOGRAPHIC_COORDINATES_PROPERTY_NAME, GEOGRAPHIC_COORDINATES_ELEVATION_ITEM_NAME));
	// The receiver reports no position accuracy, so the driver keeps the item out of the property.
	ASSERT_TRUE(!hw_item_defined(gps, GEOGRAPHIC_COORDINATES_PROPERTY_NAME, GEOGRAPHIC_COORDINATES_ACCURACY_ITEM_NAME));
	ASSERT_TRUE(hw_property_defined(gps, UTC_TIME_PROPERTY_NAME));
	ASSERT_TRUE(hw_item_defined(gps, UTC_TIME_PROPERTY_NAME, UTC_TIME_ITEM_NAME));
	ASSERT_TRUE(hw_property_defined(gps, GPS_STATUS_PROPERTY_NAME));
	ASSERT_TRUE(hw_item_defined(gps, GPS_STATUS_PROPERTY_NAME, GPS_STATUS_NO_FIX_ITEM_NAME));
	ASSERT_TRUE(hw_item_defined(gps, GPS_STATUS_PROPERTY_NAME, GPS_STATUS_2D_FIX_ITEM_NAME));
	ASSERT_TRUE(hw_item_defined(gps, GPS_STATUS_PROPERTY_NAME, GPS_STATUS_3D_FIX_ITEM_NAME));
	ASSERT_TRUE(hw_property_defined(gps, GPS_ADVANCED_PROPERTY_NAME));
	ASSERT_TRUE(hw_item_defined(gps, GPS_ADVANCED_PROPERTY_NAME, GPS_ADVANCED_ENABLED_ITEM_NAME));
	ASSERT_TRUE(hw_item_defined(gps, GPS_ADVANCED_PROPERTY_NAME, GPS_ADVANCED_DISABLED_ITEM_NAME));
	// GPS_ADVANCED_STATUS follows GPS_ADVANCED, which starts disabled in a fresh configuration.
	ASSERT_TRUE(hw_property_hidden(gps, GPS_ADVANCED_STATUS_PROPERTY_NAME));
	ASSERT_TRUE(hw_property_defined(gps, X_GPS_SELECTED_SYSTEM_PROPERTY_NAME));
	ASSERT_TRUE(hw_item_defined(gps, X_GPS_SELECTED_SYSTEM_PROPERTY_NAME, AUTOMATIC_SYSTEM_ITEM_NAME));
	ASSERT_TRUE(hw_item_defined(gps, X_GPS_SELECTED_SYSTEM_PROPERTY_NAME, MULTIPLE_SYSTEM_ITEM_NAME));
	ASSERT_TRUE(hw_item_defined(gps, X_GPS_SELECTED_SYSTEM_PROPERTY_NAME, "GPS"));
	ASSERT_TRUE(hw_item_defined(gps, X_GPS_SELECTED_SYSTEM_PROPERTY_NAME, "GALILEO"));
	ASSERT_TRUE(hw_item_defined(gps, X_GPS_SELECTED_SYSTEM_PROPERTY_NAME, "GLONASS"));
	ASSERT_TRUE(hw_item_defined(gps, X_GPS_SELECTED_SYSTEM_PROPERTY_NAME, "BEIDOU"));
	ASSERT_TRUE(hw_item_defined(gps, X_GPS_SELECTED_SYSTEM_PROPERTY_NAME, "NAVIC"));
	ASSERT_TRUE(hw_item_defined(gps, X_GPS_SELECTED_SYSTEM_PROPERTY_NAME, "QZSS"));
}

// The one scenario this run exists for: the receiver streams and the driver parses what it sends.
//
// It cannot be shown by counting publications. INDIGO suppresses an update that says nothing new,
// and a receiver repeating the same sentences - exactly what one without a fix does - therefore
// goes quiet once its first cycle has been published. Two observations prove the link instead. The
// driver treats a read that brings nothing within its 5 s timeout as the receiver being gone and
// disconnects itself, so staying connected well past that window means lines keep arriving. And
// selecting a positioning system makes the driver drop everything it knows, after which only a
// freshly parsed GSA can bring the fix status back.
static void nmea_receives_sentences_from_the_receiver(void) {
	ASSERT_TRUE(hw_wait_settled(gps, GPS_STATUS_PROPERTY_NAME, INDIGO_OK_STATE, DATA_TIMEOUT));
	indigo_usleep((unsigned long)(SILENCE_WINDOW * 1000000));
	printf("    still connected after %g s, which is past the driver's %g s read timeout\n", SILENCE_WINDOW, READ_TIMEOUT);
	ASSERT_TRUE(hw_connected(gps));
	ASSERT_EQ_INT(INDIGO_OK_STATE, hw_property_state(gps, CONNECTION_PROPERTY_NAME));
	hw_forget_states();
	// Re-selecting the system that is already selected publishes no switch update, because nothing
	// about the switch changed; the reset it triggers is what has to show.
	hw_request_switch(gps, X_GPS_SELECTED_SYSTEM_PROPERTY_NAME, AUTOMATIC_SYSTEM_ITEM_NAME, true);
	ASSERT_TRUE(wait_for_states(GPS_STATUS_PROPERTY_NAME, (1u << INDIGO_BUSY_STATE) | (1u << INDIGO_OK_STATE), DATA_TIMEOUT));
	ASSERT_EQ_INT(1, active_status_lights());
}

// Whatever the receiver reports has to reach GPS_STATUS as exactly one active light, and the fix
// dependent properties have to agree with it. No fix is a result, not a failure.
static void nmea_reports_the_fix_state(void) {
	char utc[INDIGO_VALUE_SIZE] = "";
	ASSERT_TRUE(hw_wait_settled(gps, GPS_STATUS_PROPERTY_NAME, INDIGO_OK_STATE, DATA_TIMEOUT));
	ASSERT_EQ_INT(1, active_status_lights());
	has_fix = status_light(GPS_STATUS_NO_FIX_ITEM_NAME) == INDIGO_IDLE_STATE;
	ASSERT_TRUE(hw_text_item(gps, UTC_TIME_PROPERTY_NAME, UTC_TIME_ITEM_NAME, utc, sizeof(utc)));
	if (!has_fix) {
		printf("    the receiver reports no fix; position and time must stay unpublished\n");
		ASSERT_EQ_INT(INDIGO_ALERT_STATE, status_light(GPS_STATUS_NO_FIX_ITEM_NAME));
		// Over a whole window neither property may ever claim a valid position or time.
		hw_forget_states();
		indigo_usleep((unsigned long)(QUIET_WINDOW * 1000000));
		ASSERT_EQ_INT(0, hw_states_seen(gps, GEOGRAPHIC_COORDINATES_PROPERTY_NAME) & (1u << INDIGO_OK_STATE));
		ASSERT_EQ_INT(0, hw_states_seen(gps, UTC_TIME_PROPERTY_NAME) & (1u << INDIGO_OK_STATE));
		return;
	}
	printf("    the receiver reports a %s fix\n", status_light(GPS_STATUS_3D_FIX_ITEM_NAME) != INDIGO_IDLE_STATE ? "3D" : "2D");
	ASSERT_TRUE(hw_wait_settled(gps, GEOGRAPHIC_COORDINATES_PROPERTY_NAME, INDIGO_OK_STATE, DATA_TIMEOUT));
	double latitude = coordinate(GEOGRAPHIC_COORDINATES_LATITUDE_ITEM_NAME);
	double longitude = coordinate(GEOGRAPHIC_COORDINATES_LONGITUDE_ITEM_NAME);
	double elevation = coordinate(GEOGRAPHIC_COORDINATES_ELEVATION_ITEM_NAME);
	printf("    latitude %.4f, longitude %.4f, elevation %.0f m, UTC %s\n", latitude, longitude, elevation, utc);
	ASSERT_TRUE(latitude >= -90 && latitude <= 90);
	ASSERT_TRUE(longitude >= -180 && longitude <= 360);
	ASSERT_TRUE(elevation > -500 && elevation < 9000);
	// A 3D fix carries the time as well; a 2D fix does not have to.
	if (status_light(GPS_STATUS_3D_FIX_ITEM_NAME) != INDIGO_IDLE_STATE) {
		int year = 0, month = 0, day = 0, hour = 0, minute = 0, second = 0;
		ASSERT_TRUE(hw_wait_settled(gps, UTC_TIME_PROPERTY_NAME, INDIGO_OK_STATE, DATA_TIMEOUT));
		ASSERT_TRUE(hw_text_item(gps, UTC_TIME_PROPERTY_NAME, UTC_TIME_ITEM_NAME, utc, sizeof(utc)));
		ASSERT_EQ_INT(6, sscanf(utc, "%d-%d-%dT%d:%d:%d", &year, &month, &day, &hour, &minute, &second));
		ASSERT_TRUE(year >= 2024 && month >= 1 && month <= 12 && day >= 1 && day <= 31);
		ASSERT_TRUE(hour < 24 && minute < 60 && second < 60);
	}
}

// GPS_ADVANCED_STATUS appears and disappears with GPS_ADVANCED, and whatever the receiver supplies
// in it has to be inside the range the property publishes.
static void nmea_publishes_the_advanced_status(void) {
	double in_use = 0, in_view = 0, pdop = 0, hdop = 0, vdop = 0, minimum = 0, maximum = 0;
	ASSERT_TRUE(hw_set_switch(gps, GPS_ADVANCED_PROPERTY_NAME, GPS_ADVANCED_ENABLED_ITEM_NAME, INDIGO_OK_STATE, SHORT_TIMEOUT));
	ASSERT_TRUE(hw_property_defined(gps, GPS_ADVANCED_STATUS_PROPERTY_NAME));
	ASSERT_TRUE(hw_number_item(gps, GPS_ADVANCED_STATUS_PROPERTY_NAME, GPS_ADVANCED_STATUS_SVS_IN_USE_ITEM_NAME, &in_use));
	ASSERT_TRUE(hw_number_item(gps, GPS_ADVANCED_STATUS_PROPERTY_NAME, GPS_ADVANCED_STATUS_SVS_IN_VIEW_ITEM_NAME, &in_view));
	ASSERT_TRUE(hw_number_item(gps, GPS_ADVANCED_STATUS_PROPERTY_NAME, GPS_ADVANCED_STATUS_PDOP_ITEM_NAME, &pdop));
	ASSERT_TRUE(hw_number_item(gps, GPS_ADVANCED_STATUS_PROPERTY_NAME, GPS_ADVANCED_STATUS_HDOP_ITEM_NAME, &hdop));
	ASSERT_TRUE(hw_number_item(gps, GPS_ADVANCED_STATUS_PROPERTY_NAME, GPS_ADVANCED_STATUS_VDOP_ITEM_NAME, &vdop));
	printf("    %.0f SVs in use, %.0f in view, PDOP %.2f, HDOP %.2f, VDOP %.2f\n", in_use, in_view, pdop, hdop, vdop);
	ASSERT_TRUE(hw_number_item_range(gps, GPS_ADVANCED_STATUS_PROPERTY_NAME, GPS_ADVANCED_STATUS_SVS_IN_VIEW_ITEM_NAME, &minimum, &maximum));
	ASSERT_TRUE(in_view >= minimum && in_view <= maximum);
	ASSERT_TRUE(in_use >= minimum && in_use <= maximum);
	ASSERT_TRUE(hw_number_item_range(gps, GPS_ADVANCED_STATUS_PROPERTY_NAME, GPS_ADVANCED_STATUS_PDOP_ITEM_NAME, &minimum, &maximum));
	ASSERT_TRUE(pdop >= minimum && pdop <= maximum);
	ASSERT_TRUE(hdop >= minimum && hdop <= maximum);
	ASSERT_TRUE(vdop >= minimum && vdop <= maximum);
	// A receiver without a fix uses no satellites, and the DOP the GSA carries is its no-solution
	// placeholder rather than a measured dilution.
	if (!has_fix) {
		ASSERT_NEAR(0, in_use, 0);
	}
	ASSERT_TRUE(hw_set_switch(gps, GPS_ADVANCED_PROPERTY_NAME, GPS_ADVANCED_DISABLED_ITEM_NAME, INDIGO_OK_STATE, SHORT_TIMEOUT));
	ASSERT_TRUE(hw_property_hidden(gps, GPS_ADVANCED_STATUS_PROPERTY_NAME));
}

// Selecting a constellation restarts the driver's picture of the receiver and filters the talker
// ids it accepts from then on. Selecting one the receiver does not send must leave the driver
// waiting rather than reporting the data of another constellation.
static void nmea_selects_the_positioning_system(void) {
	ASSERT_TRUE(hw_set_switch(gps, X_GPS_SELECTED_SYSTEM_PROPERTY_NAME, present_system, INDIGO_OK_STATE, SHORT_TIMEOUT));
	ASSERT_TRUE(hw_wait_settled(gps, GPS_STATUS_PROPERTY_NAME, INDIGO_OK_STATE, DATA_TIMEOUT));
	ASSERT_EQ_INT(1, active_status_lights());
	ASSERT_TRUE(hw_set_switch(gps, X_GPS_SELECTED_SYSTEM_PROPERTY_NAME, MULTIPLE_SYSTEM_ITEM_NAME, INDIGO_OK_STATE, SHORT_TIMEOUT));
	// A combined solution accepts the status of every talker, so the fix state still arrives.
	ASSERT_TRUE(hw_wait_settled(gps, GPS_STATUS_PROPERTY_NAME, INDIGO_OK_STATE, DATA_TIMEOUT));
	ASSERT_TRUE(hw_set_switch(gps, X_GPS_SELECTED_SYSTEM_PROPERTY_NAME, absent_system, INDIGO_OK_STATE, SHORT_TIMEOUT));
	// Nothing the receiver sends belongs to that constellation, so the reset state has to hold and
	// no light may come back on.
	indigo_usleep((unsigned long)(QUIET_WINDOW * 1000000));
	ASSERT_EQ_INT(INDIGO_BUSY_STATE, hw_property_state(gps, GPS_STATUS_PROPERTY_NAME));
	ASSERT_EQ_INT(0, active_status_lights());
	ASSERT_EQ_INT(INDIGO_BUSY_STATE, hw_property_state(gps, GEOGRAPHIC_COORDINATES_PROPERTY_NAME));
	ASSERT_TRUE(hw_set_switch(gps, X_GPS_SELECTED_SYSTEM_PROPERTY_NAME, AUTOMATIC_SYSTEM_ITEM_NAME, INDIGO_OK_STATE, SHORT_TIMEOUT));
	ASSERT_TRUE(hw_wait_settled(gps, GPS_STATUS_PROPERTY_NAME, INDIGO_OK_STATE, DATA_TIMEOUT));
	ASSERT_EQ_INT(1, active_status_lights());
}

// A port that cannot be opened has to fail the connection and leave nothing of a connected device
// behind, and the real port has to work again straight afterwards.
static void nmea_refuses_an_unusable_port(void) {
	char port[INDIGO_VALUE_SIZE] = "";
	ASSERT_TRUE(hw_text_item(gps, DEVICE_PORT_PROPERTY_NAME, DEVICE_PORT_ITEM_NAME, port, sizeof(port)));
	ASSERT_TRUE(hw_disconnect(gps, SHORT_TIMEOUT));
	// The framework itself refuses a path it cannot read, and keeps it, so the connection attempt
	// below still reaches the driver with it.
	ASSERT_TRUE(hw_set_text(gps, DEVICE_PORT_PROPERTY_NAME, DEVICE_PORT_ITEM_NAME, "/dev/indigo-no-such-gps", INDIGO_ALERT_STATE, SHORT_TIMEOUT));
	ASSERT_TRUE(hw_set_switch(gps, CONNECTION_PROPERTY_NAME, CONNECTION_CONNECTED_ITEM_NAME, INDIGO_ALERT_STATE, SHORT_TIMEOUT));
	ASSERT_TRUE(!hw_connected(gps));
	ASSERT_TRUE(hw_property_hidden(gps, GPS_STATUS_PROPERTY_NAME));
	ASSERT_TRUE(hw_property_hidden(gps, GEOGRAPHIC_COORDINATES_PROPERTY_NAME));
	ASSERT_TRUE(hw_set_text(gps, DEVICE_PORT_PROPERTY_NAME, DEVICE_PORT_ITEM_NAME, port, INDIGO_OK_STATE, SHORT_TIMEOUT));
	ASSERT_TRUE(hw_connect(gps, SHORT_TIMEOUT));
	ASSERT_TRUE(hw_wait_settled(gps, GPS_STATUS_PROPERTY_NAME, INDIGO_OK_STATE, DATA_TIMEOUT));
	ASSERT_EQ_INT(1, active_status_lights());
}

// Disconnecting withdraws the connected properties, and reconnecting starts a fresh session rather
// than resuming the previous one with its last values.
static void nmea_reconnects(void) {
	ASSERT_TRUE(hw_disconnect(gps, SHORT_TIMEOUT));
	ASSERT_TRUE(hw_property_hidden(gps, GEOGRAPHIC_COORDINATES_PROPERTY_NAME));
	ASSERT_TRUE(hw_property_hidden(gps, UTC_TIME_PROPERTY_NAME));
	ASSERT_TRUE(hw_property_hidden(gps, GPS_STATUS_PROPERTY_NAME));
	ASSERT_TRUE(hw_property_hidden(gps, GPS_ADVANCED_PROPERTY_NAME));
	// X_GPS_SELECTED_SYSTEM is always defined and survives the disconnect.
	ASSERT_TRUE(hw_property_defined(gps, X_GPS_SELECTED_SYSTEM_PROPERTY_NAME));
	ASSERT_TRUE(hw_connect(gps, SHORT_TIMEOUT));
	ASSERT_TRUE(hw_property_defined(gps, GEOGRAPHIC_COORDINATES_PROPERTY_NAME));
	ASSERT_TRUE(hw_property_defined(gps, GPS_STATUS_PROPERTY_NAME));
	// A reconnect starts from the reset state, so the fix status can only come back from sentences
	// read in this session.
	ASSERT_EQ_INT(0, active_status_lights());
	ASSERT_TRUE(hw_wait_settled(gps, GPS_STATUS_PROPERTY_NAME, INDIGO_OK_STATE, DATA_TIMEOUT));
	ASSERT_EQ_INT(1, active_status_lights());
}

static void nmea_reinitializes(void) {
	ASSERT_TRUE(hw_disconnect(gps, SHORT_TIMEOUT));
	ASSERT_EQ_INT(INDIGO_OK, indigo_gps_nmea(INDIGO_DRIVER_SHUTDOWN, NULL));
	ASSERT_EQ_INT(-1, hw_device_index(DEVICE_NAME));
	ASSERT_EQ_INT(INDIGO_OK, indigo_gps_nmea(INDIGO_DRIVER_INIT, NULL));
	gps = hw_wait_for_device(DEVICE_NAME, SHORT_TIMEOUT);
	ASSERT_TRUE(gps >= 0);
	ASSERT_TRUE(select_port());
	ASSERT_TRUE(hw_connect(gps, SHORT_TIMEOUT));
	ASSERT_TRUE(hw_wait_settled(gps, GPS_STATUS_PROPERTY_NAME, INDIGO_OK_STATE, DATA_TIMEOUT));
	ASSERT_EQ_INT(1, active_status_lights());
}

int main(int argc, char **argv) {
	if (argc < 2 || strcmp(argv[1], "--run")) {
		fprintf(stderr, "Physical NMEA 0183 GPS test: run explicitly with --run (or make test-gps-nmea-hw).\n");
		return 2;
	}
	setvbuf(stdout, NULL, _IONBF, 0);
	for (int i = 2; i < argc; i++) {
		if (!strcmp(argv[i], "--debug")) {
			indigo_set_log_level(INDIGO_LOG_DEBUG);
		}
	}
	// GPS_ADVANCED is persistent, so the session keeps its configuration out of the user's own
	// folder and starts from the disabled default the property contract scenario asserts.
	if (!indigo_test_use_private_home()) {
		return 1;
	}
	serial_port = getenv("GPS_NMEA_HW_PORT");
	const char *requested = getenv("GPS_NMEA_HW_SYSTEM");
	if (requested != NULL && *requested) {
		present_system = requested;
	}
	requested = getenv("GPS_NMEA_HW_ABSENT_SYSTEM");
	if (requested != NULL && *requested) {
		absent_system = requested;
	}
	const indigo_test_case tests[] = {
		{ "nmea_reports_identity_and_capabilities", nmea_reports_identity_and_capabilities },
		{ "nmea_publishes_the_property_contract", nmea_publishes_the_property_contract },
		{ "nmea_receives_sentences_from_the_receiver", nmea_receives_sentences_from_the_receiver },
		{ "nmea_reports_the_fix_state", nmea_reports_the_fix_state },
		{ "nmea_publishes_the_advanced_status", nmea_publishes_the_advanced_status },
		{ "nmea_selects_the_positioning_system", nmea_selects_the_positioning_system },
		{ "nmea_refuses_an_unusable_port", nmea_refuses_an_unusable_port },
		{ "nmea_reconnects", nmea_reconnects },
		{ "nmea_reinitializes", nmea_reinitializes }
	};
	int result = 1;
	bool started = false, initialized = false;
	HW_CHECK(indigo_start() == INDIGO_OK);
	started = true;
	HW_CHECK(hw_attach_client("NMEA GPS hardware test") == INDIGO_OK);
	HW_CHECK(indigo_gps_nmea(INDIGO_DRIVER_INIT, NULL) == INDIGO_OK);
	initialized = true;
	gps = hw_wait_for_device(DEVICE_NAME, SHORT_TIMEOUT);
	HW_CHECK(gps >= 0);
	HW_CHECK(select_port());
	HW_CHECK(hw_connect(gps, SHORT_TIMEOUT));
	printf("Selected system %s present, %s absent\n", present_system, absent_system);
	result = indigo_run_tests("Generic NMEA 0183 GPS hardware", tests, ARRAY_SIZE(tests));
cleanup:
	// The driver only reads the receiver, so the session has nothing to restore in it; leave the
	// selection back on autodetect for the next run.
	if (gps >= 0 && hw_connected(gps)) {
		hw_request_switch(gps, X_GPS_SELECTED_SYSTEM_PROPERTY_NAME, AUTOMATIC_SYSTEM_ITEM_NAME, true);
	}
	if (!hw_disconnect(gps, SHORT_TIMEOUT)) {
		indigo_test_failures++;
	}
	if (initialized && indigo_gps_nmea(INDIGO_DRIVER_SHUTDOWN, NULL) != INDIGO_OK) {
		indigo_test_failures++;
	}
	indigo_detach_client(&hw_client);
	if (started) {
		indigo_stop();
	}
	hw_release_properties();
	indigo_test_remove_private_home();
	return indigo_test_failures ? 1 : result;
}
