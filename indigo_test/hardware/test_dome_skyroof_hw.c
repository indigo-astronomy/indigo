// Copyright (c) 2026 INDIGO initiative
// All rights reserved.
//
// You may use this software under the terms of 'INDIGO Astronomy
// open-source license' (see LICENSE.md).
//
// THIS SOFTWARE IS PROVIDED BY THE AUTHORS 'AS IS' AND ANY EXPRESS
// OR IMPLIED WARRANTIES, INCLUDING, BUT NOT LIMITED TO, THE IMPLIED
// WARRANTIES OF MERCHANTABILITY AND FITNESS FOR A PARTICULAR PURPOSE
// ARE DISCLAIMED. IN NO EVENT SHALL THE AUTHOR BE LIABLE FOR ANY
// DIRECT, INDIRECT, INCIDENTAL, SPECIAL, EXEMPLARY, OR CONSEQUENTIAL
// DAMAGES (INCLUDING, BUT NOT LIMITED TO, PROCUREMENT OF SUBSTITUTE
// GOODS OR SERVICES; LOSS OF USE, DATA, OR PROFITS; OR BUSINESS
// INTERRUPTION) HOWEVER CAUSED AND ON ANY THEORY OF LIABILITY,
// WHETHER IN CONTRACT, STRICT LIABILITY, OR TORT (INCLUDING
// NEGLIGENCE OR OTHERWISE) ARISING IN ANY WAY OUT OF THE USE OF THIS
// SOFTWARE, EVEN IF ADVISED OF THE POSSIBILITY OF SUCH DAMAGE.

// Code is generated by AI

// Opt-in acceptance test for a physically connected Interactive Astronomy SkyRoof controller, or for the
// Arduino sketch dome_skyroof_simulator.ino running on a board. It checks the model, the roof labels, the
// mount park sensor read at the connection and the heater control, opens and closes the roof, aborts an
// opening and closes the roof from there, reconnects and runs driver INIT/SHUTDOWN.
//
// THE ROOF MOVES AND THE HEATER SWITCHES. The session returns the roof to the state it found and leaves the
// heater off.
//
// The port comes from SKYROOF_HW_PORT.

#include <math.h>
#include <stdlib.h>
#include <indigo_drivers/dome_skyroof/indigo_dome_skyroof.h>
#include "dome_hw_common.h"

#define DEVICE_NAME "SkyRoof"

#define SHORT_TIMEOUT 15.0
#define MOTION_TIMEOUT 320.0

static int roof = -1;
static const char *serial_port = NULL;
static bool state_captured = false, roof_was_open = false;

static bool select_port(void) {
	if (serial_port == NULL || !*serial_port) {
		fprintf(stderr, "    set SKYROOF_HW_PORT to the controller's port\n");
		return false;
	}
	printf("Using port %s\n", serial_port);
	return hw_set_text(roof, DEVICE_PORT_PROPERTY_NAME, DEVICE_PORT_ITEM_NAME, serial_port, INDIGO_OK_STATE, SHORT_TIMEOUT);
}

static bool set_heater(bool on) {
	return hw_set_switch(roof, "X_HEATER_CONTROL", on ? "ON" : "OFF", INDIGO_OK_STATE, SHORT_TIMEOUT) && dome_hw_switch_is(roof, "X_HEATER_CONTROL", on ? "ON" : "OFF");
}

static void restore_initial_state(void) {
	if (roof < 0 || !state_captured || !hw_connected(roof)) {
		return;
	}
	set_heater(false);
	if (!dome_hw_switch_is(roof, DOME_SHUTTER_PROPERTY_NAME, roof_was_open ? DOME_SHUTTER_OPENED_ITEM_NAME : DOME_SHUTTER_CLOSED_ITEM_NAME)) {
		dome_hw_open_close(roof, DOME_SHUTTER_PROPERTY_NAME, roof_was_open, INDIGO_OK_STATE, MOTION_TIMEOUT);
	}
}

static void skyroof_publishes_the_property_contract(void) {
	char model[INDIGO_VALUE_SIZE] = "";
	indigo_property_state park = INDIGO_BUSY_STATE;
	ASSERT_TRUE((hw_device_interface(roof) & INDIGO_INTERFACE_DOME) != 0);
	ASSERT_TRUE(hw_text_item(roof, INFO_PROPERTY_NAME, INFO_DEVICE_MODEL_ITEM_NAME, model, sizeof(model)));
	ASSERT_TRUE(hw_light_item(roof, "X_MOUNT_PARK_STATUS", "STATUS", &park));
	printf("    model %s, mount park sensor %s, roof %s\n", model, park == INDIGO_OK_STATE ? "parked" : "not parked", roof_was_open ? "open" : "closed");
	ASSERT_STREQ("Interactive Astronomy SkyRoof", model);
	ASSERT_TRUE(park == INDIGO_OK_STATE || park == INDIGO_IDLE_STATE);
	ASSERT_TRUE(hw_property_defined(roof, "X_HEATER_CONTROL"));
	ASSERT_TRUE(hw_property_hidden(roof, DOME_HORIZONTAL_COORDINATES_PROPERTY_NAME));
	ASSERT_TRUE(hw_property_hidden(roof, DOME_PARK_PROPERTY_NAME));
}

static void skyroof_opens_and_closes_the_roof(void) {
	bool open = roof_was_open;
	for (int i = 0; i < 2; i++) {
		open = !open;
		ASSERT_TRUE(dome_hw_open_close(roof, DOME_SHUTTER_PROPERTY_NAME, open, INDIGO_OK_STATE, MOTION_TIMEOUT));
	}
	// Repeating a request for the side the roof is on ends at once.
	ASSERT_TRUE(dome_hw_open_close(roof, DOME_SHUTTER_PROPERTY_NAME, open, INDIGO_OK_STATE, SHORT_TIMEOUT));
}

// An aborted move leaves the roof between the ends: the shutter shows no side, in ALERT.
static void skyroof_aborts_a_move(void) {
	bool open = dome_hw_switch_is(roof, DOME_SHUTTER_PROPERTY_NAME, DOME_SHUTTER_OPENED_ITEM_NAME);
	unsigned before = hw_revision(roof, DOME_SHUTTER_PROPERTY_NAME);
	indigo_change_switch_property_1(&hw_client, DEVICE_NAME, DOME_SHUTTER_PROPERTY_NAME, open ? DOME_SHUTTER_CLOSED_ITEM_NAME : DOME_SHUTTER_OPENED_ITEM_NAME, true);
	ASSERT_TRUE(hw_wait_state(roof, DOME_SHUTTER_PROPERTY_NAME, before, INDIGO_BUSY_STATE, SHORT_TIMEOUT));
	indigo_usleep(3000000);
	ASSERT_TRUE(dome_hw_abort(roof, SHORT_TIMEOUT));
	ASSERT_TRUE(dome_hw_idle(roof, DOME_SHUTTER_PROPERTY_NAME, SHORT_TIMEOUT));
	ASSERT_EQ_INT(INDIGO_ALERT_STATE, hw_property_state(roof, DOME_SHUTTER_PROPERTY_NAME));
	ASSERT_TRUE(!dome_hw_switch_is(roof, DOME_SHUTTER_PROPERTY_NAME, DOME_SHUTTER_OPENED_ITEM_NAME) && !dome_hw_switch_is(roof, DOME_SHUTTER_PROPERTY_NAME, DOME_SHUTTER_CLOSED_ITEM_NAME));
	ASSERT_TRUE(dome_hw_open_close(roof, DOME_SHUTTER_PROPERTY_NAME, open, INDIGO_OK_STATE, MOTION_TIMEOUT));
}

static void skyroof_switches_the_heater(void) {
	ASSERT_TRUE(set_heater(true));
	ASSERT_TRUE(set_heater(false));
	ASSERT_TRUE(set_heater(false));
}

static void skyroof_reconnects(void) {
	bool open = dome_hw_switch_is(roof, DOME_SHUTTER_PROPERTY_NAME, DOME_SHUTTER_OPENED_ITEM_NAME);
	ASSERT_TRUE(hw_disconnect(roof, SHORT_TIMEOUT));
	ASSERT_TRUE(hw_property_hidden(roof, "X_MOUNT_PARK_STATUS"));
	ASSERT_TRUE(hw_connect(roof, SHORT_TIMEOUT));
	ASSERT_TRUE(dome_hw_switch_is(roof, DOME_SHUTTER_PROPERTY_NAME, open ? DOME_SHUTTER_OPENED_ITEM_NAME : DOME_SHUTTER_CLOSED_ITEM_NAME));
	ASSERT_EQ_INT(INDIGO_OK_STATE, hw_property_state(roof, DOME_SHUTTER_PROPERTY_NAME));
}

static void skyroof_rejects_shutdown_while_connected(void) {
	ASSERT_EQ_INT(INDIGO_BUSY, indigo_dome_skyroof(INDIGO_DRIVER_SHUTDOWN, NULL));
	ASSERT_TRUE(hw_connected(roof));
}

static void skyroof_reinitializes(void) {
	ASSERT_TRUE(hw_disconnect(roof, SHORT_TIMEOUT));
	ASSERT_EQ_INT(INDIGO_OK, indigo_dome_skyroof(INDIGO_DRIVER_SHUTDOWN, NULL));
	ASSERT_EQ_INT(-1, hw_device_index(DEVICE_NAME));
	ASSERT_EQ_INT(INDIGO_OK, indigo_dome_skyroof(INDIGO_DRIVER_INIT, NULL));
	roof = hw_wait_for_device(DEVICE_NAME, SHORT_TIMEOUT);
	ASSERT_TRUE(roof >= 0);
	ASSERT_TRUE(select_port());
	ASSERT_TRUE(hw_connect(roof, SHORT_TIMEOUT));
	ASSERT_TRUE(hw_property_defined(roof, "X_MOUNT_PARK_STATUS"));
}

int main(int argc, char **argv) {
	if (argc < 2 || strcmp(argv[1], "--run")) {
		fprintf(stderr, "Physical SkyRoof test: run explicitly with --run (or make test-dome-skyroof-hw).\n");
		return 2;
	}
	setvbuf(stdout, NULL, _IONBF, 0);
	for (int i = 2; i < argc; i++) {
		if (!strcmp(argv[i], "--debug")) {
			indigo_set_log_level(INDIGO_LOG_DEBUG);
		}
	}
	if (!indigo_test_use_private_home()) {
		return 1;
	}
	serial_port = hw_port("SKYROOF_HW_PORT");
	const indigo_test_case tests[] = {
		{ "skyroof_publishes_the_property_contract", skyroof_publishes_the_property_contract },
		{ "skyroof_opens_and_closes_the_roof", skyroof_opens_and_closes_the_roof },
		{ "skyroof_aborts_a_move", skyroof_aborts_a_move },
		{ "skyroof_switches_the_heater", skyroof_switches_the_heater },
		{ "skyroof_reconnects", skyroof_reconnects },
		{ "skyroof_rejects_shutdown_while_connected", skyroof_rejects_shutdown_while_connected },
		{ "skyroof_reinitializes", skyroof_reinitializes }
	};
	int result = 1;
	bool started = false, initialized = false;
	HW_CHECK(hw_start() == INDIGO_OK);
	started = true;
	HW_CHECK(hw_attach_client("SkyRoof hardware test") == INDIGO_OK);
	HW_CHECK(indigo_dome_skyroof(INDIGO_DRIVER_INIT, NULL) == INDIGO_OK);
	initialized = true;
	roof = hw_wait_for_device(DEVICE_NAME, SHORT_TIMEOUT);
	HW_CHECK(roof >= 0);
	HW_CHECK(select_port());
	HW_CHECK(hw_connect(roof, SHORT_TIMEOUT));
	HW_CHECK(dome_hw_switch_is(roof, DOME_SHUTTER_PROPERTY_NAME, DOME_SHUTTER_OPENED_ITEM_NAME) || dome_hw_switch_is(roof, DOME_SHUTTER_PROPERTY_NAME, DOME_SHUTTER_CLOSED_ITEM_NAME));
	roof_was_open = dome_hw_switch_is(roof, DOME_SHUTTER_PROPERTY_NAME, DOME_SHUTTER_OPENED_ITEM_NAME);
	state_captured = true;
	result = indigo_run_tests("SkyRoof hardware", tests, ARRAY_SIZE(tests));
cleanup:
	restore_initial_state();
	if (!hw_disconnect(roof, SHORT_TIMEOUT)) {
		indigo_test_failures++;
	}
	if (initialized && indigo_dome_skyroof(INDIGO_DRIVER_SHUTDOWN, NULL) != INDIGO_OK) {
		indigo_test_failures++;
	}
	indigo_detach_client(&hw_client);
	if (started) {
		indigo_stop();
	}
	hw_release_properties();
	indigo_test_remove_private_home();
	return indigo_test_failures ? 1 : result;
}
