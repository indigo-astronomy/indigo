// Copyright (c) 2026 INDIGO initiative
// All rights reserved.
//
// You may use this software under the terms of 'INDIGO Astronomy
// open-source license' (see LICENSE.md).
//
// THIS SOFTWARE IS PROVIDED BY THE AUTHORS 'AS IS' AND ANY EXPRESS
// OR IMPLIED WARRANTIES, INCLUDING, BUT NOT LIMITED TO, THE IMPLIED
// WARRANTIES OF MERCHANTABILITY AND FITNESS FOR A PARTICULAR PURPOSE
// ARE DISCLAIMED. IN NO EVENT SHALL THE AUTHOR BE LIABLE FOR ANY
// DIRECT, INDIRECT, INCIDENTAL, SPECIAL, EXEMPLARY, OR CONSEQUENTIAL
// DAMAGES (INCLUDING, BUT NOT LIMITED TO, PROCUREMENT OF SUBSTITUTE
// GOODS OR SERVICES; LOSS OF USE, DATA, OR PROFITS; OR BUSINESS
// INTERRUPTION) HOWEVER CAUSED AND ON ANY THEORY OF LIABILITY,
// WHETHER IN CONTRACT, STRICT LIABILITY, OR TORT (INCLUDING
// NEGLIGENCE OR OTHERWISE) ARISING IN ANY WAY OUT OF THE USE OF THIS
// SOFTWARE, EVEN IF ADVISED OF THE POSSIBILITY OF SUCH DAMAGE.

// Code is generated by AI

// Opt-in acceptance test for a physically connected WeMacro Rail controller. It runs the focuser
// hardware acceptance checklist of DRIVER_TESTING_RULES.md for a relative focuser without position
// readback: the published property contract, relative moves in both directions at both speeds,
// reversal, the overlapping request and the controls refused during a move, abort while moving and
// while idle, the shutter, the rail configuration, batches with and without return, abort of a
// batch, a disconnect during a move, reconnect and driver INIT/SHUTDOWN.
//
// THE RAIL PHYSICALLY MOVES. The longest single move is WEMACRO_HW_TRAVEL steps (default 2000) and
// every scenario moves back by the same amount. The controller has no position readback, so a move
// cut short by an abort or a disconnect is compensated from the step rate the suite measured, and
// the rail may end up a few steps away from where it was found. Batches move by a tenth of the
// travel and return. The shutter output fires during the shutter and batch scenarios.
//
// The port comes from WEMACRO_HW_PORT. When it is not set the port the driver itself detected
// through its CH340 match pattern is used.

#include <math.h>
#include <stdlib.h>
#include <indigo_drivers/focuser_wemacro/indigo_focuser_wemacro.h>
#include "hardware_test_common.h"

#define DEVICE_NAME "WeMacro Rail"

// One write over the 9600 baud link plus the driver's own connection work, which waits up to 2 s
// for the initial status and then runs the reset sequence.
#define SHORT_TIMEOUT 15.0
// The driver's own completion deadline is 5 s plus the travel at 2000 steps/s.
#define MOVE_TIMEOUT 60.0
#define BATCH_TIMEOUT 90.0

// The driver-defined properties are declared in the generated source rather than in the header, so
// the test names them the way the simulator integration test does.
#define X_RAIL_CONFIG_PROPERTY_NAME "X_RAIL_CONFIG"
#define X_RAIL_CONFIG_BACK_ITEM_NAME "BACK"
#define X_RAIL_CONFIG_BEEP_ITEM_NAME "BEEP"
#define X_RAIL_SHUTTER_PROPERTY_NAME "X_RAIL_SHUTTER"
#define X_RAIL_SHUTTER_ITEM_NAME "SHUTTER"
#define X_RAIL_EXECUTE_PROPERTY_NAME "X_RAIL_EXECUTE"
#define X_RAIL_EXECUTE_SETTLE_TIME_ITEM_NAME "SETTLE_TIME"
#define X_RAIL_EXECUTE_PER_STEP_ITEM_NAME "SHUTTER_PER_STEP"
#define X_RAIL_EXECUTE_INTERVAL_ITEM_NAME "SHUTTER_INTERVAL"
#define X_RAIL_EXECUTE_LENGTH_ITEM_NAME "LENGTH"
#define X_RAIL_EXECUTE_COUNT_ITEM_NAME "COUNT"

#define SLOW_SPEED 1
#define FAST_SPEED 2

static int focuser = -1;
static const char *serial_port = NULL;
static double travel = 2000;
// Steps per second measured at each speed, used to compensate a move that was cut short.
static double slow_rate = 0, fast_rate = 0;
// What the driver reported when the session connected. Every scenario restores what it changes.
static double initial_speed;
static bool initial_reversed, initial_back, initial_beep;
static bool state_captured = false;

static bool select_port(void) {
	if (serial_port == NULL || !*serial_port) {
		char detected[INDIGO_VALUE_SIZE] = "";
		if (hw_text_item(focuser, DEVICE_PORT_PROPERTY_NAME, DEVICE_PORT_ITEM_NAME, detected, sizeof(detected)) && *detected) {
			printf("Using the port the driver detected: %s\n", detected);
			return true;
		}
		fprintf(stderr, "    no serial port was detected, set WEMACRO_HW_PORT\n");
		return false;
	}
	printf("Using port %s\n", serial_port);
	return hw_set_text(focuser, DEVICE_PORT_PROPERTY_NAME, DEVICE_PORT_ITEM_NAME, serial_port, INDIGO_OK_STATE, SHORT_TIMEOUT);
}

static bool set_speed(double speed) {
	return hw_set_number(focuser, FOCUSER_SPEED_PROPERTY_NAME, FOCUSER_SPEED_ITEM_NAME, speed, INDIGO_OK_STATE, SHORT_TIMEOUT);
}

static bool set_direction(const char *direction) {
	return hw_set_switch(focuser, FOCUSER_DIRECTION_PROPERTY_NAME, direction, INDIGO_OK_STATE, SHORT_TIMEOUT);
}

// Starts a relative move and waits for its BUSY, without waiting for the completion.
static bool start_move(const char *direction, double steps) {
	if (!set_direction(direction)) {
		return false;
	}
	unsigned before = hw_revision(focuser, FOCUSER_STEPS_PROPERTY_NAME);
	hw_request_number(focuser, FOCUSER_STEPS_PROPERTY_NAME, FOCUSER_STEPS_ITEM_NAME, steps);
	return hw_wait_state(focuser, FOCUSER_STEPS_PROPERTY_NAME, before, INDIGO_BUSY_STATE, SHORT_TIMEOUT);
}

// A relative move waited out to its completion, which the driver publishes only when the
// controller reported the status of the requested direction. Returns the duration, or -1.
static double move_by(const char *direction, double steps) {
	if (!set_direction(direction)) {
		return -1;
	}
	unsigned before = hw_revision(focuser, FOCUSER_STEPS_PROPERTY_NAME);
	double started = indigo_monotonic_time();
	hw_request_number(focuser, FOCUSER_STEPS_PROPERTY_NAME, FOCUSER_STEPS_ITEM_NAME, steps);
	if (!hw_wait_state(focuser, FOCUSER_STEPS_PROPERTY_NAME, before, INDIGO_OK_STATE, MOVE_TIMEOUT)) {
		return -1;
	}
	return indigo_monotonic_time() - started;
}

// After an abort or a disconnect the rail stopped somewhere along an outward move, so move back by
// what the measured rate says it covered in the time it ran.
static void compensate_outward_run(double seconds, double rate) {
	double steps = round(seconds * rate);
	if (steps > travel) {
		steps = travel;
	}
	if (steps >= 1) {
		printf("    moving back an estimated %g steps (%.2f s at %.0f steps/s)\n", steps, seconds, rate);
		move_by(FOCUSER_DIRECTION_MOVE_INWARD_ITEM_NAME, steps);
	}
}

static bool set_rail_config(bool back, bool beep) {
	static const char *names[] = { X_RAIL_CONFIG_BACK_ITEM_NAME, X_RAIL_CONFIG_BEEP_ITEM_NAME };
	bool values[] = { back, beep };
	unsigned before = hw_revision(focuser, X_RAIL_CONFIG_PROPERTY_NAME);
	indigo_change_switch_property(&hw_client, DEVICE_NAME, X_RAIL_CONFIG_PROPERTY_NAME, 2, names, values);
	if (!hw_wait_state(focuser, X_RAIL_CONFIG_PROPERTY_NAME, before, INDIGO_OK_STATE, SHORT_TIMEOUT)) {
		return false;
	}
	bool back_value = !back, beep_value = !beep;
	return hw_switch_item(focuser, X_RAIL_CONFIG_PROPERTY_NAME, X_RAIL_CONFIG_BACK_ITEM_NAME, &back_value) && hw_switch_item(focuser, X_RAIL_CONFIG_PROPERTY_NAME, X_RAIL_CONFIG_BEEP_ITEM_NAME, &beep_value) && back_value == back && beep_value == beep;
}

// Sends a complete batch request without waiting for anything.
static void request_batch(double settle, double per_step, double interval, double length, double count) {
	static const char *names[] = { X_RAIL_EXECUTE_SETTLE_TIME_ITEM_NAME, X_RAIL_EXECUTE_PER_STEP_ITEM_NAME, X_RAIL_EXECUTE_INTERVAL_ITEM_NAME, X_RAIL_EXECUTE_LENGTH_ITEM_NAME, X_RAIL_EXECUTE_COUNT_ITEM_NAME };
	double values[] = { settle, per_step, interval, length, count };
	indigo_change_number_property(&hw_client, DEVICE_NAME, X_RAIL_EXECUTE_PROPERTY_NAME, 5, names, values);
}

static bool capture_initial_state(void) {
	if (!hw_number_item(focuser, FOCUSER_SPEED_PROPERTY_NAME, FOCUSER_SPEED_ITEM_NAME, &initial_speed)) {
		return false;
	}
	if (!hw_switch_item(focuser, FOCUSER_REVERSE_MOTION_PROPERTY_NAME, FOCUSER_REVERSE_MOTION_ENABLED_ITEM_NAME, &initial_reversed)) {
		return false;
	}
	if (!hw_switch_item(focuser, X_RAIL_CONFIG_PROPERTY_NAME, X_RAIL_CONFIG_BACK_ITEM_NAME, &initial_back)) {
		return false;
	}
	if (!hw_switch_item(focuser, X_RAIL_CONFIG_PROPERTY_NAME, X_RAIL_CONFIG_BEEP_ITEM_NAME, &initial_beep)) {
		return false;
	}
	state_captured = true;
	return true;
}

// Whatever happened above, put the driver settings back the way the session found them.
static void restore_initial_state(void) {
	if (focuser < 0 || !state_captured || !hw_connected(focuser)) {
		return;
	}
	hw_set_switch(focuser, FOCUSER_ABORT_MOTION_PROPERTY_NAME, FOCUSER_ABORT_MOTION_ITEM_NAME, INDIGO_OK_STATE, SHORT_TIMEOUT);
	hw_set_switch(focuser, FOCUSER_REVERSE_MOTION_PROPERTY_NAME, initial_reversed ? FOCUSER_REVERSE_MOTION_ENABLED_ITEM_NAME : FOCUSER_REVERSE_MOTION_DISABLED_ITEM_NAME, INDIGO_OK_STATE, SHORT_TIMEOUT);
	set_rail_config(initial_back, initial_beep);
	set_speed(initial_speed);
}

static void wemacro_reports_identity_and_capabilities(void) {
	char model[INDIGO_VALUE_SIZE] = "", port[INDIGO_VALUE_SIZE] = "";
	ASSERT_TRUE((hw_device_interface(focuser) & INDIGO_INTERFACE_FOCUSER) != 0);
	ASSERT_STREQ(DEVICE_NAME, hw_device_name(focuser));
	ASSERT_TRUE(hw_text_item(focuser, INFO_PROPERTY_NAME, INFO_DEVICE_MODEL_ITEM_NAME, model, sizeof(model)));
	// The controller has no identity query, so the driver publishes a fixed model name.
	ASSERT_STREQ("WeMacro Rail controller", model);
	ASSERT_TRUE(hw_text_item(focuser, DEVICE_PORT_PROPERTY_NAME, DEVICE_PORT_ITEM_NAME, port, sizeof(port)));
	printf("    %s on %s, speed %g, reverse %s, return %s, beep %s\n", model, port, initial_speed, initial_reversed ? "on" : "off", initial_back ? "on" : "off", initial_beep ? "on" : "off");
}

static void wemacro_publishes_the_property_contract(void) {
	double min = 0, max = 0;
	ASSERT_TRUE(hw_property_defined(focuser, FOCUSER_SPEED_PROPERTY_NAME));
	ASSERT_TRUE(hw_property_defined(focuser, FOCUSER_DIRECTION_PROPERTY_NAME));
	ASSERT_TRUE(hw_property_defined(focuser, FOCUSER_STEPS_PROPERTY_NAME));
	ASSERT_TRUE(hw_property_defined(focuser, FOCUSER_ABORT_MOTION_PROPERTY_NAME));
	ASSERT_TRUE(hw_property_defined(focuser, FOCUSER_REVERSE_MOTION_PROPERTY_NAME));
	ASSERT_TRUE(hw_property_defined(focuser, X_RAIL_CONFIG_PROPERTY_NAME));
	ASSERT_TRUE(hw_property_defined(focuser, X_RAIL_SHUTTER_PROPERTY_NAME));
	ASSERT_TRUE(hw_property_defined(focuser, X_RAIL_EXECUTE_PROPERTY_NAME));
	// The controller has no position readback, probe or compensation, so all of these stay hidden.
	ASSERT_TRUE(hw_property_hidden(focuser, FOCUSER_POSITION_PROPERTY_NAME));
	ASSERT_TRUE(hw_property_hidden(focuser, FOCUSER_ON_POSITION_SET_PROPERTY_NAME));
	ASSERT_TRUE(hw_property_hidden(focuser, FOCUSER_LIMITS_PROPERTY_NAME));
	ASSERT_TRUE(hw_property_hidden(focuser, FOCUSER_TEMPERATURE_PROPERTY_NAME));
	ASSERT_TRUE(hw_property_hidden(focuser, FOCUSER_BACKLASH_PROPERTY_NAME));
	ASSERT_TRUE(hw_property_hidden(focuser, FOCUSER_COMPENSATION_PROPERTY_NAME));
	ASSERT_TRUE(hw_property_hidden(focuser, FOCUSER_MODE_PROPERTY_NAME));
	ASSERT_TRUE(hw_number_item_range(focuser, FOCUSER_SPEED_PROPERTY_NAME, FOCUSER_SPEED_ITEM_NAME, &min, &max));
	ASSERT_EQ_INT(SLOW_SPEED, (int)min);
	ASSERT_EQ_INT(FAST_SPEED, (int)max);
	ASSERT_TRUE(hw_number_item_range(focuser, FOCUSER_STEPS_PROPERTY_NAME, FOCUSER_STEPS_ITEM_NAME, &min, &max));
	ASSERT_EQ_INT(0, (int)min);
	ASSERT_EQ_INT(0xFFFFFF, (int)max);
	ASSERT_TRUE(hw_number_item_range(focuser, X_RAIL_EXECUTE_PROPERTY_NAME, X_RAIL_EXECUTE_COUNT_ITEM_NAME, &min, &max));
	ASSERT_EQ_INT(1, (int)min);
	ASSERT_EQ_INT(INDIGO_OK_STATE, hw_property_state(focuser, FOCUSER_STEPS_PROPERTY_NAME));
}

// Both directions have to complete, which the driver reports only after the controller answered
// with the status of the direction it was asked for. A zero request is a no-op that still answers.
static void wemacro_moves_relative_in_both_directions(void) {
	ASSERT_TRUE(set_speed(SLOW_SPEED));
	hw_forget_states();
	double outward = move_by(FOCUSER_DIRECTION_MOVE_OUTWARD_ITEM_NAME, travel);
	ASSERT_TRUE(outward > 0);
	ASSERT_TRUE((hw_states_seen(focuser, FOCUSER_STEPS_PROPERTY_NAME) & (1u << INDIGO_BUSY_STATE)) != 0);
	double inward = move_by(FOCUSER_DIRECTION_MOVE_INWARD_ITEM_NAME, travel);
	ASSERT_TRUE(inward > 0);
	slow_rate = travel / ((outward + inward) / 2);
	printf("    %g steps took %.2f s outward and %.2f s inward, %.0f steps/s\n", travel, outward, inward, slow_rate);
	// The two directions run the same distance, so they have to take about the same time; a move
	// completed by a stray status would be over far too early.
	ASSERT_TRUE(outward > inward / 2 && inward > outward / 2);
	double zero = move_by(FOCUSER_DIRECTION_MOVE_OUTWARD_ITEM_NAME, 0);
	ASSERT_TRUE(zero >= 0 && zero < 1);
}

// Both speeds have to reach the controller, and the same move has to take less time at the faster
// one, which is the only proof the speed byte did anything.
static void wemacro_changes_the_speed(void) {
	ASSERT_TRUE(slow_rate > 0);
	ASSERT_TRUE(set_speed(FAST_SPEED));
	double outward = move_by(FOCUSER_DIRECTION_MOVE_OUTWARD_ITEM_NAME, travel);
	ASSERT_TRUE(outward > 0);
	double inward = move_by(FOCUSER_DIRECTION_MOVE_INWARD_ITEM_NAME, travel);
	ASSERT_TRUE(inward > 0);
	fast_rate = travel / ((outward + inward) / 2);
	printf("    %g steps at speed %d: %.0f steps/s, at speed %d: %.0f steps/s\n", travel, SLOW_SPEED, slow_rate, FAST_SPEED, fast_rate);
	ASSERT_TRUE(fast_rate > slow_rate);
	ASSERT_TRUE(set_speed(SLOW_SPEED));
}

// Reversal swaps the command the driver sends, so both directions have to complete with the
// controller status of the swapped command, and the rail returns as before.
static void wemacro_reverses_the_motion(void) {
	ASSERT_TRUE(hw_set_switch(focuser, FOCUSER_REVERSE_MOTION_PROPERTY_NAME, FOCUSER_REVERSE_MOTION_ENABLED_ITEM_NAME, INDIGO_OK_STATE, SHORT_TIMEOUT));
	ASSERT_TRUE(set_speed(FAST_SPEED));
	ASSERT_TRUE(move_by(FOCUSER_DIRECTION_MOVE_OUTWARD_ITEM_NAME, travel / 2) > 0);
	ASSERT_TRUE(move_by(FOCUSER_DIRECTION_MOVE_INWARD_ITEM_NAME, travel / 2) > 0);
	ASSERT_TRUE(hw_set_switch(focuser, FOCUSER_REVERSE_MOTION_PROPERTY_NAME, FOCUSER_REVERSE_MOTION_DISABLED_ITEM_NAME, INDIGO_OK_STATE, SHORT_TIMEOUT));
	ASSERT_TRUE(set_speed(SLOW_SPEED));
}

// A second move, a speed change, reversal and the rail configuration are all refused while the
// rail runs; the first move has to finish with its own duration and nothing it changed.
static void wemacro_refuses_requests_during_a_move(void) {
	ASSERT_TRUE(slow_rate > 0);
	ASSERT_TRUE(set_speed(SLOW_SPEED));
	double started = indigo_monotonic_time();
	ASSERT_TRUE(start_move(FOCUSER_DIRECTION_MOVE_OUTWARD_ITEM_NAME, travel));
	hw_request_number(focuser, FOCUSER_STEPS_PROPERTY_NAME, FOCUSER_STEPS_ITEM_NAME, travel / 2);
	ASSERT_TRUE(hw_set_number(focuser, FOCUSER_SPEED_PROPERTY_NAME, FOCUSER_SPEED_ITEM_NAME, FAST_SPEED, INDIGO_ALERT_STATE, SHORT_TIMEOUT));
	double speed = 0;
	ASSERT_TRUE(hw_number_item(focuser, FOCUSER_SPEED_PROPERTY_NAME, FOCUSER_SPEED_ITEM_NAME, &speed));
	ASSERT_EQ_INT(SLOW_SPEED, (int)speed);
	ASSERT_TRUE(hw_set_switch(focuser, FOCUSER_REVERSE_MOTION_PROPERTY_NAME, FOCUSER_REVERSE_MOTION_ENABLED_ITEM_NAME, INDIGO_ALERT_STATE, SHORT_TIMEOUT));
	bool reversed = true;
	ASSERT_TRUE(hw_switch_item(focuser, FOCUSER_REVERSE_MOTION_PROPERTY_NAME, FOCUSER_REVERSE_MOTION_ENABLED_ITEM_NAME, &reversed));
	ASSERT_FALSE(reversed);
	ASSERT_TRUE(hw_wait_settled(focuser, FOCUSER_STEPS_PROPERTY_NAME, INDIGO_OK_STATE, MOVE_TIMEOUT));
	double elapsed = indigo_monotonic_time() - started;
	printf("    the first move took %.2f s, %.2f s expected\n", elapsed, travel / slow_rate);
	// The second request must not have been executed after the first one.
	ASSERT_TRUE(elapsed < 1.4 * travel / slow_rate + 1);
	ASSERT_TRUE(move_by(FOCUSER_DIRECTION_MOVE_INWARD_ITEM_NAME, travel) > 0);
}

// Abort has to stop the rail mid-move, end FOCUSER_STEPS ALERT and leave the driver able to take a
// fresh move. The move back right after the stop must run its full length: a status the controller
// sends after the stop must not be taken for the completion of the next move.
static void wemacro_aborts_a_move(void) {
	ASSERT_TRUE(slow_rate > 0);
	ASSERT_TRUE(set_speed(SLOW_SPEED));
	double started = indigo_monotonic_time();
	ASSERT_TRUE(start_move(FOCUSER_DIRECTION_MOVE_OUTWARD_ITEM_NAME, travel));
	double ran = travel / slow_rate / 2;
	indigo_usleep((unsigned)(ran * 1000000));
	ASSERT_TRUE(hw_set_switch(focuser, FOCUSER_ABORT_MOTION_PROPERTY_NAME, FOCUSER_ABORT_MOTION_ITEM_NAME, INDIGO_OK_STATE, SHORT_TIMEOUT));
	ran = indigo_monotonic_time() - started;
	ASSERT_EQ_INT(INDIGO_ALERT_STATE, hw_property_state(focuser, FOCUSER_STEPS_PROPERTY_NAME));
	bool abort = true;
	ASSERT_TRUE(hw_switch_item(focuser, FOCUSER_ABORT_MOTION_PROPERTY_NAME, FOCUSER_ABORT_MOTION_ITEM_NAME, &abort));
	ASSERT_FALSE(abort);
	// No late completion may turn the aborted move OK.
	indigo_usleep(2000000);
	ASSERT_EQ_INT(INDIGO_ALERT_STATE, hw_property_state(focuser, FOCUSER_STEPS_PROPERTY_NAME));
	double steps = round(ran * slow_rate);
	if (steps > travel) {
		steps = travel;
	}
	double back = move_by(FOCUSER_DIRECTION_MOVE_INWARD_ITEM_NAME, steps);
	printf("    aborted after %.2f s, the move back by %g steps took %.2f s, %.2f s expected\n", ran, steps, back, steps / slow_rate);
	ASSERT_TRUE(back > 0);
	ASSERT_TRUE(back > steps / slow_rate / 2);
}

static void wemacro_accepts_an_abort_while_idle(void) {
	ASSERT_EQ_INT(INDIGO_OK_STATE, hw_property_state(focuser, FOCUSER_STEPS_PROPERTY_NAME));
	ASSERT_TRUE(hw_set_switch(focuser, FOCUSER_ABORT_MOTION_PROPERTY_NAME, FOCUSER_ABORT_MOTION_ITEM_NAME, INDIGO_OK_STATE, SHORT_TIMEOUT));
	ASSERT_EQ_INT(INDIGO_OK_STATE, hw_property_state(focuser, FOCUSER_STEPS_PROPERTY_NAME));
	// The next move has to run its full length.
	double outward = move_by(FOCUSER_DIRECTION_MOVE_OUTWARD_ITEM_NAME, travel / 2);
	ASSERT_TRUE(outward > travel / 2 / slow_rate / 2);
	ASSERT_TRUE(move_by(FOCUSER_DIRECTION_MOVE_INWARD_ITEM_NAME, travel / 2) > 0);
}

static void wemacro_fires_the_shutter(void) {
	ASSERT_TRUE(hw_set_switch(focuser, X_RAIL_SHUTTER_PROPERTY_NAME, X_RAIL_SHUTTER_ITEM_NAME, INDIGO_OK_STATE, SHORT_TIMEOUT));
	bool shutter = true;
	ASSERT_TRUE(hw_switch_item(focuser, X_RAIL_SHUTTER_PROPERTY_NAME, X_RAIL_SHUTTER_ITEM_NAME, &shutter));
	ASSERT_FALSE(shutter);
	// The controller does not answer the shutter command, so the proof it is still in step is that
	// the next move completes with its status.
	ASSERT_TRUE(move_by(FOCUSER_DIRECTION_MOVE_OUTWARD_ITEM_NAME, travel / 4) > 0);
	ASSERT_TRUE(move_by(FOCUSER_DIRECTION_MOVE_INWARD_ITEM_NAME, travel / 4) > 0);
}

static void wemacro_changes_the_rail_configuration(void) {
	ASSERT_TRUE(set_rail_config(true, false));
	ASSERT_TRUE(set_rail_config(false, true));
	ASSERT_TRUE(set_rail_config(true, true));
	ASSERT_TRUE(set_rail_config(false, false));
	// The configuration reaches the controller with the next speed write.
	ASSERT_TRUE(set_speed(FAST_SPEED));
	ASSERT_TRUE(set_speed(SLOW_SPEED));
}

// A batch with return: the controller reports every step and every shot, the remaining count has
// to drop once per position and not once per shot, the requested count has to stay the target, and
// the batch ends OK when the rail is back where it started.
static void wemacro_runs_a_batch_with_return(void) {
	double length = round(travel / 10), count = 3, per_step = 2, value = -1, target = -1;
	ASSERT_TRUE(set_rail_config(true, false));
	unsigned before = hw_revision(focuser, X_RAIL_EXECUTE_PROPERTY_NAME);
	double started = indigo_monotonic_time();
	request_batch(0, per_step, 1, length, count);
	ASSERT_TRUE(hw_wait_state(focuser, X_RAIL_EXECUTE_PROPERTY_NAME, before, INDIGO_BUSY_STATE, SHORT_TIMEOUT));
	// After the first position the count is one lower, and it must not drop again before the
	// second position has had all its shots, one shot interval later.
	ASSERT_TRUE(hw_wait_number(focuser, X_RAIL_EXECUTE_PROPERTY_NAME, X_RAIL_EXECUTE_COUNT_ITEM_NAME, count - 1, 0, BATCH_TIMEOUT));
	double first = indigo_monotonic_time() - started;
	ASSERT_TRUE(hw_wait_number(focuser, X_RAIL_EXECUTE_PROPERTY_NAME, X_RAIL_EXECUTE_COUNT_ITEM_NAME, count - 2, 0, BATCH_TIMEOUT));
	double second = indigo_monotonic_time() - started;
	ASSERT_TRUE(hw_wait_settled(focuser, X_RAIL_EXECUTE_PROPERTY_NAME, INDIGO_OK_STATE, BATCH_TIMEOUT));
	printf("    %g positions %g steps apart, %g shots each, with return took %.2f s, positions done at %.2f s and %.2f s\n", count, length, per_step, indigo_monotonic_time() - started, first, second);
	ASSERT_TRUE(second - first > per_step * 1 - 0.5);
	ASSERT_TRUE(hw_number_item(focuser, X_RAIL_EXECUTE_PROPERTY_NAME, X_RAIL_EXECUTE_COUNT_ITEM_NAME, &value));
	ASSERT_TRUE(hw_number_item_target(focuser, X_RAIL_EXECUTE_PROPERTY_NAME, X_RAIL_EXECUTE_COUNT_ITEM_NAME, &target));
	ASSERT_NEAR(0, value, 0);
	ASSERT_NEAR(count, target, 0);
	ASSERT_TRUE(hw_number_item(focuser, X_RAIL_EXECUTE_PROPERTY_NAME, X_RAIL_EXECUTE_LENGTH_ITEM_NAME, &value));
	ASSERT_NEAR(length, value, 0);
	ASSERT_TRUE(set_rail_config(false, false));
	// The rail is back and the next move has to run as usual.
	ASSERT_TRUE(move_by(FOCUSER_DIRECTION_MOVE_OUTWARD_ITEM_NAME, travel / 4) > 0);
	ASSERT_TRUE(move_by(FOCUSER_DIRECTION_MOVE_INWARD_ITEM_NAME, travel / 4) > 0);
}

// A batch without return of a single shot moves the rail by nothing, so it fires the shutter once
// and ends OK when the controller reports that shot.
static void wemacro_runs_a_batch_without_return(void) {
	double value = -1;
	ASSERT_TRUE(set_rail_config(false, false));
	unsigned before = hw_revision(focuser, X_RAIL_EXECUTE_PROPERTY_NAME);
	request_batch(0, 1, 1, round(travel / 10), 1);
	ASSERT_TRUE(hw_wait_state(focuser, X_RAIL_EXECUTE_PROPERTY_NAME, before, INDIGO_BUSY_STATE, SHORT_TIMEOUT));
	ASSERT_TRUE(hw_wait_settled(focuser, X_RAIL_EXECUTE_PROPERTY_NAME, INDIGO_OK_STATE, BATCH_TIMEOUT));
	ASSERT_TRUE(hw_number_item(focuser, X_RAIL_EXECUTE_PROPERTY_NAME, X_RAIL_EXECUTE_COUNT_ITEM_NAME, &value));
	ASSERT_NEAR(0, value, 0);
	ASSERT_TRUE(move_by(FOCUSER_DIRECTION_MOVE_OUTWARD_ITEM_NAME, travel / 4) > 0);
	ASSERT_TRUE(move_by(FOCUSER_DIRECTION_MOVE_INWARD_ITEM_NAME, travel / 4) > 0);
}

// FOCUSER_ABORT_MOTION also stops a batch, which ends ALERT, and a move is accepted afterwards. The
// batch steps are short, so the rail ends at most a few of them away from where it started.
static void wemacro_aborts_a_batch(void) {
	double length = round(travel / 20), value = -1;
	ASSERT_TRUE(set_rail_config(false, false));
	unsigned before = hw_revision(focuser, X_RAIL_EXECUTE_PROPERTY_NAME);
	request_batch(0, 1, 1, length, 5);
	ASSERT_TRUE(hw_wait_state(focuser, X_RAIL_EXECUTE_PROPERTY_NAME, before, INDIGO_BUSY_STATE, SHORT_TIMEOUT));
	// Abort after the first position, while the rail steps to the second one.
	ASSERT_TRUE(hw_wait_number(focuser, X_RAIL_EXECUTE_PROPERTY_NAME, X_RAIL_EXECUTE_COUNT_ITEM_NAME, 4, 0, BATCH_TIMEOUT));
	indigo_usleep(300000);
	ASSERT_TRUE(hw_set_switch(focuser, FOCUSER_ABORT_MOTION_PROPERTY_NAME, FOCUSER_ABORT_MOTION_ITEM_NAME, INDIGO_OK_STATE, SHORT_TIMEOUT));
	ASSERT_TRUE(hw_wait_settled(focuser, X_RAIL_EXECUTE_PROPERTY_NAME, INDIGO_ALERT_STATE, SHORT_TIMEOUT));
	ASSERT_TRUE(hw_number_item(focuser, X_RAIL_EXECUTE_PROPERTY_NAME, X_RAIL_EXECUTE_COUNT_ITEM_NAME, &value));
	printf("    aborted with %g of 5 shots remaining, %g steps apart\n", value, length);
	ASSERT_TRUE(value > 0 && value < 5);
	indigo_usleep(2000000);
	ASSERT_EQ_INT(INDIGO_ALERT_STATE, hw_property_state(focuser, X_RAIL_EXECUTE_PROPERTY_NAME));
	ASSERT_TRUE(move_by(FOCUSER_DIRECTION_MOVE_OUTWARD_ITEM_NAME, travel / 4) > 0);
	ASSERT_TRUE(move_by(FOCUSER_DIRECTION_MOVE_INWARD_ITEM_NAME, travel / 4) > 0);
}

// Disconnecting while the rail runs has to stop it and tear the connection down cleanly; the driver
// has to come back through its reset sequence and move again afterwards.
static void wemacro_survives_a_disconnect_during_a_move(void) {
	ASSERT_TRUE(slow_rate > 0);
	ASSERT_TRUE(set_speed(SLOW_SPEED));
	double started = indigo_monotonic_time();
	ASSERT_TRUE(start_move(FOCUSER_DIRECTION_MOVE_OUTWARD_ITEM_NAME, travel));
	indigo_usleep((unsigned)(travel / slow_rate / 2 * 1000000));
	ASSERT_TRUE(hw_disconnect(focuser, MOVE_TIMEOUT));
	double ran = indigo_monotonic_time() - started;
	ASSERT_TRUE(hw_property_hidden(focuser, X_RAIL_EXECUTE_PROPERTY_NAME));
	ASSERT_TRUE(hw_property_state(focuser, FOCUSER_STEPS_PROPERTY_NAME) != INDIGO_BUSY_STATE);
	ASSERT_TRUE(hw_connect(focuser, SHORT_TIMEOUT));
	ASSERT_TRUE(hw_property_defined(focuser, X_RAIL_EXECUTE_PROPERTY_NAME));
	ASSERT_TRUE(hw_property_state(focuser, FOCUSER_STEPS_PROPERTY_NAME) != INDIGO_BUSY_STATE);
	ASSERT_TRUE(set_speed(SLOW_SPEED));
	compensate_outward_run(ran, slow_rate);
	ASSERT_EQ_INT(INDIGO_OK_STATE, hw_property_state(focuser, FOCUSER_STEPS_PROPERTY_NAME));
}

static void wemacro_reconnects(void) {
	ASSERT_TRUE(hw_disconnect(focuser, SHORT_TIMEOUT));
	ASSERT_TRUE(hw_property_hidden(focuser, X_RAIL_CONFIG_PROPERTY_NAME));
	ASSERT_TRUE(hw_connect(focuser, SHORT_TIMEOUT));
	ASSERT_TRUE(hw_property_defined(focuser, X_RAIL_CONFIG_PROPERTY_NAME));
	ASSERT_TRUE(move_by(FOCUSER_DIRECTION_MOVE_OUTWARD_ITEM_NAME, travel / 4) > 0);
	ASSERT_TRUE(move_by(FOCUSER_DIRECTION_MOVE_INWARD_ITEM_NAME, travel / 4) > 0);
}

// A full driver teardown and bring-up, which is what a server does when the driver is unloaded and
// loaded again. It has to leave no device behind and find the controller a second time.
static void wemacro_reinitializes(void) {
	ASSERT_TRUE(hw_disconnect(focuser, SHORT_TIMEOUT));
	ASSERT_EQ_INT(INDIGO_OK, indigo_focuser_wemacro(INDIGO_DRIVER_SHUTDOWN, NULL));
	ASSERT_EQ_INT(-1, hw_device_index(DEVICE_NAME));
	ASSERT_EQ_INT(INDIGO_OK, indigo_focuser_wemacro(INDIGO_DRIVER_INIT, NULL));
	focuser = hw_wait_for_device(DEVICE_NAME, SHORT_TIMEOUT);
	ASSERT_TRUE(focuser >= 0);
	ASSERT_TRUE(select_port());
	ASSERT_TRUE(hw_connect(focuser, SHORT_TIMEOUT));
	ASSERT_TRUE(move_by(FOCUSER_DIRECTION_MOVE_OUTWARD_ITEM_NAME, travel / 4) > 0);
	ASSERT_TRUE(move_by(FOCUSER_DIRECTION_MOVE_INWARD_ITEM_NAME, travel / 4) > 0);
}

int main(int argc, char **argv) {
	if (argc < 2 || strcmp(argv[1], "--run")) {
		fprintf(stderr, "Physical WeMacro Rail test: run explicitly with --run (or make test-focuser-wemacro-hw).\n");
		return 2;
	}
	setvbuf(stdout, NULL, _IONBF, 0);
	for (int i = 2; i < argc; i++) {
		if (!strcmp(argv[i], "--debug")) {
			indigo_set_log_level(INDIGO_LOG_DEBUG);
		}
	}
	// X_RAIL_CONFIG is persistent, so the session keeps its configuration out of the user's own folder.
	if (!indigo_test_use_private_home()) {
		return 1;
	}
	serial_port = hw_port("WEMACRO_HW_PORT");
	const char *requested_travel = getenv("WEMACRO_HW_TRAVEL");
	if (requested_travel != NULL && atoi(requested_travel) > 0) {
		travel = atoi(requested_travel);
	}
	const indigo_test_case tests[] = {
		{ "wemacro_reports_identity_and_capabilities", wemacro_reports_identity_and_capabilities },
		{ "wemacro_publishes_the_property_contract", wemacro_publishes_the_property_contract },
		{ "wemacro_moves_relative_in_both_directions", wemacro_moves_relative_in_both_directions },
		{ "wemacro_changes_the_speed", wemacro_changes_the_speed },
		{ "wemacro_reverses_the_motion", wemacro_reverses_the_motion },
		{ "wemacro_refuses_requests_during_a_move", wemacro_refuses_requests_during_a_move },
		{ "wemacro_aborts_a_move", wemacro_aborts_a_move },
		{ "wemacro_accepts_an_abort_while_idle", wemacro_accepts_an_abort_while_idle },
		{ "wemacro_fires_the_shutter", wemacro_fires_the_shutter },
		{ "wemacro_changes_the_rail_configuration", wemacro_changes_the_rail_configuration },
		{ "wemacro_runs_a_batch_with_return", wemacro_runs_a_batch_with_return },
		{ "wemacro_runs_a_batch_without_return", wemacro_runs_a_batch_without_return },
		{ "wemacro_aborts_a_batch", wemacro_aborts_a_batch },
		{ "wemacro_survives_a_disconnect_during_a_move", wemacro_survives_a_disconnect_during_a_move },
		{ "wemacro_reconnects", wemacro_reconnects },
		{ "wemacro_reinitializes", wemacro_reinitializes }
	};
	int result = 1;
	bool started = false, initialized = false;
	HW_CHECK(hw_start() == INDIGO_OK);
	started = true;
	HW_CHECK(hw_attach_client("WeMacro Rail hardware test") == INDIGO_OK);
	HW_CHECK(indigo_focuser_wemacro(INDIGO_DRIVER_INIT, NULL) == INDIGO_OK);
	initialized = true;
	focuser = hw_wait_for_device(DEVICE_NAME, SHORT_TIMEOUT);
	HW_CHECK(focuser >= 0);
	HW_CHECK(select_port());
	HW_CHECK(hw_connect(focuser, SHORT_TIMEOUT));
	HW_CHECK(capture_initial_state());
	printf("Speed %g, travel %g steps\n", initial_speed, travel);
	result = indigo_run_tests("WeMacro Rail hardware", tests, ARRAY_SIZE(tests));
cleanup:
	// Leave the driver settings exactly as the session found them, whatever happened above.
	restore_initial_state();
	if (!hw_disconnect(focuser, MOVE_TIMEOUT)) {
		indigo_test_failures++;
	}
	if (initialized && indigo_focuser_wemacro(INDIGO_DRIVER_SHUTDOWN, NULL) != INDIGO_OK) {
		indigo_test_failures++;
	}
	indigo_detach_client(&hw_client);
	if (started) {
		indigo_stop();
	}
	hw_release_properties();
	indigo_test_remove_private_home();
	return indigo_test_failures ? 1 : result;
}
