// Copyright (c) 2026 INDIGO initiative
// All rights reserved.
//
// You may use this software under the terms of 'INDIGO Astronomy
// open-source license' (see LICENSE.md).
//
// THIS SOFTWARE IS PROVIDED BY THE AUTHORS 'AS IS' AND ANY EXPRESS
// OR IMPLIED WARRANTIES, INCLUDING, BUT NOT LIMITED TO, THE IMPLIED
// WARRANTIES OF MERCHANTABILITY AND FITNESS FOR A PARTICULAR PURPOSE
// ARE DISCLAIMED. IN NO EVENT SHALL THE AUTHOR BE LIABLE FOR ANY
// DIRECT, INDIRECT, INCIDENTAL, SPECIAL, EXEMPLARY, OR CONSEQUENTIAL
// DAMAGES (INCLUDING, BUT NOT LIMITED TO, PROCUREMENT OF SUBSTITUTE
// GOODS OR SERVICES; LOSS OF USE, DATA, OR PROFITS; OR BUSINESS
// INTERRUPTION) HOWEVER CAUSED AND ON ANY THEORY OF LIABILITY,
// WHETHER IN CONTRACT, STRICT LIABILITY, OR TORT (INCLUDING
// NEGLIGENCE OR OTHERWISE) ARISING IN ANY WAY OUT OF THE USE OF THIS
// SOFTWARE, EVEN IF ADVISED OF THE POSSIBILITY OF SUCH DAMAGE.

// Code is generated by AI

// Physical PTP camera (DSLR / mirrorless) acceptance test over USB. Compression, image size,
// shutter and the other camera controls are found by their labels, so the cases skip what the
// connected body does not offer. Every setting a case changes is restored. Images go to a
// private directory only; DSLR_DELETE_IMAGE is switched ON on connect, so the frames the suite
// shoots do not fill the camera card. Hot-plug is not part of this suite.

#include <pthread.h>
#include <math.h>
#include <stdio.h>
#include <stdlib.h>
#include <sys/stat.h>
#include <jpeglib.h>

#include <indigo/indigo_driver.h>
#include <indigo_drivers/ccd_ptp/indigo_ccd_ptp.h>

#include "../test_runner.h"
#include "hardware_device_record.h"

#define MAX_DEVICES 8
#define MAX_PROPERTIES 192
#define CHECK(condition) do { if (!(condition)) { fprintf(stderr, "%s:%d: %s\n", __FILE__, __LINE__, #condition); indigo_test_failures++; goto cleanup; } } while (0)

typedef struct {
	char format[16];
	long size;
	unsigned width, height;
	bool complete, valid;
	double deviation;
} observed_image;

typedef struct {
	char name[INDIGO_NAME_SIZE];
	char driver[INDIGO_NAME_SIZE];
	unsigned interface;
	bool present;
	indigo_property *properties[MAX_PROPERTIES];
	unsigned revisions[MAX_PROPERTIES];
	unsigned images, previews;
	observed_image image, preview;
	char saved_file[INDIGO_VALUE_SIZE];
	unsigned saved_files;
} observed_device;

static observed_device devices[MAX_DEVICES];
static pthread_mutex_t mutex = PTHREAD_MUTEX_INITIALIZER;
static indigo_client client;
static int camera = -1;
static int focuser = -1;
static bool initialized;
static char image_dir[512];

static int device_slot(const char *name) {
	for (int device_index = 0; device_index < MAX_DEVICES; device_index++) {
		if (!*devices[device_index].name || !strcmp(devices[device_index].name, name)) {
			return device_index;
		}
	}
	return -1;
}

// A cleanup path may run without a selected camera (index -1).
static int property_slot(int device_index, const char *name) {
	if (device_index < 0) {
		return -1;
	}
	for (int property_index = 0; property_index < MAX_PROPERTIES; property_index++) {
		if (devices[device_index].properties[property_index] && !strcmp(devices[device_index].properties[property_index]->name, name)) {
			return property_index;
		}
	}
	return -1;
}

// JPEG: complete when it ends with EOI; dimensions and pixel deviation from a full decode, which
// also proves the payload is not truncated. TIFF-based RAW (ARW, NEF, CR2, DNG): byte-order header;
// Fujifilm RAF: its magic.
static void inspect_image(observed_image *image, indigo_item *item) {
	const uint8_t *bytes = item->blob.value;
	long size = item->blob.size;
	memset(image, 0, sizeof(*image));
	snprintf(image->format, sizeof(image->format), "%s", item->blob.format);
	image->size = size;
	if (!strcmp(item->blob.format, ".jpeg")) {
		image->complete = size > 4 && bytes[0] == 0xFF && bytes[1] == 0xD8 && bytes[size - 2] == 0xFF && bytes[size - 1] == 0xD9;
		struct jpeg_decompress_struct info = { 0 };
		struct jpeg_error_mgr errors;
		info.err = jpeg_std_error(&errors);
		jpeg_create_decompress(&info);
		jpeg_mem_src(&info, bytes, size);
		if (image->complete && jpeg_read_header(&info, TRUE) == JPEG_HEADER_OK) {
			info.out_color_space = JCS_GRAYSCALE;
			info.scale_num = 1;
			info.scale_denom = 8;
			jpeg_start_decompress(&info);
			image->width = info.image_width;
			image->height = info.image_height;
			JSAMPARRAY row = (*info.mem->alloc_sarray)((j_common_ptr)&info, JPOOL_IMAGE, info.output_width, 1);
			double sum = 0, squares = 0;
			unsigned long count = 0;
			while (info.output_scanline < info.output_height) {
				jpeg_read_scanlines(&info, row, 1);
				for (unsigned i = 0; i < info.output_width; i++) {
					sum += row[0][i];
					squares += (double)row[0][i] * row[0][i];
					count++;
				}
			}
			jpeg_finish_decompress(&info);
			double mean = count ? sum / count : 0;
			image->deviation = count ? sqrt(fmax(0, squares / count - mean * mean)) : 0;
			image->valid = image->width > 0 && image->height > 0;
		}
		jpeg_destroy_decompress(&info);
	} else if (!strcmp(item->blob.format, ".raw")) {
		indigo_raw_header header = { 0 };
		if (size >= (long)sizeof(header)) {
			memcpy(&header, bytes, sizeof(header));
		}
		unsigned channels = header.signature == INDIGO_RAW_RGB24 ? 3 : header.signature == INDIGO_RAW_MONO16 ? 2 : header.signature == INDIGO_RAW_RGB48 ? 6 : 0;
		image->width = header.width;
		image->height = header.height;
		image->complete = channels && (uint64_t)header.width * header.height * channels + sizeof(header) <= (uint64_t)size;
		image->valid = image->complete && header.width && header.height;
	} else {
		image->complete = size > 16 && ((bytes[0] == 'I' && bytes[1] == 'I' && bytes[2] == 0x2A && bytes[3] == 0) || (bytes[0] == 'M' && bytes[1] == 'M' && bytes[2] == 0 && bytes[3] == 0x2A) || (bytes[0] == 'I' && bytes[1] == 'I' && bytes[2] == 0x55) || !memcmp(bytes, "FUJIFILMCCD-RAW ", 16));
		image->valid = image->complete;
	}
}

static indigo_result observe(indigo_device *device, indigo_property *property, const char *message, bool update) {
	pthread_mutex_lock(&mutex);
	int device_index = device_slot(property->device);
	if (device_index >= 0) {
		observed_device *observed = devices + device_index;
		snprintf(observed->name, INDIGO_NAME_SIZE, "%s", property->device);
		if (!strcmp(property->name, INFO_PROPERTY_NAME)) {
			observed->present = true;
			for (int item_index = 0; item_index < property->count; item_index++) {
				if (!strcmp(property->items[item_index].name, INFO_DEVICE_INTERFACE_ITEM_NAME)) {
					observed->interface = strtoul(property->items[item_index].text.value, NULL, 10);
				} else if (!strcmp(property->items[item_index].name, INFO_DEVICE_DRIVER_ITEM_NAME)) {
					snprintf(observed->driver, INDIGO_NAME_SIZE, "%s", property->items[item_index].text.value);
				}
			}
		}
		int property_index = property_slot(device_index, property->name);
		if (property_index < 0) {
			for (property_index = 0; property_index < MAX_PROPERTIES && observed->properties[property_index]; property_index++) { }
		}
		if (property_index < MAX_PROPERTIES) {
			indigo_release_property(observed->properties[property_index]);
			observed->properties[property_index] = indigo_copy_property(NULL, property);
			observed->revisions[property_index]++;
		}
		if (update && property->state == INDIGO_OK_STATE && property->count && property->items[0].blob.value) {
			if (!strcmp(property->name, CCD_IMAGE_PROPERTY_NAME)) {
				inspect_image(&observed->image, property->items);
				observed->images++;
				printf("    image %u: %s %ld bytes, %u x %u%s%s\n", observed->images, observed->image.format, observed->image.size, observed->image.width, observed->image.height, observed->image.complete ? "" : ", incomplete", observed->image.valid ? "" : ", invalid");
			} else if (!strcmp(property->name, CCD_PREVIEW_IMAGE_PROPERTY_NAME)) {
				inspect_image(&observed->preview, property->items);
				observed->previews++;
			}
		}
		if (update && !strcmp(property->name, CCD_IMAGE_FILE_PROPERTY_NAME) && property->state == INDIGO_OK_STATE && *property->items[0].text.value && strcmp(property->items[0].text.value, observed->saved_file)) {
			snprintf(observed->saved_file, sizeof(observed->saved_file), "%s", property->items[0].text.value);
			observed->saved_files++;
		}
	}
	pthread_mutex_unlock(&mutex);
	if (message && *message) {
		fprintf(stderr, "    %s %s: %s\n", property->device, property->name, message);
	}
	return INDIGO_OK;
}

static indigo_result define_property(indigo_client *client, indigo_device *device, indigo_property *property, const char *message) {
	return observe(device, property, message, false);
}

static indigo_result update_property(indigo_client *client, indigo_device *device, indigo_property *property, const char *message) {
	return observe(device, property, message, true);
}

static indigo_result report_message(indigo_client *client, indigo_device *device, indigo_property *property, const char *message) {
	fprintf(stderr, "    message: %s\n", message ? message : "");
	return INDIGO_OK;
}

static indigo_result delete_property(indigo_client *client, indigo_device *device, indigo_property *property, const char *message) {
	pthread_mutex_lock(&mutex);
	for (int device_index = 0; device_index < MAX_DEVICES; device_index++) {
		if (!strcmp(devices[device_index].name, property->device)) {
			if (!*property->name) {
				devices[device_index].present = false;
			}
			for (int property_index = 0; property_index < MAX_PROPERTIES; property_index++) {
				if (devices[device_index].properties[property_index] && (!*property->name || !strcmp(devices[device_index].properties[property_index]->name, property->name))) {
					indigo_release_property(devices[device_index].properties[property_index]);
					devices[device_index].properties[property_index] = NULL;
				}
			}
		}
	}
	pthread_mutex_unlock(&mutex);
	return INDIGO_OK;
}

static unsigned property_revision(int device_index, const char *name) {
	pthread_mutex_lock(&mutex);
	int property_index = property_slot(device_index, name);
	unsigned result = property_index < 0 ? 0 : devices[device_index].revisions[property_index];
	pthread_mutex_unlock(&mutex);
	return result;
}

static indigo_property *snapshot(int device_index, const char *name) {
	pthread_mutex_lock(&mutex);
	int property_index = property_slot(device_index, name);
	indigo_property *result = property_index < 0 ? NULL : indigo_copy_property(NULL, devices[device_index].properties[property_index]);
	pthread_mutex_unlock(&mutex);
	return result;
}

static bool wait_state(int device_index, const char *name, unsigned after, indigo_property_state state, double timeout) {
	for (int iteration = 0; iteration < timeout * 100; iteration++) {
		pthread_mutex_lock(&mutex);
		int property_index = property_slot(device_index, name);
		bool changed = property_index >= 0 && devices[device_index].revisions[property_index] > after;
		indigo_property_state actual = property_index < 0 ? INDIGO_IDLE_STATE : devices[device_index].properties[property_index]->state;
		pthread_mutex_unlock(&mutex);
		if (changed && actual == state) {
			return true;
		}
		if (changed && actual == INDIGO_ALERT_STATE && state != INDIGO_ALERT_STATE) {
			fprintf(stderr, "Failed: %s %s entered ALERT while waiting for %d\n", devices[device_index].name, name, state);
			return false;
		}
		indigo_usleep(10000);
	}
	fprintf(stderr, "Timeout: %s %s expected state %d\n", devices[device_index].name, name, state);
	return false;
}

static bool change_switch(int device_index, const char *name, const char *item, indigo_property_state state) {
	if (device_index < 0) {
		return false;
	}
	unsigned before = property_revision(device_index, name);
	indigo_change_switch_property_1(&client, devices[device_index].name, name, item, true);
	return wait_state(device_index, name, before, state, 60);
}

static bool change_number(int device_index, const char *name, const char *item, double value, indigo_property_state state, double timeout) {
	if (device_index < 0) {
		return false;
	}
	unsigned before = property_revision(device_index, name);
	indigo_change_number_property_1(&client, devices[device_index].name, name, item, value);
	return wait_state(device_index, name, before, state, timeout);
}

// Item name of the switch item whose label is exactly the given one.
static bool find_label(const char *property_name, const char *label, char *name) {
	indigo_property *property = snapshot(camera, property_name);
	bool found = false;
	for (int i = 0; property && i < property->count && !found; i++) {
		if (!strcmp(property->items[i].label, label)) {
			snprintf(name, INDIGO_NAME_SIZE, "%s", property->items[i].name);
			found = true;
		}
	}
	indigo_release_property(property);
	return found;
}

static bool selected_item(int device_index, const char *property_name, char *name) {
	indigo_property *property = snapshot(device_index, property_name);
	bool found = false;
	for (int i = 0; property && i < property->count && !found; i++) {
		if (property->items[i].sw.value) {
			snprintf(name, INDIGO_NAME_SIZE, "%s", property->items[i].name);
			found = true;
		}
	}
	indigo_release_property(property);
	return found;
}

static bool is_selected(const char *property_name, const char *item_name) {
	indigo_property *property = snapshot(camera, property_name);
	bool result = property && indigo_get_switch(property, item_name);
	indigo_release_property(property);
	return result;
}

// Select by label and confirm by readback; the camera echoes the value through its own events.
static bool select_label(const char *property_name, const char *label) {
	char name[INDIGO_NAME_SIZE];
	if (!find_label(property_name, label, name)) {
		fprintf(stderr, "%s has no item labelled '%s'\n", property_name, label);
		return false;
	}
	if (is_selected(property_name, name)) {
		return true;
	}
	if (!change_switch(camera, property_name, name, INDIGO_OK_STATE)) {
		return false;
	}
	for (int iteration = 0; iteration < 500 && !is_selected(property_name, name); iteration++) {
		indigo_usleep(10000);
	}
	return is_selected(property_name, name);
}

static bool writable(const char *property_name) {
	indigo_property *property = snapshot(camera, property_name);
	bool result = property && property->perm == INDIGO_RW_PERM;
	indigo_release_property(property);
	return result;
}

static bool select_name(const char *property_name, const char *name) {
	if (is_selected(property_name, name)) {
		return true;
	}
	if (!writable(property_name)) {
		fprintf(stderr, "%s is read-only\n", property_name);
		return false;
	}
	// The driver keeps the property BUSY until the camera's own report confirms the value (it may drop
	// an acknowledged write right after a capture), so OK must mean the camera holds it.
	if (!change_switch(camera, property_name, name, INDIGO_OK_STATE)) {
		return false;
	}
	if (!is_selected(property_name, name)) {
		fprintf(stderr, "%s is OK without %s selected\n", property_name, name);
		return false;
	}
	return true;
}

// Compression items carry vendor labels: Sony offers "JPEG" and "RAW+JPEG", Fujifilm "FINE",
// "NORMAL" and "FINE+RAW". JPEG only is "JPEG" or else the first label without RAW, RAW+JPEG is
// "RAW+JPEG" or else the first label combining RAW with another format.
static bool find_compression(bool jpeg, bool raw, char *name) {
	if (find_label(DSLR_COMPRESSION_PROPERTY_NAME, jpeg && raw ? "RAW+JPEG" : jpeg ? "JPEG" : "RAW", name)) {
		return true;
	}
	indigo_property *property = snapshot(camera, DSLR_COMPRESSION_PROPERTY_NAME);
	bool found = false;
	for (int i = 0; property && i < property->count && !found; i++) {
		const char *label = property->items[i].label;
		bool has_raw = strstr(label, "RAW") != NULL;
		if ((jpeg && !raw && !has_raw) || (jpeg && raw && has_raw && strchr(label, '+'))) {
			snprintf(name, INDIGO_NAME_SIZE, "%s", property->items[i].name);
			found = true;
		}
	}
	indigo_release_property(property);
	return found;
}

static bool select_jpeg(void) {
	char name[INDIGO_NAME_SIZE];
	if (!find_compression(true, false, name)) {
		fprintf(stderr, "%s offers no JPEG only item\n", DSLR_COMPRESSION_PROPERTY_NAME);
		return false;
	}
	return select_name(DSLR_COMPRESSION_PROPERTY_NAME, name);
}

static double number_value(int device_index, const char *property_name, int item_index) {
	indigo_property *property = snapshot(device_index, property_name);
	double result = property && property->count > item_index ? property->items[item_index].number.value : NAN;
	indigo_release_property(property);
	return result;
}

static observed_device state_copy(void) {
	pthread_mutex_lock(&mutex);
	observed_device result = devices[camera];
	pthread_mutex_unlock(&mutex);
	memset(result.properties, 0, sizeof(result.properties));
	return result;
}

// One completed exposure must deliver exactly one new, complete main image.
static bool acquire(double duration, double timeout) {
	unsigned before = state_copy().images;
	if (!change_number(camera, CCD_EXPOSURE_PROPERTY_NAME, CCD_EXPOSURE_ITEM_NAME, duration, INDIGO_OK_STATE, timeout)) {
		return false;
	}
	observed_device after = state_copy();
	if (after.images != before + 1 || !after.image.valid) {
		fprintf(stderr, "Expected one valid image, got %u (valid %d)\n", after.images - before, after.image.valid);
		return false;
	}
	return true;
}

// Downloaded test frames are deleted from the camera, so a run does not write them to the card. The
// driver deletes only the objects it has just downloaded.
static bool delete_test_images(void) {
	indigo_property *property = snapshot(camera, DSLR_DELETE_IMAGE_PROPERTY_NAME);
	bool change = property && !property->hidden && property->perm == INDIGO_RW_PERM && !indigo_get_switch(property, DSLR_DELETE_IMAGE_ON_ITEM_NAME);
	indigo_release_property(property);
	return !change || change_switch(camera, DSLR_DELETE_IMAGE_PROPERTY_NAME, DSLR_DELETE_IMAGE_ON_ITEM_NAME, INDIGO_OK_STATE);
}

static bool connect_camera(void) {
	return change_switch(camera, CONNECTION_PROPERTY_NAME, CONNECTION_CONNECTED_ITEM_NAME, INDIGO_OK_STATE) && delete_test_images() && change_switch(camera, CCD_UPLOAD_MODE_PROPERTY_NAME, CCD_UPLOAD_MODE_CLIENT_ITEM_NAME, INDIGO_OK_STATE) && change_switch(camera, CCD_IMAGE_FORMAT_PROPERTY_NAME, CCD_IMAGE_FORMAT_NATIVE_ITEM_NAME, INDIGO_OK_STATE);
}

static bool disconnected(int device_index) {
	pthread_mutex_lock(&mutex);
	bool present = device_index >= 0 && devices[device_index].present;
	int property_index = device_index < 0 ? -1 : property_slot(device_index, CONNECTION_PROPERTY_NAME);
	bool result = !present || property_index < 0 || indigo_get_switch(devices[device_index].properties[property_index], CONNECTION_DISCONNECTED_ITEM_NAME);
	pthread_mutex_unlock(&mutex);
	return result;
}

static bool disconnect_device(int device_index) {
	if (disconnected(device_index)) {
		return true;
	}
	return change_switch(device_index, CONNECTION_PROPERTY_NAME, CONNECTION_DISCONNECTED_ITEM_NAME, INDIGO_OK_STATE);
}

static bool wait_presence(void) {
	for (int iteration = 0; iteration < 3000; iteration++) {
		pthread_mutex_lock(&mutex);
		bool ready = camera >= 0 && devices[camera].present && property_slot(camera, CONNECTION_PROPERTY_NAME) >= 0;
		pthread_mutex_unlock(&mutex);
		if (ready) {
			return true;
		}
		indigo_usleep(10000);
	}
	return false;
}

static bool select_camera(void) {
	const char *requested = getenv("INDIGO_TEST_DEVICE");
	int matches = 0;
	pthread_mutex_lock(&mutex);
	for (int device_index = 0; device_index < MAX_DEVICES; device_index++) {
		if (devices[device_index].present && (devices[device_index].interface & INDIGO_INTERFACE_CCD) && !strcmp(devices[device_index].driver, "indigo_ccd_ptp")) {
			printf("    discovered camera: %s\n", devices[device_index].name);
			if (!requested || !strcmp(requested, devices[device_index].name)) {
				camera = device_index;
				matches++;
			}
		}
	}
	pthread_mutex_unlock(&mutex);
	if (matches != 1) {
		fprintf(stderr, "Expected one matching PTP camera, found %d. Set INDIGO_TEST_DEVICE to an exact discovered name when needed.\n", matches);
		camera = -1;
		return false;
	}
	printf("    selected: %s\n", devices[camera].name);
	return true;
}

static void find_focuser(void) {
	char name[INDIGO_NAME_SIZE];
	snprintf(name, sizeof(name), "%s (focuser)", devices[camera].name);
	pthread_mutex_lock(&mutex);
	focuser = -1;
	for (int device_index = 0; device_index < MAX_DEVICES; device_index++) {
		if (devices[device_index].present && !strcmp(devices[device_index].name, name)) {
			focuser = device_index;
		}
	}
	pthread_mutex_unlock(&mutex);
}

// Settings the suite changes, captured after the first connection and restored at the end. Fujifilm
// control priority comes last: any other write switches the body to PC priority, and only camera
// priority brings back what the camera's own dials select (e.g. Bulb with the shutter dial on B).
static const char *restored_properties[] = { DSLR_COMPRESSION_PROPERTY_NAME, CCD_MODE_PROPERTY_NAME, DSLR_SHUTTER_PROPERTY_NAME, DSLR_ISO_PROPERTY_NAME, DSLR_WHITE_BALANCE_PROPERTY_NAME, DSLR_FOCUS_MODE_PROPERTY_NAME, CCD_PREVIEW_PROPERTY_NAME, "DSLR_ControlPriority" };
static char restored_items[sizeof(restored_properties) / sizeof(restored_properties[0])][INDIGO_NAME_SIZE];

static void remember_settings(void) {
	for (unsigned i = 0; i < sizeof(restored_properties) / sizeof(restored_properties[0]); i++) {
		if (!selected_item(camera, restored_properties[i], restored_items[i])) {
			restored_items[i][0] = 0;
		}
		printf("    initial %s: %s\n", restored_properties[i], restored_items[i]);
	}
}

static bool restore_settings(void) {
	bool result = true;
	bool deferred[sizeof(restored_properties) / sizeof(restored_properties[0])] = { false };
	for (unsigned i = 0; i < sizeof(restored_properties) / sizeof(restored_properties[0]); i++) {
		indigo_property *property = snapshot(camera, restored_properties[i]);
		bool present = property != NULL;
		bool offered = present && *restored_items[i] && indigo_get_item(property, restored_items[i]) != NULL;
		indigo_release_property(property);
		if (*restored_items[i] && !present) {
			fprintf(stderr, "Cannot restore %s: the property is gone\n", restored_properties[i]);
			result = false;
			continue;
		}
		// The camera owns a read-only setting.
		if (!*restored_items[i] || !writable(restored_properties[i])) {
			continue;
		}
		// A value the camera reported but no longer offers (Fujifilm Bulb under PC priority) cannot be
		// written; it must come back with the camera's control priority.
		if (!offered) {
			deferred[i] = true;
			continue;
		}
		if (!select_name(restored_properties[i], restored_items[i])) {
			fprintf(stderr, "Failed to restore %s to %s\n", restored_properties[i], restored_items[i]);
			result = false;
		}
	}
	for (unsigned i = 0; i < sizeof(restored_properties) / sizeof(restored_properties[0]); i++) {
		for (int iteration = 0; deferred[i] && iteration < 500 && !is_selected(restored_properties[i], restored_items[i]); iteration++) {
			indigo_usleep(10000);
		}
		if (deferred[i] && !is_selected(restored_properties[i], restored_items[i])) {
			fprintf(stderr, "%s did not return to %s\n", restored_properties[i], restored_items[i]);
			result = false;
		}
	}
	return result;
}

// Fixed shutter used by the image cases, short enough for a lit or a dark scene. Outside M (or S)
// the camera owns the shutter and DSLR_SHUTTER is read-only; its own choice is used then.
static char fixed_shutter[INDIGO_NAME_SIZE];

static bool use_fixed_shutter(void) {
	if (!writable(DSLR_SHUTTER_PROPERTY_NAME)) {
		return true;
	}
	if (!*fixed_shutter) {
		const char *candidates[] = { "1/100", "1/125", "1/80", "1/60", "1/160", "1/200", "1/250" };
		// Sony labels "1/100", Fujifilm "1/100s".
		for (unsigned i = 0; i < sizeof(candidates) / sizeof(candidates[0]) && !*fixed_shutter; i++) {
			char suffixed[INDIGO_VALUE_SIZE];
			snprintf(suffixed, sizeof(suffixed), "%ss", candidates[i]);
			if (!find_label(DSLR_SHUTTER_PROPERTY_NAME, candidates[i], fixed_shutter)) {
				find_label(DSLR_SHUTTER_PROPERTY_NAME, suffixed, fixed_shutter);
			}
		}
	}
	return *fixed_shutter && select_name(DSLR_SHUTTER_PROPERTY_NAME, fixed_shutter);
}

static void discovery_and_identity(void) {
	CHECK(select_camera());
	CHECK(connect_camera());
	// Remembered first, so a later failure in this case still leaves something to restore.
	remember_settings();
	indigo_property *info = snapshot(camera, INFO_PROPERTY_NAME);
	CHECK(info != NULL);
	const char *model = indigo_get_text_item_value(indigo_get_item(info, INFO_DEVICE_MODEL_ITEM_NAME));
	const char *version = indigo_get_text_item_value(indigo_get_item(info, INFO_DEVICE_FW_REVISION_ITEM_NAME));
	const char *serial = indigo_get_text_item_value(indigo_get_item(info, INFO_DEVICE_SERIAL_NUM_ITEM_NAME));
	printf("    model: %s, firmware: %s, serial: %s\n", model ? model : "", version ? version : "", serial ? serial : "");
	bool identified = model && *model;
	indigo_release_property(info);
	CHECK(identified);
	double width = number_value(camera, CCD_INFO_PROPERTY_NAME, 0), height = number_value(camera, CCD_INFO_PROPERTY_NAME, 1), pixel = number_value(camera, CCD_INFO_PROPERTY_NAME, 4);
	printf("    sensor: %g x %g, pixel %g um\n", width, height, pixel);
	CHECK(width > 0 && height > 0);
	const char *required[] = { CCD_EXPOSURE_PROPERTY_NAME, CCD_ABORT_EXPOSURE_PROPERTY_NAME, CCD_IMAGE_PROPERTY_NAME, CCD_IMAGE_FORMAT_PROPERTY_NAME, CCD_UPLOAD_MODE_PROPERTY_NAME, CCD_STREAMING_PROPERTY_NAME, DSLR_SHUTTER_PROPERTY_NAME, DSLR_COMPRESSION_PROPERTY_NAME };
	for (unsigned i = 0; i < sizeof(required) / sizeof(required[0]); i++) {
		indigo_property *property = snapshot(camera, required[i]);
		if (property == NULL) {
			fprintf(stderr, "Missing %s\n", required[i]);
		}
		bool present = property != NULL;
		indigo_release_property(property);
		CHECK(present);
	}
	indigo_property *compression = snapshot(camera, DSLR_COMPRESSION_PROPERTY_NAME);
	for (int i = 0; compression && i < compression->count; i++) {
		printf("    compression %s: %s\n", compression->items[i].name, compression->items[i].label);
	}
	indigo_release_property(compression);
	find_focuser();
	printf("    focuser: %s\n", focuser >= 0 ? devices[focuser].name : "none");
	char program[INDIGO_NAME_SIZE] = "";
	selected_item(camera, DSLR_PROGRAM_PROPERTY_NAME, program);
	printf("    program: %s, shutter %s\n", program, writable(DSLR_SHUTTER_PROPERTY_NAME) ? "writable" : "read-only");
cleanup:
	return;
}

// Each writable control is moved to another value, read back and put back.
static void control_readback(void) {
	const char *controls[] = { DSLR_ISO_PROPERTY_NAME, DSLR_WHITE_BALANCE_PROPERTY_NAME, DSLR_SHUTTER_PROPERTY_NAME };
	CHECK(camera >= 0);
	for (unsigned i = 0; i < sizeof(controls) / sizeof(controls[0]); i++) {
		indigo_property *property = snapshot(camera, controls[i]);
		if (property == NULL || property->perm != INDIGO_RW_PERM || property->count < 2) {
			printf("    %s is not writable, skipped\n", controls[i]);
			indigo_release_property(property);
			continue;
		}
		char original[INDIGO_NAME_SIZE] = "", other[INDIGO_NAME_SIZE] = "", label[INDIGO_VALUE_SIZE] = "";
		for (int j = 0; j < property->count; j++) {
			if (property->items[j].sw.value) {
				snprintf(original, sizeof(original), "%s", property->items[j].name);
			} else if (!*other && strcmp(property->items[j].name, "+") && strcmp(property->items[j].name, "-") && strcmp(property->items[j].label, "Bulb")) {
				snprintf(other, sizeof(other), "%s", property->items[j].name);
				snprintf(label, sizeof(label), "%s", property->items[j].label);
			}
		}
		indigo_release_property(property);
		printf("    %s: %s -> %s (%s)\n", controls[i], original, other, label);
		CHECK(*original && *other);
		CHECK(select_name(controls[i], other));
		indigo_property *changed = snapshot(camera, controls[i]);
		bool offered = changed && indigo_get_item(changed, original) != NULL;
		indigo_release_property(changed);
		if (!offered) {
			// Fujifilm Bulb from the shutter dial is not writable; restore_settings() brings it back.
			printf("    %s %s is no longer offered, restored at exit\n", controls[i], original);
			continue;
		}
		CHECK(select_name(controls[i], original));
	}
cleanup:
	return;
}

static void jpeg_exposures(void) {
	CHECK(camera >= 0);
	CHECK(select_jpeg());
	CHECK(use_fixed_shutter());
	for (int i = 0; i < 3; i++) {
		CHECK(acquire(0.01, 60));
		observed_device state = state_copy();
		CHECK(!strcmp(state.image.format, ".jpeg") && state.image.complete);
		CHECK(state.image.deviation > 0);
	}
cleanup:
	return;
}

// Every image size must deliver a JPEG of its own, smaller sizes fewer pixels.
static void image_sizes(void) {
	char names[8][INDIGO_NAME_SIZE], labels[8][INDIGO_VALUE_SIZE];
	unsigned long pixels[8] = { 0 };
	int count = 0;
	CHECK(camera >= 0);
	CHECK(select_jpeg());
	CHECK(use_fixed_shutter());
	indigo_property *mode = snapshot(camera, CCD_MODE_PROPERTY_NAME);
	if (mode == NULL || mode->perm != INDIGO_RW_PERM) {
		printf("    image size is not writable, skipped\n");
		indigo_release_property(mode);
		return;
	}
	for (int i = 0; i < mode->count && count < 8; i++, count++) {
		snprintf(names[count], INDIGO_NAME_SIZE, "%s", mode->items[i].name);
		snprintf(labels[count], INDIGO_VALUE_SIZE, "%s", mode->items[i].label);
	}
	indigo_release_property(mode);
	int kept = 0;
	for (int i = 0; i < count; i++) {
		bool selected = select_name(CCD_MODE_PROPERTY_NAME, names[i]);
		printf("    size %s (%s): %s\n", labels[i], names[i], selected ? "kept" : "not kept by the camera");
		kept += selected;
	}
	CHECK(kept == count);
	for (int i = 0; i < count; i++) {
		CHECK(select_name(CCD_MODE_PROPERTY_NAME, names[i]));
		CHECK(acquire(0.01, 60));
		observed_device state = state_copy();
		pixels[i] = (unsigned long)state.image.width * state.image.height;
		printf("    size %s: %u x %u\n", labels[i], state.image.width, state.image.height);
		CHECK(pixels[i] > 0);
	}
	for (int i = 0; i < count; i++) {
		for (int j = 0; j < count; j++) {
			// Labels name the size first (L/M/S); equal labels would compare equal sizes.
			if (labels[i][0] == 'L' && (labels[j][0] == 'M' || labels[j][0] == 'S')) {
				CHECK(pixels[i] > pixels[j]);
			}
			if (labels[i][0] == 'M' && labels[j][0] == 'S') {
				CHECK(pixels[i] > pixels[j]);
			}
		}
	}
cleanup:
	return;
}

static void raw_exposure(void) {
	CHECK(camera >= 0);
	char name[INDIGO_NAME_SIZE];
	if (!find_compression(false, true, name)) {
		printf("    RAW is not offered, skipped\n");
		return;
	}
	CHECK(select_name(DSLR_COMPRESSION_PROPERTY_NAME, name));
	CHECK(use_fixed_shutter());
	for (int i = 0; i < 2; i++) {
		CHECK(acquire(0.01, 120));
		observed_device state = state_copy();
		CHECK(strcmp(state.image.format, ".jpeg") && state.image.complete);
		CHECK(state.image.size > 1000000);
	}
cleanup:
	return;
}

// RAW+JPEG: the RAW is the main image and the JPEG of the same shot the preview, twice in a row.
static void raw_jpeg_with_preview(void) {
	CHECK(camera >= 0);
	char name[INDIGO_NAME_SIZE];
	if (!find_compression(true, true, name)) {
		printf("    RAW+JPEG is not offered, skipped\n");
		return;
	}
	CHECK(select_name(DSLR_COMPRESSION_PROPERTY_NAME, name));
	CHECK(select_name(CCD_PREVIEW_PROPERTY_NAME, CCD_PREVIEW_ENABLED_ITEM_NAME));
	CHECK(use_fixed_shutter());
	for (int i = 0; i < 2; i++) {
		observed_device before = state_copy();
		CHECK(acquire(0.01, 120));
		for (int iteration = 0; iteration < 1000 && state_copy().previews == before.previews; iteration++) {
			indigo_usleep(10000);
		}
		observed_device after = state_copy();
		printf("    preview %s %ld bytes, %u x %u\n", after.preview.format, after.preview.size, after.preview.width, after.preview.height);
		CHECK(strcmp(after.image.format, ".jpeg") && after.image.complete);
		CHECK(after.previews == before.previews + 1);
		CHECK(!strcmp(after.preview.format, ".jpeg") && after.preview.valid);
	}
	// The pair must be fully drained: a following JPEG shot delivers its own single image.
	CHECK(select_name(CCD_PREVIEW_PROPERTY_NAME, CCD_PREVIEW_DISABLED_ITEM_NAME));
	CHECK(select_jpeg());
	CHECK(acquire(0.01, 60));
	CHECK(!strcmp(state_copy().image.format, ".jpeg"));
cleanup:
	select_name(CCD_PREVIEW_PROPERTY_NAME, CCD_PREVIEW_DISABLED_ITEM_NAME);
	return;
}

// The decoded RAW format turns the camera JPEG into an RGB24 image of the same size.
static void decoded_jpeg(void) {
	CHECK(camera >= 0);
	CHECK(select_jpeg());
	CHECK(use_fixed_shutter());
	CHECK(acquire(0.01, 60));
	observed_device native = state_copy();
	CHECK(change_switch(camera, CCD_IMAGE_FORMAT_PROPERTY_NAME, CCD_IMAGE_FORMAT_RAW_ITEM_NAME, INDIGO_OK_STATE));
	CHECK(acquire(0.01, 60));
	observed_device decoded = state_copy();
	printf("    native %u x %u, decoded %s %u x %u\n", native.image.width, native.image.height, decoded.image.format, decoded.image.width, decoded.image.height);
	CHECK(!strcmp(decoded.image.format, ".raw") && decoded.image.valid);
	CHECK(decoded.image.width == native.image.width && decoded.image.height == native.image.height);
cleanup:
	change_switch(camera, CCD_IMAGE_FORMAT_PROPERTY_NAME, CCD_IMAGE_FORMAT_NATIVE_ITEM_NAME, INDIGO_OK_STATE);
	return;
}

// Upload BOTH saves the native file next to the client copy; the file must hold exactly the BLOB.
static void local_save(void) {
	CHECK(camera >= 0);
	CHECK(select_jpeg());
	CHECK(use_fixed_shutter());
	unsigned before = property_revision(camera, CCD_LOCAL_MODE_PROPERTY_NAME);
	indigo_change_text_property_1_raw(&client, devices[camera].name, CCD_LOCAL_MODE_PROPERTY_NAME, CCD_LOCAL_MODE_DIR_ITEM_NAME, image_dir);
	CHECK(wait_state(camera, CCD_LOCAL_MODE_PROPERTY_NAME, before, INDIGO_OK_STATE, 10));
	CHECK(change_switch(camera, CCD_UPLOAD_MODE_PROPERTY_NAME, CCD_UPLOAD_MODE_BOTH_ITEM_NAME, INDIGO_OK_STATE));
	unsigned files = state_copy().saved_files;
	CHECK(acquire(0.01, 60));
	for (int iteration = 0; iteration < 500 && state_copy().saved_files == files; iteration++) {
		indigo_usleep(10000);
	}
	observed_device state = state_copy();
	struct stat file_info = { 0 };
	bool saved = state.saved_files == files + 1 && !stat(state.saved_file, &file_info);
	printf("    saved %s, %lld bytes, BLOB %ld bytes\n", state.saved_file, (long long)file_info.st_size, state.image.size);
	if (saved) {
		remove(state.saved_file);
	}
	CHECK(saved);
	CHECK(file_info.st_size == state.image.size);
	CHECK(strncmp(state.saved_file, image_dir, strlen(image_dir)) == 0);
cleanup:
	change_switch(camera, CCD_UPLOAD_MODE_PROPERTY_NAME, CCD_UPLOAD_MODE_CLIENT_ITEM_NAME, INDIGO_OK_STATE);
	return;
}

// BULB timing as seen on the bus: completion not before the requested duration.
static void bulb_exposures(void) {
	CHECK(camera >= 0);
	char bulb[INDIGO_NAME_SIZE];
	if (!find_label(DSLR_SHUTTER_PROPERTY_NAME, "Bulb", bulb)) {
		printf("    Bulb is not offered (mode dial not in M, or no USB BULB), skipped\n");
		return;
	}
	CHECK(select_jpeg());
	CHECK(select_name(DSLR_SHUTTER_PROPERTY_NAME, bulb));
	double durations[] = { 1.25, 2.5 };
	for (unsigned i = 0; i < sizeof(durations) / sizeof(durations[0]); i++) {
		double started = indigo_monotonic_time();
		CHECK(acquire(durations[i], durations[i] + 60));
		double elapsed = indigo_monotonic_time() - started;
		printf("    bulb %g s completed after %.3f s\n", durations[i], elapsed);
		CHECK(elapsed >= durations[i]);
	}
cleanup:
	return;
}

static void abort_and_reacquire(void) {
	CHECK(camera >= 0);
	char bulb[INDIGO_NAME_SIZE];
	CHECK(select_jpeg());
	bool has_bulb = find_label(DSLR_SHUTTER_PROPERTY_NAME, "Bulb", bulb);
	if (has_bulb) {
		CHECK(select_name(DSLR_SHUTTER_PROPERTY_NAME, bulb));
	} else {
		CHECK(use_fixed_shutter());
	}
	unsigned images = state_copy().images;
	unsigned revision = property_revision(camera, CCD_EXPOSURE_PROPERTY_NAME);
	indigo_change_number_property_1(&client, devices[camera].name, CCD_EXPOSURE_PROPERTY_NAME, CCD_EXPOSURE_ITEM_NAME, 10);
	CHECK(wait_state(camera, CCD_EXPOSURE_PROPERTY_NAME, revision, INDIGO_BUSY_STATE, 10));
	indigo_usleep(2000000);
	revision = property_revision(camera, CCD_EXPOSURE_PROPERTY_NAME);
	double started = indigo_monotonic_time();
	indigo_change_switch_property_1(&client, devices[camera].name, CCD_ABORT_EXPOSURE_PROPERTY_NAME, CCD_ABORT_EXPOSURE_ITEM_NAME, true);
	if (has_bulb) {
		CHECK(wait_state(camera, CCD_EXPOSURE_PROPERTY_NAME, revision, INDIGO_ALERT_STATE, 30));
	} else {
		// Without BULB the camera's own shutter ends the frame, possibly before the abort arrives.
		indigo_property_state state = INDIGO_BUSY_STATE;
		for (int iteration = 0; iteration < 3000 && state == INDIGO_BUSY_STATE; iteration++) {
			indigo_property *exposure = snapshot(camera, CCD_EXPOSURE_PROPERTY_NAME);
			state = exposure ? exposure->state : INDIGO_ALERT_STATE;
			indigo_release_property(exposure);
			if (state == INDIGO_BUSY_STATE) {
				indigo_usleep(10000);
			}
		}
		printf("    timed exposure %s\n", state == INDIGO_OK_STATE ? "completed before the abort" : state == INDIGO_ALERT_STATE ? "aborted" : "still busy");
		CHECK(state == INDIGO_OK_STATE || state == INDIGO_ALERT_STATE);
	}
	printf("    abort completed after %.3f s\n", indigo_monotonic_time() - started);
	// A BULB abort closes the shutter, and the camera may still store and hand over that frame.
	indigo_usleep(5000000);
	unsigned late = state_copy().images - images;
	printf("    images after abort: %u\n", late);
	CHECK(late <= 1);
	CHECK(use_fixed_shutter());
	CHECK(acquire(0.01, 60));
	CHECK(!strcmp(state_copy().image.format, ".jpeg"));
cleanup:
	return;
}

static void finite_liveview(void) {
	CHECK(camera >= 0);
	CHECK(use_fixed_shutter());
	unsigned before = state_copy().images;
	unsigned revision = property_revision(camera, CCD_STREAMING_PROPERTY_NAME);
	double started = indigo_monotonic_time();
	indigo_change_number_property(&client, devices[camera].name, CCD_STREAMING_PROPERTY_NAME, 2, (const char *[]){ CCD_STREAMING_EXPOSURE_ITEM_NAME, CCD_STREAMING_COUNT_ITEM_NAME }, (double []){ 0.01, 5 });
	CHECK(wait_state(camera, CCD_STREAMING_PROPERTY_NAME, revision, INDIGO_OK_STATE, 60));
	observed_device state = state_copy();
	printf("    5 live view frames in %.3f s, last %u x %u\n", indigo_monotonic_time() - started, state.image.width, state.image.height);
	CHECK(state.images == before + 5);
	CHECK(!strcmp(state.image.format, ".jpeg") && state.image.valid);
	CHECK(number_value(camera, CCD_STREAMING_PROPERTY_NAME, 1) == 0);
cleanup:
	return;
}

static void indefinite_liveview_abort_and_restart(void) {
	CHECK(camera >= 0);
	CHECK(use_fixed_shutter());
	unsigned before = state_copy().images;
	unsigned revision = property_revision(camera, CCD_STREAMING_PROPERTY_NAME);
	indigo_change_number_property(&client, devices[camera].name, CCD_STREAMING_PROPERTY_NAME, 2, (const char *[]){ CCD_STREAMING_EXPOSURE_ITEM_NAME, CCD_STREAMING_COUNT_ITEM_NAME }, (double []){ 0.01, -1 });
	CHECK(wait_state(camera, CCD_STREAMING_PROPERTY_NAME, revision, INDIGO_BUSY_STATE, 10));
	double started = indigo_monotonic_time();
	for (int iteration = 0; iteration < 6000 && state_copy().images < before + 30; iteration++) {
		indigo_usleep(10000);
	}
	double elapsed = indigo_monotonic_time() - started;
	unsigned frames = state_copy().images - before;
	printf("    indefinite live view: %u frames in %.3f s\n", frames, elapsed);
	CHECK(frames >= 30);
	revision = property_revision(camera, CCD_STREAMING_PROPERTY_NAME);
	indigo_change_switch_property_1(&client, devices[camera].name, CCD_ABORT_EXPOSURE_PROPERTY_NAME, CCD_ABORT_EXPOSURE_ITEM_NAME, true);
	CHECK(wait_state(camera, CCD_STREAMING_PROPERTY_NAME, revision, INDIGO_OK_STATE, 30) || wait_state(camera, CCD_STREAMING_PROPERTY_NAME, revision, INDIGO_ALERT_STATE, 1));
	indigo_usleep(1000000);
	unsigned stopped = state_copy().images;
	indigo_usleep(2000000);
	CHECK(state_copy().images == stopped);
	CHECK(state_copy().image.valid);
	before = state_copy().images;
	revision = property_revision(camera, CCD_STREAMING_PROPERTY_NAME);
	indigo_change_number_property(&client, devices[camera].name, CCD_STREAMING_PROPERTY_NAME, 2, (const char *[]){ CCD_STREAMING_EXPOSURE_ITEM_NAME, CCD_STREAMING_COUNT_ITEM_NAME }, (double []){ 0.01, 2 });
	CHECK(wait_state(camera, CCD_STREAMING_PROPERTY_NAME, revision, INDIGO_OK_STATE, 60));
	CHECK(state_copy().images == before + 2);
	CHECK(acquire(0.01, 60));
cleanup:
	return;
}

// Relative lens focus through the logical focuser, in manual focus (the camera answers DeviceBusy
// to focus steps in AF-S). A state machine check only: lens travel is not observable here.
static void lens_focuser(void) {
	CHECK(camera >= 0);
	find_focuser();
	if (focuser < 0) {
		printf("    no focuser device, skipped\n");
		return;
	}
	char manual[INDIGO_NAME_SIZE] = "1";
	indigo_property *focus_mode = snapshot(camera, DSLR_FOCUS_MODE_PROPERTY_NAME);
	bool has_manual = focus_mode && indigo_get_item(focus_mode, manual) && focus_mode->perm == INDIGO_RW_PERM;
	printf("    focus mode %s: %s\n", manual, has_manual ? indigo_get_item(focus_mode, manual)->label : "not offered");
	indigo_release_property(focus_mode);
	if (has_manual) {
		CHECK(select_name(DSLR_FOCUS_MODE_PROPERTY_NAME, manual));
	}
	CHECK(change_switch(focuser, CONNECTION_PROPERTY_NAME, CONNECTION_CONNECTED_ITEM_NAME, INDIGO_OK_STATE));
	CHECK(change_switch(focuser, FOCUSER_DIRECTION_PROPERTY_NAME, FOCUSER_DIRECTION_MOVE_INWARD_ITEM_NAME, INDIGO_OK_STATE));
	CHECK(change_number(focuser, FOCUSER_STEPS_PROPERTY_NAME, FOCUSER_STEPS_ITEM_NAME, 3, INDIGO_OK_STATE, 60));
	CHECK(change_switch(focuser, FOCUSER_DIRECTION_PROPERTY_NAME, FOCUSER_DIRECTION_MOVE_OUTWARD_ITEM_NAME, INDIGO_OK_STATE));
	CHECK(change_number(focuser, FOCUSER_STEPS_PROPERTY_NAME, FOCUSER_STEPS_ITEM_NAME, 3, INDIGO_OK_STATE, 60));
	CHECK(disconnect_device(focuser));
	CHECK(use_fixed_shutter());
	CHECK(acquire(0.01, 60));
cleanup:
	if (focuser >= 0) {
		disconnect_device(focuser);
	}
	return;
}

static void reconnect(void) {
	CHECK(camera >= 0);
	for (int i = 0; i < 3; i++) {
		CHECK(disconnect_device(camera));
		CHECK(connect_camera());
		CHECK(use_fixed_shutter());
		CHECK(acquire(0.01, 60));
	}
cleanup:
	return;
}

// Restores the initial settings before the driver is shut down, so the last case leaves the camera
// as it was found.
static void shutdown_and_reinit(void) {
	CHECK(camera >= 0);
	CHECK(restore_settings());
	CHECK(indigo_ccd_ptp(INDIGO_DRIVER_SHUTDOWN, NULL) == INDIGO_BUSY);
	CHECK(disconnect_device(camera));
	CHECK(indigo_ccd_ptp(INDIGO_DRIVER_SHUTDOWN, NULL) == INDIGO_OK);
	initialized = false;
	CHECK(indigo_ccd_ptp(INDIGO_DRIVER_INIT, NULL) == INDIGO_OK);
	initialized = true;
	CHECK(wait_presence());
	CHECK(connect_camera());
	CHECK(use_fixed_shutter());
	CHECK(acquire(0.01, 60));
	CHECK(restore_settings());
cleanup:
	return;
}

int main(int argc, char **argv) {
	if (argc != 2 || strcmp(argv[1], "--run")) {
		fprintf(stderr, "Physical PTP camera test: run explicitly with --run (or make test-ccd-ptp-hw).\n");
		return 2;
	}
	setvbuf(stdout, NULL, _IONBF, 0);
	indigo_test_use_private_home();
	snprintf(image_dir, sizeof(image_dir), "%s/ptp-images/", getenv("HOME") ? getenv("HOME") : "/tmp");
	mkdir(image_dir, 0700);
	if (getenv("INDIGO_TEST_DEBUG")) {
		indigo_set_log_level(INDIGO_LOG_DEBUG);
	}
	client = (indigo_client){ .name = "PTP hardware test", .version = INDIGO_VERSION_CURRENT, .define_property = define_property, .update_property = update_property, .delete_property = delete_property, .send_message = report_message };
	const indigo_test_case tests[] = {
		{ "Discovery and identity", discovery_and_identity },
		{ "Control readback", control_readback },
		{ "JPEG exposures", jpeg_exposures },
		{ "Image sizes", image_sizes },
		{ "RAW exposure", raw_exposure },
		{ "RAW+JPEG with preview", raw_jpeg_with_preview },
		{ "Decoded JPEG", decoded_jpeg },
		{ "Local save", local_save },
		{ "Bulb exposures", bulb_exposures },
		{ "Abort and reacquire", abort_and_reacquire },
		{ "Finite live view", finite_liveview },
		{ "Indefinite live view, abort and restart", indefinite_liveview_abort_and_restart },
		{ "Lens focuser", lens_focuser },
		{ "Reconnect", reconnect },
		{ "Shutdown and reinit", shutdown_and_reinit }
	};
	int result = 1;
	if (hw_start() == INDIGO_OK && indigo_attach_client(&client) == INDIGO_OK && indigo_ccd_ptp(INDIGO_DRIVER_INIT, NULL) == INDIGO_OK) {
		initialized = true;
		// USB enumeration runs on the hot-plug thread; give it time to attach the camera.
		for (int iteration = 0; iteration < 300; iteration++) {
			indigo_usleep(10000);
		}
		result = indigo_run_tests("PTP hardware", tests, (int)(sizeof(tests) / sizeof(tests[0])));
	} else {
		fprintf(stderr, "Driver initialization failed\n");
	}
	// Leave the camera as it was found even when a case ended disconnected or after a reinit.
	if (camera >= 0 && initialized && wait_presence() && (!disconnected(camera) || connect_camera())) {
		indigo_change_switch_property_1(&client, devices[camera].name, CCD_ABORT_EXPOSURE_PROPERTY_NAME, CCD_ABORT_EXPOSURE_ITEM_NAME, true);
		if (!restore_settings()) {
			fprintf(stderr, "Camera settings were not fully restored\n");
			result = 1;
		}
		disconnect_device(focuser);
		disconnect_device(camera);
	}
	if (initialized) {
		indigo_ccd_ptp(INDIGO_DRIVER_SHUTDOWN, NULL);
	}
	indigo_detach_client(&client);
	indigo_stop();
	for (int device_index = 0; device_index < MAX_DEVICES; device_index++) {
		for (int property_index = 0; property_index < MAX_PROPERTIES; property_index++) {
			indigo_release_property(devices[device_index].properties[property_index]);
		}
	}
	rmdir(image_dir);
	indigo_test_remove_private_home();
	return result;
}
