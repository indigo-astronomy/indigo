// Copyright (c) 2026 INDIGO initiative
// All rights reserved.
//
// You may use this software under the terms of 'INDIGO Astronomy
// open-source license' (see LICENSE.md).
//
// THIS SOFTWARE IS PROVIDED BY THE AUTHORS 'AS IS' AND ANY EXPRESS
// OR IMPLIED WARRANTIES, INCLUDING, BUT NOT LIMITED TO, THE IMPLIED
// WARRANTIES OF MERCHANTABILITY AND FITNESS FOR A PARTICULAR PURPOSE
// ARE DISCLAIMED. IN NO EVENT SHALL THE AUTHOR BE LIABLE FOR ANY
// DIRECT, INDIRECT, INCIDENTAL, SPECIAL, EXEMPLARY, OR CONSEQUENTIAL
// DAMAGES (INCLUDING, BUT NOT LIMITED TO, PROCUREMENT OF SUBSTITUTE
// GOODS OR SERVICES; LOSS OF USE, DATA, OR PROFITS; OR BUSINESS
// INTERRUPTION) HOWEVER CAUSED AND ON ANY THEORY OF LIABILITY,
// WHETHER IN CONTRACT, STRICT LIABILITY, OR TORT (INCLUDING
// NEGLIGENCE OR OTHERWISE) ARISING IN ANY WAY OUT OF THE USE OF THIS
// SOFTWARE, EVEN IF ADVISED OF THE POSSIBILITY OF SUCH DAMAGE.

// Code is generated by AI

// Opt-in acceptance test for a physically connected Rigel Systems nSTEP, or for the Arduino sketch
// focuser_nstep_simulator.ino running on a board. The position is read-only, so every move is relative: the suite
// checks the values read at the connection, moves by steps both ways in every stepping mode, aborts a move,
// refuses a setting during a move, writes and reads back the speed, backlash, compensation and phase wiring
// (kept over a reconnect), switches the compensation mode, reconnects and runs driver INIT/SHUTDOWN.
//
// THE FOCUSER MOVES. The session writes back the settings it found and steps back to the position it found.
// The phase wiring is changed only for the readback; no move runs with another wiring.
//
// The port comes from NSTEP_HW_PORT.

#include <math.h>
#include <stdlib.h>
#include <indigo_drivers/focuser_nstep/indigo_focuser_nstep.h>
#include "focuser_hw_common.h"

#define DEVICE_NAME "nSTEP"

#define SHORT_TIMEOUT 15.0
#define MOVE_TIMEOUT 120.0

static int focuser = -1;
static const char *serial_port = NULL;
static bool state_captured = false, temperature_present = false;
static double initial_position = 0, initial_speed = 0, initial_backlash = 0, initial_compensation = 0;
static const char *initial_wiring = "0";

static bool select_port(void) {
	if (serial_port == NULL || !*serial_port) {
		fprintf(stderr, "    set NSTEP_HW_PORT to the focuser's port\n");
		return false;
	}
	printf("Using port %s\n", serial_port);
	return hw_set_text(focuser, DEVICE_PORT_PROPERTY_NAME, DEVICE_PORT_ITEM_NAME, serial_port, INDIGO_OK_STATE, SHORT_TIMEOUT);
}

static bool set_number(const char *property, const char *item, double value) {
	return focuser_hw_set_number(focuser, property, item, value, INDIGO_OK_STATE, SHORT_TIMEOUT) && focuser_hw_value(focuser, property, item) == value;
}

static double value(const char *property, const char *item) {
	return focuser_hw_value(focuser, property, item);
}

static bool wait_defined(const char *name, bool defined, double timeout) {
	double deadline = indigo_monotonic_time() + timeout;
	while (indigo_monotonic_time() < deadline) {
		if (hw_property_defined(focuser, name) == defined) {
			return true;
		}
		indigo_usleep(10000);
	}
	fprintf(stderr, "    timeout: %s is %s\n", name, defined ? "not defined" : "still defined");
	return false;
}

// Steps back to a position with relative moves of at most 999 steps.
static bool return_to(double position) {
	for (int i = 0; i < 100; i++) {
		double difference = position - focuser_hw_position(focuser);
		if (difference == 0) {
			return true;
		}
		double steps = fabs(difference) > 999 ? 999 : fabs(difference);
		if (!focuser_hw_steps(focuser, difference > 0, steps, INDIGO_OK_STATE, MOVE_TIMEOUT)) {
			return false;
		}
	}
	return false;
}

static void restore_initial_state(void) {
	if (focuser < 0 || !state_captured || !hw_connected(focuser)) {
		return;
	}
	if (temperature_present && !focuser_hw_switch_is(focuser, FOCUSER_MODE_PROPERTY_NAME, FOCUSER_MODE_MANUAL_ITEM_NAME)) {
		focuser_hw_set_switch(focuser, FOCUSER_MODE_PROPERTY_NAME, FOCUSER_MODE_MANUAL_ITEM_NAME, SHORT_TIMEOUT);
	}
	focuser_hw_idle(focuser, FOCUSER_STEPS_PROPERTY_NAME, MOVE_TIMEOUT);
	focuser_hw_set_switch(focuser, "X_FOCUSER_PHASE_WIRING", initial_wiring, SHORT_TIMEOUT);
	focuser_hw_set_switch(focuser, "X_FOCUSER_STEPPING_MODE", "FULL", SHORT_TIMEOUT);
	return_to(initial_position);
	set_number(FOCUSER_BACKLASH_PROPERTY_NAME, FOCUSER_BACKLASH_ITEM_NAME, initial_backlash);
	if (temperature_present) {
		set_number(FOCUSER_COMPENSATION_PROPERTY_NAME, FOCUSER_COMPENSATION_ITEM_NAME, initial_compensation);
	}
	set_number(FOCUSER_SPEED_PROPERTY_NAME, FOCUSER_SPEED_ITEM_NAME, initial_speed);
}

static void nstep_publishes_the_values(void) {
	char model[INDIGO_VALUE_SIZE] = "";
	ASSERT_TRUE((hw_device_interface(focuser) & INDIGO_INTERFACE_FOCUSER) != 0);
	ASSERT_TRUE(hw_text_item(focuser, INFO_PROPERTY_NAME, INFO_DEVICE_MODEL_ITEM_NAME, model, sizeof(model)));
	ASSERT_TRUE(!strcmp(model, "Rigel Systems nSTEP"));
	ASSERT_TRUE(initial_speed >= 1 && initial_speed <= 254);
	ASSERT_TRUE(initial_backlash >= 0 && initial_backlash <= 999);
	ASSERT_TRUE(hw_property_defined(focuser, "X_FOCUSER_STEPPING_MODE"));
	ASSERT_TRUE(hw_property_defined(focuser, "X_FOCUSER_PHASE_WIRING"));
	if (temperature_present) {
		double temperature = value(FOCUSER_TEMPERATURE_PROPERTY_NAME, FOCUSER_TEMPERATURE_ITEM_NAME);
		printf("    position %g, speed %g, backlash %g, compensation %g, wiring %s, %.1f C\n", initial_position, initial_speed, initial_backlash, initial_compensation, initial_wiring, temperature);
		ASSERT_TRUE(temperature > -50 && temperature < 50);
		ASSERT_EQ_INT(INDIGO_OK_STATE, hw_property_state(focuser, FOCUSER_TEMPERATURE_PROPERTY_NAME));
		ASSERT_TRUE(!hw_property_hidden(focuser, FOCUSER_COMPENSATION_PROPERTY_NAME));
		ASSERT_TRUE(!hw_property_hidden(focuser, FOCUSER_MODE_PROPERTY_NAME));
	} else {
		printf("    position %g, speed %g, backlash %g, wiring %s, no temperature probe\n", initial_position, initial_speed, initial_backlash, initial_wiring);
		ASSERT_TRUE(hw_property_hidden(focuser, FOCUSER_COMPENSATION_PROPERTY_NAME));
	}
}

// An outward move increases the position; a move ends at its target and the position target follows it.
static void nstep_moves_by_steps(void) {
	double base = focuser_hw_position(focuser);
	ASSERT_TRUE(focuser_hw_steps(focuser, true, 250, INDIGO_OK_STATE, MOVE_TIMEOUT));
	ASSERT_EQ_INT((int)base + 250, (int)focuser_hw_position(focuser));
	ASSERT_EQ_INT((int)base + 250, (int)value(FOCUSER_POSITION_PROPERTY_NAME, FOCUSER_POSITION_ITEM_NAME));
	ASSERT_TRUE(focuser_hw_steps(focuser, false, 999, INDIGO_OK_STATE, MOVE_TIMEOUT));
	ASSERT_EQ_INT((int)base - 749, (int)focuser_hw_position(focuser));
	ASSERT_TRUE(focuser_hw_steps(focuser, true, 749, INDIGO_OK_STATE, MOVE_TIMEOUT));
	ASSERT_EQ_INT((int)base, (int)focuser_hw_position(focuser));
	ASSERT_TRUE(focuser_hw_steps(focuser, true, 0, INDIGO_OK_STATE, SHORT_TIMEOUT));
	ASSERT_EQ_INT((int)base, (int)focuser_hw_position(focuser));
}

static void nstep_moves_in_every_stepping_mode(void) {
	static const char *modes[] = { "WAVE", "HALF", "FULL" };
	double base = focuser_hw_position(focuser);
	for (int i = 0; i < 3; i++) {
		ASSERT_TRUE(focuser_hw_set_switch(focuser, "X_FOCUSER_STEPPING_MODE", modes[i], SHORT_TIMEOUT));
		ASSERT_TRUE(focuser_hw_steps(focuser, true, 40, INDIGO_OK_STATE, MOVE_TIMEOUT));
		ASSERT_EQ_INT((int)base + 40, (int)focuser_hw_position(focuser));
		ASSERT_TRUE(focuser_hw_steps(focuser, false, 40, INDIGO_OK_STATE, MOVE_TIMEOUT));
		ASSERT_EQ_INT((int)base, (int)focuser_hw_position(focuser));
	}
}

// An aborted move ends ALERT at the position where it stopped, and the motor stays there.
static void nstep_aborts_a_move(void) {
	double base = focuser_hw_position(focuser);
	unsigned before = hw_revision(focuser, FOCUSER_STEPS_PROPERTY_NAME);
	ASSERT_TRUE(hw_set_switch(focuser, FOCUSER_DIRECTION_PROPERTY_NAME, FOCUSER_DIRECTION_MOVE_OUTWARD_ITEM_NAME, INDIGO_OK_STATE, SHORT_TIMEOUT));
	hw_request_number(focuser, FOCUSER_STEPS_PROPERTY_NAME, FOCUSER_STEPS_ITEM_NAME, 999);
	ASSERT_TRUE(hw_wait_state(focuser, FOCUSER_STEPS_PROPERTY_NAME, before, INDIGO_BUSY_STATE, SHORT_TIMEOUT));
	indigo_usleep(2000000);
	ASSERT_TRUE(focuser_hw_abort(focuser, SHORT_TIMEOUT));
	ASSERT_TRUE(focuser_hw_idle(focuser, FOCUSER_STEPS_PROPERTY_NAME, SHORT_TIMEOUT));
	ASSERT_EQ_INT(INDIGO_ALERT_STATE, hw_property_state(focuser, FOCUSER_STEPS_PROPERTY_NAME));
	ASSERT_EQ_INT(INDIGO_ALERT_STATE, hw_property_state(focuser, FOCUSER_POSITION_PROPERTY_NAME));
	double stopped = focuser_hw_position(focuser);
	printf("    stopped at %g on the way from %g to %g\n", stopped, base, base + 999);
	ASSERT_TRUE(stopped > base && stopped < base + 999);
	ASSERT_EQ_INT((int)stopped, (int)value(FOCUSER_POSITION_PROPERTY_NAME, FOCUSER_POSITION_ITEM_NAME));
	indigo_usleep(1500000);
	ASSERT_EQ_INT((int)stopped, (int)focuser_hw_position(focuser));
	ASSERT_TRUE(return_to(base));
}

// A setting requested during a move is refused and keeps the device value.
static void nstep_refuses_settings_during_a_move(void) {
	double speed = value(FOCUSER_SPEED_PROPERTY_NAME, FOCUSER_SPEED_ITEM_NAME);
	double backlash = value(FOCUSER_BACKLASH_PROPERTY_NAME, FOCUSER_BACKLASH_ITEM_NAME);
	unsigned before = hw_revision(focuser, FOCUSER_STEPS_PROPERTY_NAME);
	ASSERT_TRUE(hw_set_switch(focuser, FOCUSER_DIRECTION_PROPERTY_NAME, FOCUSER_DIRECTION_MOVE_OUTWARD_ITEM_NAME, INDIGO_OK_STATE, SHORT_TIMEOUT));
	hw_request_number(focuser, FOCUSER_STEPS_PROPERTY_NAME, FOCUSER_STEPS_ITEM_NAME, 300);
	ASSERT_TRUE(hw_wait_state(focuser, FOCUSER_STEPS_PROPERTY_NAME, before, INDIGO_BUSY_STATE, SHORT_TIMEOUT));
	ASSERT_TRUE(focuser_hw_set_number(focuser, FOCUSER_SPEED_PROPERTY_NAME, FOCUSER_SPEED_ITEM_NAME, speed == 60 ? 61 : 60, INDIGO_ALERT_STATE, SHORT_TIMEOUT));
	ASSERT_TRUE(focuser_hw_set_number(focuser, FOCUSER_BACKLASH_PROPERTY_NAME, FOCUSER_BACKLASH_ITEM_NAME, backlash == 7 ? 8 : 7, INDIGO_ALERT_STATE, SHORT_TIMEOUT));
	ASSERT_EQ_INT((int)speed, (int)value(FOCUSER_SPEED_PROPERTY_NAME, FOCUSER_SPEED_ITEM_NAME));
	ASSERT_EQ_INT((int)backlash, (int)value(FOCUSER_BACKLASH_PROPERTY_NAME, FOCUSER_BACKLASH_ITEM_NAME));
	ASSERT_TRUE(focuser_hw_idle(focuser, FOCUSER_STEPS_PROPERTY_NAME, MOVE_TIMEOUT));
	ASSERT_EQ_INT(INDIGO_OK_STATE, hw_property_state(focuser, FOCUSER_STEPS_PROPERTY_NAME));
	ASSERT_TRUE(focuser_hw_steps(focuser, false, 300, INDIGO_OK_STATE, MOVE_TIMEOUT));
}

// Every setting is confirmed by a readback, and the controller keeps it over a reconnect.
static void nstep_changes_the_settings(void) {
	ASSERT_TRUE(set_number(FOCUSER_SPEED_PROPERTY_NAME, FOCUSER_SPEED_ITEM_NAME, 1));
	ASSERT_TRUE(set_number(FOCUSER_SPEED_PROPERTY_NAME, FOCUSER_SPEED_ITEM_NAME, 254));
	ASSERT_TRUE(set_number(FOCUSER_SPEED_PROPERTY_NAME, FOCUSER_SPEED_ITEM_NAME, 120));
	ASSERT_TRUE(set_number(FOCUSER_BACKLASH_PROPERTY_NAME, FOCUSER_BACKLASH_ITEM_NAME, 12));
	if (temperature_present) {
		ASSERT_TRUE(set_number(FOCUSER_COMPENSATION_PROPERTY_NAME, FOCUSER_COMPENSATION_ITEM_NAME, -4));
		ASSERT_TRUE(set_number(FOCUSER_COMPENSATION_PROPERTY_NAME, FOCUSER_COMPENSATION_ITEM_NAME, 7));
	}
	ASSERT_TRUE(focuser_hw_set_switch(focuser, "X_FOCUSER_PHASE_WIRING", "1", SHORT_TIMEOUT));
	ASSERT_TRUE(focuser_hw_set_switch(focuser, "X_FOCUSER_PHASE_WIRING", "2", SHORT_TIMEOUT));
	ASSERT_TRUE(hw_disconnect(focuser, SHORT_TIMEOUT));
	ASSERT_TRUE(hw_connect(focuser, SHORT_TIMEOUT));
	ASSERT_EQ_INT(120, (int)value(FOCUSER_SPEED_PROPERTY_NAME, FOCUSER_SPEED_ITEM_NAME));
	ASSERT_EQ_INT(12, (int)value(FOCUSER_BACKLASH_PROPERTY_NAME, FOCUSER_BACKLASH_ITEM_NAME));
	if (temperature_present) {
		ASSERT_EQ_INT(7, (int)value(FOCUSER_COMPENSATION_PROPERTY_NAME, FOCUSER_COMPENSATION_ITEM_NAME));
	}
	ASSERT_TRUE(focuser_hw_switch_is(focuser, "X_FOCUSER_PHASE_WIRING", "2"));
	ASSERT_TRUE(focuser_hw_set_switch(focuser, "X_FOCUSER_PHASE_WIRING", initial_wiring, SHORT_TIMEOUT));
	ASSERT_TRUE(set_number(FOCUSER_BACKLASH_PROPERTY_NAME, FOCUSER_BACKLASH_ITEM_NAME, initial_backlash));
	if (temperature_present) {
		ASSERT_TRUE(set_number(FOCUSER_COMPENSATION_PROPERTY_NAME, FOCUSER_COMPENSATION_ITEM_NAME, initial_compensation));
	}
	ASSERT_TRUE(set_number(FOCUSER_SPEED_PROPERTY_NAME, FOCUSER_SPEED_ITEM_NAME, initial_speed));
}

// The automatic mode removes the manual controls and the manual mode brings them back; the controller
// keeps the mode over a reconnect.
static void nstep_switches_the_compensation_mode(void) {
	if (!temperature_present) {
		printf("    no temperature probe, no compensation mode\n");
		return;
	}
	ASSERT_TRUE(focuser_hw_set_switch(focuser, FOCUSER_MODE_PROPERTY_NAME, FOCUSER_MODE_AUTOMATIC_ITEM_NAME, SHORT_TIMEOUT));
	ASSERT_TRUE(wait_defined(FOCUSER_STEPS_PROPERTY_NAME, false, SHORT_TIMEOUT));
	ASSERT_TRUE(!hw_property_defined(focuser, FOCUSER_POSITION_PROPERTY_NAME));
	ASSERT_TRUE(focuser_hw_set_switch(focuser, FOCUSER_MODE_PROPERTY_NAME, FOCUSER_MODE_MANUAL_ITEM_NAME, SHORT_TIMEOUT));
	ASSERT_TRUE(wait_defined(FOCUSER_STEPS_PROPERTY_NAME, true, SHORT_TIMEOUT));
	ASSERT_TRUE(hw_property_defined(focuser, FOCUSER_POSITION_PROPERTY_NAME));
	ASSERT_TRUE(focuser_hw_steps(focuser, true, 20, INDIGO_OK_STATE, MOVE_TIMEOUT));
	ASSERT_TRUE(focuser_hw_steps(focuser, false, 20, INDIGO_OK_STATE, MOVE_TIMEOUT));
}

static void nstep_reconnects(void) {
	double position = focuser_hw_position(focuser);
	ASSERT_TRUE(hw_disconnect(focuser, SHORT_TIMEOUT));
	ASSERT_TRUE(hw_property_hidden(focuser, FOCUSER_POSITION_PROPERTY_NAME));
	ASSERT_TRUE(hw_connect(focuser, SHORT_TIMEOUT));
	ASSERT_EQ_INT((int)position, (int)focuser_hw_position(focuser));
	ASSERT_EQ_INT(INDIGO_OK_STATE, hw_property_state(focuser, FOCUSER_POSITION_PROPERTY_NAME));
	ASSERT_EQ_INT((int)initial_speed, (int)value(FOCUSER_SPEED_PROPERTY_NAME, FOCUSER_SPEED_ITEM_NAME));
}

static void nstep_rejects_shutdown_while_connected(void) {
	ASSERT_EQ_INT(INDIGO_BUSY, indigo_focuser_nstep(INDIGO_DRIVER_SHUTDOWN, NULL));
	ASSERT_TRUE(hw_connected(focuser));
}

static void nstep_reinitializes(void) {
	double position = focuser_hw_position(focuser);
	ASSERT_TRUE(hw_disconnect(focuser, SHORT_TIMEOUT));
	ASSERT_EQ_INT(INDIGO_OK, indigo_focuser_nstep(INDIGO_DRIVER_SHUTDOWN, NULL));
	ASSERT_EQ_INT(-1, hw_device_index(DEVICE_NAME));
	ASSERT_EQ_INT(INDIGO_OK, indigo_focuser_nstep(INDIGO_DRIVER_INIT, NULL));
	focuser = hw_wait_for_device(DEVICE_NAME, SHORT_TIMEOUT);
	ASSERT_TRUE(focuser >= 0);
	ASSERT_TRUE(select_port());
	ASSERT_TRUE(hw_connect(focuser, SHORT_TIMEOUT));
	ASSERT_EQ_INT((int)position, (int)focuser_hw_position(focuser));
}

int main(int argc, char **argv) {
	if (argc < 2 || strcmp(argv[1], "--run")) {
		fprintf(stderr, "Physical nSTEP test: run explicitly with --run (or make test-focuser-nstep-hw).\n");
		return 2;
	}
	setvbuf(stdout, NULL, _IONBF, 0);
	for (int i = 2; i < argc; i++) {
		if (!strcmp(argv[i], "--debug")) {
			indigo_set_log_level(INDIGO_LOG_DEBUG);
		}
	}
	if (!indigo_test_use_private_home()) {
		return 1;
	}
	serial_port = hw_port("NSTEP_HW_PORT");
	const indigo_test_case tests[] = {
		{ "nstep_publishes_the_values", nstep_publishes_the_values },
		{ "nstep_moves_by_steps", nstep_moves_by_steps },
		{ "nstep_moves_in_every_stepping_mode", nstep_moves_in_every_stepping_mode },
		{ "nstep_aborts_a_move", nstep_aborts_a_move },
		{ "nstep_refuses_settings_during_a_move", nstep_refuses_settings_during_a_move },
		{ "nstep_changes_the_settings", nstep_changes_the_settings },
		{ "nstep_switches_the_compensation_mode", nstep_switches_the_compensation_mode },
		{ "nstep_reconnects", nstep_reconnects },
		{ "nstep_rejects_shutdown_while_connected", nstep_rejects_shutdown_while_connected },
		{ "nstep_reinitializes", nstep_reinitializes }
	};
	int result = 1;
	bool started = false, initialized = false;
	HW_CHECK(hw_start() == INDIGO_OK);
	started = true;
	HW_CHECK(hw_attach_client("nSTEP hardware test") == INDIGO_OK);
	HW_CHECK(indigo_focuser_nstep(INDIGO_DRIVER_INIT, NULL) == INDIGO_OK);
	initialized = true;
	focuser = hw_wait_for_device(DEVICE_NAME, SHORT_TIMEOUT);
	HW_CHECK(focuser >= 0);
	HW_CHECK(select_port());
	HW_CHECK(hw_connect(focuser, SHORT_TIMEOUT));
	HW_CHECK(focuser_hw_idle(focuser, FOCUSER_POSITION_PROPERTY_NAME, MOVE_TIMEOUT));
	temperature_present = !hw_property_hidden(focuser, FOCUSER_TEMPERATURE_PROPERTY_NAME);
	// the manual controls exist only in manual mode
	if (temperature_present && !focuser_hw_switch_is(focuser, FOCUSER_MODE_PROPERTY_NAME, FOCUSER_MODE_MANUAL_ITEM_NAME)) {
		HW_CHECK(focuser_hw_set_switch(focuser, FOCUSER_MODE_PROPERTY_NAME, FOCUSER_MODE_MANUAL_ITEM_NAME, SHORT_TIMEOUT));
		HW_CHECK(wait_defined(FOCUSER_STEPS_PROPERTY_NAME, true, SHORT_TIMEOUT));
	}
	initial_position = focuser_hw_position(focuser);
	initial_speed = value(FOCUSER_SPEED_PROPERTY_NAME, FOCUSER_SPEED_ITEM_NAME);
	initial_backlash = value(FOCUSER_BACKLASH_PROPERTY_NAME, FOCUSER_BACKLASH_ITEM_NAME);
	initial_compensation = temperature_present ? value(FOCUSER_COMPENSATION_PROPERTY_NAME, FOCUSER_COMPENSATION_ITEM_NAME) : 0;
	initial_wiring = focuser_hw_switch_is(focuser, "X_FOCUSER_PHASE_WIRING", "2") ? "2" : focuser_hw_switch_is(focuser, "X_FOCUSER_PHASE_WIRING", "1") ? "1" : "0";
	state_captured = true;
	result = indigo_run_tests("nSTEP hardware", tests, ARRAY_SIZE(tests));
cleanup:
	restore_initial_state();
	if (!hw_disconnect(focuser, SHORT_TIMEOUT)) {
		indigo_test_failures++;
	}
	if (initialized && indigo_focuser_nstep(INDIGO_DRIVER_SHUTDOWN, NULL) != INDIGO_OK) {
		indigo_test_failures++;
	}
	indigo_detach_client(&hw_client);
	if (started) {
		indigo_stop();
	}
	hw_release_properties();
	indigo_test_remove_private_home();
	return indigo_test_failures ? 1 : result;
}
