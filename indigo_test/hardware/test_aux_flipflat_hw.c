// Copyright (c) 2026 INDIGO initiative
// All rights reserved.
//
// You may use this software under the terms of 'INDIGO Astronomy
// open-source license' (see LICENSE.md).
//
// THIS SOFTWARE IS PROVIDED BY THE AUTHORS 'AS IS' AND ANY EXPRESS
// OR IMPLIED WARRANTIES, INCLUDING, BUT NOT LIMITED TO, THE IMPLIED
// WARRANTIES OF MERCHANTABILITY AND FITNESS FOR A PARTICULAR PURPOSE
// ARE DISCLAIMED. IN NO EVENT SHALL THE AUTHOR BE LIABLE FOR ANY
// DIRECT, INDIRECT, INCIDENTAL, SPECIAL, EXEMPLARY, OR CONSEQUENTIAL
// DAMAGES (INCLUDING, BUT NOT LIMITED TO, PROCUREMENT OF SUBSTITUTE
// GOODS OR SERVICES; LOSS OF USE, DATA, OR PROFITS; OR BUSINESS
// INTERRUPTION) HOWEVER CAUSED AND ON ANY THEORY OF LIABILITY,
// WHETHER IN CONTRACT, STRICT LIABILITY, OR TORT (INCLUDING
// NEGLIGENCE OR OTHERWISE) ARISING IN ANY WAY OUT OF THE USE OF THIS
// SOFTWARE, EVEN IF ADVISED OF THE POSSIBILITY OF SUCH DAMAGE.

// Code is generated by AI

// Opt-in acceptance test for a physically connected Alnitak Flip-Flat, Flat-Man or Flip-Mask, or for
// the Arduino sketch aux_flipflat_simulator.ino running on a board. It checks the product id and
// firmware handshake, opens and closes the cover, switches the light and sets the intensity at the
// ends and in the middle of the range, reconnects and runs driver INIT/SHUTDOWN. Controls the
// connected model does not have are checked to stay hidden instead.
//
// THE COVER MOVES AND THE PANEL LIGHTS UP. The session leaves the light off, the cover as it found it
// and restores the intensity.
//
// The port comes from FLIPFLAT_HW_PORT. The driver has no match pattern, so the port must be given.

#include <math.h>
#include <stdlib.h>
#include <indigo_drivers/aux_flipflat/indigo_aux_flipflat.h>
#include "hardware_test_common.h"

#define DEVICE_NAME "FlipFlat"
// The driver waits 30 s for the cover.
#define COVER_TIMEOUT 40.0

#define SHORT_TIMEOUT 15.0

static int box = -1;
static const char *serial_port = NULL;
static double initial_intensity = 0;
static bool state_captured = false, has_light = false, has_cover = false, cover_was_open = false;

static bool set_cover(bool open) {
	bool value = !open;
	return hw_set_switch(box, AUX_COVER_PROPERTY_NAME, open ? AUX_COVER_OPEN_ITEM_NAME : AUX_COVER_CLOSE_ITEM_NAME, INDIGO_OK_STATE, COVER_TIMEOUT) && hw_switch_item(box, AUX_COVER_PROPERTY_NAME, AUX_COVER_OPEN_ITEM_NAME, &value) && value == open;
}

static bool select_port(void) {
	if (serial_port == NULL || !*serial_port) {
		fprintf(stderr, "    set FLIPFLAT_HW_PORT to the device's serial port\n");
		return false;
	}
	printf("Using port %s\n", serial_port);
	return hw_set_text(box, DEVICE_PORT_PROPERTY_NAME, DEVICE_PORT_ITEM_NAME, serial_port, INDIGO_OK_STATE, SHORT_TIMEOUT);
}

static bool set_light(bool on) {
	return hw_set_switch(box, AUX_LIGHT_SWITCH_PROPERTY_NAME, on ? AUX_LIGHT_SWITCH_ON_ITEM_NAME : AUX_LIGHT_SWITCH_OFF_ITEM_NAME, INDIGO_OK_STATE, SHORT_TIMEOUT);
}

static bool light_is(bool on) {
	bool value = !on;
	return hw_switch_item(box, AUX_LIGHT_SWITCH_PROPERTY_NAME, AUX_LIGHT_SWITCH_ON_ITEM_NAME, &value) && value == on;
}

static bool set_intensity(double percent) {
	double value = -1;
	return hw_set_number(box, AUX_LIGHT_INTENSITY_PROPERTY_NAME, AUX_LIGHT_INTENSITY_ITEM_NAME, percent, INDIGO_OK_STATE, SHORT_TIMEOUT) && hw_number_item(box, AUX_LIGHT_INTENSITY_PROPERTY_NAME, AUX_LIGHT_INTENSITY_ITEM_NAME, &value) && value == percent;
}

static void restore_initial_state(void) {
	if (box < 0 || !state_captured || !hw_connected(box)) {
		return;
	}
	if (has_light) {
		set_intensity(initial_intensity);
		set_light(false);
	}
	if (has_cover) {
		set_cover(cover_was_open);
	}
}

static void flipflat_publishes_the_property_contract(void) {
	char model[INDIGO_VALUE_SIZE] = "", firmware[INDIGO_VALUE_SIZE] = "";
	ASSERT_TRUE((hw_device_interface(box) & INDIGO_INTERFACE_AUX_LIGHTBOX) != 0);
	ASSERT_STREQ(DEVICE_NAME, hw_device_name(box));
	// The product id of the ping answer names the model; V answers the firmware version.
	ASSERT_TRUE(hw_text_item(box, INFO_PROPERTY_NAME, INFO_DEVICE_MODEL_ITEM_NAME, model, sizeof(model)));
	ASSERT_TRUE(*model && strcmp(model, "Unknown"));
	ASSERT_TRUE(hw_text_item(box, INFO_PROPERTY_NAME, INFO_DEVICE_FW_REVISION_ITEM_NAME, firmware, sizeof(firmware)));
	ASSERT_TRUE(*firmware && strcmp(firmware, "Unknown"));
	printf("    %s firmware %s, light %s, cover %s\n", model, firmware, has_light ? "yes" : "no", has_cover ? "yes" : "no");
	if (!strcmp(model, "Flip-Flat")) {
		ASSERT_TRUE(has_light && has_cover);
	} else if (!strcmp(model, "Flip-Mask/Remote Dust Cover")) {
		ASSERT_TRUE(!has_light && has_cover);
	} else {
		ASSERT_TRUE(has_light && !has_cover);
	}
	if (has_light) {
		double min = -1, max = -1;
		ASSERT_TRUE(hw_number_item_range(box, AUX_LIGHT_INTENSITY_PROPERTY_NAME, AUX_LIGHT_INTENSITY_ITEM_NAME, &min, &max));
		ASSERT_EQ_INT(0, (int)min);
		ASSERT_EQ_INT(100, (int)max);
	}
	if (has_cover) {
		// The status read at connect publishes the cover state.
		ASSERT_EQ_INT(INDIGO_OK_STATE, hw_property_state(box, AUX_COVER_PROPERTY_NAME));
	}
}

static void flipflat_opens_and_closes_the_cover(void) {
	if (!has_cover) {
		printf("    this model has no cover\n");
		return;
	}
	for (int i = 0; i < 2; i++) {
		double started = indigo_monotonic_time();
		ASSERT_TRUE(set_cover(!cover_was_open));
		printf("    cover %s in %.1f s\n", cover_was_open ? "closed" : "opened", indigo_monotonic_time() - started);
		started = indigo_monotonic_time();
		ASSERT_TRUE(set_cover(cover_was_open));
		printf("    cover %s in %.1f s\n", cover_was_open ? "opened" : "closed", indigo_monotonic_time() - started);
	}
}

static void flipflat_switches_the_light(void) {
	if (!has_light) {
		printf("    this model has no light\n");
		return;
	}
	ASSERT_TRUE(set_light(true));
	ASSERT_TRUE(light_is(true));
	ASSERT_TRUE(set_light(false));
	ASSERT_TRUE(light_is(false));
	// Repeating a request is answered the same way.
	ASSERT_TRUE(set_light(false));
	ASSERT_TRUE(light_is(false));
	ASSERT_TRUE(set_light(true));
	ASSERT_TRUE(set_light(true));
	ASSERT_TRUE(light_is(true));
	ASSERT_TRUE(set_light(false));
}

// The intensity is a percentage the driver scales to the box's 0 to 255; the box echoes the value it
// was sent, so every setting is confirmed by the box.
static void flipflat_sets_the_intensity(void) {
	if (!has_light) {
		printf("    this model has no light\n");
		return;
	}
	ASSERT_TRUE(set_light(true));
	static const double values[] = { 0, 1, 50, 99, 100, 37 };
	for (int i = 0; i < ARRAY_SIZE(values); i++) {
		ASSERT_TRUE(set_intensity(values[i]));
	}
	ASSERT_TRUE(set_intensity(37));
	ASSERT_TRUE(set_light(false));
}

// The light, the intensity and the cover are read back from the device at connect.
static void flipflat_reconnects(void) {
	if (has_light) {
		ASSERT_TRUE(set_intensity(60));
		ASSERT_TRUE(set_light(true));
	}
	ASSERT_TRUE(hw_disconnect(box, SHORT_TIMEOUT));
	ASSERT_TRUE(hw_connect(box, SHORT_TIMEOUT));
	if (has_light) {
		double value = -1;
		bool on = false;
		ASSERT_TRUE(hw_number_item(box, AUX_LIGHT_INTENSITY_PROPERTY_NAME, AUX_LIGHT_INTENSITY_ITEM_NAME, &value));
		// The device holds 0 to 255, so the percentage comes back within a step of the scale.
		ASSERT_NEAR(60, value, 1);
		ASSERT_TRUE(hw_switch_item(box, AUX_LIGHT_SWITCH_PROPERTY_NAME, AUX_LIGHT_SWITCH_ON_ITEM_NAME, &on));
		ASSERT_TRUE(on);
		ASSERT_TRUE(set_light(false));
	}
	if (has_cover) {
		bool open = !cover_was_open;
		ASSERT_TRUE(hw_switch_item(box, AUX_COVER_PROPERTY_NAME, AUX_COVER_OPEN_ITEM_NAME, &open));
		ASSERT_TRUE(open == cover_was_open);
	}
}

static void flipflat_rejects_shutdown_while_connected(void) {
	ASSERT_EQ_INT(INDIGO_BUSY, indigo_aux_flipflat(INDIGO_DRIVER_SHUTDOWN, NULL));
	if (has_light) {
		ASSERT_TRUE(set_light(true));
		ASSERT_TRUE(set_light(false));
	}
}

static void flipflat_reinitializes(void) {
	ASSERT_TRUE(hw_disconnect(box, SHORT_TIMEOUT));
	ASSERT_EQ_INT(INDIGO_OK, indigo_aux_flipflat(INDIGO_DRIVER_SHUTDOWN, NULL));
	ASSERT_EQ_INT(-1, hw_device_index(DEVICE_NAME));
	ASSERT_EQ_INT(INDIGO_OK, indigo_aux_flipflat(INDIGO_DRIVER_INIT, NULL));
	box = hw_wait_for_device(DEVICE_NAME, SHORT_TIMEOUT);
	ASSERT_TRUE(box >= 0);
	ASSERT_TRUE(select_port());
	ASSERT_TRUE(hw_connect(box, SHORT_TIMEOUT));
	if (has_light) {
		ASSERT_TRUE(set_light(true));
		ASSERT_TRUE(set_intensity(80));
		ASSERT_TRUE(set_light(false));
	}
}

int main(int argc, char **argv) {
	if (argc < 2 || strcmp(argv[1], "--run")) {
		fprintf(stderr, "Physical Alnitak FlipFlat test: run explicitly with --run (or make test-aux-flipflat-hw).\n");
		return 2;
	}
	setvbuf(stdout, NULL, _IONBF, 0);
	for (int i = 2; i < argc; i++) {
		if (!strcmp(argv[i], "--debug")) {
			indigo_set_log_level(INDIGO_LOG_DEBUG);
		}
	}
	// AUX_LIGHT_SWITCH and AUX_LIGHT_INTENSITY are persistent, so the session keeps its configuration out of
	// the user's own folder.
	if (!indigo_test_use_private_home()) {
		return 1;
	}
	serial_port = hw_port("FLIPFLAT_HW_PORT");
	const indigo_test_case tests[] = {
		{ "flipflat_publishes_the_property_contract", flipflat_publishes_the_property_contract },
		{ "flipflat_opens_and_closes_the_cover", flipflat_opens_and_closes_the_cover },
		{ "flipflat_switches_the_light", flipflat_switches_the_light },
		{ "flipflat_sets_the_intensity", flipflat_sets_the_intensity },
		{ "flipflat_reconnects", flipflat_reconnects },
		{ "flipflat_rejects_shutdown_while_connected", flipflat_rejects_shutdown_while_connected },
		{ "flipflat_reinitializes", flipflat_reinitializes }
	};
	int result = 1;
	bool started = false, initialized = false;
	HW_CHECK(hw_start() == INDIGO_OK);
	started = true;
	HW_CHECK(hw_attach_client("Alnitak FlipFlat hardware test") == INDIGO_OK);
	HW_CHECK(indigo_aux_flipflat(INDIGO_DRIVER_INIT, NULL) == INDIGO_OK);
	initialized = true;
	box = hw_wait_for_device(DEVICE_NAME, SHORT_TIMEOUT);
	HW_CHECK(box >= 0);
	HW_CHECK(select_port());
	HW_CHECK(hw_connect(box, SHORT_TIMEOUT));
	has_light = hw_property_defined(box, AUX_LIGHT_SWITCH_PROPERTY_NAME);
	has_cover = hw_property_defined(box, AUX_COVER_PROPERTY_NAME);
	if (has_light) {
		HW_CHECK(hw_number_item(box, AUX_LIGHT_INTENSITY_PROPERTY_NAME, AUX_LIGHT_INTENSITY_ITEM_NAME, &initial_intensity));
	}
	if (has_cover) {
		HW_CHECK(hw_switch_item(box, AUX_COVER_PROPERTY_NAME, AUX_COVER_OPEN_ITEM_NAME, &cover_was_open));
	}
	state_captured = true;
	result = indigo_run_tests("Alnitak FlipFlat hardware", tests, ARRAY_SIZE(tests));
cleanup:
	restore_initial_state();
	if (!hw_disconnect(box, SHORT_TIMEOUT)) {
		indigo_test_failures++;
	}
	if (initialized && indigo_aux_flipflat(INDIGO_DRIVER_SHUTDOWN, NULL) != INDIGO_OK) {
		indigo_test_failures++;
	}
	indigo_detach_client(&hw_client);
	if (started) {
		indigo_stop();
	}
	hw_release_properties();
	indigo_test_remove_private_home();
	return indigo_test_failures ? 1 : result;
}
