// Copyright (c) 2026 INDIGO initiative
// All rights reserved.
//
// You may use this software under the terms of 'INDIGO Astronomy
// open-source license' (see LICENSE.md).
//
// THIS SOFTWARE IS PROVIDED BY THE AUTHORS 'AS IS' AND ANY EXPRESS
// OR IMPLIED WARRANTIES, INCLUDING, BUT NOT LIMITED TO, THE IMPLIED
// WARRANTIES OF MERCHANTABILITY AND FITNESS FOR A PARTICULAR PURPOSE
// ARE DISCLAIMED. IN NO EVENT SHALL THE AUTHOR BE LIABLE FOR ANY
// DIRECT, INDIRECT, INCIDENTAL, SPECIAL, EXEMPLARY, OR CONSEQUENTIAL
// DAMAGES (INCLUDING, BUT NOT LIMITED TO, PROCUREMENT OF SUBSTITUTE
// GOODS OR SERVICES; LOSS OF USE, DATA, OR PROFITS; OR BUSINESS
// INTERRUPTION) HOWEVER CAUSED AND ON ANY THEORY OF LIABILITY,
// WHETHER IN CONTRACT, STRICT LIABILITY, OR TORT (INCLUDING
// NEGLIGENCE OR OTHERWISE) ARISING IN ANY WAY OUT OF THE USE OF THIS
// SOFTWARE, EVEN IF ADVISED OF THE POSSIBILITY OF SUCH DAMAGE.

// Code is generated by AI

// The unattended hot-plug acceptance suite shared by the USB camera drivers. The per driver
// hardware suites cover imaging and keep their unplug case behind a prompt that a person has to
// answer with a cable; this one answers it by switching the power of the camera's USB port, so the
// whole suite runs from a Makefile target on a machine nobody is sitting at.
//
// One source is built once per driver. TEST_ENTRY is the driver entry point, TEST_NAME the label
// in the report and TEST_VENDORS the USB vendor ids that identify the camera's port, as a brace
// enclosed list, because a camera line sold under several brands enumerates under several ids.
// TEST_DEFECT_CASES names, comma separated, the cases a driver is known to fail because of a
// defect recorded in its REFACTOR.md. Those cases run only under --known-defects, following the
// convention the simulator suites use, so a recorded defect does not hide a new regression behind
// a suite that is red anyway.
//
// What the scenarios are looking for is the driver's reaction to a disconnect it did not ask for:
// the logical device has to disappear when the camera does, whatever the driver was doing at that
// moment, and a camera that comes back has to be usable again without a restart. A driver that
// leaks the device of a camera that is gone, that publishes a second device for a camera that came
// back, or that takes the process down with it fails here and passes every simulator test.

#include <stdio.h>
#include <stdlib.h>
#include <string.h>
#include <indigo/indigo_bus.h>
#include <indigo/indigo_driver.h>
#include <indigo/indigo_names.h>

#include "hardware_test_common.h"
#include "usb_hotplug_test_common.h"

#ifndef TEST_NAME
#error TEST_NAME, TEST_ENTRY and TEST_VENDORS have to be defined by the build rule
#endif

#ifndef TEST_DEFECT_CASES
#define TEST_DEFECT_CASES ""
#endif

extern indigo_result TEST_ENTRY(indigo_driver_action action, indigo_driver_info *info);

// A camera that is switched off has to be gone from the bus quickly; coming back costs a USB
// enumeration and, for a camera that loads its firmware over USB, a second one. Both are
// overridable from the build rule, for a driver whose SDK needs longer than the shared default.
#ifndef UNPLUG_TIMEOUT
#define UNPLUG_TIMEOUT      10
#endif
#ifndef REPLUG_TIMEOUT
#define REPLUG_TIMEOUT      30
#endif
#define SHORT_TIMEOUT       15
// Long enough that the camera is still exposing when the port is switched off.
#define LONG_EXPOSURE       20
#define PROBE_EXPOSURE      0.1
#define STREAM_EXPOSURE     0.2
// A camera loses its power for this long, so it starts from reset rather than from a glitch.
#define PORT_OFF_TIME       2
#define CYCLE_REPEATS       3

static usb_hotplug_port port;
static int camera = -1, guider = -1;
static char camera_name[INDIGO_NAME_SIZE], guider_name[INDIGO_NAME_SIZE];
static bool park_others = true, known_defects_mode = false;

// Liveness of a device as the bus defines it, tracked here rather than taken from the shared
// harness. A device is published by a define of its CONNECTION property and withdrawn by the
// device wide delete indigo_detach_device() sends, and nothing else changes that.
//
// The distinction matters exactly here. A driver that withdraws a camera which has just been
// switched off still has a disconnect in flight, and the CONNECTION *update* that finishes it
// reaches the client after the withdrawal. A model that treats any publication as presence counts
// that update as the device coming back and never sees the removal, which reads like a driver that
// leaks the device of a camera that is gone. Updates are therefore ignored here.

#define LIVE_MAX HW_MAX_DEVICES

typedef struct {
	char name[INDIGO_NAME_SIZE];
	unsigned interface;
	bool live;
} live_device;

static live_device live_devices[LIVE_MAX];
static pthread_mutex_t live_mutex = PTHREAD_MUTEX_INITIALIZER;
static indigo_result (*inner_define)(indigo_client *, indigo_device *, indigo_property *, const char *);
static indigo_result (*inner_delete)(indigo_client *, indigo_device *, indigo_property *, const char *);

// Caller holds live_mutex.
static live_device *live_slot(const char *name) {
	for (int i = 0; i < LIVE_MAX; i++) {
		if (!strcmp(live_devices[i].name, name)) {
			return live_devices + i;
		}
	}
	for (int i = 0; i < LIVE_MAX; i++) {
		if (!*live_devices[i].name) {
			snprintf(live_devices[i].name, INDIGO_NAME_SIZE, "%s", name);
			return live_devices + i;
		}
	}
	return NULL;
}

static indigo_result observe_define(indigo_client *client, indigo_device *device, indigo_property *property, const char *message) {
	pthread_mutex_lock(&live_mutex);
	live_device *slot = live_slot(property->device);
	if (slot) {
		if (!strcmp(property->name, CONNECTION_PROPERTY_NAME)) {
			slot->live = true;
		} else if (!strcmp(property->name, INFO_PROPERTY_NAME)) {
			for (int i = 0; i < property->count; i++) {
				if (!strcmp(property->items[i].name, INFO_DEVICE_INTERFACE_ITEM_NAME)) {
					slot->interface = (unsigned)strtoul(property->items[i].text.value, NULL, 10);
				}
			}
		}
	}
	pthread_mutex_unlock(&live_mutex);
	return inner_define(client, device, property, message);
}

static indigo_result observe_delete(indigo_client *client, indigo_device *device, indigo_property *property, const char *message) {
	if (!*property->name) {
		pthread_mutex_lock(&live_mutex);
		live_device *slot = live_slot(property->device);
		if (slot) {
			slot->live = false;
		}
		pthread_mutex_unlock(&live_mutex);
	}
	if (hw_trace) {
		fprintf(stderr, "    [trace] %s delete '%s'\n", property->device, property->name);
	}
	return inner_delete(client, device, property, message);
}

static bool device_is_live(const char *name) {
	if (!name || !*name) {
		return false;
	}
	pthread_mutex_lock(&live_mutex);
	live_device *slot = live_slot(name);
	bool live = slot && slot->live;
	pthread_mutex_unlock(&live_mutex);
	return live;
}

static int count_live_interface(unsigned interface) {
	pthread_mutex_lock(&live_mutex);
	int count = 0;
	for (int i = 0; i < LIVE_MAX; i++) {
		if (*live_devices[i].name && live_devices[i].live && (live_devices[i].interface & interface)) {
			count++;
		}
	}
	pthread_mutex_unlock(&live_mutex);
	return count;
}

static void report_live_devices(void) {
	pthread_mutex_lock(&live_mutex);
	for (int i = 0; i < LIVE_MAX; i++) {
		if (*live_devices[i].name) {
			fprintf(stderr, "      %s live=%s interface=%u\n", live_devices[i].name, live_devices[i].live ? "yes" : "no", live_devices[i].interface);
		}
	}
	pthread_mutex_unlock(&live_mutex);
}

typedef struct {
	const char *name;
	void (*run)(void);
} hotplug_case;

// A case reproduces a recorded defect when the build rule named it. The comparison is on whole
// names, so one case name cannot match because another one contains it.
static bool reproduces_a_known_defect(const char *name) {
	static const char *defects = "," TEST_DEFECT_CASES ",";
	char needle[128];
	snprintf(needle, sizeof(needle), ",%s,", name);
	return strstr(defects, needle) != NULL;
}

// The camera and, when the driver exposes one, the ST4 guider that shares its USB connection. Both
// are looked up again after every cycle, because a driver is free to publish a returning camera in
// a different slot.
static int find_interface(unsigned interface, double timeout) {
	double deadline = indigo_monotonic_time() + timeout;
	while (indigo_monotonic_time() < deadline) {
		int found = -1;
		pthread_mutex_lock(&hw_mutex);
		for (int d = 0; d < HW_MAX_DEVICES && found < 0; d++) {
			if (hw_devices[d].present && (hw_devices[d].interface & interface) && hw_slot(d, CONNECTION_PROPERTY_NAME) >= 0) {
				found = d;
			}
		}
		pthread_mutex_unlock(&hw_mutex);
		if (found >= 0) {
			return found;
		}
		indigo_usleep(20000);
	}
	return -1;
}

static bool wait_until_live(const char *name, double timeout) {
	double deadline = indigo_monotonic_time() + timeout;
	while (indigo_monotonic_time() < deadline) {
		if (device_is_live(name)) {
			return true;
		}
		indigo_usleep(20000);
	}
	fprintf(stderr, "    %s was not published again within %gs\n", name, timeout);
	report_live_devices();
	return false;
}

static bool wait_until_withdrawn(const char *name, double timeout) {
	if (!name || !*name) {
		return true;
	}
	double deadline = indigo_monotonic_time() + timeout;
	while (indigo_monotonic_time() < deadline) {
		if (!device_is_live(name)) {
			return true;
		}
		indigo_usleep(20000);
	}
	fprintf(stderr, "    %s is still published %gs after its camera was switched off\n", name, timeout);
	report_live_devices();
	return false;
}

// Switches the port off and waits until the driver has withdrawn every device the camera backs. A
// driver that keeps the device published is the defect this suite exists for, so the wait is the
// assertion and not a convenience.
static bool unplug(void) {
	if (!usb_hotplug_off(&port, UNPLUG_TIMEOUT)) {
		return false;
	}
	if (!wait_until_withdrawn(camera_name, UNPLUG_TIMEOUT) || !wait_until_withdrawn(guider_name, UNPLUG_TIMEOUT)) {
		return false;
	}
	camera = guider = -1;
	return true;
}

// Switches the port back on and waits for the driver to publish the camera again under the name it
// had before, which is what a client that stored a device name in its configuration depends on.
static bool replug(void) {
	if (!usb_hotplug_on(&port, REPLUG_TIMEOUT)) {
		return false;
	}
	// The camera is back when the driver defines its CONNECTION property again. Waiting for the
	// shared cache to report it present instead would return immediately: a disconnect that
	// finishes after the device was withdrawn updates that same property, and the cache counts any
	// publication as presence, so the camera that just left still looks like it is there.
	if (!wait_until_live(camera_name, REPLUG_TIMEOUT)) {
		fprintf(stderr, "    the driver did not publish the camera again after the port came back\n");
		return false;
	}
	camera = find_interface(INDIGO_INTERFACE_CCD, SHORT_TIMEOUT);
	if (camera < 0 || strcmp(camera_name, hw_device_name(camera))) {
		fprintf(stderr, "    the camera came back as '%s' instead of '%s'\n", camera < 0 ? "(nothing)" : hw_device_name(camera), camera_name);
		return false;
	}
	guider = find_interface(INDIGO_INTERFACE_GUIDER, SHORT_TIMEOUT);
	snprintf(guider_name, sizeof(guider_name), "%s", guider < 0 ? "" : hw_device_name(guider));
	return true;
}

// Proves the camera works again: connect, take the shortest exposure it accepts, disconnect.
static bool expose_once(void) {
	if (!hw_connect(camera, SHORT_TIMEOUT)) {
		// hw_connect() reports a request that timed out or was rejected, but it also returns false
		// for a CONNECTION that settled in OK state while the device stayed disconnected, and that
		// one is silent. Say which of the two happened, so a driver that answers a connect with a
		// successful state and no connection is not read as a timeout.
		fprintf(stderr, "    %s did not connect, CONNECTION state %d, connected %s\n", camera_name, hw_property_state(camera, CONNECTION_PROPERTY_NAME), hw_connected(camera) ? "yes" : "no");
		return false;
	}
	if (!hw_set_number(camera, CCD_EXPOSURE_PROPERTY_NAME, CCD_EXPOSURE_ITEM_NAME, PROBE_EXPOSURE, INDIGO_OK_STATE, SHORT_TIMEOUT)) {
		return false;
	}
	return true;
}

static bool recover(void) {
	return replug() && expose_once() && hw_disconnect(camera, SHORT_TIMEOUT);
}

// Takes the driver down and brings it back up, which is the only way back from a driver that is
// left holding a device its camera no longer backs.
static bool restart_driver(void) {
	hw_disconnect(guider, SHORT_TIMEOUT);
	hw_disconnect(camera, SHORT_TIMEOUT);
	camera = guider = -1;
	if (TEST_ENTRY(INDIGO_DRIVER_SHUTDOWN, NULL) != INDIGO_OK || TEST_ENTRY(INDIGO_DRIVER_INIT, NULL) != INDIGO_OK) {
		fprintf(stderr, "    the driver could not be restarted\n");
		return false;
	}
	camera = find_interface(INDIGO_INTERFACE_CCD, REPLUG_TIMEOUT);
	guider = find_interface(INDIGO_INTERFACE_GUIDER, SHORT_TIMEOUT);
	return camera >= 0;
}

// Puts the port and the driver back into the state every case starts from: port on, camera
// published and proven usable, nothing connected. Without it the first case that fails takes every
// case after it down for its own reason, and the report no longer says which scenario broke.
//
// The camera is proven by connecting to it rather than by its presence, because a driver that
// keeps the device of a camera that is gone publishes something that answers no request.
static bool ensure_camera(void) {
	if (port.off && !usb_hotplug_on(&port, REPLUG_TIMEOUT)) {
		return false;
	}
	if (camera < 0) {
		if (!wait_until_live(camera_name, REPLUG_TIMEOUT)) {
			return false;
		}
		camera = find_interface(INDIGO_INTERFACE_CCD, SHORT_TIMEOUT);
	}
	if (camera < 0 || !hw_connect(camera, SHORT_TIMEOUT)) {
		fprintf(stderr, "    the published camera does not answer, restarting the driver\n");
		if (!restart_driver() || !hw_connect(camera, SHORT_TIMEOUT)) {
			return false;
		}
	}
	snprintf(camera_name, sizeof(camera_name), "%s", hw_device_name(camera));
	guider = find_interface(INDIGO_INTERFACE_GUIDER, SHORT_TIMEOUT);
	snprintf(guider_name, sizeof(guider_name), "%s", guider < 0 ? "" : hw_device_name(guider));
	return hw_disconnect(guider, SHORT_TIMEOUT) && hw_disconnect(camera, SHORT_TIMEOUT);
}

static void camera_returns_after_an_idle_port_cycle(void) {
	ASSERT_TRUE(ensure_camera());
	ASSERT_TRUE(unplug());
	ASSERT_TRUE(recover());
}

static void camera_returns_after_a_port_cycle_while_connected(void) {
	ASSERT_TRUE(ensure_camera());
	ASSERT_TRUE(hw_connect(camera, SHORT_TIMEOUT));
	if (guider >= 0) {
		ASSERT_TRUE(hw_connect(guider, SHORT_TIMEOUT));
	}
	ASSERT_TRUE(unplug());
	ASSERT_TRUE(recover());
}

static void camera_returns_after_a_port_cycle_during_an_exposure(void) {
	ASSERT_TRUE(ensure_camera());
	ASSERT_TRUE(hw_connect(camera, SHORT_TIMEOUT));
	unsigned before = hw_revision(camera, CCD_EXPOSURE_PROPERTY_NAME);
	hw_request_number(camera, CCD_EXPOSURE_PROPERTY_NAME, CCD_EXPOSURE_ITEM_NAME, LONG_EXPOSURE);
	ASSERT_TRUE(hw_wait_state(camera, CCD_EXPOSURE_PROPERTY_NAME, before, INDIGO_BUSY_STATE, SHORT_TIMEOUT));
	ASSERT_TRUE(unplug());
	ASSERT_TRUE(recover());
}

static void camera_returns_after_a_port_cycle_during_streaming(void) {
	ASSERT_TRUE(ensure_camera());
	ASSERT_TRUE(hw_connect(camera, SHORT_TIMEOUT));
	if (!hw_property_defined(camera, CCD_STREAMING_PROPERTY_NAME)) {
		printf("    %s does not stream, nothing to interrupt\n", camera_name);
		ASSERT_TRUE(hw_disconnect(camera, SHORT_TIMEOUT));
		return;
	}
	unsigned before = hw_revision(camera, CCD_STREAMING_PROPERTY_NAME);
	const char *items[] = { CCD_STREAMING_EXPOSURE_ITEM_NAME, CCD_STREAMING_COUNT_ITEM_NAME };
	double values[] = { STREAM_EXPOSURE, -1 };
	indigo_change_number_property(&hw_client, camera_name, CCD_STREAMING_PROPERTY_NAME, 2, items, values);
	ASSERT_TRUE(hw_wait_state(camera, CCD_STREAMING_PROPERTY_NAME, before, INDIGO_BUSY_STATE, SHORT_TIMEOUT));
	ASSERT_TRUE(unplug());
	ASSERT_TRUE(recover());
}

// A driver that publishes the returning camera without withdrawing the one that left accumulates a
// device per cycle, which only shows up when the cycle is repeated.
static void repeated_port_cycles_leave_exactly_one_camera(void) {
	ASSERT_TRUE(ensure_camera());
	for (int i = 0; i < CYCLE_REPEATS; i++) {
		printf("    cycle %d of %d\n", i + 1, CYCLE_REPEATS);
		ASSERT_TRUE(unplug());
		ASSERT_EQ_INT(0, count_live_interface(INDIGO_INTERFACE_CCD));
		ASSERT_TRUE(replug());
		ASSERT_EQ_INT(1, count_live_interface(INDIGO_INTERFACE_CCD));
	}
	ASSERT_TRUE(expose_once());
	ASSERT_TRUE(hw_disconnect(camera, SHORT_TIMEOUT));
}

// A driver initialized with no camera attached has to stay empty and pick the camera up when it
// arrives, which is the cold start a server goes through when it is launched before the camera is
// powered.
static void driver_finds_a_camera_attached_after_init(void) {
	ASSERT_TRUE(ensure_camera());
	ASSERT_TRUE(unplug());
	ASSERT_EQ_INT(INDIGO_OK, TEST_ENTRY(INDIGO_DRIVER_SHUTDOWN, NULL));
	ASSERT_EQ_INT(INDIGO_OK, TEST_ENTRY(INDIGO_DRIVER_INIT, NULL));
	// Live rather than merely published: a device the driver has withdrawn stays in the shared
	// cache when a disconnect update lands after the withdrawal.
	indigo_usleep(2000000);
	ASSERT_EQ_INT(0, count_live_interface(INDIGO_INTERFACE_CCD));
	ASSERT_TRUE(recover());
}

int main(int argc, char **argv) {
	if (argc < 2 || strcmp(argv[1], "--run")) {
		fprintf(stderr, "Unattended " TEST_NAME " hot-plug test: run explicitly with --run.\n");
		fprintf(stderr, "It switches the power of the camera's USB port, so it needs a Linux host and write access to the port.\n");
		return 2;
	}
	setvbuf(stdout, NULL, _IONBF, 0);
	if (!USB_HOTPLUG_SUPPORTED) {
		// Switching a port off is a Linux interface. The suite is reported as skipped rather than
		// failed, so a macOS run of the hardware targets stays green.
		printf("SKIP: the unattended " TEST_NAME " hot-plug suite needs a Linux host to switch the USB port.\n");
		return 0;
	}
	for (int i = 2; i < argc; i++) {
		if (!strcmp(argv[i], "--debug")) {
			indigo_set_log_level(INDIGO_LOG_DEBUG);
		} else if (!strcmp(argv[i], "--known-defects")) {
			// Runs the reproducers of the recorded defects instead of the rest of the suite. A
			// failure is the expected outcome there and does not fail the run.
			known_defects_mode = true;
		} else if (!strcmp(argv[i], "--keep-others")) {
			// For a host with enough power to carry every attached device at once.
			park_others = false;
		}
	}
	const unsigned vendors[] = TEST_VENDORS;
	static const hotplug_case cases[] = {
		{ "camera_returns_after_an_idle_port_cycle", camera_returns_after_an_idle_port_cycle },
		{ "camera_returns_after_a_port_cycle_while_connected", camera_returns_after_a_port_cycle_while_connected },
		{ "camera_returns_after_a_port_cycle_during_an_exposure", camera_returns_after_a_port_cycle_during_an_exposure },
		{ "camera_returns_after_a_port_cycle_during_streaming", camera_returns_after_a_port_cycle_during_streaming },
		{ "repeated_port_cycles_leave_exactly_one_camera", repeated_port_cycles_leave_exactly_one_camera },
		{ "driver_finds_a_camera_attached_after_init", driver_finds_a_camera_attached_after_init }
	};
	indigo_test_case tests[ARRAY_SIZE(cases)];
	int test_count = 0;
	for (int i = 0; i < (int)ARRAY_SIZE(cases); i++) {
		if (reproduces_a_known_defect(cases[i].name) == known_defects_mode) {
			tests[test_count].name = cases[i].name;
			tests[test_count++].function = cases[i].run;
		}
	}
	if (test_count == 0) {
		printf("No " TEST_NAME " hot-plug case is %s.\n", known_defects_mode ? "recorded as a known defect" : "left to run");
		return 0;
	}
	int result = 1;
	bool started = false, initialized = false;
	// The camera has to be attached now: a port that is already switched off carries no device to
	// identify it by, and the numbering is per machine, so it cannot be guessed.
	HW_CHECK(usb_hotplug_find(vendors, (int)ARRAY_SIZE(vendors), &port));
	printf("Switching USB port of %s (%04x:%04x %s)\n", port.device, port.vendor, port.product, port.product_name);
	// Every other camera stays powered off for the whole run. A host whose USB power budget cannot
	// carry all of them at once browns out mid-exposure otherwise, and the resulting failure looks
	// like a driver defect.
	if (park_others && usb_hotplug_park_others(&port) > 0) {
		indigo_usleep(2000000);
	}
	// The driver saves its camera settings on a CONFIG request, so the run keeps its configuration
	// out of the user's own folder.
	HW_CHECK(indigo_test_use_private_home());
	HW_CHECK(indigo_start() == INDIGO_OK);
	started = true;
	HW_CHECK(hw_attach_client(TEST_NAME " hot-plug test") == INDIGO_OK);
	// Liveness is observed in front of the shared harness, never instead of it.
	inner_define = hw_client.define_property;
	inner_delete = hw_client.delete_property;
	hw_client.define_property = observe_define;
	hw_client.delete_property = observe_delete;
	HW_CHECK(TEST_ENTRY(INDIGO_DRIVER_INIT, NULL) == INDIGO_OK);
	initialized = true;
	camera = find_interface(INDIGO_INTERFACE_CCD, REPLUG_TIMEOUT);
	HW_CHECK(camera >= 0);
	snprintf(camera_name, sizeof(camera_name), "%s", hw_device_name(camera));
	guider = find_interface(INDIGO_INTERFACE_GUIDER, SHORT_TIMEOUT);
	snprintf(guider_name, sizeof(guider_name), "%s", guider < 0 ? "" : hw_device_name(guider));
	printf("Found %s%s%s\n", camera_name, guider >= 0 ? " and " : "", guider >= 0 ? hw_device_name(guider) : "");
	if (known_defects_mode) {
		int reproduced = 0, unexpected = 0;
		printf("Running " TEST_NAME " unattended hot-plug defect reproducers\n");
		for (int i = 0; i < test_count; i++) {
			int before = indigo_test_failures;
			indigo_current_test_name = tests[i].name;
			tests[i].function();
			indigo_current_test_name = NULL;
			if (indigo_test_failures == before) {
				printf("  UNEXPECTED PASS %s\n", tests[i].name);
				unexpected++;
			} else {
				printf("  EXPECTED FAIL %s\n", tests[i].name);
				reproduced++;
			}
			indigo_test_failures = before;
		}
		printf(TEST_NAME " hot-plug defect reproducers: %d run, %d reproduced, %d no longer reproduce\n", test_count, reproduced, unexpected);
		result = 0;
	} else {
		result = indigo_run_tests(TEST_NAME " unattended hot-plug", tests, test_count);
	}
cleanup:
	if (!hw_disconnect(guider, SHORT_TIMEOUT) || !hw_disconnect(camera, SHORT_TIMEOUT)) {
		indigo_test_failures++;
	}
	if (initialized && TEST_ENTRY(INDIGO_DRIVER_SHUTDOWN, NULL) != INDIGO_OK) {
		indigo_test_failures++;
	}
	indigo_detach_client(&hw_client);
	if (started) {
		indigo_stop();
	}
	hw_release_properties();
	indigo_test_remove_private_home();
	// The port is left the way the run found it, whichever way the run ended.
	if (port.off && !usb_hotplug_on(&port, REPLUG_TIMEOUT)) {
		indigo_test_failures++;
	}
	usb_hotplug_unpark_others();
	return indigo_test_failures ? 1 : result;
}
