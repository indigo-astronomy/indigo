// Copyright (c) 2026 INDIGO initiative
// All rights reserved.
//
// You may use this software under the terms of 'INDIGO Astronomy
// open-source license' (see LICENSE.md).
//
// THIS SOFTWARE IS PROVIDED BY THE AUTHORS 'AS IS' AND ANY EXPRESS
// OR IMPLIED WARRANTIES, INCLUDING, BUT NOT LIMITED TO, THE IMPLIED
// WARRANTIES OF MERCHANTABILITY AND FITNESS FOR A PARTICULAR PURPOSE
// ARE DISCLAIMED. IN NO EVENT SHALL THE AUTHOR BE LIABLE FOR ANY
// DIRECT, INDIRECT, INCIDENTAL, SPECIAL, EXEMPLARY, OR CONSEQUENTIAL
// DAMAGES (INCLUDING, BUT NOT LIMITED TO, PROCUREMENT OF SUBSTITUTE
// GOODS OR SERVICES; LOSS OF USE, DATA, OR PROFITS; OR BUSINESS
// INTERRUPTION) HOWEVER CAUSED AND ON ANY THEORY OF LIABILITY,
// WHETHER IN CONTRACT, STRICT LIABILITY, OR TORT (INCLUDING
// NEGLIGENCE OR OTHERWISE) ARISING IN ANY WAY OUT OF THE USE OF THIS
// SOFTWARE, EVEN IF ADVISED OF THE POSSIBILITY OF SUCH DAMAGE.

// Code is generated by AI

// Opt-in acceptance test for a physically connected SynScan mount reached over the network.
// It implements the mount hardware acceptance checklist of DRIVER_TESTING_RULES.md against the
// real motor controller: discovery and connection, identity and capability readback, coordinate
// and status readback, tracking and rates, manual motion, SYNC, a small reachable slew, abort
// followed by a fresh command, park/unpark, home, the controller autohome procedure, the snap
// port, guide pulses including a duration accuracy measurement, and reconnect plus driver
// reinitialization.
//
// The mount physically moves. Every slew in this test is deliberately small and relative to the
// pointing the mount had when the test started, and the original pointing, tracking state, guide
// rates, park and home positions are restored at the end. The controller autohome procedure is
// the one exception: it drives both axes to their home index and is therefore only run when
// SYNSCAN_HW_AUTOHOME=1 is set.
//
// The mount address comes from SYNSCAN_HW_URL. The default is "synscan://", which exercises the
// driver's UDP broadcast autodetection; an explicit "synscan://host:port" skips autodetection,
// and a serial device path such as /dev/ttyACM0 reaches a controller wired to this host.

#include <dirent.h>
#include <limits.h>
#include <math.h>
#include <pthread.h>
#include <stdlib.h>
#include <string.h>
#include <unistd.h>
#include <indigo/indigo_bus.h>
#include <indigo/indigo_client.h>
#include <indigo/indigo_driver.h>
#include <indigo/indigo_names.h>
#include <indigo/indigo_timer.h>
#include <indigo_drivers/mount_synscan/indigo_mount_synscan.h>
#include "../test_runner.h"

#define ARRAY_SIZE(a) (sizeof(a) / sizeof((a)[0]))
#define MAX_DEVICES 8
#define MAX_PROPERTIES 96

// The driver object of this test is built with indigo_uni_config_folder redirected here, so the
// park position file of a test run never lands in the user's own INDIGO configuration folder.
static char park_folder[] = "/tmp/indigo-synscan-hw-park-XXXXXX";


#define MOUNT_DEVICE_NAME "Mount SynScan"
#define GUIDER_DEVICE_NAME "Mount SynScan (guider)"
#define AUX_DEVICE_NAME "Mount SynScan (aux)"

#define MOUNT_POLARSCOPE_PROPERTY_NAME "POLARSCOPE"
#define MOUNT_POLARSCOPE_BRIGHTNESS_ITEM_NAME "BRIGHTNESS"
#define MOUNT_USE_ENCODERS_PROPERTY_NAME "MOUNT_USE_ENCODERS"
#define MOUNT_USE_RA_ENCODER_ITEM_NAME "RA"
#define MOUNT_USE_DEC_ENCODER_ITEM_NAME "DEC"
#define MOUNT_AUTOHOME_PROPERTY_NAME "MOUNT_AUTOHOME"
#define MOUNT_AUTOHOME_ITEM_NAME "AUTOHOME"
#define MOUNT_AUTOHOME_SETTINGS_PROPERTY_NAME "MOUNT_AUTOHOME_SETTINGS"
#define MOUNT_AUTOHOME_DEC_OFFSET_ITEM_NAME "DEC_OFFSET"
#define MOUNT_OPERATING_MODE_PROPERTY_NAME "MOUNT_OPERATING_MODE"

// A network round trip plus the motor controller's own reply latency, with room for one retry.
#define SHORT_TIMEOUT 15.0
// A small slew, a park or a home slew including the driver's stop-and-settle polling.
#define MOTION_TIMEOUT 120.0
// The controller autohome procedure searches the home index on both axes from wherever they are.
#define AUTOHOME_TIMEOUT 600.0

#define CHECK(condition) do { if (!(condition)) { fprintf(stderr, "%s:%d: %s\n", __FILE__, __LINE__, #condition); indigo_test_failures++; goto cleanup; } } while (0)

typedef struct {
	char name[INDIGO_NAME_SIZE];
	indigo_device *device;
	unsigned interface;
	bool present;
	indigo_property *properties[MAX_PROPERTIES];
	unsigned revisions[MAX_PROPERTIES];
} observed_device;

static observed_device devices[MAX_DEVICES];
static pthread_mutex_t mutex = PTHREAD_MUTEX_INITIALIZER;
static int mount = -1, guider = -1, aux = -1;
static char last_message_text[INDIGO_VALUE_SIZE];
static indigo_client client;
static const char *mount_url = "synscan://";

// The pointing, tracking state and settings captured once the mount is connected. Every scenario
// works relative to these values and the session restores them before it disconnects.
static double initial_ra, initial_dec, initial_guide_ra, initial_guide_dec;
static double initial_park_ha, initial_park_dec, initial_home_ha, initial_home_dec;
static bool initial_tracking, settings_captured;

// Whether the aux device connected at the start of the session. The driver refuses the aux device
// on a controller without a snap port, so later scenarios expect that refusal instead of a
// connection.
static bool aux_has_snap_port;

// The observing site the driver is told to use, and the declination the motion scenarios run at.
// The site matters because the driver derives hour angle, horizontal coordinates and hemisphere
// handling from it, so it is set explicitly instead of inherited from a saved configuration.
static double site_latitude = 48.0, site_longitude = 17.0, test_declination = 60.0;

// The park file is named after the detected model, which is only known once the mount answered,
// so the whole temporary folder is swept instead of guessing the file name.
static void remove_park_files(void) {
	DIR *directory = opendir(park_folder);
	if (directory == NULL) {
		return;
	}
	struct dirent *entry;
	while ((entry = readdir(directory)) != NULL) {
		if (entry->d_name[0] == '.') {
			continue;
		}
		char path[PATH_MAX];
		snprintf(path, sizeof(path), "%s/%s", park_folder, entry->d_name);
		unlink(path);
	}
	closedir(directory);
}

static int slot(int d, const char *name) {
	for (int p = 0; p < MAX_PROPERTIES; p++) {
		if (devices[d].properties[p] && !strcmp(devices[d].properties[p]->name, name)) {
			return p;
		}
	}
	return -1;
}

static indigo_result observe(indigo_device *device, indigo_property *property, const char *message) {
	pthread_mutex_lock(&mutex);
	int d;
	for (d = 0; d < MAX_DEVICES; d++) {
		if (!*devices[d].name || !strcmp(devices[d].name, property->device)) {
			break;
		}
	}
	if (d < MAX_DEVICES) {
		snprintf(devices[d].name, INDIGO_NAME_SIZE, "%s", property->device);
		devices[d].device = device;
		devices[d].present = true;
		if (!strcmp(property->name, INFO_PROPERTY_NAME)) {
			for (int i = 0; i < property->count; i++) {
				if (!strcmp(property->items[i].name, INFO_DEVICE_INTERFACE_ITEM_NAME)) {
					devices[d].interface = (unsigned)strtoul(property->items[i].text.value, NULL, 10);
				}
			}
		}
		int p = slot(d, property->name);
		if (p < 0) {
			for (p = 0; p < MAX_PROPERTIES && devices[d].properties[p]; p++) { }
		}
		if (p < MAX_PROPERTIES) {
			indigo_release_property(devices[d].properties[p]);
			devices[d].properties[p] = indigo_copy_property(NULL, property);
			devices[d].revisions[p]++;
		}
	}
	pthread_mutex_unlock(&mutex);
	if (message && *message) {
		fprintf(stderr, "    %s %s: %s\n", property->device, property->name, message);
	}
	return INDIGO_OK;
}

static indigo_result define_property(indigo_client *client, indigo_device *device, indigo_property *property, const char *message) {
	return observe(device, property, message);
}

static indigo_result update_property(indigo_client *client, indigo_device *device, indigo_property *property, const char *message) {
	return observe(device, property, message);
}

static indigo_result report_message(indigo_client *client, indigo_device *device, indigo_property *property, const char *message) {
	if (message && *message) {
		pthread_mutex_lock(&mutex);
		snprintf(last_message_text, INDIGO_VALUE_SIZE, "%s", message);
		pthread_mutex_unlock(&mutex);
	}
	return INDIGO_OK;
}

static indigo_result delete_property(indigo_client *client, indigo_device *device, indigo_property *property, const char *message) {
	if (!*property->name) {
		pthread_mutex_lock(&mutex);
		for (int d = 0; d < MAX_DEVICES; d++) {
			if (!strcmp(devices[d].name, property->device)) {
				devices[d].present = false;
				for (int p = 0; p < MAX_PROPERTIES; p++) {
					indigo_release_property(devices[d].properties[p]);
					devices[d].properties[p] = NULL;
					devices[d].revisions[p] = 0;
				}
			}
		}
		pthread_mutex_unlock(&mutex);
	}
	return INDIGO_OK;
}

static int device_index(const char *name) {
	pthread_mutex_lock(&mutex);
	int result = -1;
	for (int d = 0; d < MAX_DEVICES; d++) {
		if (!strcmp(devices[d].name, name)) {
			result = d;
		}
	}
	pthread_mutex_unlock(&mutex);
	return result;
}

static unsigned revision(int d, const char *name) {
	pthread_mutex_lock(&mutex);
	int p = slot(d, name);
	unsigned result = p < 0 ? 0 : devices[d].revisions[p];
	pthread_mutex_unlock(&mutex);
	return result;
}


static bool property_defined(int d, const char *name) {
	pthread_mutex_lock(&mutex);
	bool found = slot(d, name) >= 0;
	pthread_mutex_unlock(&mutex);
	return found;
}

static bool number_item(int d, const char *name, const char *item, double *value) {
	pthread_mutex_lock(&mutex);
	int p = slot(d, name);
	bool found = false;
	if (p >= 0) {
		indigo_property *property = devices[d].properties[p];
		for (int i = 0; i < property->count && !found; i++) {
			if (!strcmp(property->items[i].name, item)) {
				*value = property->items[i].number.value;
				found = true;
			}
		}
	}
	pthread_mutex_unlock(&mutex);
	if (!found) {
		fprintf(stderr, "    missing number item %s.%s\n", name, item);
	}
	return found;
}

static bool switch_item(int d, const char *name, const char *item, bool *value) {
	pthread_mutex_lock(&mutex);
	int p = slot(d, name);
	bool found = false;
	if (p >= 0) {
		indigo_property *property = devices[d].properties[p];
		for (int i = 0; i < property->count && !found; i++) {
			if (!strcmp(property->items[i].name, item)) {
				*value = property->items[i].sw.value;
				found = true;
			}
		}
	}
	pthread_mutex_unlock(&mutex);
	if (!found) {
		fprintf(stderr, "    missing switch item %s.%s\n", name, item);
	}
	return found;
}

static bool text_item(int d, const char *name, const char *item, char *value, size_t size) {
	pthread_mutex_lock(&mutex);
	int p = slot(d, name);
	bool found = false;
	if (p >= 0) {
		indigo_property *property = devices[d].properties[p];
		for (int i = 0; i < property->count && !found; i++) {
			if (!strcmp(property->items[i].name, item)) {
				snprintf(value, size, "%s", property->items[i].text.value);
				found = true;
			}
		}
	}
	pthread_mutex_unlock(&mutex);
	if (!found) {
		fprintf(stderr, "    missing text item %s.%s\n", name, item);
	}
	return found;
}

static indigo_property_state property_state(int d, const char *name) {
	pthread_mutex_lock(&mutex);
	int p = slot(d, name);
	indigo_property_state state = p < 0 ? INDIGO_IDLE_STATE : devices[d].properties[p]->state;
	pthread_mutex_unlock(&mutex);
	return state;
}

// Waits for a newer revision of the property in the requested state. A revision gate is required
// because the mount keeps republishing polled properties, so a stale OK must not satisfy a wait.
static bool wait_state(int d, const char *name, unsigned after, indigo_property_state state, double timeout) {
	double deadline = indigo_monotonic_time() + timeout;
	while (indigo_monotonic_time() < deadline) {
		pthread_mutex_lock(&mutex);
		int p = slot(d, name);
		bool ready = p >= 0 && devices[d].revisions[p] > after && devices[d].properties[p]->state == state;
		pthread_mutex_unlock(&mutex);
		if (ready) {
			return true;
		}
		indigo_usleep(20000);
	}
	// Report what the property actually settled on. A mount that stopped answering reports ALERT
	// on every request, which must not be mistaken for a property stuck in BUSY.
	fprintf(stderr, "    timeout: %s %s expected state %d, last published state %d\n", devices[d].name, name, state, property_state(d, name));
	return false;
}

// Waits for the property to settle out of BUSY, then reports the state it settled in. Coordinate
// and park properties are published by the poll handler while an operation runs, so the terminal
// state is the first non-BUSY revision after the request was accepted.
static bool wait_settled(int d, const char *name, indigo_property_state state, double timeout) {
	double deadline = indigo_monotonic_time() + timeout;
	while (indigo_monotonic_time() < deadline) {
		if (property_state(d, name) == state) {
			return true;
		}
		indigo_usleep(50000);
	}
	fprintf(stderr, "    timeout: %s %s did not settle in state %d (state %d)\n", devices[d].name, name, state, property_state(d, name));
	return false;
}

static bool set_switch(int d, const char *name, const char *item, indigo_property_state expected, double timeout) {
	unsigned before = revision(d, name);
	indigo_change_switch_property_1(&client, devices[d].name, name, item, true);
	return wait_state(d, name, before, expected, timeout);
}

static bool set_number(int d, const char *name, const char *item, double value, indigo_property_state expected, double timeout) {
	unsigned before = revision(d, name);
	indigo_change_number_property_1(&client, devices[d].name, name, item, value);
	return wait_state(d, name, before, expected, timeout);
}

static bool set_text(int d, const char *name, const char *item, const char *value, indigo_property_state expected, double timeout) {
	unsigned before = revision(d, name);
	indigo_change_text_property_1(&client, devices[d].name, name, item, value);
	return wait_state(d, name, before, expected, timeout);
}

// Right ascension difference in hours, normalized to the shortest way around the circle. The
// offset added before the modulo must be a whole number of days so that a zero difference stays
// zero.
static double ra_difference(double a, double b) {
	double difference = fmod(a - b + 48.0, 24.0);
	if (difference > 12.0) {
		difference -= 24.0;
	}
	return difference;
}

static bool set_coordinates(int d, double ra, double dec, indigo_property_state expected, double timeout) {
	static const char *items[] = { MOUNT_EQUATORIAL_COORDINATES_RA_ITEM_NAME, MOUNT_EQUATORIAL_COORDINATES_DEC_ITEM_NAME };
	double values[] = { ra, dec };
	indigo_change_number_property(&client, devices[d].name, MOUNT_EQUATORIAL_COORDINATES_PROPERTY_NAME, 2, items, values);
	return wait_settled(d, MOUNT_EQUATORIAL_COORDINATES_PROPERTY_NAME, expected, timeout);
}

// A coordinate slew is complete when the mount is actually pointing at the target, so that is what
// this waits for. Waiting only for the property to reach OK is not enough: the coordinates are
// republished by the poll handler about once a second and a poll that was already in flight when
// the request was accepted can land after it, so the state alone can say OK while the mount has
// not moved. Requiring the reported pointing to match the request makes the wait independent of
// that ordering.
static bool slew_coordinates(int d, double ra, double dec, double timeout) {
	static const char *items[] = { MOUNT_EQUATORIAL_COORDINATES_RA_ITEM_NAME, MOUNT_EQUATORIAL_COORDINATES_DEC_ITEM_NAME };
	double values[] = { ra, dec };
	indigo_change_number_property(&client, devices[d].name, MOUNT_EQUATORIAL_COORDINATES_PROPERTY_NAME, 2, items, values);
	double deadline = indigo_monotonic_time() + timeout, reached_ra = 0, reached_dec = 0;
	while (indigo_monotonic_time() < deadline) {
		if (property_state(d, MOUNT_EQUATORIAL_COORDINATES_PROPERTY_NAME) == INDIGO_OK_STATE && number_item(d, MOUNT_EQUATORIAL_COORDINATES_PROPERTY_NAME, MOUNT_EQUATORIAL_COORDINATES_RA_ITEM_NAME, &reached_ra) && number_item(d, MOUNT_EQUATORIAL_COORDINATES_PROPERTY_NAME, MOUNT_EQUATORIAL_COORDINATES_DEC_ITEM_NAME, &reached_dec) && fabs(reached_dec - dec) < 0.3 && fabs(ra_difference(reached_ra, ra)) < 0.05) {
			return true;
		}
		indigo_usleep(50000);
	}
	fprintf(stderr, "    timeout: %s did not reach RA %.5f DEC %.5f, stopped at RA %.5f DEC %.5f in state %d\n", MOUNT_EQUATORIAL_COORDINATES_PROPERTY_NAME, ra, dec, reached_ra, reached_dec, property_state(d, MOUNT_EQUATORIAL_COORDINATES_PROPERTY_NAME));
	return false;
}

// Proves a just-accepted slew is not reported as finished before it starts. The change branch
// publishes BUSY, and no update may downgrade that to OK until the mount has actually arrived.
static bool slew_reports_busy_until_arrival(int d, double ra, double dec, double timeout) {
	static const char *items[] = { MOUNT_EQUATORIAL_COORDINATES_RA_ITEM_NAME, MOUNT_EQUATORIAL_COORDINATES_DEC_ITEM_NAME };
	double values[] = { ra, dec };
	indigo_change_number_property(&client, devices[d].name, MOUNT_EQUATORIAL_COORDINATES_PROPERTY_NAME, 2, items, values);
	if (!wait_settled(d, MOUNT_EQUATORIAL_COORDINATES_PROPERTY_NAME, INDIGO_BUSY_STATE, SHORT_TIMEOUT)) {
		return false;
	}
	// Sample across several poll cycles; a spurious OK appears within the first second.
	for (int i = 0; i < 40; i++) {
		double reached_ra = 0, reached_dec = 0;
		if (property_state(d, MOUNT_EQUATORIAL_COORDINATES_PROPERTY_NAME) == INDIGO_OK_STATE) {
			if (!number_item(d, MOUNT_EQUATORIAL_COORDINATES_PROPERTY_NAME, MOUNT_EQUATORIAL_COORDINATES_DEC_ITEM_NAME, &reached_dec) || fabs(reached_dec - dec) > 0.3) {
				number_item(d, MOUNT_EQUATORIAL_COORDINATES_PROPERTY_NAME, MOUNT_EQUATORIAL_COORDINATES_RA_ITEM_NAME, &reached_ra);
				fprintf(stderr, "    slew reported OK before arrival: at RA %.5f DEC %.5f, target RA %.5f DEC %.5f\n", reached_ra, reached_dec, ra, dec);
				return false;
			}
			return true;
		}
		indigo_usleep(50000);
	}
	return wait_settled(d, MOUNT_EQUATORIAL_COORDINATES_PROPERTY_NAME, INDIGO_OK_STATE, timeout);
}

// The mount is reached over Wi-Fi and powers its radio down when idle, so a connection attempt can
// be refused because a single UDP exchange was lost rather than because the driver mishandled it.
// One retry is allowed and is reported, so a genuine connect defect still fails the test while a
// dropped packet does not. A refused attempt must still leave the device disconnected and usable.
static bool connect_device(int d, double timeout) {
	if (d < 0) {
		return false;
	}
	for (int attempt = 0; attempt < 2; attempt++) {
		unsigned before = revision(d, CONNECTION_PROPERTY_NAME);
		indigo_change_switch_property_1(&client, devices[d].name, CONNECTION_PROPERTY_NAME, CONNECTION_CONNECTED_ITEM_NAME, true);
		bool value = false;
		if (wait_state(d, CONNECTION_PROPERTY_NAME, before, INDIGO_OK_STATE, timeout) && switch_item(d, CONNECTION_PROPERTY_NAME, CONNECTION_CONNECTED_ITEM_NAME, &value) && value) {
			if (attempt > 0) {
				printf("    note: %s connected on the second attempt after a lost UDP exchange\n", devices[d].name);
			}
			return true;
		}
		if (property_state(d, CONNECTION_PROPERTY_NAME) != INDIGO_ALERT_STATE) {
			return false;
		}
		indigo_usleep(2000000);
	}
	return false;
}

// Connects the aux device where the controller has a snap port. Where it has none, the driver has
// to refuse the device cleanly: ALERT, left disconnected, and without disturbing the connection
// the mount and guider share.
static bool connect_aux(void) {
	if (aux_has_snap_port) {
		return connect_device(aux, SHORT_TIMEOUT);
	}
	if (aux < 0) {
		return false;
	}
	unsigned before = revision(aux, CONNECTION_PROPERTY_NAME);
	indigo_change_switch_property_1(&client, devices[aux].name, CONNECTION_PROPERTY_NAME, CONNECTION_CONNECTED_ITEM_NAME, true);
	bool connected = true;
	return wait_state(aux, CONNECTION_PROPERTY_NAME, before, INDIGO_ALERT_STATE, SHORT_TIMEOUT) && switch_item(aux, CONNECTION_PROPERTY_NAME, CONNECTION_CONNECTED_ITEM_NAME, &connected) && !connected;
}

static bool disconnect_device(int d) {
	if (d < 0 || !devices[d].present) {
		return true;
	}
	bool connected = false;
	if (!switch_item(d, CONNECTION_PROPERTY_NAME, CONNECTION_CONNECTED_ITEM_NAME, &connected) || !connected) {
		return true;
	}
	unsigned before = revision(d, CONNECTION_PROPERTY_NAME);
	indigo_change_switch_property_1(&client, devices[d].name, CONNECTION_PROPERTY_NAME, CONNECTION_DISCONNECTED_ITEM_NAME, true);
	return wait_state(d, CONNECTION_PROPERTY_NAME, before, INDIGO_OK_STATE, SHORT_TIMEOUT);
}

static bool wait_presence(double timeout) {
	double deadline = indigo_monotonic_time() + timeout;
	while (indigo_monotonic_time() < deadline) {
		mount = device_index(MOUNT_DEVICE_NAME);
		guider = device_index(GUIDER_DEVICE_NAME);
		aux = device_index(AUX_DEVICE_NAME);
		if (mount >= 0 && guider >= 0 && aux >= 0 && property_defined(mount, CONNECTION_PROPERTY_NAME)) {
			return true;
		}
		indigo_usleep(20000);
	}
	fprintf(stderr, "    timeout waiting for the SynScan devices to be defined\n");
	return false;
}

// Points the mount device at the configured address. The guider and the aux device share this
// connection and have no visible DEVICE_PORT of their own.
static bool select_mount_url(void) {
	return set_text(mount, DEVICE_PORT_PROPERTY_NAME, DEVICE_PORT_ITEM_NAME, mount_url, INDIGO_OK_STATE, SHORT_TIMEOUT);
}


// The driver derives hour angle, horizontal coordinates and hemisphere handling from the site, so
// the session sets it explicitly instead of relying on whatever a saved configuration holds.
static bool set_site(void) {
	static const char *items[] = { GEOGRAPHIC_COORDINATES_LATITUDE_ITEM_NAME, GEOGRAPHIC_COORDINATES_LONGITUDE_ITEM_NAME, GEOGRAPHIC_COORDINATES_ELEVATION_ITEM_NAME };
	double values[] = { site_latitude, site_longitude, 0 };
	unsigned before = revision(mount, GEOGRAPHIC_COORDINATES_PROPERTY_NAME);
	indigo_change_number_property(&client, devices[mount].name, GEOGRAPHIC_COORDINATES_PROPERTY_NAME, 3, items, values);
	return wait_state(mount, GEOGRAPHIC_COORDINATES_PROPERTY_NAME, before, INDIGO_OK_STATE, SHORT_TIMEOUT);
}

static bool current_coordinates(double *ra, double *dec) {
	return number_item(mount, MOUNT_EQUATORIAL_COORDINATES_PROPERTY_NAME, MOUNT_EQUATORIAL_COORDINATES_RA_ITEM_NAME, ra) && number_item(mount, MOUNT_EQUATORIAL_COORDINATES_PROPERTY_NAME, MOUNT_EQUATORIAL_COORDINATES_DEC_ITEM_NAME, dec);
}


// Degrees of right ascension the reported pointing travelled over the given interval. A stopped
// RA axis keeps its hour angle, so its reported right ascension runs away at the sidereal rate of
// about 0.0042 degrees per second; a tracking axis keeps its right ascension instead.
static bool measure_ra_drift(double seconds, double *degrees) {
	double before = 0, after = 0;
	if (!number_item(mount, MOUNT_RAW_COORDINATES_PROPERTY_NAME, MOUNT_RAW_COORDINATES_RA_ITEM_NAME, &before)) {
		return false;
	}
	indigo_usleep((unsigned long)(seconds * 1000000));
	if (!number_item(mount, MOUNT_RAW_COORDINATES_PROPERTY_NAME, MOUNT_RAW_COORDINATES_RA_ITEM_NAME, &after)) {
		return false;
	}
	*degrees = ra_difference(after, before) * 15.0;
	return true;
}

// A target a few degrees away from the current pointing, kept away from the pole so the DEC axis
// can move in both directions and the RA axis does not have to cross the meridian.
static void nearby_target(double ra, double dec, double *target_ra, double *target_dec) {
	*target_ra = fmod(ra + 0.2 + 24.0, 24.0);
	*target_dec = dec > 0 ? dec - 3.0 : dec + 3.0;
	if (*target_dec > 85.0) {
		*target_dec = 85.0;
	}
	if (*target_dec < -85.0) {
		*target_dec = -85.0;
	}
}

static bool stop_all_motion(void) {
	bool ok = set_switch(mount, MOUNT_ABORT_MOTION_PROPERTY_NAME, MOUNT_ABORT_MOTION_ITEM_NAME, INDIGO_OK_STATE, SHORT_TIMEOUT);
	return wait_settled(mount, MOUNT_EQUATORIAL_COORDINATES_PROPERTY_NAME, INDIGO_OK_STATE, MOTION_TIMEOUT) && ok;
}

// Brings the mount back to a known idle state. An assertion aborts its test case where it stands,
// so a scenario must never inherit a parked, tracking or still moving mount from the one before.
static bool prepare_mount(void) {
	bool ok = stop_all_motion();
	ok = set_switch(mount, MOUNT_PARK_PROPERTY_NAME, MOUNT_PARK_UNPARKED_ITEM_NAME, INDIGO_OK_STATE, SHORT_TIMEOUT) && ok;
	ok = set_switch(mount, MOUNT_TRACKING_PROPERTY_NAME, MOUNT_TRACKING_OFF_ITEM_NAME, INDIGO_OK_STATE, SHORT_TIMEOUT) && ok;
	ok = set_switch(mount, MOUNT_SLEW_RATE_PROPERTY_NAME, MOUNT_SLEW_RATE_GUIDE_ITEM_NAME, INDIGO_OK_STATE, SHORT_TIMEOUT) && ok;
	ok = set_switch(mount, MOUNT_ON_COORDINATES_SET_PROPERTY_NAME, MOUNT_ON_COORDINATES_SET_TRACK_ITEM_NAME, INDIGO_OK_STATE, SHORT_TIMEOUT) && ok;
	return ok;
}

// The mount starts at its home position on the celestial pole, where a declination direction has
// no meaning and the hour angle is degenerate. Every motion scenario therefore runs from a
// defined pointing well away from the pole.
static bool slew_to_test_pointing(void) {
	double lst = 0;
	if (!number_item(mount, MOUNT_LST_TIME_PROPERTY_NAME, MOUNT_LST_TIME_ITEM_NAME, &lst)) {
		return false;
	}
	double ra = fmod(lst - 1.0 + 24.0, 24.0);
	printf("Slewing to the test pointing RA %.5f, DEC %.5f\n", ra, test_declination);
	return slew_coordinates(mount, ra, test_declination, MOTION_TIMEOUT);
}

static bool capture_initial_settings(void) {
	bool ok = current_coordinates(&initial_ra, &initial_dec);
	ok = ok && number_item(mount, MOUNT_GUIDE_RATE_PROPERTY_NAME, MOUNT_GUIDE_RATE_RA_ITEM_NAME, &initial_guide_ra);
	ok = ok && number_item(mount, MOUNT_GUIDE_RATE_PROPERTY_NAME, MOUNT_GUIDE_RATE_DEC_ITEM_NAME, &initial_guide_dec);
	ok = ok && number_item(mount, MOUNT_PARK_POSITION_PROPERTY_NAME, MOUNT_PARK_POSITION_HA_ITEM_NAME, &initial_park_ha);
	ok = ok && number_item(mount, MOUNT_PARK_POSITION_PROPERTY_NAME, MOUNT_PARK_POSITION_DEC_ITEM_NAME, &initial_park_dec);
	ok = ok && number_item(mount, MOUNT_HOME_POSITION_PROPERTY_NAME, MOUNT_HOME_POSITION_HA_ITEM_NAME, &initial_home_ha);
	ok = ok && number_item(mount, MOUNT_HOME_POSITION_PROPERTY_NAME, MOUNT_HOME_POSITION_DEC_ITEM_NAME, &initial_home_dec);
	ok = ok && switch_item(mount, MOUNT_TRACKING_PROPERTY_NAME, MOUNT_TRACKING_ON_ITEM_NAME, &initial_tracking);
	settings_captured = ok;
	return ok;
}

static void restore_initial_settings(void) {
	if (!settings_captured) {
		return;
	}
	static const char *guide_items[] = { MOUNT_GUIDE_RATE_RA_ITEM_NAME, MOUNT_GUIDE_RATE_DEC_ITEM_NAME };
	double guide_values[] = { initial_guide_ra, initial_guide_dec };
	static const char *park_items[] = { MOUNT_PARK_POSITION_HA_ITEM_NAME, MOUNT_PARK_POSITION_DEC_ITEM_NAME };
	double park_values[] = { initial_park_ha, initial_park_dec };
	static const char *home_items[] = { MOUNT_HOME_POSITION_HA_ITEM_NAME, MOUNT_HOME_POSITION_DEC_ITEM_NAME };
	double home_values[] = { initial_home_ha, initial_home_dec };
	indigo_change_number_property(&client, devices[mount].name, MOUNT_GUIDE_RATE_PROPERTY_NAME, 2, guide_items, guide_values);
	indigo_change_number_property(&client, devices[mount].name, MOUNT_PARK_POSITION_PROPERTY_NAME, 2, park_items, park_values);
	indigo_change_number_property(&client, devices[mount].name, MOUNT_HOME_POSITION_PROPERTY_NAME, 2, home_items, home_values);
	set_switch(mount, MOUNT_PARK_PROPERTY_NAME, MOUNT_PARK_UNPARKED_ITEM_NAME, INDIGO_OK_STATE, SHORT_TIMEOUT);
	set_switch(mount, MOUNT_TRACK_RATE_PROPERTY_NAME, MOUNT_TRACK_RATE_SIDEREAL_ITEM_NAME, INDIGO_OK_STATE, SHORT_TIMEOUT);
	set_switch(mount, MOUNT_SLEW_RATE_PROPERTY_NAME, MOUNT_SLEW_RATE_GUIDE_ITEM_NAME, INDIGO_OK_STATE, SHORT_TIMEOUT);
	set_switch(mount, MOUNT_ON_COORDINATES_SET_PROPERTY_NAME, MOUNT_ON_COORDINATES_SET_TRACK_ITEM_NAME, INDIGO_OK_STATE, SHORT_TIMEOUT);
	set_switch(mount, MOUNT_TRACKING_PROPERTY_NAME, initial_tracking ? MOUNT_TRACKING_ON_ITEM_NAME : MOUNT_TRACKING_OFF_ITEM_NAME, INDIGO_OK_STATE, SHORT_TIMEOUT);
}

// The driver applies its own alignment model to the reported coordinates. Stale points from an
// earlier physical setup would make every slew and sync assertion meaningless, so the session
// starts from an empty model, exactly as the driver README tells users to do.
static bool clear_alignment_model(void) {
	if (!property_defined(mount, MOUNT_ALIGNMENT_DELETE_POINTS_PROPERTY_NAME)) {
		return true;
	}
	return set_switch(mount, MOUNT_ALIGNMENT_DELETE_POINTS_PROPERTY_NAME, MOUNT_ALIGNMENT_DELETE_ALL_POINTS_ITEM_NAME, INDIGO_OK_STATE, SHORT_TIMEOUT);
}

static void synscan_discovers_and_connects(void) {
	ASSERT_TRUE(mount >= 0 && guider >= 0 && aux >= 0);
	ASSERT_TRUE((devices[mount].interface & INDIGO_INTERFACE_MOUNT) != 0);
	ASSERT_TRUE((devices[guider].interface & INDIGO_INTERFACE_GUIDER) != 0);
	ASSERT_TRUE((devices[aux].interface & INDIGO_INTERFACE_AUX_SHUTTER) != 0);
	char port[INDIGO_VALUE_SIZE];
	ASSERT_TRUE(text_item(mount, DEVICE_PORT_PROPERTY_NAME, DEVICE_PORT_ITEM_NAME, port, sizeof(port)));
	if (!strcmp(mount_url, "synscan://")) {
		// Autodetection rewrites DEVICE_PORT with the address that actually answered the broadcast.
		ASSERT_TRUE(!strncmp(port, "synscan://", 10) && port[10] != 0);
	} else {
		// An explicit address or serial device is used as given.
		ASSERT_STREQ(mount_url, port);
	}
	printf("    connected through %s\n", port);
	ASSERT_TRUE(property_state(mount, CONNECTION_PROPERTY_NAME) == INDIGO_OK_STATE);
}

static void synscan_reports_identity_and_capabilities(void) {
	char model[INDIGO_VALUE_SIZE], vendor[INDIGO_VALUE_SIZE], firmware[INDIGO_VALUE_SIZE];
	ASSERT_TRUE(text_item(mount, MOUNT_INFO_PROPERTY_NAME, MOUNT_INFO_MODEL_ITEM_NAME, model, sizeof(model)));
	ASSERT_TRUE(text_item(mount, MOUNT_INFO_PROPERTY_NAME, MOUNT_INFO_VENDOR_ITEM_NAME, vendor, sizeof(vendor)));
	ASSERT_TRUE(text_item(mount, MOUNT_INFO_PROPERTY_NAME, MOUNT_INFO_FIRMWARE_ITEM_NAME, firmware, sizeof(firmware)));
	ASSERT_TRUE(*model && *vendor && *firmware);
	printf("    %s %s, firmware %s\n", vendor, model, firmware);
	static const char *mandatory[] = {
		MOUNT_INFO_PROPERTY_NAME,
		GEOGRAPHIC_COORDINATES_PROPERTY_NAME,
		MOUNT_LST_TIME_PROPERTY_NAME,
		MOUNT_PARK_PROPERTY_NAME,
		MOUNT_PARK_SET_PROPERTY_NAME,
		MOUNT_PARK_POSITION_PROPERTY_NAME,
		MOUNT_HOME_PROPERTY_NAME,
		MOUNT_HOME_SET_PROPERTY_NAME,
		MOUNT_HOME_POSITION_PROPERTY_NAME,
		MOUNT_SLEW_RATE_PROPERTY_NAME,
		MOUNT_MOTION_RA_PROPERTY_NAME,
		MOUNT_MOTION_DEC_PROPERTY_NAME,
		MOUNT_TRACK_RATE_PROPERTY_NAME,
		MOUNT_TRACKING_PROPERTY_NAME,
		MOUNT_GUIDE_RATE_PROPERTY_NAME,
		MOUNT_ON_COORDINATES_SET_PROPERTY_NAME,
		MOUNT_EQUATORIAL_COORDINATES_PROPERTY_NAME,
		MOUNT_HORIZONTAL_COORDINATES_PROPERTY_NAME,
		MOUNT_RAW_COORDINATES_PROPERTY_NAME,
		MOUNT_SIDE_OF_PIER_PROPERTY_NAME,
		MOUNT_ABORT_MOTION_PROPERTY_NAME,
		MOUNT_STATE_PROPERTY_NAME,
		MOUNT_ALIGNMENT_MODE_PROPERTY_NAME,
		MOUNT_EPOCH_PROPERTY_NAME
	};
	for (int i = 0; i < ARRAY_SIZE(mandatory); i++) {
		if (!property_defined(mount, mandatory[i])) {
			fprintf(stderr, "    %s is not defined\n", mandatory[i]);
			indigo_test_failures++;
			return;
		}
	}
	// Optional properties are capability gated; report what this controller actually exposes.
	printf("    polarscope: %s, encoders: %s, PPEC: %s, autohome: %s, operating mode: %s, snap port: %s\n", property_defined(mount, MOUNT_POLARSCOPE_PROPERTY_NAME) ? "yes" : "no", property_defined(mount, MOUNT_USE_ENCODERS_PROPERTY_NAME) ? "yes" : "no", property_defined(mount, MOUNT_PEC_PROPERTY_NAME) ? "yes" : "no", property_defined(mount, MOUNT_AUTOHOME_PROPERTY_NAME) ? "yes" : "no", property_defined(mount, MOUNT_OPERATING_MODE_PROPERTY_NAME) ? "yes" : "no", property_defined(aux, CCD_EXPOSURE_PROPERTY_NAME) ? "yes" : "no");
	ASSERT_TRUE(property_defined(guider, GUIDER_GUIDE_RA_PROPERTY_NAME));
	ASSERT_TRUE(property_defined(guider, GUIDER_GUIDE_DEC_PROPERTY_NAME));
	ASSERT_TRUE(property_defined(guider, GUIDER_RATE_PROPERTY_NAME));
}

static void synscan_reads_coordinates_and_state(void) {
	double ra = 0, dec = 0, raw_ra = 0, raw_dec = 0, lst = 0, alt = 0, az = 0;
	ASSERT_TRUE(current_coordinates(&ra, &dec));
	ASSERT_TRUE(number_item(mount, MOUNT_RAW_COORDINATES_PROPERTY_NAME, MOUNT_RAW_COORDINATES_RA_ITEM_NAME, &raw_ra));
	ASSERT_TRUE(number_item(mount, MOUNT_RAW_COORDINATES_PROPERTY_NAME, MOUNT_RAW_COORDINATES_DEC_ITEM_NAME, &raw_dec));
	ASSERT_TRUE(number_item(mount, MOUNT_LST_TIME_PROPERTY_NAME, MOUNT_LST_TIME_ITEM_NAME, &lst));
	ASSERT_TRUE(number_item(mount, MOUNT_HORIZONTAL_COORDINATES_PROPERTY_NAME, MOUNT_HORIZONTAL_COORDINATES_ALT_ITEM_NAME, &alt));
	ASSERT_TRUE(number_item(mount, MOUNT_HORIZONTAL_COORDINATES_PROPERTY_NAME, MOUNT_HORIZONTAL_COORDINATES_AZ_ITEM_NAME, &az));
	printf("    RA %.5f, DEC %.5f, raw RA %.5f, raw DEC %.5f, LST %.5f, alt %.3f, az %.3f\n", ra, dec, raw_ra, raw_dec, lst, alt, az);
	ASSERT_TRUE(ra >= 0 && ra < 24 && dec >= -90 && dec <= 90);
	ASSERT_TRUE(raw_ra >= 0 && raw_ra < 24 && raw_dec >= -180 && raw_dec <= 180);
	ASSERT_TRUE(lst >= 0 && lst < 24 && alt >= -90 && alt <= 90 && az >= 0 && az <= 360);
	bool east = false, west = false;
	ASSERT_TRUE(switch_item(mount, MOUNT_SIDE_OF_PIER_PROPERTY_NAME, MOUNT_SIDE_OF_PIER_EAST_ITEM_NAME, &east));
	ASSERT_TRUE(switch_item(mount, MOUNT_SIDE_OF_PIER_PROPERTY_NAME, MOUNT_SIDE_OF_PIER_WEST_ITEM_NAME, &west));
	ASSERT_TRUE(east != west);
	// The coordinates are polled, so a fresh revision must arrive without any request.
	unsigned before = revision(mount, MOUNT_EQUATORIAL_COORDINATES_PROPERTY_NAME);
	ASSERT_TRUE(wait_state(mount, MOUNT_EQUATORIAL_COORDINATES_PROPERTY_NAME, before, INDIGO_OK_STATE, SHORT_TIMEOUT));
	ASSERT_TRUE(property_state(mount, MOUNT_STATE_PROPERTY_NAME) == INDIGO_OK_STATE);
}

static void synscan_tracking_and_rates(void) {
	ASSERT_TRUE(prepare_mount());
	ASSERT_TRUE(set_switch(mount, MOUNT_TRACKING_PROPERTY_NAME, MOUNT_TRACKING_ON_ITEM_NAME, INDIGO_OK_STATE, SHORT_TIMEOUT));
	indigo_property_state tracking_light = INDIGO_IDLE_STATE;
	pthread_mutex_lock(&mutex);
	int p = slot(mount, MOUNT_STATE_PROPERTY_NAME);
	if (p >= 0) {
		indigo_property *property = devices[mount].properties[p];
		for (int i = 0; i < property->count; i++) {
			if (!strcmp(property->items[i].name, MOUNT_STATE_TRACKING_ITEM_NAME)) {
				tracking_light = property->items[i].light.value;
			}
		}
	}
	pthread_mutex_unlock(&mutex);
	ASSERT_TRUE(tracking_light == INDIGO_BUSY_STATE || tracking_light == INDIGO_OK_STATE);
	// A tracking RA axis holds the sky, so the reported right ascension must stand still.
	double tracking_drift = 0, idle_drift = 0;
	ASSERT_TRUE(measure_ra_drift(12.0, &tracking_drift));
	printf("    tracking for 12 s: RA moved %.5f degrees\n", tracking_drift);
	ASSERT_TRUE(fabs(tracking_drift) < 0.01);
	ASSERT_TRUE(set_switch(mount, MOUNT_TRACK_RATE_PROPERTY_NAME, MOUNT_TRACK_RATE_SOLAR_ITEM_NAME, INDIGO_OK_STATE, SHORT_TIMEOUT));
	ASSERT_TRUE(set_switch(mount, MOUNT_TRACK_RATE_PROPERTY_NAME, MOUNT_TRACK_RATE_LUNAR_ITEM_NAME, INDIGO_OK_STATE, SHORT_TIMEOUT));
	ASSERT_TRUE(set_switch(mount, MOUNT_TRACK_RATE_PROPERTY_NAME, MOUNT_TRACK_RATE_SIDEREAL_ITEM_NAME, INDIGO_OK_STATE, SHORT_TIMEOUT));
	ASSERT_TRUE(set_switch(mount, MOUNT_TRACKING_PROPERTY_NAME, MOUNT_TRACKING_OFF_ITEM_NAME, INDIGO_OK_STATE, SHORT_TIMEOUT));
	// A stopped RA axis holds its hour angle instead, so the sky runs away at the sidereal rate
	// of 0.05 degrees over 12 s.
	ASSERT_TRUE(measure_ra_drift(12.0, &idle_drift));
	printf("    idle for 12 s: RA moved %.5f degrees, sidereal is 0.050\n", idle_drift);
	ASSERT_NEAR(0.050, fabs(idle_drift), 0.02);
	static const char *guide_items[] = { MOUNT_GUIDE_RATE_RA_ITEM_NAME, MOUNT_GUIDE_RATE_DEC_ITEM_NAME };
	double guide_values[] = { 30, 70 };
	unsigned before = revision(mount, MOUNT_GUIDE_RATE_PROPERTY_NAME);
	indigo_change_number_property(&client, devices[mount].name, MOUNT_GUIDE_RATE_PROPERTY_NAME, 2, guide_items, guide_values);
	ASSERT_TRUE(wait_state(mount, MOUNT_GUIDE_RATE_PROPERTY_NAME, before, INDIGO_OK_STATE, SHORT_TIMEOUT));
	double ra_rate = 0, dec_rate = 0;
	ASSERT_TRUE(number_item(mount, MOUNT_GUIDE_RATE_PROPERTY_NAME, MOUNT_GUIDE_RATE_RA_ITEM_NAME, &ra_rate));
	ASSERT_TRUE(number_item(mount, MOUNT_GUIDE_RATE_PROPERTY_NAME, MOUNT_GUIDE_RATE_DEC_ITEM_NAME, &dec_rate));
	ASSERT_NEAR(30, ra_rate, 0.5);
	ASSERT_NEAR(70, dec_rate, 0.5);
	guide_values[0] = initial_guide_ra;
	guide_values[1] = initial_guide_dec;
	before = revision(mount, MOUNT_GUIDE_RATE_PROPERTY_NAME);
	indigo_change_number_property(&client, devices[mount].name, MOUNT_GUIDE_RATE_PROPERTY_NAME, 2, guide_items, guide_values);
	ASSERT_TRUE(wait_state(mount, MOUNT_GUIDE_RATE_PROPERTY_NAME, before, INDIGO_OK_STATE, SHORT_TIMEOUT));
	if (property_defined(mount, MOUNT_POLARSCOPE_PROPERTY_NAME)) {
		ASSERT_TRUE(set_number(mount, MOUNT_POLARSCOPE_PROPERTY_NAME, MOUNT_POLARSCOPE_BRIGHTNESS_ITEM_NAME, 128, INDIGO_OK_STATE, SHORT_TIMEOUT));
		ASSERT_TRUE(set_number(mount, MOUNT_POLARSCOPE_PROPERTY_NAME, MOUNT_POLARSCOPE_BRIGHTNESS_ITEM_NAME, 0, INDIGO_OK_STATE, SHORT_TIMEOUT));
	}
}

// Manual motion is checked in both directions on both axes at a rate that is fast enough to move
// measurably within a couple of seconds but slow enough to stay within a few degrees.
static bool manual_motion_moves(const char *property, const char *item, bool use_ra, double *travel) {
	double before_ra = 0, before_dec = 0, after_ra = 0, after_dec = 0;
	if (!number_item(mount, MOUNT_RAW_COORDINATES_PROPERTY_NAME, MOUNT_RAW_COORDINATES_RA_ITEM_NAME, &before_ra) || !number_item(mount, MOUNT_RAW_COORDINATES_PROPERTY_NAME, MOUNT_RAW_COORDINATES_DEC_ITEM_NAME, &before_dec)) {
		return false;
	}
	if (!set_switch(mount, property, item, INDIGO_OK_STATE, SHORT_TIMEOUT)) {
		return false;
	}
	indigo_usleep(3000000);
	bool stopped = set_switch(mount, property, use_ra ? MOUNT_MOTION_WEST_ITEM_NAME : MOUNT_MOTION_NORTH_ITEM_NAME, INDIGO_OK_STATE, SHORT_TIMEOUT);
	// Releasing both direction switches is what stops the axis; INDIGO_AT_MOST_ONE_OF_MANY_RULE
	// lets the same item be sent with value false.
	indigo_change_switch_property_1(&client, devices[mount].name, property, use_ra ? MOUNT_MOTION_WEST_ITEM_NAME : MOUNT_MOTION_NORTH_ITEM_NAME, false);
	stopped = wait_settled(mount, property, INDIGO_OK_STATE, SHORT_TIMEOUT) && stopped;
	indigo_usleep(1000000);
	if (!number_item(mount, MOUNT_RAW_COORDINATES_PROPERTY_NAME, MOUNT_RAW_COORDINATES_RA_ITEM_NAME, &after_ra) || !number_item(mount, MOUNT_RAW_COORDINATES_PROPERTY_NAME, MOUNT_RAW_COORDINATES_DEC_ITEM_NAME, &after_dec)) {
		return false;
	}
	*travel = use_ra ? ra_difference(after_ra, before_ra) * 15.0 : after_dec - before_dec;
	printf("    %s %s moved %.4f degrees\n", property, item, *travel);
	return stopped;
}

static void synscan_manual_motion(void) {
	ASSERT_TRUE(prepare_mount());
	ASSERT_TRUE(slew_to_test_pointing());
	ASSERT_TRUE(set_switch(mount, MOUNT_SLEW_RATE_PROPERTY_NAME, MOUNT_SLEW_RATE_CENTERING_ITEM_NAME, INDIGO_OK_STATE, SHORT_TIMEOUT));
	double west = 0, east = 0, north = 0, south = 0;
	ASSERT_TRUE(manual_motion_moves(MOUNT_MOTION_RA_PROPERTY_NAME, MOUNT_MOTION_WEST_ITEM_NAME, true, &west));
	ASSERT_TRUE(manual_motion_moves(MOUNT_MOTION_RA_PROPERTY_NAME, MOUNT_MOTION_EAST_ITEM_NAME, true, &east));
	ASSERT_TRUE(manual_motion_moves(MOUNT_MOTION_DEC_PROPERTY_NAME, MOUNT_MOTION_NORTH_ITEM_NAME, false, &north));
	ASSERT_TRUE(manual_motion_moves(MOUNT_MOTION_DEC_PROPERTY_NAME, MOUNT_MOTION_SOUTH_ITEM_NAME, false, &south));
	// Each direction must move measurably and the two directions of an axis must be opposite.
	ASSERT_TRUE(fabs(west) > 0.002 && fabs(east) > 0.002 && fabs(north) > 0.002 && fabs(south) > 0.002);
	ASSERT_TRUE(west * east < 0);
	ASSERT_TRUE(north * south < 0);
	// Away from the pole the declination directions have a defined sign: north raises it.
	ASSERT_TRUE(north > 0);
	ASSERT_TRUE(south < 0);
	// West moves the telescope towards increasing hour angle, which lowers the reported right
	// ascension once the sidereal drift of the stopped axis is taken out.
	ASSERT_TRUE(west < 0);
	ASSERT_TRUE(east > 0);
	ASSERT_TRUE(set_switch(mount, MOUNT_SLEW_RATE_PROPERTY_NAME, MOUNT_SLEW_RATE_FIND_ITEM_NAME, INDIGO_OK_STATE, SHORT_TIMEOUT));
	ASSERT_TRUE(set_switch(mount, MOUNT_SLEW_RATE_PROPERTY_NAME, MOUNT_SLEW_RATE_MAX_ITEM_NAME, INDIGO_OK_STATE, SHORT_TIMEOUT));
	ASSERT_TRUE(set_switch(mount, MOUNT_SLEW_RATE_PROPERTY_NAME, MOUNT_SLEW_RATE_GUIDE_ITEM_NAME, INDIGO_OK_STATE, SHORT_TIMEOUT));
	// Manual motion must be abortable, and the aborted property must not stay BUSY.
	ASSERT_TRUE(set_switch(mount, MOUNT_SLEW_RATE_PROPERTY_NAME, MOUNT_SLEW_RATE_CENTERING_ITEM_NAME, INDIGO_OK_STATE, SHORT_TIMEOUT));
	ASSERT_TRUE(set_switch(mount, MOUNT_MOTION_DEC_PROPERTY_NAME, MOUNT_MOTION_NORTH_ITEM_NAME, INDIGO_OK_STATE, SHORT_TIMEOUT));
	ASSERT_TRUE(set_switch(mount, MOUNT_ABORT_MOTION_PROPERTY_NAME, MOUNT_ABORT_MOTION_ITEM_NAME, INDIGO_OK_STATE, SHORT_TIMEOUT));
	ASSERT_TRUE(property_state(mount, MOUNT_MOTION_DEC_PROPERTY_NAME) != INDIGO_BUSY_STATE);
	double stopped_dec = 0, settled_dec = 0;
	ASSERT_TRUE(number_item(mount, MOUNT_RAW_COORDINATES_PROPERTY_NAME, MOUNT_RAW_COORDINATES_DEC_ITEM_NAME, &stopped_dec));
	indigo_usleep(3000000);
	ASSERT_TRUE(number_item(mount, MOUNT_RAW_COORDINATES_PROPERTY_NAME, MOUNT_RAW_COORDINATES_DEC_ITEM_NAME, &settled_dec));
	printf("    DEC after abort: %.5f -> %.5f\n", stopped_dec, settled_dec);
	ASSERT_TRUE(fabs(settled_dec - stopped_dec) < 0.02);
	// A fresh command must be accepted right after the abort.
	double travel = 0;
	ASSERT_TRUE(manual_motion_moves(MOUNT_MOTION_DEC_PROPERTY_NAME, MOUNT_MOTION_SOUTH_ITEM_NAME, false, &travel));
	ASSERT_TRUE(fabs(travel) > 0.002);
	ASSERT_TRUE(set_switch(mount, MOUNT_SLEW_RATE_PROPERTY_NAME, MOUNT_SLEW_RATE_GUIDE_ITEM_NAME, INDIGO_OK_STATE, SHORT_TIMEOUT));
}

static void synscan_syncs_and_slews(void) {
	double ra = 0, dec = 0, target_ra = 0, target_dec = 0, reached_ra = 0, reached_dec = 0;
	ASSERT_TRUE(prepare_mount());
	ASSERT_TRUE(slew_to_test_pointing());
	ASSERT_TRUE(set_switch(mount, MOUNT_TRACKING_PROPERTY_NAME, MOUNT_TRACKING_ON_ITEM_NAME, INDIGO_OK_STATE, SHORT_TIMEOUT));
	ASSERT_TRUE(current_coordinates(&ra, &dec));
	// SYNC must not move the mount, so it is checked against the pointing it already has.
	ASSERT_TRUE(set_switch(mount, MOUNT_ON_COORDINATES_SET_PROPERTY_NAME, MOUNT_ON_COORDINATES_SET_SYNC_ITEM_NAME, INDIGO_OK_STATE, SHORT_TIMEOUT));
	double raw_before = 0, raw_after = 0;
	ASSERT_TRUE(number_item(mount, MOUNT_RAW_COORDINATES_PROPERTY_NAME, MOUNT_RAW_COORDINATES_DEC_ITEM_NAME, &raw_before));
	ASSERT_TRUE(set_coordinates(mount, ra, dec, INDIGO_OK_STATE, SHORT_TIMEOUT));
	indigo_usleep(2000000);
	ASSERT_TRUE(number_item(mount, MOUNT_RAW_COORDINATES_PROPERTY_NAME, MOUNT_RAW_COORDINATES_DEC_ITEM_NAME, &raw_after));
	ASSERT_TRUE(current_coordinates(&reached_ra, &reached_dec));
	printf("    sync to RA %.5f DEC %.5f reports RA %.5f DEC %.5f, raw DEC %.5f -> %.5f\n", ra, dec, reached_ra, reached_dec, raw_before, raw_after);
	ASSERT_TRUE(fabs(raw_after - raw_before) < 0.02);
	ASSERT_NEAR(dec, reached_dec, 0.2);
	ASSERT_TRUE(fabs(ra_difference(reached_ra, ra)) < 0.02);
	// A small slew with tracking requested afterwards.
	ASSERT_TRUE(set_switch(mount, MOUNT_ON_COORDINATES_SET_PROPERTY_NAME, MOUNT_ON_COORDINATES_SET_TRACK_ITEM_NAME, INDIGO_OK_STATE, SHORT_TIMEOUT));
	ASSERT_TRUE(current_coordinates(&ra, &dec));
	nearby_target(ra, dec, &target_ra, &target_dec);
	printf("    slewing from RA %.5f DEC %.5f to RA %.5f DEC %.5f\n", ra, dec, target_ra, target_dec);
	// This slew also proves the accepted request is not reported as finished before it starts.
	ASSERT_TRUE(slew_reports_busy_until_arrival(mount, target_ra, target_dec, MOTION_TIMEOUT));
	ASSERT_TRUE(slew_coordinates(mount, target_ra, target_dec, MOTION_TIMEOUT));
	ASSERT_TRUE(current_coordinates(&reached_ra, &reached_dec));
	printf("    arrived at RA %.5f DEC %.5f\n", reached_ra, reached_dec);
	ASSERT_NEAR(target_dec, reached_dec, 0.3);
	ASSERT_TRUE(fabs(ra_difference(reached_ra, target_ra)) < 0.05);
	// MOUNT_ON_COORDINATES_SET.TRACK must leave the mount tracking after the slew.
	bool tracking = false;
	ASSERT_TRUE(switch_item(mount, MOUNT_TRACKING_PROPERTY_NAME, MOUNT_TRACKING_ON_ITEM_NAME, &tracking));
	ASSERT_TRUE(tracking);
	// Slewing back must work as a fresh operation.
	ASSERT_TRUE(slew_coordinates(mount, ra, dec, MOTION_TIMEOUT));
	ASSERT_TRUE(current_coordinates(&reached_ra, &reached_dec));
	ASSERT_NEAR(dec, reached_dec, 0.3);
	ASSERT_TRUE(fabs(ra_difference(reached_ra, ra)) < 0.05);
}

static void synscan_aborts_slew_and_recovers(void) {
	double ra = 0, dec = 0, target_ra = 0, target_dec = 0, aborted_dec = 0, settled_dec = 0;
	ASSERT_TRUE(prepare_mount());
	ASSERT_TRUE(slew_to_test_pointing());
	ASSERT_TRUE(current_coordinates(&ra, &dec));
	// A long declination excursion, aborted as soon as the slew is reported as started. The
	// controller reaches several degrees per second, so a shorter target would be reached before
	// the abort arrives.
	target_dec = dec - 40.0;
	target_ra = ra;
	ASSERT_TRUE(set_switch(mount, MOUNT_ON_COORDINATES_SET_PROPERTY_NAME, MOUNT_ON_COORDINATES_SET_SLEW_ITEM_NAME, INDIGO_OK_STATE, SHORT_TIMEOUT));
	static const char *items[] = { MOUNT_EQUATORIAL_COORDINATES_RA_ITEM_NAME, MOUNT_EQUATORIAL_COORDINATES_DEC_ITEM_NAME };
	double values[] = { target_ra, target_dec };
	indigo_change_number_property(&client, devices[mount].name, MOUNT_EQUATORIAL_COORDINATES_PROPERTY_NAME, 2, items, values);
	ASSERT_TRUE(wait_settled(mount, MOUNT_EQUATORIAL_COORDINATES_PROPERTY_NAME, INDIGO_BUSY_STATE, SHORT_TIMEOUT));
	ASSERT_TRUE(set_switch(mount, MOUNT_ABORT_MOTION_PROPERTY_NAME, MOUNT_ABORT_MOTION_ITEM_NAME, INDIGO_OK_STATE, SHORT_TIMEOUT));
	// The aborted slew must report ALERT rather than a silent OK, and must not stay BUSY.
	ASSERT_TRUE(wait_settled(mount, MOUNT_EQUATORIAL_COORDINATES_PROPERTY_NAME, INDIGO_ALERT_STATE, SHORT_TIMEOUT));
	// The axis coasts to a stop after the instant-stop command, so the check is that it comes to
	// rest, not that it froze in place at the moment of the abort.
	indigo_usleep(2000000);
	ASSERT_TRUE(number_item(mount, MOUNT_RAW_COORDINATES_PROPERTY_NAME, MOUNT_RAW_COORDINATES_DEC_ITEM_NAME, &aborted_dec));
	indigo_usleep(4000000);
	ASSERT_TRUE(number_item(mount, MOUNT_RAW_COORDINATES_PROPERTY_NAME, MOUNT_RAW_COORDINATES_DEC_ITEM_NAME, &settled_dec));
	printf("    aborted slew stopped the DEC axis: %.5f -> %.5f\n", aborted_dec, settled_dec);
	ASSERT_TRUE(fabs(settled_dec - aborted_dec) < 0.02);
	// The mount must not have reached the abandoned target.
	double reached_ra = 0, reached_dec = 0;
	ASSERT_TRUE(current_coordinates(&reached_ra, &reached_dec));
	printf("    abandoned target DEC %.5f, stopped at DEC %.5f\n", target_dec, reached_dec);
	ASSERT_TRUE(fabs(reached_dec - target_dec) > 0.5);
	// A fresh slew back to the starting pointing must succeed right after the abort.
	ASSERT_TRUE(slew_coordinates(mount, ra, dec, MOTION_TIMEOUT));
	ASSERT_TRUE(current_coordinates(&reached_ra, &reached_dec));
	printf("    recovered to RA %.5f DEC %.5f\n", reached_ra, reached_dec);
	ASSERT_NEAR(dec, reached_dec, 0.3);
	ASSERT_TRUE(set_switch(mount, MOUNT_ON_COORDINATES_SET_PROPERTY_NAME, MOUNT_ON_COORDINATES_SET_TRACK_ITEM_NAME, INDIGO_OK_STATE, SHORT_TIMEOUT));
}

static void synscan_parks_and_unparks(void) {
	double ra = 0, dec = 0, drift = 0, park_ha = 0, park_dec = 0;
	ASSERT_TRUE(prepare_mount());
	ASSERT_TRUE(slew_to_test_pointing());
	ASSERT_TRUE(current_coordinates(&ra, &dec));
	// Park where the mount already is, so the park workflow is exercised with a short slew.
	ASSERT_TRUE(set_switch(mount, MOUNT_PARK_SET_PROPERTY_NAME, MOUNT_PARK_SET_CURRENT_ITEM_NAME, INDIGO_OK_STATE, SHORT_TIMEOUT));
	ASSERT_TRUE(number_item(mount, MOUNT_PARK_POSITION_PROPERTY_NAME, MOUNT_PARK_POSITION_HA_ITEM_NAME, &park_ha));
	ASSERT_TRUE(number_item(mount, MOUNT_PARK_POSITION_PROPERTY_NAME, MOUNT_PARK_POSITION_DEC_ITEM_NAME, &park_dec));
	printf("    park position set to HA %.5f DEC %.5f\n", park_ha, park_dec);
	ASSERT_NEAR(dec, park_dec, 0.3);
	ASSERT_TRUE(set_switch(mount, MOUNT_PARK_PROPERTY_NAME, MOUNT_PARK_PARKED_ITEM_NAME, INDIGO_OK_STATE, MOTION_TIMEOUT));
	bool parked = false, tracking = true;
	ASSERT_TRUE(switch_item(mount, MOUNT_PARK_PROPERTY_NAME, MOUNT_PARK_PARKED_ITEM_NAME, &parked));
	ASSERT_TRUE(parked);
	// A completed park stops tracking, and must say so before anything else touches the property.
	// The rejected requests below leave their requested values in MOUNT_TRACKING, so this is the
	// only point at which the published tracking state can be checked.
	ASSERT_TRUE(switch_item(mount, MOUNT_TRACKING_PROPERTY_NAME, MOUNT_TRACKING_ON_ITEM_NAME, &tracking));
	ASSERT_FALSE(tracking);
	// A parked mount must refuse motion, tracking and goto requests.
	ASSERT_TRUE(set_switch(mount, MOUNT_TRACKING_PROPERTY_NAME, MOUNT_TRACKING_ON_ITEM_NAME, INDIGO_ALERT_STATE, SHORT_TIMEOUT));
	ASSERT_TRUE(set_switch(mount, MOUNT_MOTION_RA_PROPERTY_NAME, MOUNT_MOTION_WEST_ITEM_NAME, INDIGO_ALERT_STATE, SHORT_TIMEOUT));
	ASSERT_TRUE(set_switch(mount, MOUNT_MOTION_DEC_PROPERTY_NAME, MOUNT_MOTION_NORTH_ITEM_NAME, INDIGO_ALERT_STATE, SHORT_TIMEOUT));
	ASSERT_TRUE(set_coordinates(mount, ra, dec, INDIGO_ALERT_STATE, SHORT_TIMEOUT));
	// Parking must stop the RA axis, so the reported right ascension has to run away at the
	// sidereal rate of 0.05 degrees over 12 s instead of standing still.
	ASSERT_TRUE(measure_ra_drift(12.0, &drift));
	printf("    parked RA axis: reported RA moved %.5f degrees in 12 s, sidereal is 0.050\n", drift);
	ASSERT_NEAR(0.050, fabs(drift), 0.02);
	ASSERT_TRUE(set_switch(mount, MOUNT_PARK_PROPERTY_NAME, MOUNT_PARK_UNPARKED_ITEM_NAME, INDIGO_OK_STATE, SHORT_TIMEOUT));
	// Everything refused above must be accepted again once the mount is unparked.
	ASSERT_TRUE(set_switch(mount, MOUNT_TRACKING_PROPERTY_NAME, MOUNT_TRACKING_ON_ITEM_NAME, INDIGO_OK_STATE, SHORT_TIMEOUT));
	ASSERT_TRUE(set_switch(mount, MOUNT_TRACKING_PROPERTY_NAME, MOUNT_TRACKING_OFF_ITEM_NAME, INDIGO_OK_STATE, SHORT_TIMEOUT));
}

static void synscan_homes(void) {
	double ra = 0, dec = 0, home_ha = 0, home_dec = 0, reached_ra = 0, reached_dec = 0;
	ASSERT_TRUE(prepare_mount());
	ASSERT_TRUE(slew_to_test_pointing());
	ASSERT_TRUE(current_coordinates(&ra, &dec));
	// Home to the current pointing so the home workflow runs without a large rotation.
	ASSERT_TRUE(set_switch(mount, MOUNT_HOME_SET_PROPERTY_NAME, MOUNT_HOME_SET_CURRENT_ITEM_NAME, INDIGO_OK_STATE, SHORT_TIMEOUT));
	ASSERT_TRUE(number_item(mount, MOUNT_HOME_POSITION_PROPERTY_NAME, MOUNT_HOME_POSITION_HA_ITEM_NAME, &home_ha));
	ASSERT_TRUE(number_item(mount, MOUNT_HOME_POSITION_PROPERTY_NAME, MOUNT_HOME_POSITION_DEC_ITEM_NAME, &home_dec));
	printf("    home position set to HA %.5f DEC %.5f\n", home_ha, home_dec);
	ASSERT_TRUE(set_switch(mount, MOUNT_TRACKING_PROPERTY_NAME, MOUNT_TRACKING_ON_ITEM_NAME, INDIGO_OK_STATE, SHORT_TIMEOUT));
	ASSERT_TRUE(set_switch(mount, MOUNT_HOME_PROPERTY_NAME, MOUNT_HOME_ITEM_NAME, INDIGO_OK_STATE, MOTION_TIMEOUT));
	ASSERT_TRUE(current_coordinates(&reached_ra, &reached_dec));
	printf("    homed to RA %.5f DEC %.5f\n", reached_ra, reached_dec);
	ASSERT_NEAR(home_dec, reached_dec, 0.3);
	// A completed home procedure must stop tracking.
	bool tracking = false;
	ASSERT_TRUE(switch_item(mount, MOUNT_TRACKING_PROPERTY_NAME, MOUNT_TRACKING_ON_ITEM_NAME, &tracking));
	ASSERT_FALSE(tracking);
	indigo_property_state home_light = INDIGO_IDLE_STATE;
	pthread_mutex_lock(&mutex);
	int p = slot(mount, MOUNT_STATE_PROPERTY_NAME);
	if (p >= 0) {
		indigo_property *property = devices[mount].properties[p];
		for (int i = 0; i < property->count; i++) {
			if (!strcmp(property->items[i].name, MOUNT_STATE_HOME_ITEM_NAME)) {
				home_light = property->items[i].light.value;
			}
		}
	}
	pthread_mutex_unlock(&mutex);
	printf("    MOUNT_STATE.HOME light: %d\n", home_light);
	ASSERT_TRUE(home_light == INDIGO_OK_STATE);
}

static void synscan_runs_autohome(void) {
	if (!property_defined(mount, MOUNT_AUTOHOME_PROPERTY_NAME)) {
		printf("    controller reports no home indexer, autohome not applicable\n");
		return;
	}
	if (!getenv("SYNSCAN_HW_AUTOHOME")) {
		printf("    autohome skipped, set SYNSCAN_HW_AUTOHOME=1 to run it\n");
		return;
	}
	ASSERT_TRUE(prepare_mount());
	ASSERT_TRUE(set_number(mount, MOUNT_AUTOHOME_SETTINGS_PROPERTY_NAME, MOUNT_AUTOHOME_DEC_OFFSET_ITEM_NAME, 0, INDIGO_OK_STATE, SHORT_TIMEOUT));
	unsigned before = revision(mount, MOUNT_AUTOHOME_PROPERTY_NAME);
	indigo_change_switch_property_1(&client, devices[mount].name, MOUNT_AUTOHOME_PROPERTY_NAME, MOUNT_AUTOHOME_ITEM_NAME, true);
	ASSERT_TRUE(wait_state(mount, MOUNT_AUTOHOME_PROPERTY_NAME, before, INDIGO_BUSY_STATE, SHORT_TIMEOUT));
	// The coordinates must report the procedure as motion in progress.
	ASSERT_TRUE(property_state(mount, MOUNT_EQUATORIAL_COORDINATES_PROPERTY_NAME) == INDIGO_BUSY_STATE);
	ASSERT_TRUE(wait_settled(mount, MOUNT_AUTOHOME_PROPERTY_NAME, INDIGO_OK_STATE, AUTOHOME_TIMEOUT));
	bool running = true;
	ASSERT_TRUE(switch_item(mount, MOUNT_AUTOHOME_PROPERTY_NAME, MOUNT_AUTOHOME_ITEM_NAME, &running));
	ASSERT_FALSE(running);
	ASSERT_TRUE(wait_settled(mount, MOUNT_EQUATORIAL_COORDINATES_PROPERTY_NAME, INDIGO_OK_STATE, MOTION_TIMEOUT));
	double reached_ra = 0, reached_dec = 0;
	ASSERT_TRUE(current_coordinates(&reached_ra, &reached_dec));
	printf("    autohome finished at RA %.5f DEC %.5f\n", reached_ra, reached_dec);
}

static void synscan_controls_snap_port(void) {
	if (!property_defined(aux, CCD_EXPOSURE_PROPERTY_NAME)) {
		printf("    controller has no snap port, AUX shutter not applicable\n");
		return;
	}
	unsigned before = revision(aux, CCD_EXPOSURE_PROPERTY_NAME);
	indigo_change_number_property_1(&client, devices[aux].name, CCD_EXPOSURE_PROPERTY_NAME, CCD_EXPOSURE_ITEM_NAME, 3);
	ASSERT_TRUE(wait_state(aux, CCD_EXPOSURE_PROPERTY_NAME, before, INDIGO_BUSY_STATE, SHORT_TIMEOUT));
	ASSERT_TRUE(wait_settled(aux, CCD_EXPOSURE_PROPERTY_NAME, INDIGO_OK_STATE, SHORT_TIMEOUT));
	// An aborted exposure must release the snap port and report ALERT.
	before = revision(aux, CCD_EXPOSURE_PROPERTY_NAME);
	indigo_change_number_property_1(&client, devices[aux].name, CCD_EXPOSURE_PROPERTY_NAME, CCD_EXPOSURE_ITEM_NAME, 20);
	ASSERT_TRUE(wait_state(aux, CCD_EXPOSURE_PROPERTY_NAME, before, INDIGO_BUSY_STATE, SHORT_TIMEOUT));
	ASSERT_TRUE(set_switch(aux, CCD_ABORT_EXPOSURE_PROPERTY_NAME, CCD_ABORT_EXPOSURE_ITEM_NAME, INDIGO_OK_STATE, SHORT_TIMEOUT));
	ASSERT_TRUE(wait_settled(aux, CCD_EXPOSURE_PROPERTY_NAME, INDIGO_ALERT_STATE, SHORT_TIMEOUT));
}

// Measures how long a guide pulse keeps GUIDER_GUIDE_* busy, from issuing the request to the
// completion update. This is public-property completion timing over the network transport and the
// driver's finalizer, not an electrical measurement of the ST4 relay output.
static bool measure_pulse(const char *property, const char *item, double request_ms, double *error_ms) {
	unsigned before = revision(guider, property);
	double started = indigo_monotonic_time();
	indigo_change_number_property_1(&client, devices[guider].name, property, item, request_ms);
	if (!wait_state(guider, property, before, INDIGO_BUSY_STATE, SHORT_TIMEOUT)) {
		return false;
	}
	if (!wait_settled(guider, property, INDIGO_OK_STATE, SHORT_TIMEOUT)) {
		return false;
	}
	*error_ms = (indigo_monotonic_time() - started) * 1000.0 - request_ms;
	return true;
}

static void synscan_guides(void) {
	ASSERT_TRUE(prepare_mount());
	ASSERT_TRUE(slew_to_test_pointing());
	ASSERT_TRUE(set_number(guider, GUIDER_RATE_PROPERTY_NAME, GUIDER_RATE_ITEM_NAME, 50, INDIGO_OK_STATE, SHORT_TIMEOUT));
	ASSERT_TRUE(set_number(guider, GUIDER_RATE_PROPERTY_NAME, GUIDER_DEC_RATE_ITEM_NAME, 50, INDIGO_OK_STATE, SHORT_TIMEOUT));
	// An RA pulse needs the RA axis to be tracking; the driver must refuse it otherwise.
	ASSERT_TRUE(set_switch(mount, MOUNT_TRACKING_PROPERTY_NAME, MOUNT_TRACKING_OFF_ITEM_NAME, INDIGO_OK_STATE, SHORT_TIMEOUT));
	ASSERT_TRUE(set_number(guider, GUIDER_GUIDE_RA_PROPERTY_NAME, GUIDER_GUIDE_WEST_ITEM_NAME, 300, INDIGO_ALERT_STATE, SHORT_TIMEOUT));
	// A DEC pulse does not require tracking.
	double error_ms = 0;
	ASSERT_TRUE(measure_pulse(GUIDER_GUIDE_DEC_PROPERTY_NAME, GUIDER_GUIDE_NORTH_ITEM_NAME, 300, &error_ms));
	ASSERT_TRUE(set_switch(mount, MOUNT_TRACKING_PROPERTY_NAME, MOUNT_TRACKING_ON_ITEM_NAME, INDIGO_OK_STATE, SHORT_TIMEOUT));
	// A pulse while tracking runs the RA axis off the tracking rate for its duration, which shows
	// as a shift of the reported right ascension. One pulse moves less than the resolution the
	// mount reports positions at, so the effect is accumulated over a train of pulses and checked
	// in both directions. At the 50 % guide rate in use here one second of pulse is worth about
	// 0.002 degrees, so eight pulses have to clear the noise of a tracking axis comfortably.
	double raw_before = 0, raw_after = 0, west_travel = 0, east_travel = 0;
	ASSERT_TRUE(number_item(mount, MOUNT_RAW_COORDINATES_PROPERTY_NAME, MOUNT_RAW_COORDINATES_RA_ITEM_NAME, &raw_before));
	for (int i = 0; i < 8; i++) {
		ASSERT_TRUE(measure_pulse(GUIDER_GUIDE_RA_PROPERTY_NAME, GUIDER_GUIDE_WEST_ITEM_NAME, 1000, &error_ms));
	}
	ASSERT_TRUE(number_item(mount, MOUNT_RAW_COORDINATES_PROPERTY_NAME, MOUNT_RAW_COORDINATES_RA_ITEM_NAME, &raw_after));
	west_travel = ra_difference(raw_after, raw_before) * 15.0;
	raw_before = raw_after;
	for (int i = 0; i < 8; i++) {
		ASSERT_TRUE(measure_pulse(GUIDER_GUIDE_RA_PROPERTY_NAME, GUIDER_GUIDE_EAST_ITEM_NAME, 1000, &error_ms));
	}
	ASSERT_TRUE(number_item(mount, MOUNT_RAW_COORDINATES_PROPERTY_NAME, MOUNT_RAW_COORDINATES_RA_ITEM_NAME, &raw_after));
	east_travel = ra_difference(raw_after, raw_before) * 15.0;
	// Compare the two trains against each other rather than against zero. Both are measured on a
	// tracking axis whose rate is not exact, and that common tracking error cancels in the
	// difference while the guide correction does not. Eight pulses of one second at the 50 % guide
	// rate are worth about 0.017 degrees each way, so the two trains should differ by about 0.033
	// degrees, with west lowering the reported right ascension and east raising it.
	double differential = west_travel - east_travel;
	printf("    8 x 1000 ms west pulses moved the reported RA by %.5f degrees, 8 x east by %.5f, differential %.5f\n", west_travel, east_travel, differential);
	ASSERT_TRUE(differential < 0);
	ASSERT_NEAR(0.033, fabs(differential), 0.020);
	// The RA axis must be tracking again once the pulse finished, which shows as a reported right
	// ascension that stands still.
	bool tracking = false;
	ASSERT_TRUE(switch_item(mount, MOUNT_TRACKING_PROPERTY_NAME, MOUNT_TRACKING_ON_ITEM_NAME, &tracking));
	ASSERT_TRUE(tracking);
	double drift = 0;
	ASSERT_TRUE(measure_ra_drift(12.0, &drift));
	printf("    RA drift over 12 s after the pulse: %.5f degrees, a stopped axis would show 0.050\n", drift);
	ASSERT_TRUE(fabs(drift) < 0.01);
	// A same-direction pulse issued while another is running replaces it, so the axis stops one
	// new duration after the second request, not at the first pulse's deadline. The second pulse
	// is deliberately shorter than what is left of the first: replacing finishes at about
	// 500 + 600 ms, whereas extending or keeping the longer deadline would run the full 2000 ms,
	// so the two behaviours cannot be confused.
	unsigned before = revision(guider, GUIDER_GUIDE_DEC_PROPERTY_NAME);
	double started = indigo_monotonic_time();
	indigo_change_number_property_1(&client, devices[guider].name, GUIDER_GUIDE_DEC_PROPERTY_NAME, GUIDER_GUIDE_NORTH_ITEM_NAME, 2000);
	ASSERT_TRUE(wait_state(guider, GUIDER_GUIDE_DEC_PROPERTY_NAME, before, INDIGO_BUSY_STATE, SHORT_TIMEOUT));
	indigo_usleep(500000);
	indigo_change_number_property_1(&client, devices[guider].name, GUIDER_GUIDE_DEC_PROPERTY_NAME, GUIDER_GUIDE_NORTH_ITEM_NAME, 600);
	ASSERT_TRUE(wait_settled(guider, GUIDER_GUIDE_DEC_PROPERTY_NAME, INDIGO_OK_STATE, SHORT_TIMEOUT));
	double replaced = (indigo_monotonic_time() - started) * 1000.0;
	printf("    2000 ms north pulse replaced after 500 ms by a 600 ms north pulse finished in %.0f ms\n", replaced);
	ASSERT_TRUE(replaced > 900 && replaced < 1600);
	// An opposite-direction pulse on the same axis replaces the active pulse the same way, so it
	// completes on the new, shorter schedule rather than the one it superseded.
	before = revision(guider, GUIDER_GUIDE_DEC_PROPERTY_NAME);
	started = indigo_monotonic_time();
	indigo_change_number_property_1(&client, devices[guider].name, GUIDER_GUIDE_DEC_PROPERTY_NAME, GUIDER_GUIDE_NORTH_ITEM_NAME, 2500);
	ASSERT_TRUE(wait_state(guider, GUIDER_GUIDE_DEC_PROPERTY_NAME, before, INDIGO_BUSY_STATE, SHORT_TIMEOUT));
	indigo_usleep(500000);
	indigo_change_number_property_1(&client, devices[guider].name, GUIDER_GUIDE_DEC_PROPERTY_NAME, GUIDER_GUIDE_SOUTH_ITEM_NAME, 500);
	ASSERT_TRUE(wait_settled(guider, GUIDER_GUIDE_DEC_PROPERTY_NAME, INDIGO_OK_STATE, SHORT_TIMEOUT));
	double cancelled = (indigo_monotonic_time() - started) * 1000.0;
	printf("    2500 ms north pulse cancelled by a 500 ms south pulse finished in %.0f ms\n", cancelled);
	ASSERT_TRUE(cancelled > 800 && cancelled < 1600);
	// A shorter pulse in the same direction is what separates replacing the running pulse from
	// extending it: replacing ends on the new, earlier deadline, extending would keep the original
	// one. A 3000 ms pulse replaced after 500 ms by a 500 ms pulse must finish near 1000 ms, not
	// near 3000 ms.
	before = revision(guider, GUIDER_GUIDE_DEC_PROPERTY_NAME);
	started = indigo_monotonic_time();
	indigo_change_number_property_1(&client, devices[guider].name, GUIDER_GUIDE_DEC_PROPERTY_NAME, GUIDER_GUIDE_NORTH_ITEM_NAME, 3000);
	ASSERT_TRUE(wait_state(guider, GUIDER_GUIDE_DEC_PROPERTY_NAME, before, INDIGO_BUSY_STATE, SHORT_TIMEOUT));
	indigo_usleep(500000);
	indigo_change_number_property_1(&client, devices[guider].name, GUIDER_GUIDE_DEC_PROPERTY_NAME, GUIDER_GUIDE_NORTH_ITEM_NAME, 500);
	ASSERT_TRUE(wait_settled(guider, GUIDER_GUIDE_DEC_PROPERTY_NAME, INDIGO_OK_STATE, SHORT_TIMEOUT));
	double shortened = (indigo_monotonic_time() - started) * 1000.0;
	printf("    3000 ms north pulse replaced after 500 ms by a 500 ms north pulse finished in %.0f ms\n", shortened);
	ASSERT_TRUE(shortened > 800 && shortened < 1600);
}

// Required by the guider standard: a duration accuracy measurement over a range of pulse lengths.
static void synscan_guide_pulse_accuracy(void) {
	static const double durations[] = { 100, 250, 500, 1000, 2000 };
	static const char *axes[] = { GUIDER_GUIDE_RA_PROPERTY_NAME, GUIDER_GUIDE_DEC_PROPERTY_NAME };
	static const char *items[] = { GUIDER_GUIDE_WEST_ITEM_NAME, GUIDER_GUIDE_NORTH_ITEM_NAME };
	ASSERT_TRUE(prepare_mount());
	ASSERT_TRUE(set_switch(mount, MOUNT_TRACKING_PROPERTY_NAME, MOUNT_TRACKING_ON_ITEM_NAME, INDIGO_OK_STATE, SHORT_TIMEOUT));
	for (int a = 0; a < ARRAY_SIZE(axes); a++) {
		for (int d = 0; d < ARRAY_SIZE(durations); d++) {
			double sum = 0, sum_absolute = 0, worst = 0, minimum = 0, maximum = 0;
			int samples = 5;
			for (int i = 0; i < samples; i++) {
				double error_ms = 0;
				if (!measure_pulse(axes[a], items[a], durations[d], &error_ms)) {
					indigo_test_failures++;
					return;
				}
				sum += error_ms;
				sum_absolute += fabs(error_ms);
				if (fabs(error_ms) > worst) {
					worst = fabs(error_ms);
				}
				if (i == 0 || error_ms < minimum) {
					minimum = error_ms;
				}
				if (i == 0 || error_ms > maximum) {
					maximum = error_ms;
				}
				indigo_usleep(400000);
			}
			printf("    %s %.0f ms x%d: mean %+.1f ms, mean |error| %.1f ms, min %+.1f ms, max %+.1f ms\n", axes[a], durations[d], samples, sum / samples, sum_absolute / samples, minimum, maximum);
			// The finalizer runs on the shared mount queue and each stop is one UDP transaction,
			// so a pulse is expected to overrun slightly, never to end early.
			ASSERT_TRUE(minimum > -20.0);
			ASSERT_TRUE(worst < 400.0);
		}
	}
}

static void synscan_reconnects(void) {
	// The guider and the aux device share the mount connection; disconnecting the mount must not
	// break a later connection in either order.
	ASSERT_TRUE(disconnect_device(aux));
	ASSERT_TRUE(disconnect_device(guider));
	ASSERT_TRUE(disconnect_device(mount));
	ASSERT_TRUE(connect_device(mount, MOTION_TIMEOUT));
	ASSERT_TRUE(connect_device(guider, SHORT_TIMEOUT));
	ASSERT_TRUE(connect_aux());
	double ra = 0, dec = 0;
	ASSERT_TRUE(current_coordinates(&ra, &dec));
	printf("    reconnected, RA %.5f DEC %.5f\n", ra, dec);
	// Connecting a shared device first must open the transport through the master.
	ASSERT_TRUE(disconnect_device(aux));
	ASSERT_TRUE(disconnect_device(guider));
	ASSERT_TRUE(disconnect_device(mount));
	ASSERT_TRUE(connect_device(guider, MOTION_TIMEOUT));
	ASSERT_TRUE(connect_device(mount, SHORT_TIMEOUT));
	ASSERT_TRUE(current_coordinates(&ra, &dec));
	printf("    guider-first connection succeeded, RA %.5f DEC %.5f\n", ra, dec);
	// Disconnecting the master while a slave is still connected must leave the slave usable.
	ASSERT_TRUE(disconnect_device(mount));
	ASSERT_TRUE(set_number(guider, GUIDER_RATE_PROPERTY_NAME, GUIDER_RATE_ITEM_NAME, 50, INDIGO_OK_STATE, SHORT_TIMEOUT));
	ASSERT_TRUE(disconnect_device(guider));
	ASSERT_TRUE(connect_device(mount, MOTION_TIMEOUT));
	ASSERT_TRUE(connect_device(guider, SHORT_TIMEOUT));
	ASSERT_TRUE(connect_aux());
}

// The UDP transport has no session to drop, so an unreachable mount is the reachable failure mode
// on this connection: the driver has to give up within its command timeout and leave the
// connection property in a clean refused state rather than hanging or staying busy.
static void synscan_reports_unreachable_mount(void) {
	ASSERT_TRUE(disconnect_device(aux));
	ASSERT_TRUE(disconnect_device(guider));
	ASSERT_TRUE(disconnect_device(mount));
	// 203.0.113.0/24 is the TEST-NET-3 range, reserved for documentation and never routed.
	ASSERT_TRUE(set_text(mount, DEVICE_PORT_PROPERTY_NAME, DEVICE_PORT_ITEM_NAME, "synscan://203.0.113.1:11880", INDIGO_OK_STATE, SHORT_TIMEOUT));
	unsigned before = revision(mount, CONNECTION_PROPERTY_NAME);
	double started = indigo_monotonic_time();
	indigo_change_switch_property_1(&client, devices[mount].name, CONNECTION_PROPERTY_NAME, CONNECTION_CONNECTED_ITEM_NAME, true);
	ASSERT_TRUE(wait_state(mount, CONNECTION_PROPERTY_NAME, before, INDIGO_ALERT_STATE, MOTION_TIMEOUT));
	printf("    unreachable mount refused after %.1f s\n", indigo_monotonic_time() - started);
	bool connected = true;
	ASSERT_TRUE(switch_item(mount, CONNECTION_PROPERTY_NAME, CONNECTION_CONNECTED_ITEM_NAME, &connected));
	ASSERT_FALSE(connected);
	// The real mount must still be usable afterwards.
	ASSERT_TRUE(select_mount_url());
	ASSERT_TRUE(connect_device(mount, MOTION_TIMEOUT));
	ASSERT_TRUE(connect_device(guider, SHORT_TIMEOUT));
	ASSERT_TRUE(connect_aux());
	double ra = 0, dec = 0;
	ASSERT_TRUE(current_coordinates(&ra, &dec));
	printf("    recovered on the real mount, RA %.5f DEC %.5f\n", ra, dec);
}

static void synscan_reinitializes(void) {
	ASSERT_TRUE(disconnect_device(aux));
	ASSERT_TRUE(disconnect_device(guider));
	ASSERT_TRUE(disconnect_device(mount));
	ASSERT_TRUE(indigo_mount_synscan(INDIGO_DRIVER_SHUTDOWN, NULL) == INDIGO_OK);
	ASSERT_TRUE(indigo_mount_synscan(INDIGO_DRIVER_INIT, NULL) == INDIGO_OK);
	ASSERT_TRUE(wait_presence(SHORT_TIMEOUT));
	ASSERT_TRUE(select_mount_url());
	ASSERT_TRUE(connect_device(mount, MOTION_TIMEOUT));
	double ra = 0, dec = 0;
	ASSERT_TRUE(current_coordinates(&ra, &dec));
	printf("    driver reinitialized, RA %.5f DEC %.5f\n", ra, dec);
	// The session teardown restores the mount, so leave the shared connection up.
	ASSERT_TRUE(connect_device(guider, SHORT_TIMEOUT));
	ASSERT_TRUE(connect_aux());
}

int main(int argc, char **argv) {
	if (argc < 2 || strcmp(argv[1], "--run")) {
		fprintf(stderr, "Physical SynScan mount test: run explicitly with --run (or make test-mount-synscan-hw).\n");
		return 2;
	}
	setvbuf(stdout, NULL, _IONBF, 0);
	if (getenv("SYNSCAN_HW_DEBUG")) {
		indigo_set_log_level(INDIGO_LOG_DEBUG);
	}
	const char *url = getenv("SYNSCAN_HW_URL");
	if (url && *url) {
		mount_url = url;
	}
	const char *latitude = getenv("SYNSCAN_HW_LATITUDE");
	if (latitude && *latitude) {
		site_latitude = atof(latitude);
	}
	const char *longitude = getenv("SYNSCAN_HW_LONGITUDE");
	if (longitude && *longitude) {
		site_longitude = atof(longitude);
	}
	const char *declination = getenv("SYNSCAN_HW_DECLINATION");
	if (declination && *declination) {
		test_declination = atof(declination);
	}
	if (indigo_test_mkdtemp_home(park_folder) == NULL) {
		perror("mkdtemp");
		return 2;
	}
	printf("Connecting to %s\n", mount_url);
	client = (indigo_client){ .name = "SynScan hardware test", .version = INDIGO_VERSION_CURRENT, .define_property = define_property, .update_property = update_property, .delete_property = delete_property, .send_message = report_message };
	const indigo_test_case tests[] = {
		{ "synscan_discovers_and_connects", synscan_discovers_and_connects },
		{ "synscan_reports_identity_and_capabilities", synscan_reports_identity_and_capabilities },
		{ "synscan_reads_coordinates_and_state", synscan_reads_coordinates_and_state },
		{ "synscan_tracking_and_rates", synscan_tracking_and_rates },
		{ "synscan_manual_motion", synscan_manual_motion },
		{ "synscan_syncs_and_slews", synscan_syncs_and_slews },
		{ "synscan_aborts_slew_and_recovers", synscan_aborts_slew_and_recovers },
		{ "synscan_parks_and_unparks", synscan_parks_and_unparks },
		{ "synscan_homes", synscan_homes },
		{ "synscan_runs_autohome", synscan_runs_autohome },
		{ "synscan_controls_snap_port", synscan_controls_snap_port },
		{ "synscan_guides", synscan_guides },
		{ "synscan_guide_pulse_accuracy", synscan_guide_pulse_accuracy },
		{ "synscan_reconnects", synscan_reconnects },
		{ "synscan_reports_unreachable_mount", synscan_reports_unreachable_mount },
		{ "synscan_reinitializes", synscan_reinitializes }
	};
	int result = 1;
	bool started = false, initialized = false;
	CHECK(indigo_start() == INDIGO_OK);
	started = true;
	CHECK(indigo_attach_client(&client) == INDIGO_OK);
	CHECK(indigo_mount_synscan(INDIGO_DRIVER_INIT, NULL) == INDIGO_OK);
	initialized = true;
	CHECK(wait_presence(SHORT_TIMEOUT));
	CHECK(select_mount_url());
	CHECK(connect_device(mount, MOTION_TIMEOUT));
	CHECK(connect_device(guider, SHORT_TIMEOUT));
	aux_has_snap_port = connect_device(aux, SHORT_TIMEOUT);
	if (!aux_has_snap_port) {
		printf("The aux device was refused, the controller has no snap port\n");
	}
	CHECK(clear_alignment_model());
	CHECK(set_site());
	CHECK(capture_initial_settings());
	printf("Starting pointing: RA %.5f, DEC %.5f, tracking %s\n", initial_ra, initial_dec, initial_tracking ? "on" : "off");
	result = indigo_run_tests("SynScan mount hardware", tests, ARRAY_SIZE(tests));
cleanup:
	if (mount >= 0 && devices[mount].present) {
		stop_all_motion();
		restore_initial_settings();
		// Put the mount back where the session found it.
		if (settings_captured && slew_coordinates(mount, initial_ra, initial_dec, MOTION_TIMEOUT)) {
			printf("Restored the starting pointing RA %.5f, DEC %.5f\n", initial_ra, initial_dec);
		}
		set_switch(mount, MOUNT_TRACKING_PROPERTY_NAME, initial_tracking ? MOUNT_TRACKING_ON_ITEM_NAME : MOUNT_TRACKING_OFF_ITEM_NAME, INDIGO_OK_STATE, SHORT_TIMEOUT);
	}
	if (!disconnect_device(aux) || !disconnect_device(guider) || !disconnect_device(mount)) {
		indigo_test_failures++;
	}
	if (initialized && indigo_mount_synscan(INDIGO_DRIVER_SHUTDOWN, NULL) != INDIGO_OK) {
		indigo_test_failures++;
	}
	indigo_detach_client(&client);
	if (started) {
		indigo_stop();
	}
	for (int d = 0; d < MAX_DEVICES; d++) {
		for (int p = 0; p < MAX_PROPERTIES; p++) {
			indigo_release_property(devices[d].properties[p]);
		}
	}
	remove_park_files();
	indigo_test_remove_tree(park_folder);
	return indigo_test_failures ? 1 : result;
}
