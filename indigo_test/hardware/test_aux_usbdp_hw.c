// Copyright (c) 2026 INDIGO initiative
// All rights reserved.
//
// You may use this software under the terms of 'INDIGO Astronomy
// open-source license' (see LICENSE.md).
//
// THIS SOFTWARE IS PROVIDED BY THE AUTHORS 'AS IS' AND ANY EXPRESS
// OR IMPLIED WARRANTIES, INCLUDING, BUT NOT LIMITED TO, THE IMPLIED
// WARRANTIES OF MERCHANTABILITY AND FITNESS FOR A PARTICULAR PURPOSE
// ARE DISCLAIMED. IN NO EVENT SHALL THE AUTHOR BE LIABLE FOR ANY
// DIRECT, INDIRECT, INCIDENTAL, SPECIAL, EXEMPLARY, OR CONSEQUENTIAL
// DAMAGES (INCLUDING, BUT NOT LIMITED TO, PROCUREMENT OF SUBSTITUTE
// GOODS OR SERVICES; LOSS OF USE, DATA, OR PROFITS; OR BUSINESS
// INTERRUPTION) HOWEVER CAUSED AND ON ANY THEORY OF LIABILITY,
// WHETHER IN CONTRACT, STRICT LIABILITY, OR TORT (INCLUDING
// NEGLIGENCE OR OTHERWISE) ARISING IN ANY WAY OUT OF THE USE OF THIS
// SOFTWARE, EVEN IF ADVISED OF THE POSSIBILITY OF SUCH DAMAGE.

// Code is generated by AI

// Opt-in acceptance test for a physically connected USB_Dewpoint (v1 or v2), or for the Arduino sketch
// aux_usbdp_simulator.ino running on a board. It checks the identified model and the properties it
// publishes, the sensor readings and their 2 s poll, and on a v2 the heater outputs, the calibration
// offsets, the dew thresholds, the channel 2 and 3 link, the automatic mode and the aggressivity, each read
// back from the status frame; then it reconnects and runs driver INIT/SHUTDOWN.
//
// THE HEATERS RUN. The session restores every v2 setting it found.
//
// The port comes from USBDP_HW_PORT. The driver has no match pattern, so the port must be given.

#include <math.h>
#include <stdlib.h>
#include <indigo_drivers/aux_usbdp/indigo_aux_usbdp.h>
#include "hardware_test_common.h"

#define DEVICE_NAME "USB Dewpoint"
#define CALIBRATION_PROPERTY_NAME "AUX_TEMPERATURE_CALLIBRATION"
#define LINK_PROPERTY_NAME "AUX_LINK_CHANNELS_2AND3"
#define AGGRESSIVITY_PROPERTY_NAME "AUX_HEATER_AGGRESSIVITY"

#define SHORT_TIMEOUT 15.0
// The status is polled every 2 s.
#define POLL_US 4500000

static const char *heater_items[] = { AUX_HEATER_OUTLET_1_ITEM_NAME, AUX_HEATER_OUTLET_2_ITEM_NAME, AUX_HEATER_OUTLET_3_ITEM_NAME };
static const char *calibration_items[] = { "SENSOR_1", "SENSOR_2", "SENSOR_3" };
static const char *threshold_items[] = { AUX_DEW_THRESHOLD_SENSOR_1_ITEM_NAME, AUX_DEW_THRESHOLD_SENSOR_2_ITEM_NAME };
static const char *aggressivity_items[] = { "AGGRESSIVITY_1", "AGGRESSIVITY_2", "AGGRESSIVITY_5", "AGGRESSIVITY_10" };

static int box = -1;
static const char *serial_port = NULL;
static bool v2 = false, state_captured = false;
static double initial_heaters[3], initial_calibration[3], initial_thresholds[2];
static bool initial_automatic, initial_linked;
static int initial_aggressivity = -1;

static bool select_port(void) {
	if (serial_port == NULL || !*serial_port) {
		fprintf(stderr, "    set USBDP_HW_PORT to the controller's serial port\n");
		return false;
	}
	printf("Using port %s\n", serial_port);
	return hw_set_text(box, DEVICE_PORT_PROPERTY_NAME, DEVICE_PORT_ITEM_NAME, serial_port, INDIGO_OK_STATE, SHORT_TIMEOUT);
}

static double value_of(const char *property, const char *item) {
	double value = NAN;
	hw_number_item(box, property, item, &value);
	return value;
}

static bool switch_is(const char *property, const char *item) {
	bool value = false;
	return hw_switch_item(box, property, item, &value) && value;
}

static bool set_numbers(const char *property, const char **items, const double *values, int count) {
	if (!hw_wait_settled(box, property, INDIGO_OK_STATE, SHORT_TIMEOUT)) {
		return false;
	}
	unsigned before = hw_revision(box, property);
	indigo_change_number_property(&hw_client, DEVICE_NAME, property, count, items, values);
	return hw_wait_state(box, property, before, INDIGO_OK_STATE, SHORT_TIMEOUT);
}

// The poll overwrites a setting with what the controller reports, so the value has to survive two polls.
static bool numbers_are(const char *property, const char **items, const double *values, int count) {
	indigo_usleep(POLL_US);
	for (int i = 0; i < count; i++) {
		if (!hw_wait_number(box, property, items[i], values[i], 0, 1)) {
			return false;
		}
	}
	return true;
}

static bool set_switch_item(const char *property, const char *item) {
	return hw_wait_settled(box, property, INDIGO_OK_STATE, SHORT_TIMEOUT) && hw_set_switch(box, property, item, INDIGO_OK_STATE, SHORT_TIMEOUT) && switch_is(property, item);
}

static bool switch_survives(const char *property, const char *item) {
	indigo_usleep(POLL_US);
	return switch_is(property, item);
}

static bool wait_for_first_poll(void) {
	double deadline = indigo_monotonic_time() + SHORT_TIMEOUT;
	while (indigo_monotonic_time() < deadline) {
		if (value_of(AUX_WEATHER_PROPERTY_NAME, AUX_WEATHER_HUMIDITY_ITEM_NAME) > 0) {
			return true;
		}
		indigo_usleep(10000);
	}
	fprintf(stderr, "    no status frame arrived\n");
	return false;
}

static bool capture_state(void) {
	if (!wait_for_first_poll()) {
		return false;
	}
	v2 = hw_property_defined(box, AUX_HEATER_OUTLET_PROPERTY_NAME);
	if (!v2) {
		return true;
	}
	for (int i = 0; i < 3; i++) {
		initial_heaters[i] = value_of(AUX_HEATER_OUTLET_PROPERTY_NAME, heater_items[i]);
		initial_calibration[i] = value_of(CALIBRATION_PROPERTY_NAME, calibration_items[i]);
	}
	for (int i = 0; i < 2; i++) {
		initial_thresholds[i] = value_of(AUX_DEW_THRESHOLD_PROPERTY_NAME, threshold_items[i]);
	}
	initial_automatic = switch_is(AUX_DEW_CONTROL_PROPERTY_NAME, AUX_DEW_CONTROL_AUTOMATIC_ITEM_NAME);
	initial_linked = switch_is(LINK_PROPERTY_NAME, "LINKED");
	for (int i = 0; i < 4; i++) {
		if (switch_is(AGGRESSIVITY_PROPERTY_NAME, aggressivity_items[i])) {
			initial_aggressivity = i;
		}
	}
	printf("    heaters %g/%g/%g %%, calibration %g/%g/%g, thresholds %g/%g, %s, %s, aggressivity %s\n", initial_heaters[0], initial_heaters[1], initial_heaters[2], initial_calibration[0], initial_calibration[1], initial_calibration[2], initial_thresholds[0], initial_thresholds[1], initial_automatic ? "automatic" : "manual", initial_linked ? "linked" : "not linked", initial_aggressivity < 0 ? "?" : aggressivity_items[initial_aggressivity]);
	return true;
}

static void restore_initial_state(void) {
	if (box < 0 || !state_captured || !v2 || !hw_connected(box)) {
		return;
	}
	set_switch_item(LINK_PROPERTY_NAME, initial_linked ? "LINKED" : "NOT_LINKED");
	set_numbers(CALIBRATION_PROPERTY_NAME, calibration_items, initial_calibration, 3);
	set_numbers(AUX_DEW_THRESHOLD_PROPERTY_NAME, threshold_items, initial_thresholds, 2);
	if (initial_aggressivity >= 0) {
		set_switch_item(AGGRESSIVITY_PROPERTY_NAME, aggressivity_items[initial_aggressivity]);
	}
	if (!initial_automatic) {
		set_switch_item(AUX_DEW_CONTROL_PROPERTY_NAME, AUX_DEW_CONTROL_MANUAL_ITEM_NAME);
		set_numbers(AUX_HEATER_OUTLET_PROPERTY_NAME, heater_items, initial_heaters, 3);
	} else {
		set_switch_item(AUX_DEW_CONTROL_PROPERTY_NAME, AUX_DEW_CONTROL_AUTOMATIC_ITEM_NAME);
	}
}

static void usbdp_publishes_the_model_and_its_properties(void) {
	char model[INDIGO_VALUE_SIZE] = "";
	ASSERT_TRUE(hw_text_item(box, INFO_PROPERTY_NAME, INFO_DEVICE_MODEL_ITEM_NAME, model, sizeof(model)));
	printf("    model %s\n", model);
	ASSERT_STREQ(v2 ? "USB_Dewpoint v2" : "USB_Dewpoint v1", model);
	ASSERT_TRUE(hw_property_defined(box, AUX_WEATHER_PROPERTY_NAME));
	ASSERT_TRUE(hw_property_defined(box, AUX_TEMPERATURE_SENSORS_PROPERTY_NAME));
	ASSERT_TRUE(hw_property_defined(box, AUX_DEW_WARNING_PROPERTY_NAME));
	ASSERT_EQ_INT(v2, hw_item_defined(box, AUX_TEMPERATURE_SENSORS_PROPERTY_NAME, AUX_TEMPERATURE_SENSORS_SENSOR_2_ITEM_NAME));
	ASSERT_EQ_INT(v2, hw_property_defined(box, AUX_DEW_CONTROL_PROPERTY_NAME));
	ASSERT_EQ_INT(v2, hw_property_defined(box, LINK_PROPERTY_NAME));
	ASSERT_EQ_INT(v2, hw_property_defined(box, AGGRESSIVITY_PROPERTY_NAME));
	ASSERT_EQ_INT(v2, hw_property_defined(box, AUX_HEATER_OUTLET_STATE_PROPERTY_NAME));
}

static void usbdp_reports_its_sensors(void) {
	double temperature = value_of(AUX_WEATHER_PROPERTY_NAME, AUX_WEATHER_TEMPERATURE_ITEM_NAME);
	double humidity = value_of(AUX_WEATHER_PROPERTY_NAME, AUX_WEATHER_HUMIDITY_ITEM_NAME);
	double dewpoint = value_of(AUX_WEATHER_PROPERTY_NAME, AUX_WEATHER_DEWPOINT_ITEM_NAME);
	double sensor_1 = value_of(AUX_TEMPERATURE_SENSORS_PROPERTY_NAME, AUX_TEMPERATURE_SENSORS_SENSOR_1_ITEM_NAME);
	printf("    ambient %.2f C, %.2f %%, dewpoint %.2f C, sensor 1 %.2f C\n", temperature, humidity, dewpoint, sensor_1);
	ASSERT_TRUE(temperature > -40 && temperature < 60);
	ASSERT_TRUE(humidity > 0 && humidity <= 100);
	ASSERT_TRUE(dewpoint <= temperature + 0.5);
	ASSERT_TRUE(sensor_1 > -40 && sensor_1 < 60);
	ASSERT_EQ_INT(INDIGO_OK_STATE, hw_property_state(box, AUX_WEATHER_PROPERTY_NAME));
	// Two polls later the controller still answers.
	hw_forget_states();
	indigo_usleep(POLL_US);
	ASSERT_TRUE(hw_connected(box));
	ASSERT_TRUE((hw_states_seen(box, AUX_WEATHER_PROPERTY_NAME) & (1u << INDIGO_ALERT_STATE)) == 0);
}

static void usbdp_sets_the_heater_outputs(void) {
	if (!v2) {
		printf("    no heater outputs on a v1\n");
		return;
	}
	ASSERT_TRUE(set_switch_item(LINK_PROPERTY_NAME, "NOT_LINKED"));
	ASSERT_TRUE(set_switch_item(AUX_DEW_CONTROL_PROPERTY_NAME, AUX_DEW_CONTROL_MANUAL_ITEM_NAME));
	static const double values[][3] = { { 0, 0, 0 }, { 100, 0, 0 }, { 0, 100, 0 }, { 0, 0, 100 }, { 25, 50, 75 }, { 0, 0, 0 } };
	for (int i = 0; i < ARRAY_SIZE(values); i++) {
		ASSERT_TRUE(set_numbers(AUX_HEATER_OUTLET_PROPERTY_NAME, heater_items, values[i], 3));
		ASSERT_TRUE(numbers_are(AUX_HEATER_OUTLET_PROPERTY_NAME, heater_items, values[i], 3));
	}
}

// With channels 2 and 3 linked the controller drives output 3 with output 2.
static void usbdp_links_channels_2_and_3(void) {
	if (!v2) {
		printf("    no channel link on a v1\n");
		return;
	}
	ASSERT_TRUE(set_switch_item(AUX_DEW_CONTROL_PROPERTY_NAME, AUX_DEW_CONTROL_MANUAL_ITEM_NAME));
	ASSERT_TRUE(set_switch_item(LINK_PROPERTY_NAME, "LINKED"));
	ASSERT_TRUE(switch_survives(LINK_PROPERTY_NAME, "LINKED"));
	ASSERT_TRUE(set_switch_item(LINK_PROPERTY_NAME, "NOT_LINKED"));
	ASSERT_TRUE(switch_survives(LINK_PROPERTY_NAME, "NOT_LINKED"));
}

static void usbdp_sets_calibration_and_thresholds(void) {
	if (!v2) {
		printf("    calibration and thresholds are not settable on a v1\n");
		return;
	}
	static const double calibration[][3] = { { 1, 2, 3 }, { 9, 0, 9 }, { 0, 0, 0 } };
	for (int i = 0; i < ARRAY_SIZE(calibration); i++) {
		ASSERT_TRUE(set_numbers(CALIBRATION_PROPERTY_NAME, calibration_items, calibration[i], 3));
		ASSERT_TRUE(numbers_are(CALIBRATION_PROPERTY_NAME, calibration_items, calibration[i], 3));
	}
	static const double thresholds[][2] = { { 0, 9 }, { 5, 3 }, { 2, 2 } };
	for (int i = 0; i < ARRAY_SIZE(thresholds); i++) {
		ASSERT_TRUE(set_numbers(AUX_DEW_THRESHOLD_PROPERTY_NAME, threshold_items, thresholds[i], 2));
		ASSERT_TRUE(numbers_are(AUX_DEW_THRESHOLD_PROPERTY_NAME, threshold_items, thresholds[i], 2));
	}
}

static void usbdp_sets_automatic_mode_and_aggressivity(void) {
	if (!v2) {
		printf("    no automatic mode on a v1\n");
		return;
	}
	for (int i = 0; i < 4; i++) {
		ASSERT_TRUE(set_switch_item(AGGRESSIVITY_PROPERTY_NAME, aggressivity_items[i]));
		ASSERT_TRUE(switch_survives(AGGRESSIVITY_PROPERTY_NAME, aggressivity_items[i]));
	}
	ASSERT_TRUE(set_switch_item(AUX_DEW_CONTROL_PROPERTY_NAME, AUX_DEW_CONTROL_AUTOMATIC_ITEM_NAME));
	ASSERT_TRUE(switch_survives(AUX_DEW_CONTROL_PROPERTY_NAME, AUX_DEW_CONTROL_AUTOMATIC_ITEM_NAME));
	ASSERT_TRUE(set_switch_item(AUX_DEW_CONTROL_PROPERTY_NAME, AUX_DEW_CONTROL_MANUAL_ITEM_NAME));
	ASSERT_TRUE(switch_survives(AUX_DEW_CONTROL_PROPERTY_NAME, AUX_DEW_CONTROL_MANUAL_ITEM_NAME));
	static const double off[] = { 0, 0, 0 };
	ASSERT_TRUE(set_numbers(AUX_HEATER_OUTLET_PROPERTY_NAME, heater_items, off, 3));
}

static void usbdp_reconnects(void) {
	ASSERT_TRUE(hw_disconnect(box, SHORT_TIMEOUT));
	ASSERT_TRUE(hw_property_hidden(box, AUX_WEATHER_PROPERTY_NAME));
	ASSERT_TRUE(hw_connect(box, SHORT_TIMEOUT));
	ASSERT_TRUE(wait_for_first_poll());
	ASSERT_EQ_INT(v2, hw_property_defined(box, AUX_HEATER_OUTLET_PROPERTY_NAME));
}

static void usbdp_rejects_shutdown_while_connected(void) {
	ASSERT_EQ_INT(INDIGO_BUSY, indigo_aux_usbdp(INDIGO_DRIVER_SHUTDOWN, NULL));
	ASSERT_TRUE(hw_connected(box));
}

static void usbdp_reinitializes(void) {
	ASSERT_TRUE(hw_disconnect(box, SHORT_TIMEOUT));
	ASSERT_EQ_INT(INDIGO_OK, indigo_aux_usbdp(INDIGO_DRIVER_SHUTDOWN, NULL));
	ASSERT_EQ_INT(-1, hw_device_index(DEVICE_NAME));
	ASSERT_EQ_INT(INDIGO_OK, indigo_aux_usbdp(INDIGO_DRIVER_INIT, NULL));
	box = hw_wait_for_device(DEVICE_NAME, SHORT_TIMEOUT);
	ASSERT_TRUE(box >= 0);
	ASSERT_TRUE(select_port());
	ASSERT_TRUE(hw_connect(box, SHORT_TIMEOUT));
	ASSERT_TRUE(wait_for_first_poll());
}

int main(int argc, char **argv) {
	if (argc < 2 || strcmp(argv[1], "--run")) {
		fprintf(stderr, "Physical USB_Dewpoint test: run explicitly with --run (or make test-aux-usbdp-hw).\n");
		return 2;
	}
	setvbuf(stdout, NULL, _IONBF, 0);
	for (int i = 2; i < argc; i++) {
		if (!strcmp(argv[i], "--debug")) {
			indigo_set_log_level(INDIGO_LOG_DEBUG);
		}
	}
	// The calibration, the thresholds and the outlet names are persistent, so the session keeps its
	// configuration out of the user's own folder.
	if (!indigo_test_use_private_home()) {
		return 1;
	}
	serial_port = hw_port("USBDP_HW_PORT");
	const indigo_test_case tests[] = {
		{ "usbdp_publishes_the_model_and_its_properties", usbdp_publishes_the_model_and_its_properties },
		{ "usbdp_reports_its_sensors", usbdp_reports_its_sensors },
		{ "usbdp_sets_the_heater_outputs", usbdp_sets_the_heater_outputs },
		{ "usbdp_links_channels_2_and_3", usbdp_links_channels_2_and_3 },
		{ "usbdp_sets_calibration_and_thresholds", usbdp_sets_calibration_and_thresholds },
		{ "usbdp_sets_automatic_mode_and_aggressivity", usbdp_sets_automatic_mode_and_aggressivity },
		{ "usbdp_reconnects", usbdp_reconnects },
		{ "usbdp_rejects_shutdown_while_connected", usbdp_rejects_shutdown_while_connected },
		{ "usbdp_reinitializes", usbdp_reinitializes }
	};
	int result = 1;
	bool started = false, initialized = false;
	HW_CHECK(hw_start() == INDIGO_OK);
	started = true;
	HW_CHECK(hw_attach_client("USB_Dewpoint hardware test") == INDIGO_OK);
	HW_CHECK(indigo_aux_usbdp(INDIGO_DRIVER_INIT, NULL) == INDIGO_OK);
	initialized = true;
	box = hw_wait_for_device(DEVICE_NAME, SHORT_TIMEOUT);
	HW_CHECK(box >= 0);
	HW_CHECK(select_port());
	HW_CHECK(hw_connect(box, SHORT_TIMEOUT));
	HW_CHECK(capture_state());
	state_captured = true;
	result = indigo_run_tests("USB_Dewpoint hardware", tests, ARRAY_SIZE(tests));
cleanup:
	restore_initial_state();
	if (!hw_disconnect(box, SHORT_TIMEOUT)) {
		indigo_test_failures++;
	}
	if (initialized && indigo_aux_usbdp(INDIGO_DRIVER_SHUTDOWN, NULL) != INDIGO_OK) {
		indigo_test_failures++;
	}
	indigo_detach_client(&hw_client);
	if (started) {
		indigo_stop();
	}
	hw_release_properties();
	indigo_test_remove_private_home();
	return indigo_test_failures ? 1 : result;
}
