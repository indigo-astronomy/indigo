// Copyright (c) 2026 INDIGO initiative
// All rights reserved.
//
// You may use this software under the terms of 'INDIGO Astronomy
// open-source license' (see LICENSE.md).
//
// THIS SOFTWARE IS PROVIDED BY THE AUTHORS 'AS IS' AND ANY EXPRESS
// OR IMPLIED WARRANTIES, INCLUDING, BUT NOT LIMITED TO, THE IMPLIED
// WARRANTIES OF MERCHANTABILITY AND FITNESS FOR A PARTICULAR PURPOSE
// ARE DISCLAIMED. IN NO EVENT SHALL THE AUTHOR BE LIABLE FOR ANY
// DIRECT, INDIRECT, INCIDENTAL, SPECIAL, EXEMPLARY, OR CONSEQUENTIAL
// DAMAGES (INCLUDING, BUT NOT LIMITED TO, PROCUREMENT OF SUBSTITUTE
// GOODS OR SERVICES; LOSS OF USE, DATA, OR PROFITS; OR BUSINESS
// INTERRUPTION) HOWEVER CAUSED AND ON ANY THEORY OF LIABILITY,
// WHETHER IN CONTRACT, STRICT LIABILITY, OR TORT (INCLUDING
// NEGLIGENCE OR OTHERWISE) ARISING IN ANY WAY OUT OF THE USE OF THIS
// SOFTWARE, EVEN IF ADVISED OF THE POSSIBILITY OF SUCH DAMAGE.

// Code is generated by AI

// Opt-in acceptance test for a physically connected LakesideAstro focuser, or for the Arduino sketch
// focuser_lakeside_simulator.ino running on a board. It checks the values read at the connection, moves by steps
// both ways (the position is read-only), aborts a move, writes the backlash and the compensation slope and reads
// them back after a reconnect, switches the active slope and the temperature compensation mode, reconnects and
// runs driver INIT/SHUTDOWN.
//
// THE FOCUSER MOVES. The settings are stored in the controller; the session writes back the ones it found, returns
// to the position it found and leaves compensation off.
//
// The port comes from LAKESIDE_HW_PORT.

#include <math.h>
#include <stdlib.h>
#include <indigo_drivers/focuser_lakeside/indigo_focuser_lakeside.h>
#include "focuser_hw_common.h"

#define DEVICE_NAME "LakesideAstro Focuser"

#define SHORT_TIMEOUT 15.0
#define MOVE_TIMEOUT 120.0

static const char *compensation_items[] = { FOCUSER_COMPENSATION_ITEM_NAME, "DEADBAND", "PERIOD" };

static int focuser = -1;
static const char *serial_port = NULL;
static bool state_captured = false;
static double initial_position = 0, initial_backlash = 0, initial_compensation[3];

static bool select_port(void) {
	if (serial_port == NULL || !*serial_port) {
		fprintf(stderr, "    set LAKESIDE_HW_PORT to the focuser's port\n");
		return false;
	}
	printf("Using port %s\n", serial_port);
	return hw_set_text(focuser, DEVICE_PORT_PROPERTY_NAME, DEVICE_PORT_ITEM_NAME, serial_port, INDIGO_OK_STATE, SHORT_TIMEOUT);
}

static bool set_compensation(const double *values) {
	if (!focuser_hw_idle(focuser, FOCUSER_COMPENSATION_PROPERTY_NAME, SHORT_TIMEOUT)) {
		return false;
	}
	unsigned before = hw_revision(focuser, FOCUSER_COMPENSATION_PROPERTY_NAME);
	indigo_change_number_property(&hw_client, DEVICE_NAME, FOCUSER_COMPENSATION_PROPERTY_NAME, 3, compensation_items, values);
	if (!focuser_hw_settles(focuser, FOCUSER_COMPENSATION_PROPERTY_NAME, before, INDIGO_OK_STATE, SHORT_TIMEOUT)) {
		return false;
	}
	for (int i = 0; i < 3; i++) {
		if (focuser_hw_value(focuser, FOCUSER_COMPENSATION_PROPERTY_NAME, compensation_items[i]) != values[i]) {
			fprintf(stderr, "    %s is %g, expected %g\n", compensation_items[i], focuser_hw_value(focuser, FOCUSER_COMPENSATION_PROPERTY_NAME, compensation_items[i]), values[i]);
			return false;
		}
	}
	return true;
}

// The position is read-only, so the way back is a relative move.
static bool return_to(double position) {
	double current = focuser_hw_position(focuser);
	if (current == position) {
		return true;
	}
	return focuser_hw_steps(focuser, position > current, fabs(position - current), INDIGO_OK_STATE, MOVE_TIMEOUT) && focuser_hw_position(focuser) == position;
}

static void restore_initial_state(void) {
	if (focuser < 0 || !state_captured || !hw_connected(focuser)) {
		return;
	}
	focuser_hw_idle(focuser, FOCUSER_STEPS_PROPERTY_NAME, MOVE_TIMEOUT);
	focuser_hw_set_switch(focuser, FOCUSER_MODE_PROPERTY_NAME, FOCUSER_MODE_MANUAL_ITEM_NAME, SHORT_TIMEOUT);
	focuser_hw_set_switch(focuser, "X_FOCUSER_ACTIVE_SLOPE", "1", SHORT_TIMEOUT);
	set_compensation(initial_compensation);
	focuser_hw_set_number(focuser, FOCUSER_BACKLASH_PROPERTY_NAME, FOCUSER_BACKLASH_ITEM_NAME, initial_backlash, INDIGO_OK_STATE, SHORT_TIMEOUT);
	return_to(initial_position);
}

static void lakeside_publishes_the_property_contract(void) {
	double temperature = focuser_hw_value(focuser, FOCUSER_TEMPERATURE_PROPERTY_NAME, FOCUSER_TEMPERATURE_ITEM_NAME);
	indigo_property_state temperature_state = hw_property_state(focuser, FOCUSER_TEMPERATURE_PROPERTY_NAME);
	printf("    position %g, backlash %g, slope 1: %g steps/C, deadband %g, period %g, temperature %.1f C (state %d)\n", initial_position, initial_backlash, initial_compensation[0], initial_compensation[1], initial_compensation[2], temperature, temperature_state);
	ASSERT_TRUE((hw_device_interface(focuser) & INDIGO_INTERFACE_FOCUSER) != 0);
	// "TN/A#" (no probe) leaves the temperature idle; a reading is published OK.
	ASSERT_TRUE(temperature_state == INDIGO_IDLE_STATE || (temperature_state == INDIGO_OK_STATE && temperature > -50 && temperature < 60));
	ASSERT_TRUE(hw_property_defined(focuser, "X_FOCUSER_ACTIVE_SLOPE"));
	ASSERT_TRUE(hw_property_defined(focuser, FOCUSER_MODE_PROPERTY_NAME));
	ASSERT_TRUE(hw_item_defined(focuser, FOCUSER_COMPENSATION_PROPERTY_NAME, "DEADBAND"));
	ASSERT_TRUE(hw_item_defined(focuser, FOCUSER_COMPENSATION_PROPERTY_NAME, "PERIOD"));
	ASSERT_TRUE(focuser_hw_switch_is(focuser, FOCUSER_MODE_PROPERTY_NAME, FOCUSER_MODE_MANUAL_ITEM_NAME));
}

static void lakeside_moves_by_steps(void) {
	ASSERT_TRUE(focuser_hw_steps(focuser, true, 600, INDIGO_OK_STATE, MOVE_TIMEOUT));
	ASSERT_EQ_INT((int)initial_position + 600, (int)focuser_hw_position(focuser));
	ASSERT_TRUE(focuser_hw_steps(focuser, false, 1000, INDIGO_OK_STATE, MOVE_TIMEOUT));
	ASSERT_EQ_INT((int)initial_position - 400, (int)focuser_hw_position(focuser));
	ASSERT_TRUE(focuser_hw_steps(focuser, true, 400, INDIGO_OK_STATE, MOVE_TIMEOUT));
	ASSERT_EQ_INT((int)initial_position, (int)focuser_hw_position(focuser));
}

static void lakeside_aborts_a_move(void) {
	ASSERT_TRUE(hw_set_switch(focuser, FOCUSER_DIRECTION_PROPERTY_NAME, FOCUSER_DIRECTION_MOVE_OUTWARD_ITEM_NAME, INDIGO_OK_STATE, SHORT_TIMEOUT));
	unsigned before = hw_revision(focuser, FOCUSER_STEPS_PROPERTY_NAME);
	hw_request_number(focuser, FOCUSER_STEPS_PROPERTY_NAME, FOCUSER_STEPS_ITEM_NAME, 3000);
	ASSERT_TRUE(hw_wait_state(focuser, FOCUSER_STEPS_PROPERTY_NAME, before, INDIGO_BUSY_STATE, SHORT_TIMEOUT));
	indigo_usleep(2000000);
	ASSERT_TRUE(focuser_hw_abort(focuser, SHORT_TIMEOUT) || hw_property_state(focuser, FOCUSER_ABORT_MOTION_PROPERTY_NAME) == INDIGO_BUSY_STATE);
	ASSERT_TRUE(focuser_hw_idle(focuser, FOCUSER_ABORT_MOTION_PROPERTY_NAME, SHORT_TIMEOUT));
	ASSERT_TRUE(focuser_hw_idle(focuser, FOCUSER_STEPS_PROPERTY_NAME, SHORT_TIMEOUT));
	indigo_usleep(1500000);
	double stopped = focuser_hw_position(focuser);
	printf("    stopped at %g on the way from %g to %g, state %d\n", stopped, initial_position, initial_position + 3000, hw_property_state(focuser, FOCUSER_STEPS_PROPERTY_NAME));
	ASSERT_TRUE(stopped > initial_position && stopped < initial_position + 3000);
	indigo_usleep(1500000);
	ASSERT_EQ_INT((int)stopped, (int)focuser_hw_position(focuser));
	// The target keeps the request through the idle polls after the abort.
	double target = NAN;
	ASSERT_TRUE(hw_number_item_target(focuser, FOCUSER_POSITION_PROPERTY_NAME, FOCUSER_POSITION_ITEM_NAME, &target));
	ASSERT_EQ_INT((int)initial_position + 3000, (int)target);
	ASSERT_TRUE(return_to(initial_position));
}

static void lakeside_stores_backlash_and_compensation(void) {
	double values[] = { initial_compensation[0] == 25 ? 26 : 25, 7, 3 };
	ASSERT_TRUE(focuser_hw_set_number(focuser, FOCUSER_BACKLASH_PROPERTY_NAME, FOCUSER_BACKLASH_ITEM_NAME, initial_backlash == 15 ? 16 : 15, INDIGO_OK_STATE, SHORT_TIMEOUT));
	ASSERT_TRUE(set_compensation(values));
	ASSERT_TRUE(hw_disconnect(focuser, SHORT_TIMEOUT));
	ASSERT_TRUE(hw_connect(focuser, SHORT_TIMEOUT));
	ASSERT_EQ_INT(initial_backlash == 15 ? 16 : 15, (int)focuser_hw_value(focuser, FOCUSER_BACKLASH_PROPERTY_NAME, FOCUSER_BACKLASH_ITEM_NAME));
	for (int i = 0; i < 3; i++) {
		ASSERT_EQ_INT((int)values[i], (int)focuser_hw_value(focuser, FOCUSER_COMPENSATION_PROPERTY_NAME, compensation_items[i]));
	}
	ASSERT_TRUE(set_compensation(initial_compensation));
	ASSERT_TRUE(focuser_hw_set_number(focuser, FOCUSER_BACKLASH_PROPERTY_NAME, FOCUSER_BACKLASH_ITEM_NAME, initial_backlash, INDIGO_OK_STATE, SHORT_TIMEOUT));
}

// Each slope keeps its own compensation; switching shows the one of the selected slope.
static void lakeside_switches_the_slope_and_mode(void) {
	ASSERT_TRUE(focuser_hw_set_switch(focuser, "X_FOCUSER_ACTIVE_SLOPE", "2", SHORT_TIMEOUT));
	double slope_2 = focuser_hw_value(focuser, FOCUSER_COMPENSATION_PROPERTY_NAME, FOCUSER_COMPENSATION_ITEM_NAME);
	ASSERT_TRUE(focuser_hw_set_switch(focuser, "X_FOCUSER_ACTIVE_SLOPE", "1", SHORT_TIMEOUT));
	ASSERT_EQ_INT((int)initial_compensation[0], (int)focuser_hw_value(focuser, FOCUSER_COMPENSATION_PROPERTY_NAME, FOCUSER_COMPENSATION_ITEM_NAME));
	printf("    slope 2: %g steps/C\n", slope_2);
	ASSERT_TRUE(focuser_hw_set_switch(focuser, FOCUSER_MODE_PROPERTY_NAME, FOCUSER_MODE_AUTOMATIC_ITEM_NAME, SHORT_TIMEOUT));
	ASSERT_TRUE(focuser_hw_set_switch(focuser, FOCUSER_MODE_PROPERTY_NAME, FOCUSER_MODE_MANUAL_ITEM_NAME, SHORT_TIMEOUT));
}

static void lakeside_reconnects(void) {
	ASSERT_TRUE(hw_disconnect(focuser, SHORT_TIMEOUT));
	ASSERT_TRUE(hw_property_hidden(focuser, "X_FOCUSER_ACTIVE_SLOPE"));
	ASSERT_TRUE(hw_connect(focuser, SHORT_TIMEOUT));
	ASSERT_EQ_INT((int)initial_position, (int)focuser_hw_position(focuser));
	ASSERT_EQ_INT(INDIGO_OK_STATE, hw_property_state(focuser, FOCUSER_POSITION_PROPERTY_NAME));
}

static void lakeside_rejects_shutdown_while_connected(void) {
	ASSERT_EQ_INT(INDIGO_BUSY, indigo_focuser_lakeside(INDIGO_DRIVER_SHUTDOWN, NULL));
	ASSERT_TRUE(hw_connected(focuser));
}

static void lakeside_reinitializes(void) {
	ASSERT_TRUE(hw_disconnect(focuser, SHORT_TIMEOUT));
	ASSERT_EQ_INT(INDIGO_OK, indigo_focuser_lakeside(INDIGO_DRIVER_SHUTDOWN, NULL));
	ASSERT_EQ_INT(-1, hw_device_index(DEVICE_NAME));
	ASSERT_EQ_INT(INDIGO_OK, indigo_focuser_lakeside(INDIGO_DRIVER_INIT, NULL));
	focuser = hw_wait_for_device(DEVICE_NAME, SHORT_TIMEOUT);
	ASSERT_TRUE(focuser >= 0);
	ASSERT_TRUE(select_port());
	ASSERT_TRUE(hw_connect(focuser, SHORT_TIMEOUT));
	ASSERT_EQ_INT((int)initial_position, (int)focuser_hw_position(focuser));
}

int main(int argc, char **argv) {
	if (argc < 2 || strcmp(argv[1], "--run")) {
		fprintf(stderr, "Physical Lakeside test: run explicitly with --run (or make test-focuser-lakeside-hw).\n");
		return 2;
	}
	setvbuf(stdout, NULL, _IONBF, 0);
	for (int i = 2; i < argc; i++) {
		if (!strcmp(argv[i], "--debug")) {
			indigo_set_log_level(INDIGO_LOG_DEBUG);
		}
	}
	if (!indigo_test_use_private_home()) {
		return 1;
	}
	serial_port = hw_port("LAKESIDE_HW_PORT");
	const indigo_test_case tests[] = {
		{ "lakeside_publishes_the_property_contract", lakeside_publishes_the_property_contract },
		{ "lakeside_moves_by_steps", lakeside_moves_by_steps },
		{ "lakeside_aborts_a_move", lakeside_aborts_a_move },
		{ "lakeside_stores_backlash_and_compensation", lakeside_stores_backlash_and_compensation },
		{ "lakeside_switches_the_slope_and_mode", lakeside_switches_the_slope_and_mode },
		{ "lakeside_reconnects", lakeside_reconnects },
		{ "lakeside_rejects_shutdown_while_connected", lakeside_rejects_shutdown_while_connected },
		{ "lakeside_reinitializes", lakeside_reinitializes }
	};
	int result = 1;
	bool started = false, initialized = false;
	HW_CHECK(hw_start() == INDIGO_OK);
	started = true;
	HW_CHECK(hw_attach_client("Lakeside hardware test") == INDIGO_OK);
	HW_CHECK(indigo_focuser_lakeside(INDIGO_DRIVER_INIT, NULL) == INDIGO_OK);
	initialized = true;
	focuser = hw_wait_for_device(DEVICE_NAME, SHORT_TIMEOUT);
	HW_CHECK(focuser >= 0);
	HW_CHECK(select_port());
	HW_CHECK(hw_connect(focuser, SHORT_TIMEOUT));
	HW_CHECK(focuser_hw_idle(focuser, FOCUSER_POSITION_PROPERTY_NAME, MOVE_TIMEOUT));
	initial_position = focuser_hw_position(focuser);
	initial_backlash = focuser_hw_value(focuser, FOCUSER_BACKLASH_PROPERTY_NAME, FOCUSER_BACKLASH_ITEM_NAME);
	for (int i = 0; i < 3; i++) {
		initial_compensation[i] = focuser_hw_value(focuser, FOCUSER_COMPENSATION_PROPERTY_NAME, compensation_items[i]);
	}
	HW_CHECK(initial_position >= 1000 && initial_position <= 65535 - 4000);
	state_captured = true;
	result = indigo_run_tests("Lakeside hardware", tests, ARRAY_SIZE(tests));
cleanup:
	restore_initial_state();
	if (!hw_disconnect(focuser, SHORT_TIMEOUT)) {
		indigo_test_failures++;
	}
	if (initialized && indigo_focuser_lakeside(INDIGO_DRIVER_SHUTDOWN, NULL) != INDIGO_OK) {
		indigo_test_failures++;
	}
	indigo_detach_client(&hw_client);
	if (started) {
		indigo_stop();
	}
	hw_release_properties();
	indigo_test_remove_private_home();
	return indigo_test_failures ? 1 : result;
}
