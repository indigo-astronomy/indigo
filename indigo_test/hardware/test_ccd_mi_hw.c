// Copyright (c) 2026 INDIGO initiative
// All rights reserved.
//
// You may use this software under the terms of 'INDIGO Astronomy
// open-source license' (see LICENSE.md).
//
// THIS SOFTWARE IS PROVIDED BY THE AUTHORS 'AS IS' AND ANY EXPRESS
// OR IMPLIED WARRANTIES, INCLUDING, BUT NOT LIMITED TO, THE IMPLIED
// WARRANTIES OF MERCHANTABILITY AND FITNESS FOR A PARTICULAR PURPOSE
// ARE DISCLAIMED. IN NO EVENT SHALL THE AUTHOR BE LIABLE FOR ANY
// DIRECT, INDIRECT, INCIDENTAL, SPECIAL, EXEMPLARY, OR CONSEQUENTIAL
// DAMAGES (INCLUDING, BUT NOT LIMITED TO, PROCUREMENT OF SUBSTITUTE
// GOODS OR SERVICES; LOSS OF USE, DATA, OR PROFITS; OR BUSINESS
// INTERRUPTION) HOWEVER CAUSED AND ON ANY THEORY OF LIABILITY,
// WHETHER IN CONTRACT, STRICT LIABILITY, OR TORT (INCLUDING
// NEGLIGENCE OR OTHERWISE) ARISING IN ANY WAY OUT OF THE USE OF THIS
// SOFTWARE, EVEN IF ADVISED OF THE POSSIBILITY OF SUCH DAMAGE.

// Code is generated by AI

// Opt-in regression test for a physically connected Moravian Instruments camera. It deliberately
// contains no unplug/replug scenario: hot-plug recovery stays covered by the fake gxccd suite, so
// this test can run unattended. The driver exposes no CCD_STREAMING, so every acquisition scenario
// is exposure based.

#include <pthread.h>
#include <stdlib.h>
#include <time.h>
#include <indigo/indigo_driver.h>
#include <indigo_drivers/ccd_mi/indigo_ccd_mi.h>
#include "../test_runner.h"

#define ARRAY_SIZE(a) (sizeof(a) / sizeof((a)[0]))
#define MAX_DEVICES 16
#define MAX_PROPERTIES 128
#define CHECK(condition) do { if (!(condition)) { fprintf(stderr, "%s:%d: %s\n", __FILE__, __LINE__, #condition); indigo_test_failures++; goto cleanup; } } while (0)

typedef struct {
	char name[INDIGO_NAME_SIZE];
	indigo_device *device, *master;
	unsigned interface;
	bool present;
	indigo_property *properties[MAX_PROPERTIES];
	unsigned revisions[MAX_PROPERTIES];
	unsigned frames, invalid_frames, width, height, bytes;
} observed_device;

static observed_device devices[MAX_DEVICES];
static pthread_mutex_t mutex = PTHREAD_MUTEX_INITIALIZER;
static int camera = -1, guider = -1, wheel = -1;
static char last_message_property[INDIGO_NAME_SIZE], last_message_text[INDIGO_VALUE_SIZE];
static indigo_result (*driver_entry)(indigo_driver_action, indigo_driver_info *) = indigo_ccd_mi;
static indigo_client client;

static int slot(int d, const char *name) {
	for (int p = 0; p < MAX_PROPERTIES; p++) {
		if (devices[d].properties[p] && !strcmp(devices[d].properties[p]->name, name)) {
			return p;
		}
	}
	return -1;
}

static indigo_result observe(indigo_device *device, indigo_property *property, const char *message, bool image_update) {
	pthread_mutex_lock(&mutex);
	int d;
	for (d = 0; d < MAX_DEVICES; d++) {
		if (!*devices[d].name || !strcmp(devices[d].name, property->device)) {
			break;
		}
	}
	if (d < MAX_DEVICES) {
		snprintf(devices[d].name, INDIGO_NAME_SIZE, "%s", property->device);
		devices[d].device = device;
		devices[d].master = device->master_device;
		if (!image_update && !strcmp(property->name, "INFO")) {
			devices[d].present = true;
			for (int i = 0; i < property->count; i++) {
				if (!strcmp(property->items[i].name, "DEVICE_INTERFACE")) {
					devices[d].interface = strtoul(property->items[i].text.value, NULL, 10);
				}
			}
		}
		int p = slot(d, property->name);
		if (p < 0) {
			for (p = 0; p < MAX_PROPERTIES && devices[d].properties[p]; p++) { }
		}
		if (p < MAX_PROPERTIES) {
			indigo_release_property(devices[d].properties[p]);
			devices[d].properties[p] = indigo_copy_property(NULL, property);
			devices[d].revisions[p]++;
		}
		if (image_update && !strcmp(property->name, "CCD_IMAGE") && property->state == INDIGO_OK_STATE && property->count && property->items[0].blob.value) {
			indigo_item *item = property->items;
			indigo_raw_header header = { 0 };
			if (item->blob.size >= sizeof(header)) {
				memcpy(&header, item->blob.value, sizeof(header));
			}
			unsigned bytes = header.signature == INDIGO_RAW_MONO8 ? 1 : (header.signature == INDIGO_RAW_MONO16 ? 2 : (header.signature == INDIGO_RAW_RGB24 ? 3 : (header.signature == INDIGO_RAW_RGB48 ? 6 : 0)));
			if (strcmp(item->blob.format, ".raw") || bytes != 2 || !header.width || !header.height || (uint64_t)header.width * header.height * bytes + sizeof(header) > item->blob.size) {
				devices[d].invalid_frames++;
			}
			devices[d].width = header.width;
			devices[d].height = header.height;
			devices[d].bytes = bytes;
			devices[d].frames++;
			if (devices[d].frames <= 12 || devices[d].frames % 100 == 0) {
				printf("    frame %u: %u x %u, %ld bytes\n", devices[d].frames, header.width, header.height, item->blob.size);
			}
		}
	}
	pthread_mutex_unlock(&mutex);
	if (message && *message) {
		fprintf(stderr, "    %s %s: %s\n", property->device, property->name, message);
	}
	return INDIGO_OK;
}

static indigo_result define_property(indigo_client *client, indigo_device *device, indigo_property *property, const char *message) {
	return observe(device, property, message, false);
}

static indigo_result update_property(indigo_client *client, indigo_device *device, indigo_property *property, const char *message) {
	return observe(device, property, message, true);
}

static indigo_result report_message(indigo_client *client, indigo_device *device, indigo_property *property, const char *message) {
	// The bus delivers a property message through send_message, not through the update callback.
	if (property && message && *message) {
		pthread_mutex_lock(&mutex);
		snprintf(last_message_property, INDIGO_NAME_SIZE, "%s", property->name);
		snprintf(last_message_text, INDIGO_VALUE_SIZE, "%s", message);
		pthread_mutex_unlock(&mutex);
	}
	fprintf(stderr, "    message: %s\n", message ? message : "");
	return INDIGO_OK;
}

static indigo_result delete_property(indigo_client *client, indigo_device *device, indigo_property *property, const char *message) {
	if (!*property->name) {
		pthread_mutex_lock(&mutex);
		for (int d = 0; d < MAX_DEVICES; d++) {
			if (!strcmp(devices[d].name, property->device)) {
				devices[d].present = false;
				for (int p = 0; p < MAX_PROPERTIES; p++) {
					indigo_release_property(devices[d].properties[p]);
					devices[d].properties[p] = NULL;
				}
			}
		}
		pthread_mutex_unlock(&mutex);
	}
	return INDIGO_OK;
}

static bool wait_presence(void) {
	for (int i = 0; i < 3000; i++) {
		pthread_mutex_lock(&mutex);
		bool ready = devices[camera].present && slot(camera, "CONNECTION") >= 0;
		ready = ready && (guider < 0 || (devices[guider].present && slot(guider, "CONNECTION") >= 0));
		ready = ready && (wheel < 0 || (devices[wheel].present && slot(wheel, "CONNECTION") >= 0));
		pthread_mutex_unlock(&mutex);
		if (ready) {
			return true;
		}
		indigo_usleep(10000);
	}
	fprintf(stderr, "Timed out waiting for the camera to be redefined\n");
	return false;
}

static bool disconnect_device(int d) {
	if (d < 0) {
		return true;
	}
	pthread_mutex_lock(&mutex);
	bool present = devices[d].present;
	pthread_mutex_unlock(&mutex);
	if (!present) {
		return true;
	}
	indigo_change_switch_property_1(&client, devices[d].name, "CONNECTION", "DISCONNECTED", true);
	for (int i = 0; i < 3000; i++) {
		pthread_mutex_lock(&mutex);
		int p = slot(d, "CONNECTION");
		bool disconnected = false;
		if (p >= 0 && devices[d].properties[p]->state == INDIGO_OK_STATE) {
			indigo_property *property = devices[d].properties[p];
			for (int j = 0; j < property->count; j++) {
				if (!strcmp(property->items[j].name, "DISCONNECTED")) {
					disconnected = property->items[j].sw.value;
				}
			}
		}
		pthread_mutex_unlock(&mutex);
		if (disconnected) {
			return true;
		}
		indigo_usleep(10000);
	}
	fprintf(stderr, "Disconnect timeout: %s\n", devices[d].name);
	return false;
}

static unsigned revision(int d, const char *name) {
	pthread_mutex_lock(&mutex);
	int p = slot(d, name);
	unsigned result = p < 0 ? 0 : devices[d].revisions[p];
	pthread_mutex_unlock(&mutex);
	return result;
}

static bool wait_state(int d, const char *name, unsigned after, indigo_property_state state) {
	// The readout watchdog allows 30 s after the exposure, so a slow USB read must not time out here.
	for (int i = 0; i < 9000; i++) {
		pthread_mutex_lock(&mutex);
		int p = slot(d, name);
		bool ready = p >= 0 && devices[d].revisions[p] > after && devices[d].properties[p]->state == state;
		pthread_mutex_unlock(&mutex);
		if (ready) {
			return true;
		}
		indigo_usleep(10000);
	}
	fprintf(stderr, "Timeout: %s %s expected state %d\n", devices[d].name, name, state);
	return false;
}

static indigo_property_state cached_state(int d, const char *name) {
	pthread_mutex_lock(&mutex);
	int p = slot(d, name);
	indigo_property_state state = p < 0 ? INDIGO_ALERT_STATE : devices[d].properties[p]->state;
	pthread_mutex_unlock(&mutex);
	return state;
}

static bool switch_value(int d, const char *name, const char *item, indigo_property_state state) {
	if (d < 0) {
		return true;
	}
	unsigned before = revision(d, name);
	indigo_change_switch_property_1(&client, devices[d].name, name, item, true);
	return wait_state(d, name, before, state);
}

static bool number_value(int d, const char *name, const char *item, double value, indigo_property_state state) {
	if (d < 0) {
		return true;
	}
	unsigned before = revision(d, name);
	indigo_change_number_property_1(&client, devices[d].name, name, item, value);
	return wait_state(d, name, before, state);
}

static bool number_item(int d, const char *name, const char *item, indigo_item *copy) {
	pthread_mutex_lock(&mutex);
	int p = slot(d, name);
	bool found = false;
	if (p >= 0) {
		indigo_property *property = devices[d].properties[p];
		for (int i = 0; i < property->count && !found; i++) {
			if (!strcmp(property->items[i].name, item)) {
				*copy = property->items[i];
				found = true;
			}
		}
	}
	pthread_mutex_unlock(&mutex);
	return found;
}

static indigo_property *snapshot(int d, const char *name) {
	pthread_mutex_lock(&mutex);
	int p = slot(d, name);
	indigo_property *copy = p < 0 ? NULL : indigo_copy_property(NULL, devices[d].properties[p]);
	pthread_mutex_unlock(&mutex);
	return copy;
}

static bool restore_property(indigo_property *p) {
	if (!p) {
		return true;
	}
	unsigned before = revision(camera, p->name);
	return indigo_change_property(&client, p) == INDIGO_OK && wait_state(camera, p->name, before, INDIGO_OK_STATE);
}

static unsigned frames(void) {
	pthread_mutex_lock(&mutex);
	unsigned result = devices[camera].frames;
	pthread_mutex_unlock(&mutex);
	return result;
}

static bool frame_geometry(unsigned width, unsigned height) {
	pthread_mutex_lock(&mutex);
	bool ok = devices[camera].width == width && devices[camera].height == height && devices[camera].bytes == 2;
	pthread_mutex_unlock(&mutex);
	if (!ok) {
		fprintf(stderr, "Expected %u x %u RAW16, got %u x %u with %u bytes per pixel\n", width, height, devices[camera].width, devices[camera].height, devices[camera].bytes);
	}
	return ok;
}

static void clear_message(void) {
	pthread_mutex_lock(&mutex);
	*last_message_property = *last_message_text = 0;
	pthread_mutex_unlock(&mutex);
}

static bool message_reported(const char *name, const char *text) {
	pthread_mutex_lock(&mutex);
	bool ok = !strcmp(last_message_property, name) && !strcmp(last_message_text, text);
	pthread_mutex_unlock(&mutex);
	return ok;
}

static bool same_values(indigo_property *a, indigo_property *b) {
	if (!a || !b || a->type != b->type || a->count != b->count) {
		return false;
	}
	for (int i = 0; i < a->count; i++) {
		indigo_item *x = a->items + i, *y = b->items + i;
		if (strcmp(x->name, y->name)) {
			return false;
		}
		if (a->type == INDIGO_NUMBER_VECTOR && (x->number.value != y->number.value || x->number.target != y->number.target)) {
			return false;
		}
		if (a->type == INDIGO_SWITCH_VECTOR && x->sw.value != y->sw.value) {
			return false;
		}
		if (a->type == INDIGO_TEXT_VECTOR && strcmp(x->text.value, y->text.value)) {
			return false;
		}
	}
	return true;
}

// Requests a value the property does not hold, so an accepted change would be visible in the cache.
static bool request_other_value(indigo_property *property) {
	indigo_item *item = property->items;
	if (property->type == INDIGO_NUMBER_VECTOR) {
		double value = item->number.value < item->number.max ? item->number.value + 1 : item->number.min;
		if (value > item->number.max) {
			value = item->number.max;
		}
		if (value == item->number.value) {
			return false;
		}
		indigo_change_number_property_1(&client, devices[camera].name, property->name, item->name, value);
		return true;
	}
	if (property->type == INDIGO_SWITCH_VECTOR) {
		for (int i = 0; i < property->count; i++) {
			if (!property->items[i].sw.value) {
				indigo_change_switch_property_1(&client, devices[camera].name, property->name, property->items[i].name, true);
				return true;
			}
		}
		return false;
	}
	return false;
}

static bool rejected_while_busy(const char *name) {
	indigo_property *before = snapshot(camera, name);
	if (!before) {
		printf("    %s is not exposed by this camera, guard skipped\n", name);
		return true;
	}
	if (before->perm != INDIGO_RW_PERM) {
		printf("    %s is read-only, guard skipped\n", name);
		indigo_release_property(before);
		return true;
	}
	unsigned before_revision = revision(camera, name);
	clear_message();
	if (!request_other_value(before)) {
		printf("    %s holds no alternative value on this camera, guard skipped\n", name);
		indigo_release_property(before);
		return true;
	}
	bool refused = wait_state(camera, name, before_revision, INDIGO_ALERT_STATE);
	indigo_property *after = snapshot(camera, name);
	bool preserved = same_values(before, after), reported = message_reported(name, "Acquisition in progress");
	printf("    %s change during exposure: refused %s, driver values preserved %s, message %s\n", name, refused ? "PASS" : "FAIL", preserved ? "PASS" : "FAIL", reported ? "PASS" : "FAIL");
	indigo_release_property(before);
	indigo_release_property(after);
	return refused && preserved && reported;
}

// Every property carrying a reject_change guard in indigo_ccd_mi.driver. CCD_FRAME and CCD_MODE are
// framework owned in this driver and therefore have no generated change branch to attach a guard to.
static const char *guarded_properties[] = { "CCD_READ_MODE", "CCD_GAIN", "CCD_BIN" };

// The in-process client receives the driver properties directly, so this covers the refusal state,
// the preserved driver values and the message; the generated per-item do_update marking is only
// observable through a protocol adapter.
static bool reject_change_guards(void) {
	indigo_property *saved[ARRAY_SIZE(guarded_properties)] = { 0 };
	for (int i = 0; i < ARRAY_SIZE(guarded_properties); i++) {
		saved[i] = snapshot(camera, guarded_properties[i]);
	}
	unsigned before_frames = frames(), exposure_revision = revision(camera, "CCD_EXPOSURE");
	indigo_change_number_property_1(&client, devices[camera].name, "CCD_EXPOSURE", "EXPOSURE", 10);
	bool started = wait_state(camera, "CCD_EXPOSURE", exposure_revision, INDIGO_BUSY_STATE), ok = started;
	for (int i = 0; started && i < ARRAY_SIZE(guarded_properties); i++) {
		if (cached_state(camera, "CCD_EXPOSURE") != INDIGO_BUSY_STATE) {
			fprintf(stderr, "Exposure ended before %s was tested\n", guarded_properties[i]);
			ok = false;
			break;
		}
		// Report every guard in one run; a single refusal failure must not hide the others.
		ok = rejected_while_busy(guarded_properties[i]) && ok;
	}
	bool completed = wait_state(camera, "CCD_EXPOSURE", exposure_revision, INDIGO_OK_STATE) && frames() == before_frames + 1;
	printf("    exposure completed with its image after the refused changes: %s\n", completed ? "PASS" : "FAIL");
	ok = ok && completed;
	// A guard must not be sticky: the same properties are accepted again once the camera is idle.
	for (int i = 0; i < ARRAY_SIZE(guarded_properties); i++) {
		if (saved[i] && saved[i]->perm == INDIGO_RW_PERM && !restore_property(saved[i])) {
			fprintf(stderr, "%s was not accepted after the acquisition finished\n", guarded_properties[i]);
			ok = false;
		}
		indigo_release_property(saved[i]);
	}
	printf("    reject_change guards: %s\n", ok ? "PASS" : "FAIL");
	return ok;
}

static bool report_capabilities(void) {
	indigo_property *info = snapshot(camera, "CCD_INFO");
	indigo_property *read_mode = snapshot(camera, "CCD_READ_MODE");
	indigo_property *temperature = snapshot(camera, "CCD_TEMPERATURE");
	indigo_property *gain = snapshot(camera, "CCD_GAIN");
	indigo_property *cooler = snapshot(camera, "CCD_COOLER");
	bool ok = info != NULL;
	if (ok) {
		for (int i = 0; i < info->count; i++) {
			printf("    %s = %g\n", info->items[i].name, info->items[i].number.value);
		}
	}
	printf("    read modes: %d, temperature: %s, gain: %s, cooler: %s, guider: %s, wheel: %s\n", read_mode ? read_mode->count : 0, temperature ? (temperature->perm == INDIGO_RW_PERM ? "writable" : "read-only") : "absent", gain ? "writable" : "absent", cooler ? "present" : "absent", guider < 0 ? "absent" : devices[guider].name, wheel < 0 ? "absent" : devices[wheel].name);
	indigo_release_property(info);
	indigo_release_property(read_mode);
	indigo_release_property(temperature);
	indigo_release_property(gain);
	indigo_release_property(cooler);
	return ok;
}

static bool acquisition_scenarios(void) {
	indigo_item width, height, exposure;
	if (!number_item(camera, "CCD_INFO", "WIDTH", &width) || !number_item(camera, "CCD_INFO", "HEIGHT", &height) || !number_item(camera, "CCD_EXPOSURE", "EXPOSURE", &exposure)) {
		fprintf(stderr, "CCD_INFO or CCD_EXPOSURE is incomplete\n");
		return false;
	}
	unsigned full_width = (unsigned)width.number.value, full_height = (unsigned)height.number.value, before = frames();
	bool ok = number_value(camera, "CCD_EXPOSURE", "EXPOSURE", 0.2, INDIGO_OK_STATE) && frames() == before + 1 && frame_geometry(full_width, full_height);
	printf("    full frame light exposure: %s\n", ok ? "PASS" : "FAIL");
	indigo_property *read_mode = snapshot(camera, "CCD_READ_MODE");
	if (ok && read_mode && read_mode->count > 1) {
		for (int i = 0; ok && i < read_mode->count; i++) {
			before = frames();
			ok = switch_value(camera, "CCD_READ_MODE", read_mode->items[i].name, INDIGO_OK_STATE) && number_value(camera, "CCD_EXPOSURE", "EXPOSURE", 0.2, INDIGO_OK_STATE) && frames() == before + 1;
			printf("    read mode %s exposure: %s\n", read_mode->items[i].name, ok ? "PASS" : "FAIL");
		}
	}
	unsigned roi_width = full_width >= 256 ? 128 : full_width / 2, roi_height = full_height >= 256 ? 128 : full_height / 2;
	if (ok) {
		unsigned frame_revision = revision(camera, "CCD_FRAME");
		indigo_change_number_property(&client, devices[camera].name, "CCD_FRAME", 4, (const char *[]){ "LEFT", "TOP", "WIDTH", "HEIGHT" }, (double []){ 16, 24, roi_width, roi_height });
		before = frames();
		ok = wait_state(camera, "CCD_FRAME", frame_revision, INDIGO_OK_STATE) && switch_value(camera, "CCD_FRAME_TYPE", "DARK", INDIGO_OK_STATE) && number_value(camera, "CCD_EXPOSURE", "EXPOSURE", 0.2, INDIGO_OK_STATE) && frames() == before + 1 && frame_geometry(roi_width, roi_height);
		printf("    %u x %u dark frame at 16,24: %s\n", roi_width, roi_height, ok ? "PASS" : "FAIL");
	}
	if (ok) {
		// A bias frame is taken with the shortest exposure the driver reports, with the shutter closed.
		before = frames();
		ok = switch_value(camera, "CCD_FRAME_TYPE", "BIAS", INDIGO_OK_STATE) && number_value(camera, "CCD_EXPOSURE", "EXPOSURE", exposure.number.min, INDIGO_OK_STATE) && frames() == before + 1 && frame_geometry(roi_width, roi_height);
		printf("    minimum duration bias frame: %s\n", ok ? "PASS" : "FAIL");
	}
	if (ok) {
		unsigned frame_revision = revision(camera, "CCD_FRAME");
		indigo_change_number_property(&client, devices[camera].name, "CCD_FRAME", 4, (const char *[]){ "LEFT", "TOP", "WIDTH", "HEIGHT" }, (double []){ 0, 0, full_width, full_height });
		ok = wait_state(camera, "CCD_FRAME", frame_revision, INDIGO_OK_STATE) && switch_value(camera, "CCD_FRAME_TYPE", "LIGHT", INDIGO_OK_STATE);
		printf("    full frame light settings restored: %s\n", ok ? "PASS" : "FAIL");
	}
	indigo_release_property(read_mode);
	return ok;
}

static bool abort_and_reacquire(void) {
	unsigned exposure_revision = revision(camera, "CCD_EXPOSURE"), before = frames();
	indigo_change_number_property_1(&client, devices[camera].name, "CCD_EXPOSURE", "EXPOSURE", 60);
	bool ok = wait_state(camera, "CCD_EXPOSURE", exposure_revision, INDIGO_BUSY_STATE);
	// Let the SDK start the physical exposure before aborting it.
	indigo_usleep(500000);
	exposure_revision = revision(camera, "CCD_EXPOSURE");
	ok = ok && switch_value(camera, "CCD_ABORT_EXPOSURE", "ABORT_EXPOSURE", INDIGO_OK_STATE) && wait_state(camera, "CCD_EXPOSURE", exposure_revision, INDIGO_ALERT_STATE) && frames() == before;
	ok = ok && number_value(camera, "CCD_EXPOSURE", "EXPOSURE", 0.2, INDIGO_OK_STATE) && frames() == before + 1;
	printf("    aborted 60 s exposure delivered no image and the next exposure succeeded: %s\n", ok ? "PASS" : "FAIL");
	return ok;
}

static bool guider_scenarios(void) {
	if (guider < 0) {
		printf("    guider is not exposed by this camera, guider scenarios skipped\n");
		return true;
	}
	const char *axes[] = { "GUIDER_GUIDE_RA", "GUIDER_GUIDE_RA", "GUIDER_GUIDE_DEC", "GUIDER_GUIDE_DEC" };
	const char *directions[] = { "EAST", "WEST", "NORTH", "SOUTH" };
	bool ok = true;
	for (int i = 0; ok && i < 4; i++) {
		ok = number_value(guider, axes[i], directions[i], 100, INDIGO_OK_STATE);
	}
	printf("    all four guide directions completed: %s\n", ok ? "PASS" : "FAIL");
	if (ok) {
		// Each axis keeps its own completion, so a DEC pulse must not shorten a running RA pulse.
		unsigned ra_revision = revision(guider, "GUIDER_GUIDE_RA");
		indigo_change_number_property_1(&client, devices[guider].name, "GUIDER_GUIDE_RA", "EAST", 1000);
		ok = wait_state(guider, "GUIDER_GUIDE_RA", ra_revision, INDIGO_BUSY_STATE) && number_value(guider, "GUIDER_GUIDE_DEC", "NORTH", 300, INDIGO_OK_STATE) && wait_state(guider, "GUIDER_GUIDE_RA", ra_revision, INDIGO_OK_STATE);
		printf("    overlapping RA and DEC pulses both completed: %s\n", ok ? "PASS" : "FAIL");
	}
	if (ok) {
		ok = number_value(guider, "GUIDER_GUIDE_RA", "EAST", 0, INDIGO_OK_STATE);
		printf("    zero duration pulse completed immediately: %s\n", ok ? "PASS" : "FAIL");
	}
	if (ok) {
		unsigned exposure_revision = revision(camera, "CCD_EXPOSURE"), before = frames();
		indigo_change_number_property_1(&client, devices[camera].name, "CCD_EXPOSURE", "EXPOSURE", 3);
		ok = wait_state(camera, "CCD_EXPOSURE", exposure_revision, INDIGO_BUSY_STATE) && number_value(guider, "GUIDER_GUIDE_RA", "EAST", 100, INDIGO_OK_STATE) && number_value(guider, "GUIDER_GUIDE_DEC", "NORTH", 100, INDIGO_OK_STATE);
		ok = ok && wait_state(camera, "CCD_EXPOSURE", exposure_revision, INDIGO_OK_STATE) && frames() == before + 1;
		printf("    guide pulses during an active exposure: %s\n", ok ? "PASS" : "FAIL");
	}
	return ok;
}

static bool wheel_scenarios(void) {
	if (wheel < 0) {
		printf("    filter wheel is not exposed by this camera, wheel scenarios skipped\n");
		return true;
	}
	indigo_item slot_item;
	if (!number_item(wheel, "WHEEL_SLOT", "SLOT", &slot_item)) {
		fprintf(stderr, "WHEEL_SLOT is missing\n");
		return false;
	}
	bool ok = true;
	for (double s = slot_item.number.min; ok && s <= slot_item.number.max; s++) {
		ok = number_value(wheel, "WHEEL_SLOT", "SLOT", s, INDIGO_OK_STATE);
	}
	// Selecting the already selected slot is a no-op that must still settle in OK.
	ok = ok && number_value(wheel, "WHEEL_SLOT", "SLOT", slot_item.number.max, INDIGO_OK_STATE) && number_value(wheel, "WHEEL_SLOT", "SLOT", slot_item.number.min, INDIGO_OK_STATE);
	printf("    all %d filter slots selected: %s\n", (int)slot_item.number.max, ok ? "PASS" : "FAIL");
	return ok;
}

static bool shared_connection_cycles(void) {
	// The camera owns the SDK handle; every logical device shares it through the generated count.
	bool ok = disconnect_device(camera);
	if (ok && guider >= 0) {
		ok = number_value(guider, "GUIDER_GUIDE_RA", "EAST", 100, INDIGO_OK_STATE);
		printf("    guider still works while the camera is disconnected: %s\n", ok ? "PASS" : "FAIL");
	}
	ok = ok && disconnect_device(guider) && disconnect_device(wheel);
	ok = ok && switch_value(camera, "CONNECTION", "CONNECTED", INDIGO_OK_STATE) && switch_value(guider, "CONNECTION", "CONNECTED", INDIGO_OK_STATE) && switch_value(wheel, "CONNECTION", "CONNECTED", INDIGO_OK_STATE);
	ok = ok && switch_value(camera, "CCD_UPLOAD_MODE", "CLIENT", INDIGO_OK_STATE) && switch_value(camera, "CCD_IMAGE_FORMAT", "RAW", INDIGO_OK_STATE);
	unsigned before = frames();
	ok = ok && number_value(camera, "CCD_EXPOSURE", "EXPOSURE", 0.2, INDIGO_OK_STATE) && frames() == before + 1;
	printf("    camera-first disconnect and reconnect: %s\n", ok ? "PASS" : "FAIL");
	if (ok && guider >= 0) {
		ok = disconnect_device(guider) && disconnect_device(camera) && switch_value(guider, "CONNECTION", "CONNECTED", INDIGO_OK_STATE) && switch_value(camera, "CONNECTION", "CONNECTED", INDIGO_OK_STATE);
		ok = ok && switch_value(wheel, "CONNECTION", "CONNECTED", INDIGO_OK_STATE) && switch_value(camera, "CCD_UPLOAD_MODE", "CLIENT", INDIGO_OK_STATE) && switch_value(camera, "CCD_IMAGE_FORMAT", "RAW", INDIGO_OK_STATE);
		before = frames();
		ok = ok && number_value(camera, "CCD_EXPOSURE", "EXPOSURE", 0.2, INDIGO_OK_STATE) && frames() == before + 1;
		printf("    guider-first disconnect and reconnect: %s\n", ok ? "PASS" : "FAIL");
	}
	return ok;
}

static void hardware_workflows(void) {
	bool initialized = false;
	CHECK(indigo_start() == INDIGO_OK);
	CHECK(indigo_attach_client(&client) == INDIGO_OK);
	CHECK(driver_entry(INDIGO_DRIVER_INIT, NULL) == INDIGO_OK);
	initialized = true;
	// Wait for the SDK-backed hot-plug handler, which can take several seconds on macOS.
	for (int i = 0; i < 1500; i++) {
		bool found = false;
		pthread_mutex_lock(&mutex);
		for (int d = 0; d < MAX_DEVICES && !found; d++) {
			found = devices[d].interface & INDIGO_INTERFACE_CCD;
		}
		pthread_mutex_unlock(&mutex);
		if (found) {
			break;
		}
		indigo_usleep(10000);
	}
	// Optional logical devices are attached after the camera, so let the topology settle.
	indigo_usleep(2000000);
	const char *requested = getenv("INDIGO_TEST_DEVICE");
	int matches = 0;
	pthread_mutex_lock(&mutex);
	for (int d = 0; d < MAX_DEVICES; d++) {
		if (devices[d].interface & INDIGO_INTERFACE_CCD) {
			printf("    discovered camera: %s\n", devices[d].name);
			if (!requested || !strcmp(requested, devices[d].name)) {
				camera = d;
				matches++;
			}
		}
	}
	if (matches == 1) {
		for (int d = 0; d < MAX_DEVICES; d++) {
			if (devices[d].master != devices[camera].device) {
				continue;
			}
			if (devices[d].interface & INDIGO_INTERFACE_GUIDER) {
				guider = d;
			}
			if (devices[d].interface & INDIGO_INTERFACE_WHEEL) {
				wheel = d;
			}
		}
	}
	pthread_mutex_unlock(&mutex);
	if (matches != 1) {
		fprintf(stderr, "Expected one camera; found %d matches. Set INDIGO_TEST_DEVICE to an exact discovered name when needed.\n", matches);
		camera = -1;
	}
	CHECK(camera >= 0);
	printf("    selected: %s, guider: %s, wheel: %s\n", devices[camera].name, guider < 0 ? "not available" : devices[guider].name, wheel < 0 ? "not available" : devices[wheel].name);
	// Connecting a slave first proves the generated shared open works in either order.
	CHECK(switch_value(guider, "CONNECTION", "CONNECTED", INDIGO_OK_STATE));
	CHECK(switch_value(camera, "CONNECTION", "CONNECTED", INDIGO_OK_STATE));
	CHECK(switch_value(wheel, "CONNECTION", "CONNECTED", INDIGO_OK_STATE));
	CHECK(switch_value(camera, "CCD_UPLOAD_MODE", "CLIENT", INDIGO_OK_STATE));
	CHECK(switch_value(camera, "CCD_IMAGE_FORMAT", "RAW", INDIGO_OK_STATE));
	CHECK(report_capabilities());
	CHECK(acquisition_scenarios());
	CHECK(abort_and_reacquire());
	CHECK(reject_change_guards());
	CHECK(guider_scenarios());
	CHECK(wheel_scenarios());
	CHECK(shared_connection_cycles());
	CHECK(disconnect_device(camera));
	CHECK(disconnect_device(guider));
	CHECK(disconnect_device(wheel));
	CHECK(driver_entry(INDIGO_DRIVER_SHUTDOWN, NULL) == INDIGO_OK);
	initialized = false;
	CHECK(driver_entry(INDIGO_DRIVER_INIT, NULL) == INDIGO_OK);
	initialized = true;
	CHECK(wait_presence());
	CHECK(switch_value(camera, "CONNECTION", "CONNECTED", INDIGO_OK_STATE));
	CHECK(switch_value(guider, "CONNECTION", "CONNECTED", INDIGO_OK_STATE));
	CHECK(switch_value(wheel, "CONNECTION", "CONNECTED", INDIGO_OK_STATE));
	CHECK(switch_value(camera, "CCD_UPLOAD_MODE", "CLIENT", INDIGO_OK_STATE));
	CHECK(switch_value(camera, "CCD_IMAGE_FORMAT", "RAW", INDIGO_OK_STATE));
	unsigned before = frames();
	CHECK(number_value(camera, "CCD_EXPOSURE", "EXPOSURE", 0.2, INDIGO_OK_STATE));
	CHECK(frames() == before + 1);
	printf("    driver shutdown and reinitialization: fresh queue and exposure succeeded\n");
	pthread_mutex_lock(&mutex);
	unsigned invalid = devices[camera].invalid_frames;
	pthread_mutex_unlock(&mutex);
	CHECK(invalid == 0);
cleanup:
	if (camera >= 0) {
		// Abort any unfinished acquisition before disconnecting; disconnected properties may be unchanged.
		indigo_change_switch_property_1(&client, devices[camera].name, "CCD_ABORT_EXPOSURE", "ABORT_EXPOSURE", true);
		if (!disconnect_device(camera)) { indigo_test_failures++; }
	}
	if (!disconnect_device(guider)) { indigo_test_failures++; }
	if (!disconnect_device(wheel)) { indigo_test_failures++; }
	if (initialized && driver_entry(INDIGO_DRIVER_SHUTDOWN, NULL) != INDIGO_OK) { indigo_test_failures++; }
	indigo_detach_client(&client);
	indigo_stop();
}

int main(int argc, char **argv) {
	if (argc != 2 || strcmp(argv[1], "--run")) {
		fprintf(stderr, "Physical camera test: run explicitly with --run (or make test-ccd-mi-hw).\n");
		return 2;
	}
	setvbuf(stdout, NULL, _IONBF, 0);
	if (getenv("MI_HW_DEBUG")) {
		indigo_set_log_level(INDIGO_LOG_DEBUG);
	}
	client = (indigo_client){ .name = "MI hardware test", .version = INDIGO_VERSION_CURRENT, .define_property = define_property, .update_property = update_property, .delete_property = delete_property, .send_message = report_message };
	const indigo_test_case tests[] = { { "Physical camera exposure, reject_change, guider, wheel and reconnect", hardware_workflows } };
	int result = indigo_run_tests("Moravian Instruments hardware", tests, 1);
	for (int d = 0; d < MAX_DEVICES; d++) {
		for (int p = 0; p < MAX_PROPERTIES; p++) {
			indigo_release_property(devices[d].properties[p]);
		}
	}
	return result;
}
