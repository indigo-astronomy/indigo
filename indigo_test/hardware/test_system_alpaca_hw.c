// Copyright (c) 2026 INDIGO initiative
// All rights reserved.
//
// You may use this software under the terms of 'INDIGO Astronomy
// open-source license' (see LICENSE.md).
//
// THIS SOFTWARE IS PROVIDED BY THE AUTHORS 'AS IS' AND ANY EXPRESS
// OR IMPLIED WARRANTIES, INCLUDING, BUT NOT LIMITED TO, THE IMPLIED
// WARRANTIES OF MERCHANTABILITY AND FITNESS FOR A PARTICULAR PURPOSE
// ARE DISCLAIMED. IN NO EVENT SHALL THE AUTHOR BE LIABLE FOR ANY
// DIRECT, INDIRECT, INCIDENTAL, SPECIAL, EXEMPLARY, OR CONSEQUENTIAL
// DAMAGES (INCLUDING, BUT NOT LIMITED TO, PROCUREMENT OF SUBSTITUTE
// GOODS OR SERVICES; LOSS OF USE, DATA, OR PROFITS; OR BUSINESS
// INTERRUPTION) HOWEVER CAUSED AND ON ANY THEORY OF LIABILITY,
// WHETHER IN CONTRACT, STRICT LIABILITY, OR TORT (INCLUDING
// NEGLIGENCE OR OTHERWISE) ARISING IN ANY WAY OUT OF THE USE OF THIS
// SOFTWARE, EVEN IF ADVISED OF THE POSSIBILITY OF SUCH DAMAGE.

// Code is generated by AI

// Hardware suite of the system_alpaca driver (ASCOM Alpaca client): it finds out which Alpaca devices are reachable from this
// machine and tests every function each of them advertises, through the INDIGO proxy devices exactly as a client would, and
// verifies the effect on the real device by reading it back through the proxy and directly through the Alpaca HTTP API.
//
// SELECTION
//
// - SYSTEM_ALPACA_HW_PORT (or INDIGO_TEST_PORT, which 'run_driver_test.py --port' sets) names one Alpaca server "host:port" or
//   several separated by commas. The servers are added to X_ALPACA_SERVERS and nothing is broadcast. Without it the suite runs one
//   broadcast discovery (UDP 32227) and tests what answers. INDIGO bridges (agent_alpaca) are ignored by the driver itself.
// - SYSTEM_ALPACA_HW_DEVICES restricts the run to the devices whose DeviceName or UniqueID contains one of its comma separated
//   texts (case-insensitive); the other devices are switched off in X_ALPACA_DEVICES and never connected.
//
// CASES
//
// Every tested device gets its own group of cases "<class>_<device>_<function>", <class> being the Alpaca DeviceType in lower case
// and <device> the proxy name without "ALPACA ". Which functions a device has is decided from what it advertises (the Can* flags,
// the interface version, the optional members it implements) after it was connected once; a function it does not advertise is not
// a case: it is listed as SKIP with the reason, and the summary at the end shows per device which functions passed, failed or were
// skipped.
//
// WHAT IS CHANGED AND RESTORED
//
// Every setting a case changes is put back: tracking, tracking and guide rates, slew rate, the site, focuser position and
// temperature compensation, filter slot, rotator position and reverse, dome azimuth and shutter, cover and calibrator, switches,
// the averaging period, camera binning, cooler, set point, gain, offset and readout mode. A telescope found parked is parked again,
// one found unparked is left unparked where the last case pointed it (above the horizon) with its tracking state restored. A device
// that was connected for another client before the run is connected again at the end, because an INDIGO disconnect disconnects the
// Alpaca device for every client (D5).
//
// There are no opt-ins: a hardware run is made on devices that can not be damaged, so sync, set park, the dome shutter and switch
// writes are tested like everything else, and restored: a sync is followed by a sync back to the position read before it, the park
// position is set back to the original one (as closely as a slew can reach it), every switch gets its original value back.
//
// THE TELESCOPE MOVES. Slews go to targets computed from the site and local sidereal time of the telescope, about 50 degrees above
// the horizon, an hour and a half either side of the meridian; manual motion moves a few tenths of a degree; park and find home go
// to the positions stored in the telescope.
//
// The configuration of the driver lives in a private HOME, never in the user's own (indigo_test_use_private_home()).

#include <math.h>
#include <time.h>
#include <ctype.h>
#include <indigo_drivers/system_alpaca/indigo_system_alpaca_json.h>

#include "../integration/system_alpaca/system_alpaca_test_common.h"
#include "hardware_device_record.h"

#include <indigo/indigo_ccd_driver.h>
#include <indigo/indigo_mount_driver.h>
#include <indigo/indigo_align.h>
#include <indigo/indigo_raw_utils.h>

#define SUITE_NAME "system_alpaca hardware"

// Time the driver needs to answer a request it executes at once. Generous: the NYX-101 takes 0.5 s per Alpaca request.
#define HW_ANSWER 30.0
// Time a motion may take: slews, park, find home, focuser, rotator, dome, cover.
#define HW_MOTION 300.0
// Time a connect or disconnect may take.
#define HW_CONNECT 60.0
// Tolerance of an arrival of a telescope slew, degrees on the sky.
#define HW_SLEW_TOLERANCE 0.1
// Sidereal rate in degrees per second.
#define HW_SIDEREAL (15.0410686 / 3600.0)

#define HW_MAX_SERVERS 16
#define HW_MAX_DEVICES 32
#define HW_MAX_STEPS 640

#define HW_CHECK(condition) SA_CHECK(condition)

// ---------------------------------------------------------------------------- devices and servers

typedef struct {
	char host[64];
	int port;
	char name[INDIGO_NAME_SIZE];
	alpaca_http_connection *http;
	alpaca_http_response response;
} hw_server;

typedef struct {
	bool can_park, can_unpark, can_set_park, can_find_home, can_sync, can_slew_async, can_set_tracking, can_pulse_guide, can_set_guide_rates, can_move[2];
	bool has_side, has_site, has_guide_rates;
	int track_rates;
	bool found_parked, found_tracking;
	int found_track_rate, found_side;
	double found_guide_ra, found_guide_dec, latitude, longitude, elevation;
	char found_slew_rate[INDIGO_NAME_SIZE];
	const char *axes;
	double settle;
	bool guider_connected;
} hw_mount;

typedef struct {
	bool can_abort, can_stop, can_pulse_guide, can_asymmetric;
	int width, height, max_bin_x, max_bin_y;
	double exposure_min, exposure_max;
	double found_bin_x, found_bin_y;
	bool guider_connected;
} hw_camera;

typedef struct {
	bool absolute, temp_comp_available, has_temperature;
	int max_step, max_increment, found_position;
	bool found_temp_comp;
} hw_focuser;

typedef struct {
	int slots, found_slot;
} hw_wheel;

typedef struct {
	bool can_reverse, has_mechanical, found_reverse;
	double found_position;
} hw_rotator;

typedef struct {
	bool can_set_azimuth, can_set_altitude, can_sync, can_park, can_set_park, can_find_home, can_set_shutter, can_slave;
	double found_azimuth;
	int found_shutter;
	bool found_parked;
} hw_dome;

typedef struct {
	int found_cover, found_calibrator, found_brightness, max_brightness;
} hw_cover;

typedef struct {
	int max_switch;
} hw_switch;

typedef struct hw_device hw_device;

struct hw_device {
	char key[INDIGO_NAME_SIZE];
	char proxy[INDIGO_NAME_SIZE];
	char guider[INDIGO_NAME_SIZE];
	char device_name[INDIGO_NAME_SIZE];
	char type[32];
	char url_type[32];
	char unique_id[INDIGO_NAME_SIZE];
	char prefix[INDIGO_NAME_SIZE];
	int number;
	hw_server *server;
	int interface_version;
	bool found_connected;
	bool connected;
	bool alpaca_restored;
	hw_mount mount;
	hw_camera camera;
	hw_focuser focuser;
	hw_wheel wheel;
	hw_rotator rotator;
	hw_dome dome;
	hw_cover cover;
	hw_switch sw;
};

static hw_server hw_servers[HW_MAX_SERVERS];
static int hw_server_count = 0;
static hw_device hw_devices[HW_MAX_DEVICES];
static int hw_device_count = 0;

// ---------------------------------------------------------------------------- direct access to the Alpaca device

static alpaca_json_value *hw_reply = NULL;

static const alpaca_json_value *hw_get(hw_device *device, const char *member, const char *query, int *error_number) {
	char path[256], error[128];
	hw_server *server = device->server;
	alpaca_http_options options = { { 5000, 15000, 10000, 20000 }, NULL, false };
	int64_t number = -1;
	snprintf(path, sizeof(path), "/api/v1/%s/%d/%s", device->url_type, device->number, member);
	alpaca_json_free(hw_reply);
	hw_reply = NULL;
	*error_number = -1;
	if (alpaca_http_get(server->http, path, query, &options, &server->response) != ALPACA_HTTP_OK || server->response.status != 200 || server->response.body.data == NULL) {
		return NULL;
	}
	hw_reply = alpaca_json_parse(server->response.body.data, server->response.body.size, error, sizeof(error));
	if (hw_reply == NULL || !alpaca_json_get_int(alpaca_json_get(hw_reply, "ErrorNumber"), &number)) {
		return NULL;
	}
	*error_number = (int)number;
	return alpaca_json_get(hw_reply, "Value");
}

// PUT to the Alpaca device directly; used only to give a device back to the clients it was connected for. Returns the ErrorNumber, -1 without a valid answer.
static int hw_put(hw_device *device, const char *member, const char *form) {
	char path[256], body[512], error[128];
	hw_server *server = device->server;
	alpaca_http_options options = { { 5000, 30000, 10000, 40000 }, NULL, true };
	int64_t number = -1;
	snprintf(path, sizeof(path), "/api/v1/%s/%d/%s", device->url_type, device->number, member);
	snprintf(body, sizeof(body), "%s&ClientID=4243&ClientTransactionID=1", form);
	if (alpaca_http_put(server->http, path, NULL, body, &options, &server->response) != ALPACA_HTTP_OK || server->response.status != 200 || server->response.body.data == NULL) {
		return -1;
	}
	alpaca_json_free(hw_reply);
	hw_reply = alpaca_json_parse(server->response.body.data, server->response.body.size, error, sizeof(error));
	if (hw_reply == NULL || !alpaca_json_get_int(alpaca_json_get(hw_reply, "ErrorNumber"), &number)) {
		return -1;
	}
	return (int)number;
}

static bool hw_read_double_q(hw_device *device, const char *member, const char *query, double *value) {
	int error_number = -1;
	const alpaca_json_value *json = hw_get(device, member, query, &error_number);
	return error_number == 0 && alpaca_json_get_double(json, value);
}

static bool hw_read_double(hw_device *device, const char *member, double *value) {
	return hw_read_double_q(device, member, NULL, value);
}

static bool hw_read_bool_q(hw_device *device, const char *member, const char *query, bool *value) {
	int error_number = -1;
	const alpaca_json_value *json = hw_get(device, member, query, &error_number);
	return error_number == 0 && alpaca_json_get_bool(json, value);
}

static bool hw_read_bool(hw_device *device, const char *member, bool *value) {
	return hw_read_bool_q(device, member, NULL, value);
}

static bool hw_read_int(hw_device *device, const char *member, int *value) {
	int error_number = -1;
	int64_t number = 0;
	const alpaca_json_value *json = hw_get(device, member, NULL, &error_number);
	if (error_number == 0 && alpaca_json_get_int(json, &number)) {
		*value = (int)number;
		return true;
	}
	return false;
}

static bool hw_read_string(hw_device *device, const char *member, char *value, size_t size) {
	int error_number = -1;
	const char *text = NULL;
	const alpaca_json_value *json = hw_get(device, member, NULL, &error_number);
	if (error_number == 0 && alpaca_json_get_string(json, &text)) {
		snprintf(value, size, "%s", text);
		return true;
	}
	return false;
}

static double hw_double(hw_device *device, const char *member) {
	double value = NAN;
	return hw_read_double(device, member, &value) ? value : NAN;
}

static int hw_int(hw_device *device, const char *member) {
	int value = -9999;
	return hw_read_int(device, member, &value) ? value : -9999;
}

static bool hw_bool(hw_device *device, const char *member) {
	bool value = false;
	return hw_read_bool(device, member, &value) && value;
}

// Number of elements of an array member, -1 if it can not be read.
static int hw_array_size(hw_device *device, const char *member) {
	int error_number = -1;
	const alpaca_json_value *json = hw_get(device, member, NULL, &error_number);
	return error_number == 0 && json != NULL && alpaca_json_get_type(json) == ALPACA_JSON_ARRAY ? alpaca_json_size(json) : -1;
}

// ---------------------------------------------------------------------------- requests through the proxy

// Wait for the answer to a request made after the given revision: a state that is not BUSY. Returns it, -1 if there was none in time.
static int hw_answer(const char *device, const char *property, unsigned revision, double seconds) {
	if (!SA_WAIT(sa_revision(device, property) > revision && sa_state(device, property) != INDIGO_BUSY_STATE, seconds)) {
		fprintf(stderr, "    %s.%s got no answer within %.0f s, state %d\n", device, property, seconds, sa_state(device, property));
		return -1;
	}
	return sa_state(device, property);
}

static int hw_set_number(const char *device, const char *property, const char *item, double value, double seconds) {
	unsigned revision = sa_revision(device, property);
	return indigo_change_number_property_1(&sa_client, device, property, item, value) == INDIGO_OK ? hw_answer(device, property, revision, seconds) : -1;
}

static int hw_set_numbers(const char *device, const char *property, int count, const char **items, const double *values, double seconds) {
	unsigned revision = sa_revision(device, property);
	return indigo_change_number_property(&sa_client, device, property, count, items, values) == INDIGO_OK ? hw_answer(device, property, revision, seconds) : -1;
}

static int hw_set_switch(const char *device, const char *property, const char *item, bool value, double seconds) {
	unsigned revision = sa_revision(device, property);
	return indigo_change_switch_property_1(&sa_client, device, property, item, value) == INDIGO_OK ? hw_answer(device, property, revision, seconds) : -1;
}

// The messages published since the mark, printed to explain a failure.
static void hw_print_messages(int mark) {
	pthread_mutex_lock(&sa_cache_mutex);
	int first = sa_message_count - SA_MAX_MESSAGES > mark ? sa_message_count - SA_MAX_MESSAGES : mark;
	for (int i = first; i < sa_message_count; i++) {
		fprintf(stderr, "    message: %s\n", sa_messages[i % SA_MAX_MESSAGES]);
	}
	pthread_mutex_unlock(&sa_cache_mutex);
}

// Range of a number item: min, max and step; false if it does not exist.
static bool hw_number_range(const char *device, const char *name, const char *item_name, double *min, double *max, double *step) {
	pthread_mutex_lock(&sa_cache_mutex);
	indigo_item *item = sa_cache_item(device, name, item_name);
	if (item != NULL) {
		*min = item->number.min;
		*max = item->number.max;
		*step = item->number.step;
	}
	pthread_mutex_unlock(&sa_cache_mutex);
	return item != NULL;
}

// Name of the item that is on in a switch property, "" if none. The buffer is static.
static const char *hw_selected(const char *device, const char *name) {
	static char buffer[INDIGO_NAME_SIZE];
	buffer[0] = 0;
	pthread_mutex_lock(&sa_cache_mutex);
	sa_cache_entry *entry = sa_cache_find(device, name);
	for (int i = 0; entry != NULL && i < entry->property->count; i++) {
		if (entry->property->items[i].sw.value) {
			snprintf(buffer, sizeof(buffer), "%s", entry->property->items[i].name);
			break;
		}
	}
	pthread_mutex_unlock(&sa_cache_mutex);
	return buffer;
}

static bool hw_connect_proxy(const char *device) {
	if (!sa_request_connection(device, true) || !SA_WAIT(sa_is_connected(device), HW_CONNECT)) {
		fprintf(stderr, "    '%s' did not connect, CONNECTION state %d\n", device, sa_state(device, CONNECTION_PROPERTY_NAME));
		return false;
	}
	return true;
}

static bool hw_disconnect_proxy(const char *device) {
	if (!sa_request_connection(device, false) || !SA_WAIT(sa_state(device, CONNECTION_PROPERTY_NAME) == INDIGO_OK_STATE && sa_switch(device, CONNECTION_PROPERTY_NAME, CONNECTION_DISCONNECTED_ITEM_NAME), HW_CONNECT)) {
		fprintf(stderr, "    '%s' did not disconnect, CONNECTION state %d\n", device, sa_state(device, CONNECTION_PROPERTY_NAME));
		return false;
	}
	return true;
}

// ---------------------------------------------------------------------------- cases

typedef void (*hw_function)(hw_device *device);

typedef struct {
	char name[INDIGO_NAME_SIZE + 64];
	char function[64];
	char reason[256];
	hw_device *device;
	hw_function run;
	int result;
} hw_step;

static hw_step hw_steps[HW_MAX_STEPS];
static int hw_step_count = 0;

static void hw_add(hw_device *device, const char *function, hw_function run) {
	if (hw_step_count < HW_MAX_STEPS) {
		hw_step *step = hw_steps + hw_step_count++;
		snprintf(step->name, sizeof(step->name), "%s_%s", device->prefix, function);
		snprintf(step->function, sizeof(step->function), "%s", function);
		step->device = device;
		step->run = run;
	}
}

static void hw_skip(hw_device *device, const char *function, const char *format, ...) {
	if (hw_step_count < HW_MAX_STEPS) {
		va_list args;
		hw_step *step = hw_steps + hw_step_count++;
		snprintf(step->name, sizeof(step->name), "%s_%s", device->prefix, function);
		snprintf(step->function, sizeof(step->function), "%s", function);
		step->device = device;
		va_start(args, format);
		vsnprintf(step->reason, sizeof(step->reason), format, args);
		va_end(args);
	}
}

// Add the case when the condition holds, list it as skipped with the reason otherwise.
static void hw_add_if(hw_device *device, bool condition, const char *function, hw_function run, const char *reason) {
	if (condition) {
		hw_add(device, function, run);
	} else {
		hw_skip(device, function, "%s", reason);
	}
}

// The function every registered case runs: it finds its step by the name of the case, so a filtered run still runs the right one.
static void hw_run_step(void) {
	for (int i = 0; i < hw_step_count; i++) {
		hw_step *step = hw_steps + i;
		if (step->run != NULL && indigo_current_test_name != NULL && !strcmp(step->name, indigo_current_test_name)) {
			int before = indigo_test_failures;
			printf("  ---- %s\n", step->name);
			if (strcmp(step->function, "connect") && strcmp(step->function, "disconnect") && sa_defined(step->device->proxy, CONNECTION_PROPERTY_NAME) && !sa_is_connected(step->device->proxy)) {
				fprintf(stderr, "    '%s' is not connected, connecting it for the case\n", step->device->proxy);
				if (!hw_connect_proxy(step->device->proxy)) {
					indigo_test_failures++;
					step->result = -1;
					return;
				}
			}
			step->run(step->device);
			step->result = indigo_test_failures == before ? 1 : -1;
			return;
		}
	}
	fprintf(stderr, "    no step named %s\n", indigo_current_test_name);
	indigo_test_failures++;
}

// ---------------------------------------------------------------------------- common cases

// The Alpaca device reports itself connected (D5 makes an INDIGO disconnect a disconnect of the Alpaca device).
static bool hw_alpaca_connected(hw_device *device) {
	return hw_bool(device, "connected");
}

// After an INDIGO disconnect the Alpaca device reports Connected false (D5: the driver sends Connected=false / Disconnect). A device
// that another client had connected before the run may stay connected: the NYX-101 (firmware 1.32.1) accepts Connected=False and keeps
// reporting true, as a server does that keeps a device connected while any client uses it, so it is only reported for such a device.
static bool hw_alpaca_disconnected(hw_device *device) {
	if (SA_WAIT(!hw_alpaca_connected(device), device->found_connected ? 5 : HW_CONNECT)) {
		printf("    the Alpaca device reports Connected false\n");
		return true;
	}
	if (device->found_connected) {
		printf("    the Alpaca device still reports Connected true: it was connected for another client before the run, and the server keeps it connected\n");
		return true;
	}
	fprintf(stderr, "    the Alpaca device still reports Connected true after the disconnect\n");
	return false;
}

// Identity, a disconnect that reaches the Alpaca device (D5), a reconnect.
static void hw_connect(hw_device *device) {
	char description[INDIGO_VALUE_SIZE] = { 0 };
	HW_CHECK(device->connected && sa_is_connected(device->proxy));
	HW_CHECK(hw_alpaca_connected(device));
	printf("    INFO: model '%s', Alpaca driver '%s', interface version %s, UniqueID '%s'\n", sa_text(device->proxy, INFO_PROPERTY_NAME, INFO_DEVICE_MODEL_ITEM_NAME), sa_text(device->proxy, INFO_PROPERTY_NAME, INFO_DEVICE_FW_REVISION_ITEM_NAME), sa_text(device->proxy, INFO_PROPERTY_NAME, INFO_DEVICE_HW_REVISION_ITEM_NAME), sa_text(device->proxy, INFO_PROPERTY_NAME, INFO_DEVICE_SERIAL_NUM_ITEM_NAME));
	HW_CHECK(atoi(sa_text(device->proxy, INFO_PROPERTY_NAME, INFO_DEVICE_HW_REVISION_ITEM_NAME)) == device->interface_version);
	HW_CHECK(!strcmp(sa_text(device->proxy, INFO_PROPERTY_NAME, INFO_DEVICE_SERIAL_NUM_ITEM_NAME), device->unique_id));
	if (hw_read_string(device, "description", description, sizeof(description)) && *description) {
		HW_CHECK(strstr(sa_text(device->proxy, INFO_PROPERTY_NAME, INFO_DEVICE_MODEL_ITEM_NAME), description) != NULL || strstr(description, sa_text(device->proxy, INFO_PROPERTY_NAME, INFO_DEVICE_MODEL_ITEM_NAME)) != NULL);
	}
	HW_CHECK(hw_disconnect_proxy(device->proxy));
	HW_CHECK(hw_alpaca_disconnected(device));
	HW_CHECK(hw_connect_proxy(device->proxy));
	HW_CHECK(SA_WAIT(hw_alpaca_connected(device), HW_CONNECT));
	printf("    connected again\n");
	if (*device->guider) {
		HW_CHECK(SA_WAIT(sa_defined(device->guider, CONNECTION_PROPERTY_NAME), HW_ANSWER));
	}
cleanup:
	// the following cases need the device connected, whatever happened here
	if (!sa_is_connected(device->proxy)) {
		hw_connect_proxy(device->proxy);
	}
	return;
}

// The last case of a device: disconnect it (the guider first) and check that the Alpaca device was disconnected.
static void hw_disconnect(hw_device *device) {
	if (*device->guider && sa_defined(device->guider, CONNECTION_PROPERTY_NAME) && sa_is_connected(device->guider)) {
		HW_CHECK(hw_disconnect_proxy(device->guider));
	}
	HW_CHECK(hw_disconnect_proxy(device->proxy));
	HW_CHECK(hw_alpaca_disconnected(device));
cleanup:
	return;
}

// ---------------------------------------------------------------------------- telescope

static double hw_hours(double hours) {
	hours = fmod(hours, 24);
	return hours < 0 ? hours + 24 : hours;
}

static double hw_angle(double angle) {
	angle = fmod(angle, 360);
	return angle < 0 ? angle + 360 : angle;
}

static double hw_angle_difference(double a, double b) {
	double difference = hw_angle(a - b);
	return difference > 180 ? difference - 360 : difference;
}

static double hw_ra_difference(double a, double b) {
	double difference = hw_hours(a - b);
	return difference > 12 ? difference - 24 : difference;
}

// Angle between two positions in degrees, right ascensions in hours.
static double hw_separation(double ra1, double dec1, double ra2, double dec2) {
	double r = M_PI / 180;
	double cosine = sin(dec1 * r) * sin(dec2 * r) + cos(dec1 * r) * cos(dec2 * r) * cos((ra1 - ra2) * 15 * r);
	return acos(fmax(-1, fmin(1, cosine))) / r;
}

static double hw_altitude(double hour_angle, double dec, double latitude) {
	double r = M_PI / 180;
	return asin(sin(latitude * r) * sin(dec * r) + cos(latitude * r) * cos(dec * r) * cos(hour_angle * 15 * r)) / r;
}

static double hw_lst(hw_device *device) {
	return sa_number(device->proxy, MOUNT_LST_TIME_PROPERTY_NAME, MOUNT_LST_TIME_ITEM_NAME);
}

static double hw_latitude(hw_device *device) {
	return sa_number(device->proxy, GEOGRAPHIC_COORDINATES_PROPERTY_NAME, GEOGRAPHIC_COORDINATES_LATITUDE_ITEM_NAME);
}

// J2000 coordinates (for the bus) of a target at the given hour angle whose altitude is close to 50 degrees, with |dec| <= 80.
static void hw_mount_target(hw_device *device, double hour_angle, double *ra, double *dec) {
	double latitude = hw_latitude(device);
	double best = 0, best_error = 1000;
	for (double candidate = -80; candidate <= 80; candidate += 1) {
		double error = fabs(hw_altitude(hour_angle, candidate, latitude) - 50);
		if (error < best_error) {
			best_error = error;
			best = candidate;
		}
	}
	*ra = hw_hours(hw_lst(device) - hour_angle);
	*dec = best;
	indigo_jnow_to_j2k(ra, dec);
	*ra = hw_hours(*ra);
}

// J2000 coordinates converted to the equatorial system of the telescope (MOUNT_EPOCH: 0 is the equinox of date).
static void hw_mount_to_telescope(hw_device *device, double *ra, double *dec) {
	double epoch = sa_number(device->proxy, MOUNT_EPOCH_PROPERTY_NAME, MOUNT_EPOCH_ITEM_NAME);
	if (epoch == 0) {
		indigo_j2k_to_jnow(ra, dec);
	} else if (epoch != 2000) {
		indigo_j2k_to_eq(epoch, ra, dec);
	}
	*ra = hw_hours(*ra);
}

static void hw_mount_from_telescope(hw_device *device, double *ra, double *dec) {
	double epoch = sa_number(device->proxy, MOUNT_EPOCH_PROPERTY_NAME, MOUNT_EPOCH_ITEM_NAME);
	if (epoch == 0) {
		indigo_jnow_to_j2k(ra, dec);
	} else if (epoch != 2000) {
		indigo_eq_to_j2k(epoch, ra, dec);
	}
	*ra = hw_hours(*ra);
}

static bool hw_mount_parked(hw_device *device) {
	return sa_switch(device->proxy, MOUNT_PARK_PROPERTY_NAME, MOUNT_PARK_PARKED_ITEM_NAME);
}

static bool hw_mount_park(hw_device *device, bool parked) {
	int mark = sa_message_mark();
	int state = hw_set_switch(device->proxy, MOUNT_PARK_PROPERTY_NAME, parked ? MOUNT_PARK_PARKED_ITEM_NAME : MOUNT_PARK_UNPARKED_ITEM_NAME, true, HW_MOTION);
	if (state != INDIGO_OK_STATE || !SA_WAIT(hw_bool(device, "atpark") == parked, HW_ANSWER)) {
		fprintf(stderr, "    %s ended in state %d, AtPark %d\n", parked ? "park" : "unpark", state, hw_bool(device, "atpark"));
		hw_print_messages(mark);
		return false;
	}
	printf("    %s: AtPark %d\n", parked ? "parked" : "unparked", parked);
	return true;
}

// Unpark a parked telescope; true when it is unparked.
static bool hw_mount_unparked(hw_device *device) {
	if (!hw_mount_parked(device) && !hw_bool(device, "atpark")) {
		return true;
	}
	return device->mount.can_unpark && hw_mount_park(device, false);
}

// Where the telescope points, in J2000, read directly.
static bool hw_mount_position(hw_device *device, double *ra, double *dec) {
	if (!hw_read_double(device, "rightascension", ra) || !hw_read_double(device, "declination", dec)) {
		return false;
	}
	hw_mount_from_telescope(device, ra, dec);
	return true;
}

// The telescope arrived at the J2000 target: the proxy publishes it and the telescope reports it in its own system.
static bool hw_mount_at(hw_device *device, double ra, double dec) {
	double expected_ra = ra, expected_dec = dec, telescope_ra = NAN, telescope_dec = NAN;
	hw_mount_to_telescope(device, &expected_ra, &expected_dec);
	bool published = SA_WAIT(hw_separation(sa_number(device->proxy, MOUNT_EQUATORIAL_COORDINATES_PROPERTY_NAME, MOUNT_EQUATORIAL_COORDINATES_RA_ITEM_NAME), sa_number(device->proxy, MOUNT_EQUATORIAL_COORDINATES_PROPERTY_NAME, MOUNT_EQUATORIAL_COORDINATES_DEC_ITEM_NAME), ra, dec) < HW_SLEW_TOLERANCE, HW_ANSWER);
	bool reported = hw_read_double(device, "rightascension", &telescope_ra) && hw_read_double(device, "declination", &telescope_dec) && hw_separation(telescope_ra, telescope_dec, expected_ra, expected_dec) < HW_SLEW_TOLERANCE;
	printf("    target J2000 %.4f h %.3f deg, published %.4f h %.3f deg, telescope %.4f h %.3f deg (expected %.4f h %.3f deg in its system), slewing %d\n", ra, dec, sa_number(device->proxy, MOUNT_EQUATORIAL_COORDINATES_PROPERTY_NAME, MOUNT_EQUATORIAL_COORDINATES_RA_ITEM_NAME), sa_number(device->proxy, MOUNT_EQUATORIAL_COORDINATES_PROPERTY_NAME, MOUNT_EQUATORIAL_COORDINATES_DEC_ITEM_NAME), telescope_ra, telescope_dec, expected_ra, expected_dec, hw_bool(device, "slewing"));
	return published && reported;
}

// A goto through MOUNT_EQUATORIAL_COORDINATES; true when the telescope arrived at the target.
static bool hw_mount_goto(hw_device *device, double ra, double dec) {
	static const char *items[] = { MOUNT_EQUATORIAL_COORDINATES_RA_ITEM_NAME, MOUNT_EQUATORIAL_COORDINATES_DEC_ITEM_NAME };
	const double values[] = { ra, dec };
	int mark = sa_message_mark();
	unsigned revision = sa_revision(device->proxy, MOUNT_EQUATORIAL_COORDINATES_PROPERTY_NAME);
	if (strcmp(hw_selected(device->proxy, MOUNT_ON_COORDINATES_SET_PROPERTY_NAME), MOUNT_ON_COORDINATES_SET_TRACK_ITEM_NAME) && hw_set_switch(device->proxy, MOUNT_ON_COORDINATES_SET_PROPERTY_NAME, MOUNT_ON_COORDINATES_SET_TRACK_ITEM_NAME, true, HW_ANSWER) != INDIGO_OK_STATE) {
		return false;
	}
	double started = indigo_monotonic_time();
	int state = hw_set_numbers(device->proxy, MOUNT_EQUATORIAL_COORDINATES_PROPERTY_NAME, 2, items, values, HW_MOTION);
	printf("    goto %.4f h %.3f deg (altitude %.1f deg) ended in state %d after %.1f s\n", ra, dec, hw_altitude(hw_ra_difference(hw_lst(device), ra), dec, hw_latitude(device)), state, indigo_monotonic_time() - started);
	if (state != INDIGO_OK_STATE || !sa_state_after(device->proxy, MOUNT_EQUATORIAL_COORDINATES_PROPERTY_NAME, INDIGO_BUSY_STATE, revision)) {
		hw_print_messages(mark);
		return false;
	}
	return hw_mount_at(device, ra, dec);
}

static const char *hw_side_name(int side) {
	return side == 0 ? "pierEast" : side == 1 ? "pierWest" : "pierUnknown";
}

// MOUNT_SIDE_OF_PIER shows SideOfPier of the telescope.
static bool hw_mount_side_matches(hw_device *device) {
	int side = hw_int(device, "sideofpier");
	bool matches = SA_WAIT((side = hw_int(device, "sideofpier")) == 0 ? sa_switch(device->proxy, MOUNT_SIDE_OF_PIER_PROPERTY_NAME, MOUNT_SIDE_OF_PIER_EAST_ITEM_NAME) : side == 1 ? sa_switch(device->proxy, MOUNT_SIDE_OF_PIER_PROPERTY_NAME, MOUNT_SIDE_OF_PIER_WEST_ITEM_NAME) : !sa_switch(device->proxy, MOUNT_SIDE_OF_PIER_PROPERTY_NAME, MOUNT_SIDE_OF_PIER_EAST_ITEM_NAME) && !sa_switch(device->proxy, MOUNT_SIDE_OF_PIER_PROPERTY_NAME, MOUNT_SIDE_OF_PIER_WEST_ITEM_NAME), HW_ANSWER);
	printf("    SideOfPier %s, MOUNT_SIDE_OF_PIER EAST %d WEST %d\n", hw_side_name(side), sa_switch(device->proxy, MOUNT_SIDE_OF_PIER_PROPERTY_NAME, MOUNT_SIDE_OF_PIER_EAST_ITEM_NAME), sa_switch(device->proxy, MOUNT_SIDE_OF_PIER_PROPERTY_NAME, MOUNT_SIDE_OF_PIER_WEST_ITEM_NAME));
	return matches;
}

static void hw_mount_site_time(hw_device *device) {
	hw_mount *mount = &device->mount;
	char utc[INDIGO_VALUE_SIZE] = { 0 };
	double lst = NAN;
	// the site the telescope reports
	if (mount->has_site) {
		double longitude = mount->longitude < 0 ? mount->longitude + 360 : mount->longitude;
		printf("    site %.6f N, %.6f E, %.1f m\n", mount->latitude, mount->longitude, mount->elevation);
		HW_CHECK(SA_WAIT(fabs(hw_latitude(device) - mount->latitude) < 1e-6 && fabs(sa_number(device->proxy, GEOGRAPHIC_COORDINATES_PROPERTY_NAME, GEOGRAPHIC_COORDINATES_LONGITUDE_ITEM_NAME) - longitude) < 1e-6 && fabs(sa_number(device->proxy, GEOGRAPHIC_COORDINATES_PROPERTY_NAME, GEOGRAPHIC_COORDINATES_ELEVATION_ITEM_NAME) - mount->elevation) < 1e-3, HW_ANSWER));
		HW_CHECK(mount->latitude != 0 || mount->longitude != 0);
		// a new site is written to the telescope, then the original one again
		static const char *items[] = { GEOGRAPHIC_COORDINATES_LATITUDE_ITEM_NAME, GEOGRAPHIC_COORDINATES_LONGITUDE_ITEM_NAME, GEOGRAPHIC_COORDINATES_ELEVATION_ITEM_NAME };
		const double changed[] = { mount->latitude + (mount->latitude > 0 ? -0.1 : 0.1), fmod(longitude + 0.1, 360), mount->elevation + 10 };
		const double original[] = { mount->latitude, longitude, mount->elevation };
		HW_CHECK(hw_set_numbers(device->proxy, GEOGRAPHIC_COORDINATES_PROPERTY_NAME, 3, items, changed, HW_ANSWER) == INDIGO_OK_STATE);
		printf("    site written: telescope reports %.6f, %.6f, %.1f\n", hw_double(device, "sitelatitude"), hw_double(device, "sitelongitude"), hw_double(device, "siteelevation"));
		bool written = fabs(hw_double(device, "sitelatitude") - changed[0]) < 1e-3 && fabs(hw_angle_difference(hw_double(device, "sitelongitude"), changed[1])) < 1e-3 && fabs(hw_double(device, "siteelevation") - changed[2]) < 0.5;
		HW_CHECK(hw_set_numbers(device->proxy, GEOGRAPHIC_COORDINATES_PROPERTY_NAME, 3, items, original, HW_ANSWER) == INDIGO_OK_STATE);
		printf("    site restored: telescope reports %.6f, %.6f, %.1f\n", hw_double(device, "sitelatitude"), hw_double(device, "sitelongitude"), hw_double(device, "siteelevation"));
		HW_CHECK(fabs(hw_double(device, "sitelatitude") - mount->latitude) < 1e-4 && fabs(hw_double(device, "sitelongitude") - mount->longitude) < 1e-4 && fabs(hw_double(device, "siteelevation") - mount->elevation) < 0.5);
		HW_CHECK(written);
	} else {
		printf("    the telescope reports no site (SiteLatitude / SiteLongitude not implemented): GEOGRAPHIC_COORDINATES is an INDIGO setting\n");
	}
	// LST: the SiderealTime of the telescope, and what the site and the clock of this machine give
	HW_CHECK(hw_read_double(device, "siderealtime", &lst) || true);
	if (!isnan(lst)) {
		time_t now = time(NULL);
		double computed = indigo_lst(&now, sa_number(device->proxy, GEOGRAPHIC_COORDINATES_PROPERTY_NAME, GEOGRAPHIC_COORDINATES_LONGITUDE_ITEM_NAME));
		printf("    LST: telescope %.5f h, MOUNT_LST_TIME %.5f h, from the clock of this machine %.5f h\n", lst, hw_lst(device), computed);
		HW_CHECK(SA_WAIT(fabs(hw_ra_difference(hw_lst(device), hw_double(device, "siderealtime"))) < 0.01, HW_ANSWER));
		HW_CHECK(fabs(hw_ra_difference(lst, computed)) < 0.05);
	}
	// UTC
	if (hw_read_string(device, "utcdate", utc, sizeof(utc))) {
		struct tm tm = { 0 };
		HW_CHECK(sa_defined(device->proxy, UTC_TIME_PROPERTY_NAME));
		printf("    UTCDate '%s', UTC_TIME '%s'\n", utc, sa_text(device->proxy, UTC_TIME_PROPERTY_NAME, UTC_TIME_ITEM_NAME));
		HW_CHECK(strptime(utc, "%Y-%m-%dT%H:%M:%S", &tm) != NULL);
		double offset = difftime(timegm(&tm), time(NULL));
		printf("    the clock of the telescope is %+.0f s off the clock of this machine\n", offset);
		HW_CHECK(SA_WAIT(!strncmp(sa_text(device->proxy, UTC_TIME_PROPERTY_NAME, UTC_TIME_ITEM_NAME), utc, 13), HW_ANSWER));
		if (sa_defined(device->proxy, MOUNT_SET_HOST_TIME_PROPERTY_NAME)) {
			// the correct time is written; there is nothing to restore
			HW_CHECK(hw_set_switch(device->proxy, MOUNT_SET_HOST_TIME_PROPERTY_NAME, MOUNT_SET_HOST_TIME_ITEM_NAME, true, HW_ANSWER) == INDIGO_OK_STATE);
			HW_CHECK(hw_read_string(device, "utcdate", utc, sizeof(utc)) && strptime(utc, "%Y-%m-%dT%H:%M:%S", &tm) != NULL);
			offset = difftime(timegm(&tm), time(NULL));
			printf("    after MOUNT_SET_HOST_TIME the clock of the telescope is %+.0f s off\n", offset);
			HW_CHECK(fabs(offset) <= 5);
		}
	} else {
		printf("    the telescope does not report UTCDate\n");
	}
cleanup:
	return;
}

// REFACTOR.md 7.10: a telescope that is parked gets the unpark and the goto in a row, as the mount agent sends them; the goto waits
// for the unpark and the telescope arrives at the target on the first slew.
static void hw_mount_first_slew_from_park(hw_device *device) {
	static const char *items[] = { MOUNT_EQUATORIAL_COORDINATES_RA_ITEM_NAME, MOUNT_EQUATORIAL_COORDINATES_DEC_ITEM_NAME };
	double values[2];
	int mark = sa_message_mark();
	if (!hw_mount_parked(device)) {
		HW_CHECK(hw_mount_park(device, true));
	}
	HW_CHECK(hw_bool(device, "atpark"));
	if (strcmp(hw_selected(device->proxy, MOUNT_ON_COORDINATES_SET_PROPERTY_NAME), MOUNT_ON_COORDINATES_SET_TRACK_ITEM_NAME)) {
		HW_CHECK(hw_set_switch(device->proxy, MOUNT_ON_COORDINATES_SET_PROPERTY_NAME, MOUNT_ON_COORDINATES_SET_TRACK_ITEM_NAME, true, HW_ANSWER) == INDIGO_OK_STATE);
	}
	hw_mount_target(device, -1.5, values, values + 1);
	unsigned park_revision = sa_revision(device->proxy, MOUNT_PARK_PROPERTY_NAME);
	unsigned revision = sa_revision(device->proxy, MOUNT_EQUATORIAL_COORDINATES_PROPERTY_NAME);
	HW_CHECK(indigo_change_switch_property_1(&sa_client, device->proxy, MOUNT_PARK_PROPERTY_NAME, MOUNT_PARK_UNPARKED_ITEM_NAME, true) == INDIGO_OK);
	HW_CHECK(indigo_change_number_property(&sa_client, device->proxy, MOUNT_EQUATORIAL_COORDINATES_PROPERTY_NAME, 2, items, values) == INDIGO_OK);
	HW_CHECK(hw_answer(device->proxy, MOUNT_PARK_PROPERTY_NAME, park_revision, HW_MOTION) == INDIGO_OK_STATE);
	HW_CHECK(SA_WAIT(sa_state_after(device->proxy, MOUNT_EQUATORIAL_COORDINATES_PROPERTY_NAME, INDIGO_BUSY_STATE, revision) && sa_state(device->proxy, MOUNT_EQUATORIAL_COORDINATES_PROPERTY_NAME) != INDIGO_BUSY_STATE, HW_MOTION));
	printf("    unpark and goto in a row: MOUNT_PARK %d, MOUNT_EQUATORIAL_COORDINATES %d\n", sa_state(device->proxy, MOUNT_PARK_PROPERTY_NAME), sa_state(device->proxy, MOUNT_EQUATORIAL_COORDINATES_PROPERTY_NAME));
	HW_CHECK(sa_state(device->proxy, MOUNT_EQUATORIAL_COORDINATES_PROPERTY_NAME) == INDIGO_OK_STATE);
	HW_CHECK(!hw_bool(device, "atpark"));
	HW_CHECK(hw_mount_at(device, values[0], values[1]));
cleanup:
	if (indigo_test_failures) {
		hw_print_messages(mark);
	}
	return;
}

static void hw_mount_tracking(hw_device *device) {
	HW_CHECK(hw_mount_unparked(device));
	bool tracking = hw_bool(device, "tracking");
	for (int i = 0; i < 2; i++) {
		tracking = !tracking;
		HW_CHECK(hw_set_switch(device->proxy, MOUNT_TRACKING_PROPERTY_NAME, tracking ? MOUNT_TRACKING_ON_ITEM_NAME : MOUNT_TRACKING_OFF_ITEM_NAME, true, HW_ANSWER) == INDIGO_OK_STATE);
		HW_CHECK(SA_WAIT(hw_bool(device, "tracking") == tracking, HW_ANSWER));
		printf("    tracking %s: Tracking %d\n", tracking ? "on" : "off", tracking);
	}
cleanup:
	return;
}

static const char *hw_track_rate_item(int rate) {
	switch (rate) {
		case 0:
			return MOUNT_TRACK_RATE_SIDEREAL_ITEM_NAME;
		case 1:
			return MOUNT_TRACK_RATE_LUNAR_ITEM_NAME;
		case 2:
			return MOUNT_TRACK_RATE_SOLAR_ITEM_NAME;
		case 3:
			return MOUNT_TRACK_RATE_KING_ITEM_NAME;
		default:
			return "";
	}
}

static void hw_mount_tracking_rates(hw_device *device) {
	int error_number = -1, count = 0;
	int rates[8];
	const alpaca_json_value *json = hw_get(device, "trackingrates", NULL, &error_number);
	for (const alpaca_json_value *entry = error_number == 0 && json != NULL ? alpaca_json_first(json) : NULL; entry != NULL && count < 8; entry = alpaca_json_next(entry)) {
		int64_t rate = 0;
		if (alpaca_json_get_int(entry, &rate)) {
			rates[count++] = (int)rate;
		}
	}
	HW_CHECK(count > 0);
	for (int i = 0; i < count; i++) {
		HW_CHECK(sa_has_item(device->proxy, MOUNT_TRACK_RATE_PROPERTY_NAME, hw_track_rate_item(rates[i])));
	}
	HW_CHECK(SA_WAIT(sa_switch(device->proxy, MOUNT_TRACK_RATE_PROPERTY_NAME, hw_track_rate_item(hw_int(device, "trackingrate"))), HW_ANSWER));
	for (int i = 0; i < count; i++) {
		HW_CHECK(hw_set_switch(device->proxy, MOUNT_TRACK_RATE_PROPERTY_NAME, hw_track_rate_item(rates[i]), true, HW_ANSWER) == INDIGO_OK_STATE);
		HW_CHECK(SA_WAIT(hw_int(device, "trackingrate") == rates[i], HW_ANSWER));
		printf("    %s: TrackingRate %d\n", hw_track_rate_item(rates[i]), rates[i]);
	}
	HW_CHECK(hw_set_switch(device->proxy, MOUNT_TRACK_RATE_PROPERTY_NAME, hw_track_rate_item(device->mount.found_track_rate), true, HW_ANSWER) == INDIGO_OK_STATE);
	HW_CHECK(SA_WAIT(hw_int(device, "trackingrate") == device->mount.found_track_rate, HW_ANSWER));
cleanup:
	return;
}

static void hw_mount_guide_rates(hw_device *device) {
	hw_mount *mount = &device->mount;
	double ra_percent = mount->found_guide_ra / HW_SIDEREAL * 100, dec_percent = mount->found_guide_dec / HW_SIDEREAL * 100;
	printf("    GuideRateRightAscension %.6f, GuideRateDeclination %.6f deg/s (%.1f %%, %.1f %%), MOUNT_GUIDE_RATE %.1f %%, %.1f %%\n", mount->found_guide_ra, mount->found_guide_dec, ra_percent, dec_percent, sa_number(device->proxy, MOUNT_GUIDE_RATE_PROPERTY_NAME, MOUNT_GUIDE_RATE_RA_ITEM_NAME), sa_number(device->proxy, MOUNT_GUIDE_RATE_PROPERTY_NAME, MOUNT_GUIDE_RATE_DEC_ITEM_NAME));
	HW_CHECK(fabs(sa_number(device->proxy, MOUNT_GUIDE_RATE_PROPERTY_NAME, MOUNT_GUIDE_RATE_RA_ITEM_NAME) - ra_percent) < 1 && fabs(sa_number(device->proxy, MOUNT_GUIDE_RATE_PROPERTY_NAME, MOUNT_GUIDE_RATE_DEC_ITEM_NAME) - dec_percent) < 1);
	if (mount->can_set_guide_rates) {
		static const char *items[] = { MOUNT_GUIDE_RATE_RA_ITEM_NAME, MOUNT_GUIDE_RATE_DEC_ITEM_NAME };
		const double changed[] = { 50, 75 };
		const double original[] = { ra_percent, dec_percent };
		int mark = sa_message_mark();
		int state = hw_set_numbers(device->proxy, MOUNT_GUIDE_RATE_PROPERTY_NAME, 2, items, changed, HW_ANSWER);
		double ra = hw_double(device, "guideraterightascension"), dec = hw_double(device, "guideratedeclination");
		bool not_implemented = sa_message_seen_since(mark, "not implemented") || sa_message_seen_since(mark, "\"ErrorNumber\":1024");
		if (state == INDIGO_ALERT_STATE && not_implemented && fabs(ra - mount->found_guide_ra) < 1e-7 && fabs(dec - mount->found_guide_dec) < 1e-7) {
			// the NYX-101 (firmware 1.32.1) reports CanSetGuideRates true and answers GuideRateRightAscension with HTTP 400 and ErrorNumber
			// 0x400 (NotImplemented): the proxy reports it with the reason and the rates are unchanged, which is all a client can get from it
			hw_print_messages(mark);
			printf("    the telescope reports CanSetGuideRates true but answers NotImplemented to the setter; the rates are unchanged\n");
			HW_CHECK(SA_WAIT(fabs(sa_number(device->proxy, MOUNT_GUIDE_RATE_PROPERTY_NAME, MOUNT_GUIDE_RATE_RA_ITEM_NAME) - ra_percent) < 1, HW_ANSWER));
			return;
		}
		if (state != INDIGO_OK_STATE) {
			hw_print_messages(mark);
		}
		HW_CHECK(state == INDIGO_OK_STATE);
		printf("    set to 50 %%, 75 %%: the telescope reports %.6f, %.6f deg/s (%.1f %%, %.1f %%)\n", ra, dec, ra / HW_SIDEREAL * 100, dec / HW_SIDEREAL * 100);
		bool written = fabs(ra / HW_SIDEREAL * 100 - 50) < 5 && fabs(dec / HW_SIDEREAL * 100 - 75) < 5;
		HW_CHECK(hw_set_numbers(device->proxy, MOUNT_GUIDE_RATE_PROPERTY_NAME, 2, items, original, HW_ANSWER) == INDIGO_OK_STATE);
		HW_CHECK(fabs(hw_double(device, "guideraterightascension") - mount->found_guide_ra) < 1e-5 && fabs(hw_double(device, "guideratedeclination") - mount->found_guide_dec) < 1e-5);
		HW_CHECK(written);
	} else {
		printf("    CanSetGuideRates is false: readback only\n");
	}
cleanup:
	return;
}

// Two slews, east and west of the meridian, each verified on arrival.
static void hw_mount_slew(hw_device *device) {
	double ra, dec;
	HW_CHECK(hw_mount_unparked(device));
	hw_mount_target(device, -1.5, &ra, &dec);
	HW_CHECK(hw_mount_goto(device, ra, dec));
	if (device->mount.has_side) {
		HW_CHECK(hw_mount_side_matches(device));
	}
	hw_mount_target(device, 1.5, &ra, &dec);
	HW_CHECK(hw_mount_goto(device, ra, dec));
	if (device->mount.has_side) {
		HW_CHECK(hw_mount_side_matches(device));
	}
cleanup:
	return;
}

static void hw_mount_side_of_pier(hw_device *device) {
	double ra, dec;
	int sides[2] = { -1, -1 };
	HW_CHECK(hw_mount_unparked(device));
	for (int i = 0; i < 2; i++) {
		hw_mount_target(device, i == 0 ? -2.5 : 2.5, &ra, &dec);
		HW_CHECK(hw_mount_goto(device, ra, dec));
		HW_CHECK(hw_mount_side_matches(device));
		sides[i] = hw_int(device, "sideofpier");
	}
	printf("    2.5 h east of the meridian %s, 2.5 h west of it %s\n", hw_side_name(sides[0]), hw_side_name(sides[1]));
cleanup:
	return;
}

static void hw_mount_abort(hw_device *device) {
	static const char *items[] = { MOUNT_EQUATORIAL_COORDINATES_RA_ITEM_NAME, MOUNT_EQUATORIAL_COORDINATES_DEC_ITEM_NAME };
	double values[2], ra, dec;
	HW_CHECK(hw_mount_unparked(device));
	// from where the telescope is to 4 hours of hour angle away on the other side of the meridian
	double hour_angle = hw_ra_difference(hw_lst(device), sa_number(device->proxy, MOUNT_EQUATORIAL_COORDINATES_PROPERTY_NAME, MOUNT_EQUATORIAL_COORDINATES_RA_ITEM_NAME));
	hw_mount_target(device, hour_angle > 0 ? -2.5 : 2.5, values, values + 1);
	unsigned revision = sa_revision(device->proxy, MOUNT_EQUATORIAL_COORDINATES_PROPERTY_NAME);
	HW_CHECK(indigo_change_number_property(&sa_client, device->proxy, MOUNT_EQUATORIAL_COORDINATES_PROPERTY_NAME, 2, items, values) == INDIGO_OK);
	HW_CHECK(SA_WAIT(hw_bool(device, "slewing"), HW_ANSWER));
	double started = indigo_monotonic_time();
	HW_CHECK(hw_set_switch(device->proxy, MOUNT_ABORT_MOTION_PROPERTY_NAME, MOUNT_ABORT_MOTION_ITEM_NAME, true, HW_ANSWER) == INDIGO_OK_STATE);
	HW_CHECK(SA_WAIT(sa_state(device->proxy, MOUNT_EQUATORIAL_COORDINATES_PROPERTY_NAME) != INDIGO_BUSY_STATE, HW_MOTION));
	HW_CHECK(SA_WAIT(!hw_bool(device, "slewing"), HW_ANSWER));
	printf("    AbortSlew: the telescope stopped %.1f s after the request, MOUNT_EQUATORIAL_COORDINATES state %d\n", indigo_monotonic_time() - started, sa_state(device->proxy, MOUNT_EQUATORIAL_COORDINATES_PROPERTY_NAME));
	HW_CHECK(sa_state_after(device->proxy, MOUNT_EQUATORIAL_COORDINATES_PROPERTY_NAME, INDIGO_ALERT_STATE, revision));
	HW_CHECK(hw_mount_position(device, &ra, &dec));
	printf("    stopped %.2f deg from the target\n", hw_separation(ra, dec, values[0], values[1]));
	HW_CHECK(hw_separation(ra, dec, values[0], values[1]) > 1);
	// the telescope takes the next goto
	HW_CHECK(hw_mount_goto(device, values[0], values[1]));
cleanup:
	return;
}

// Manual motion of one axis in one direction for a few seconds at the centering rate; *change is the change of the coordinate of the
// telescope, the declination in degrees or the right ascension in hours.
static bool hw_mount_motion(hw_device *device, const char *property, const char *item, const char *member, double *change) {
	double before = hw_double(device, member);
	int mark = sa_message_mark();
	bool moved = false;
	for (int attempt = 0; attempt < 2 && !moved; attempt++) {
		if (indigo_change_switch_property_1(&sa_client, device->proxy, property, item, true) != INDIGO_OK || !SA_WAIT(sa_switch(device->proxy, property, item) && sa_state(device->proxy, property) != INDIGO_ALERT_STATE, HW_ANSWER)) {
			fprintf(stderr, "    %s.%s did not start, state %d\n", property, item, sa_state(device->proxy, property));
			hw_print_messages(mark);
			return false;
		}
		// the telescope reports Slewing while an axis moves; the NYX-101 sometimes ignores a MoveAxis that comes right after a slew
		moved = SA_WAIT(hw_bool(device, "slewing"), 3);
		if (!moved) {
			printf("    %s.%s: the telescope accepted MoveAxis but does not move (Slewing false); the request is repeated once\n", property, item);
			if (hw_set_switch(device->proxy, property, item, false, HW_ANSWER) != INDIGO_OK_STATE) {
				return false;
			}
		}
	}
	SA_WAIT(false, 3);
	if (hw_set_switch(device->proxy, property, item, false, HW_ANSWER) != INDIGO_OK_STATE || !SA_WAIT(!hw_bool(device, "slewing"), HW_ANSWER)) {
		fprintf(stderr, "    %s.%s did not stop, state %d\n", property, item, sa_state(device->proxy, property));
		hw_print_messages(mark);
		return false;
	}
	double after = hw_double(device, member);
	*change = !strcmp(member, "rightascension") ? hw_ra_difference(after, before) : after - before;
	printf("    %s.%s on %s: %s %.5f -> %.5f\n", property, item, hw_side_name(hw_int(device, "sideofpier")), member, before, after);
	return !isnan(*change);
}

// Select the centering rate for manual motion; the rate that was selected is restored by the restore case.
static bool hw_mount_centering_rate(hw_device *device) {
	if (!sa_defined(device->proxy, MOUNT_SLEW_RATE_PROPERTY_NAME)) {
		return true;
	}
	return hw_set_switch(device->proxy, MOUNT_SLEW_RATE_PROPERTY_NAME, MOUNT_SLEW_RATE_CENTERING_ITEM_NAME, true, HW_ANSWER) == INDIGO_OK_STATE;
}

// MOUNT_MOTION_DEC: NORTH always raises the declination, SOUTH lowers it, on both sides of the pier (D13).
static void hw_mount_motion_dec(hw_device *device) {
	double ra, dec, change = 0;
	HW_CHECK(sa_defined(device->proxy, MOUNT_MOTION_DEC_PROPERTY_NAME));
	HW_CHECK(hw_mount_unparked(device));
	HW_CHECK(hw_mount_centering_rate(device));
	for (int i = 0; i < 2; i++) {
		hw_mount_target(device, i == 0 ? -1.5 : 1.5, &ra, &dec);
		HW_CHECK(hw_mount_goto(device, ra, dec));
		HW_CHECK(hw_mount_motion(device, MOUNT_MOTION_DEC_PROPERTY_NAME, MOUNT_MOTION_NORTH_ITEM_NAME, "declination", &change));
		HW_CHECK(change > 0.05);
		HW_CHECK(hw_mount_motion(device, MOUNT_MOTION_DEC_PROPERTY_NAME, MOUNT_MOTION_SOUTH_ITEM_NAME, "declination", &change));
		HW_CHECK(change < -0.05);
	}
cleanup:
	return;
}

// MOUNT_MOTION_RA: WEST makes the right ascension fall (the hour angle grows), EAST makes it rise.
// The axis convention of MoveAxis (X_ALPACA_MOUNT_AXES) is found out, not assumed: a short NORTH and WEST motion with MECHANICAL (the
// default) and, if the telescope moved the wrong way, with SKY. The setting under which NORTH raises the declination and WEST lowers the
// right ascension (raises the hour angle) is kept for the manual motion cases, which check it on both sides of the pier; the case fails
// when neither works.
static bool hw_mount_axes_work(hw_device *device) {
	double north = 0, west = 0;
	if (!hw_mount_motion(device, MOUNT_MOTION_DEC_PROPERTY_NAME, MOUNT_MOTION_NORTH_ITEM_NAME, "declination", &north) || !hw_mount_motion(device, MOUNT_MOTION_RA_PROPERTY_NAME, MOUNT_MOTION_WEST_ITEM_NAME, "rightascension", &west)) {
		return false;
	}
	return north > 0.05 && west < -0.003;
}

static void hw_mount_axes_convention(hw_device *device) {
	static const char *settings[] = { "MECHANICAL", "SKY" };
	double ra, dec;
	const char *found = NULL;
	HW_CHECK(sa_defined(device->proxy, "X_ALPACA_MOUNT_AXES"));
	HW_CHECK(hw_mount_unparked(device));
	HW_CHECK(hw_mount_centering_rate(device));
	hw_mount_target(device, 1.5, &ra, &dec);
	HW_CHECK(hw_mount_goto(device, ra, dec));
	for (int i = 0; i < 2 && found == NULL; i++) {
		HW_CHECK(hw_set_switch(device->proxy, "X_ALPACA_MOUNT_AXES", settings[i], true, HW_ANSWER) == INDIGO_OK_STATE);
		if (hw_mount_axes_work(device)) {
			found = settings[i];
		} else {
			printf("    with X_ALPACA_MOUNT_AXES.%s NORTH or WEST moved the wrong way\n", settings[i]);
		}
	}
	if (found == NULL) {
		fprintf(stderr, "    neither axis convention moves the telescope north and west\n");
		HW_CHECK(false);
	}
	printf("    the telescope needs X_ALPACA_MOUNT_AXES.%s\n", found);
	device->mount.axes = found;
cleanup:
	return;
}

// The pause the telescope needs after a slew before it takes the next motion command (X_ALPACA_SETTLE_TIME) is measured, not assumed:
// with each candidate time, two gotos of 3 degrees right behind each other, twice; the first time under which every second goto moves
// the telescope is kept. A telescope that takes a goto right after a slew keeps 0, the default.
static bool hw_mount_back_to_back(hw_device *device, double ra, double dec) {
	static const char *items[] = { MOUNT_EQUATORIAL_COORDINATES_RA_ITEM_NAME, MOUNT_EQUATORIAL_COORDINATES_DEC_ITEM_NAME };
	double values[] = { ra, dec + 3 };
	double telescope_ra = NAN, telescope_dec = NAN, expected_ra = values[0], expected_dec = values[1];
	// the first goto has to arrive, whatever the setting: it is repeated once after a pause
	if (!hw_mount_goto(device, ra, dec)) {
		SA_WAIT(false, 3);
		if (!hw_mount_goto(device, ra, dec)) {
			return false;
		}
	}
	if (hw_set_numbers(device->proxy, MOUNT_EQUATORIAL_COORDINATES_PROPERTY_NAME, 2, items, values, HW_MOTION) != INDIGO_OK_STATE) {
		return false;
	}
	hw_mount_to_telescope(device, &expected_ra, &expected_dec);
	bool arrived = hw_read_double(device, "rightascension", &telescope_ra) && hw_read_double(device, "declination", &telescope_dec) && hw_separation(telescope_ra, telescope_dec, expected_ra, expected_dec) < HW_SLEW_TOLERANCE;
	printf("    goto right after a slew %s (the telescope is %.2f deg from it)\n", arrived ? "arrived" : "was ignored", hw_separation(telescope_ra, telescope_dec, expected_ra, expected_dec));
	return arrived;
}

static void hw_mount_settle_time(hw_device *device) {
	static const double candidates[] = { 0, 0.5, 1, 2, 3, 5 };
	double ra, dec, found = -1;
	HW_CHECK(sa_defined(device->proxy, "X_ALPACA_SETTLE_TIME"));
	HW_CHECK(hw_mount_unparked(device));
	hw_mount_target(device, -1.5, &ra, &dec);
	for (int i = 0; i < (int)ARRAY_SIZE(candidates) && found < 0; i++) {
		HW_CHECK(hw_set_number(device->proxy, "X_ALPACA_SETTLE_TIME", "TIME", candidates[i], HW_ANSWER) == INDIGO_OK_STATE);
		printf("    X_ALPACA_SETTLE_TIME %.1f s\n", candidates[i]);
		if (hw_mount_back_to_back(device, ra, dec) && hw_mount_back_to_back(device, ra, dec)) {
			found = candidates[i];
		}
	}
	if (found < 0) {
		fprintf(stderr, "    the telescope ignores a goto right after a slew even with a pause of %.0f s\n", candidates[ARRAY_SIZE(candidates) - 1]);
		HW_CHECK(false);
	}
	printf("    the telescope needs X_ALPACA_SETTLE_TIME %.1f s\n", found);
	device->mount.settle = found;
cleanup:
	return;
}

static void hw_mount_motion_ra(hw_device *device) {
	double change = 0;
	HW_CHECK(sa_defined(device->proxy, MOUNT_MOTION_RA_PROPERTY_NAME));
	HW_CHECK(hw_mount_unparked(device));
	HW_CHECK(hw_mount_centering_rate(device));
	HW_CHECK(hw_mount_motion(device, MOUNT_MOTION_RA_PROPERTY_NAME, MOUNT_MOTION_WEST_ITEM_NAME, "rightascension", &change));
	HW_CHECK(change < -0.003);
	HW_CHECK(hw_mount_motion(device, MOUNT_MOTION_RA_PROPERTY_NAME, MOUNT_MOTION_EAST_ITEM_NAME, "rightascension", &change));
	HW_CHECK(change > 0.003);
cleanup:
	return;
}

// One guide pulse through the guider device; the time from the request to the published end is checked against the duration.
static bool hw_guide_pulse(hw_device *device, const char *property, const char *item, double milliseconds, bool watch) {
	int mark = sa_message_mark();
	unsigned revision = sa_revision(device->guider, property);
	double started = indigo_monotonic_time();
	bool seen = false;
	if (indigo_change_number_property_1(&sa_client, device->guider, property, item, milliseconds) != INDIGO_OK) {
		return false;
	}
	if (watch) {
		seen = SA_WAIT(hw_bool(device, "ispulseguiding"), milliseconds / 1000);
	}
	if (!SA_WAIT(sa_state_after(device->guider, property, INDIGO_OK_STATE, revision) && sa_state(device->guider, property) == INDIGO_OK_STATE, milliseconds / 1000 + HW_ANSWER)) {
		fprintf(stderr, "    %s.%s %.0f ms did not end, state %d\n", property, item, milliseconds, sa_state(device->guider, property));
		hw_print_messages(mark);
		return false;
	}
	double elapsed = (indigo_monotonic_time() - started) * 1000;
	printf("    %s %.0f ms: published end after %.0f ms (%+.0f ms)%s\n", item, milliseconds, elapsed, elapsed - milliseconds, watch ? (seen ? ", IsPulseGuiding seen" : ", IsPulseGuiding not seen") : "");
	if (elapsed < milliseconds * 0.9 || elapsed > milliseconds + 5000) {
		fprintf(stderr, "    the pulse of %.0f ms ended after %.0f ms\n", milliseconds, elapsed);
		return false;
	}
	return !watch || seen;
}

static void hw_guide(hw_device *device) {
	HW_CHECK(SA_WAIT(sa_defined(device->guider, CONNECTION_PROPERTY_NAME), HW_ANSWER));
	HW_CHECK(hw_connect_proxy(device->guider));
	HW_CHECK(hw_guide_pulse(device, GUIDER_GUIDE_DEC_PROPERTY_NAME, GUIDER_GUIDE_NORTH_ITEM_NAME, 2000, true));
	HW_CHECK(SA_WAIT(!hw_bool(device, "ispulseguiding"), HW_ANSWER));
	HW_CHECK(hw_guide_pulse(device, GUIDER_GUIDE_DEC_PROPERTY_NAME, GUIDER_GUIDE_SOUTH_ITEM_NAME, 1000, false));
	HW_CHECK(hw_guide_pulse(device, GUIDER_GUIDE_RA_PROPERTY_NAME, GUIDER_GUIDE_EAST_ITEM_NAME, 1000, false));
	HW_CHECK(hw_guide_pulse(device, GUIDER_GUIDE_RA_PROPERTY_NAME, GUIDER_GUIDE_WEST_ITEM_NAME, 1000, false));
	HW_CHECK(hw_guide_pulse(device, GUIDER_GUIDE_RA_PROPERTY_NAME, GUIDER_GUIDE_WEST_ITEM_NAME, 300, false));
	HW_CHECK(SA_WAIT(!hw_bool(device, "ispulseguiding"), HW_ANSWER));
	HW_CHECK(hw_disconnect_proxy(device->guider));
cleanup:
	return;
}

static void hw_mount_pulse_guide(hw_device *device) {
	HW_CHECK(hw_mount_unparked(device));
	if (device->mount.can_set_tracking) {
		HW_CHECK(hw_set_switch(device->proxy, MOUNT_TRACKING_PROPERTY_NAME, MOUNT_TRACKING_ON_ITEM_NAME, true, HW_ANSWER) == INDIGO_OK_STATE);
	}
	double before = hw_double(device, "declination");
	hw_guide(device);
	printf("    declination before and after the pulses %.5f, %.5f\n", before, hw_double(device, "declination"));
cleanup:
	return;
}

// SYNC to a position 0.02 h and 0.2 deg away from where the telescope points, then back to the position read before the sync. The
// telescope tracks meanwhile, so that position is still where it points.
static void hw_mount_sync(hw_device *device) {
	static const char *items[] = { MOUNT_EQUATORIAL_COORDINATES_RA_ITEM_NAME, MOUNT_EQUATORIAL_COORDINATES_DEC_ITEM_NAME };
	double original[2] = { NAN, NAN }, values[2];
	bool synced = false;
	HW_CHECK(hw_mount_unparked(device));
	if (device->mount.can_set_tracking) {
		HW_CHECK(hw_set_switch(device->proxy, MOUNT_TRACKING_PROPERTY_NAME, MOUNT_TRACKING_ON_ITEM_NAME, true, HW_ANSWER) == INDIGO_OK_STATE);
	}
	HW_CHECK(hw_set_switch(device->proxy, MOUNT_ON_COORDINATES_SET_PROPERTY_NAME, MOUNT_ON_COORDINATES_SET_SYNC_ITEM_NAME, true, HW_ANSWER) == INDIGO_OK_STATE);
	HW_CHECK(hw_mount_position(device, original, original + 1));
	values[0] = hw_hours(original[0] + 0.02);
	values[1] = original[1] + (original[1] > 0 ? -0.2 : 0.2);
	synced = true;
	HW_CHECK(hw_set_numbers(device->proxy, MOUNT_EQUATORIAL_COORDINATES_PROPERTY_NAME, 2, items, values, HW_ANSWER) == INDIGO_OK_STATE);
	HW_CHECK(hw_mount_at(device, values[0], values[1]));
	printf("    synced to %.4f h %.3f deg\n", values[0], values[1]);
cleanup:
	if (synced) {
		if (hw_set_numbers(device->proxy, MOUNT_EQUATORIAL_COORDINATES_PROPERTY_NAME, 2, items, original, HW_ANSWER) != INDIGO_OK_STATE || !hw_mount_at(device, original[0], original[1])) {
			fprintf(stderr, "    the sync back to %.4f h %.3f deg failed\n", original[0], original[1]);
			indigo_test_failures++;
		} else {
			printf("    synced back to the position read before the sync, %.4f h %.3f deg\n", original[0], original[1]);
		}
	}
	hw_set_switch(device->proxy, MOUNT_ON_COORDINATES_SET_PROPERTY_NAME, MOUNT_ON_COORDINATES_SET_TRACK_ITEM_NAME, true, HW_ANSWER);
	return;
}

static void hw_mount_find_home(hw_device *device) {
	int mark = sa_message_mark();
	HW_CHECK(hw_mount_unparked(device));
	double started = indigo_monotonic_time();
	int state = hw_set_switch(device->proxy, MOUNT_HOME_PROPERTY_NAME, MOUNT_HOME_ITEM_NAME, true, HW_MOTION);
	printf("    FindHome ended in state %d after %.1f s, AtHome %d\n", state, indigo_monotonic_time() - started, hw_bool(device, "athome"));
	if (state != INDIGO_OK_STATE) {
		hw_print_messages(mark);
	}
	HW_CHECK(state == INDIGO_OK_STATE);
	HW_CHECK(SA_WAIT(hw_bool(device, "athome"), HW_ANSWER));
cleanup:
	return;
}

// Hour angle (h), declination, altitude and azimuth of the telescope, read directly.
static bool hw_mount_pose(hw_device *device, double *hour_angle, double *dec, double *altitude, double *azimuth) {
	double ra = NAN, lst = NAN;
	if (!hw_read_double(device, "rightascension", &ra) || !hw_read_double(device, "declination", dec) || !hw_read_double(device, "siderealtime", &lst)) {
		return false;
	}
	*hour_angle = hw_ra_difference(lst, ra);
	*altitude = hw_double(device, "altitude");
	*azimuth = hw_double(device, "azimuth");
	return true;
}

// MOUNT_PARK_SET at a new position, park there, then the park position of the telescope is set back where it was. The standard has no
// member that reads the park position, so it is put back by going there: a telescope whose park position is its home position (AtHome
// while parked, as on the NYX-101) goes there exactly with FindHome; any other one by a slew to the hour angle and declination it was
// parked at, which reproduces the position as closely as the slew does.
static void hw_mount_set_park(hw_device *device) {
	double park_ha = 0, park_dec = 0, park_alt = 0, park_az = 0, ha = 0, dec = 0, alt = 0, az = 0, ra = 0, target_dec = 0;
	bool changed = false, park_is_home = false;
	HW_CHECK(hw_mount_unparked(device));
	HW_CHECK(hw_mount_park(device, true));
	HW_CHECK(hw_mount_pose(device, &park_ha, &park_dec, &park_alt, &park_az));
	park_is_home = device->mount.can_find_home && hw_bool(device, "athome");
	printf("    park position: hour angle %.4f h, declination %.3f, altitude %.2f, azimuth %.2f%s\n", park_ha, park_dec, park_alt, park_az, park_is_home ? ", the home position (AtHome)" : "");
	HW_CHECK(hw_mount_park(device, false));
	hw_mount_target(device, -1.5, &ra, &target_dec);
	HW_CHECK(hw_mount_goto(device, ra, target_dec));
	HW_CHECK(hw_mount_pose(device, &ha, &dec, &alt, &az));
	HW_CHECK(hw_set_switch(device->proxy, MOUNT_PARK_SET_PROPERTY_NAME, MOUNT_PARK_SET_CURRENT_ITEM_NAME, true, HW_ANSWER) == INDIGO_OK_STATE);
	changed = true;
	printf("    park position set at altitude %.2f, azimuth %.2f\n", alt, az);
	HW_CHECK(hw_mount_goto(device, hw_hours(ra + 1), target_dec));
	HW_CHECK(hw_mount_park(device, true));
	{
		double new_alt = 0, new_az = 0, new_ha = 0, new_dec = 0;
		HW_CHECK(hw_mount_pose(device, &new_ha, &new_dec, &new_alt, &new_az));
		printf("    parked at the new park position: altitude %.2f, azimuth %.2f\n", new_alt, new_az);
		HW_CHECK(fabs(new_alt - alt) < 1 && fabs(hw_angle_difference(new_az, az)) < 2);
	}
	HW_CHECK(hw_mount_park(device, false));
cleanup:
	if (changed) {
		double restored_alt = 0, restored_az = 0, restored_ha = 0, restored_dec = 0;
		bool there = false;
		if (hw_mount_unparked(device)) {
			if (park_is_home) {
				there = hw_set_switch(device->proxy, MOUNT_HOME_PROPERTY_NAME, MOUNT_HOME_ITEM_NAME, true, HW_MOTION) == INDIGO_OK_STATE && SA_WAIT(hw_bool(device, "athome"), HW_ANSWER);
			} else {
				double target_ra = hw_hours(hw_double(device, "siderealtime") - park_ha);
				double restore_dec = park_dec;
				hw_mount_from_telescope(device, &target_ra, &restore_dec);
				there = hw_mount_goto(device, target_ra, fmax(-90, fmin(90, restore_dec)));
			}
		}
		if (!there || hw_set_switch(device->proxy, MOUNT_PARK_SET_PROPERTY_NAME, MOUNT_PARK_SET_CURRENT_ITEM_NAME, true, HW_ANSWER) != INDIGO_OK_STATE || !hw_mount_park(device, true) || !hw_mount_pose(device, &restored_ha, &restored_dec, &restored_alt, &restored_az)) {
			fprintf(stderr, "    the park position could not be set back\n");
			indigo_test_failures++;
		} else {
			printf("    park position set back %s: altitude %.2f, azimuth %.2f (originally %.2f, %.2f)\n", park_is_home ? "at the home position" : "by a slew", restored_alt, restored_az, park_alt, park_az);
			// at the pole the azimuth the telescope reports means nothing (the NYX-101 reported 0 and 102 for the same position)
			if (fabs(restored_alt - park_alt) > 0.2 || (fabs(park_dec) < 89.5 && fabs(hw_angle_difference(restored_az, park_az)) > 0.5)) {
				fprintf(stderr, "    the restored park position is off the original one\n");
				indigo_test_failures++;
			}
		}
	}
	return;
}

static void hw_mount_park_unpark(hw_device *device) {
	static const char *items[] = { MOUNT_EQUATORIAL_COORDINATES_RA_ITEM_NAME, MOUNT_EQUATORIAL_COORDINATES_DEC_ITEM_NAME };
	double values[2];
	HW_CHECK(hw_mount_unparked(device));
	HW_CHECK(hw_mount_park(device, true));
	HW_CHECK(SA_WAIT(hw_mount_parked(device), HW_ANSWER));
	HW_CHECK(SA_WAIT(!hw_bool(device, "tracking") && sa_switch(device->proxy, MOUNT_TRACKING_PROPERTY_NAME, MOUNT_TRACKING_OFF_ITEM_NAME), HW_ANSWER));
	// a goto of a parked telescope is refused without a request to it
	hw_mount_target(device, -1.5, values, values + 1);
	HW_CHECK(hw_set_numbers(device->proxy, MOUNT_EQUATORIAL_COORDINATES_PROPERTY_NAME, 2, items, values, HW_ANSWER) == INDIGO_ALERT_STATE);
	HW_CHECK(hw_bool(device, "atpark") && !hw_bool(device, "slewing"));
	printf("    a goto while parked is refused, the telescope stays parked\n");
	if (device->mount.can_unpark) {
		HW_CHECK(hw_mount_park(device, false));
		HW_CHECK(SA_WAIT(!hw_mount_parked(device), HW_ANSWER));
	}
cleanup:
	return;
}

// Put back what the cases changed: slew rate, tracking rate, tracking, and the parked state the telescope was found in.
static void hw_mount_restore(hw_device *device) {
	hw_mount *mount = &device->mount;
	if (*mount->found_slew_rate) {
		HW_CHECK(hw_set_switch(device->proxy, MOUNT_SLEW_RATE_PROPERTY_NAME, mount->found_slew_rate, true, HW_ANSWER) == INDIGO_OK_STATE);
	}
	if (mount->track_rates > 0 && sa_defined(device->proxy, MOUNT_TRACK_RATE_PROPERTY_NAME) && !sa_switch(device->proxy, MOUNT_TRACK_RATE_PROPERTY_NAME, hw_track_rate_item(mount->found_track_rate))) {
		HW_CHECK(hw_set_switch(device->proxy, MOUNT_TRACK_RATE_PROPERTY_NAME, hw_track_rate_item(mount->found_track_rate), true, HW_ANSWER) == INDIGO_OK_STATE);
	}
	if (mount->found_parked) {
		if (!hw_bool(device, "atpark")) {
			HW_CHECK(hw_mount_park(device, true));
		}
		printf("    parked again, as it was found\n");
	} else {
		if (hw_bool(device, "atpark")) {
			HW_CHECK(hw_mount_park(device, false));
		}
		if (mount->can_set_tracking) {
			HW_CHECK(hw_set_switch(device->proxy, MOUNT_TRACKING_PROPERTY_NAME, mount->found_tracking ? MOUNT_TRACKING_ON_ITEM_NAME : MOUNT_TRACKING_OFF_ITEM_NAME, true, HW_ANSWER) == INDIGO_OK_STATE);
			HW_CHECK(SA_WAIT(hw_bool(device, "tracking") == mount->found_tracking, HW_ANSWER));
		}
		printf("    left unparked with tracking %s, as it was found\n", mount->found_tracking ? "on" : "off");
	}
	HW_CHECK(hw_int(device, "trackingrate") == mount->found_track_rate || mount->track_rates == 0);
cleanup:
	return;
}

static void hw_probe_telescope(hw_device *device) {
	hw_mount *mount = &device->mount;
	mount->can_park = hw_bool(device, "canpark");
	mount->can_unpark = hw_bool(device, "canunpark");
	mount->can_set_park = hw_bool(device, "cansetpark");
	mount->can_find_home = hw_bool(device, "canfindhome");
	mount->can_sync = hw_bool(device, "cansync");
	mount->can_slew_async = hw_bool(device, "canslewasync");
	mount->can_set_tracking = hw_bool(device, "cansettracking");
	mount->can_pulse_guide = hw_bool(device, "canpulseguide");
	mount->can_set_guide_rates = hw_bool(device, "cansetguiderates");
	hw_read_bool_q(device, "canmoveaxis", "Axis=0", &mount->can_move[0]);
	hw_read_bool_q(device, "canmoveaxis", "Axis=1", &mount->can_move[1]);
	mount->has_side = hw_read_int(device, "sideofpier", &mount->found_side);
	mount->has_site = hw_read_double(device, "sitelatitude", &mount->latitude) && hw_read_double(device, "sitelongitude", &mount->longitude) && hw_read_double(device, "siteelevation", &mount->elevation);
	mount->has_guide_rates = hw_read_double(device, "guideraterightascension", &mount->found_guide_ra) && hw_read_double(device, "guideratedeclination", &mount->found_guide_dec);
	mount->track_rates = hw_array_size(device, "trackingrates");
	mount->found_parked = hw_bool(device, "atpark");
	mount->found_tracking = hw_bool(device, "tracking");
	mount->found_track_rate = hw_int(device, "trackingrate");
	snprintf(mount->found_slew_rate, sizeof(mount->found_slew_rate), "%s", hw_selected(device->proxy, MOUNT_SLEW_RATE_PROPERTY_NAME));
	if (mount->can_pulse_guide) {
		snprintf(device->guider, sizeof(device->guider), "%s (guider)", device->proxy);
	}
	printf("    CanPark %d, CanUnpark %d, CanSetPark %d, CanFindHome %d, CanSync %d, CanSlewAsync %d, CanSetTracking %d, CanPulseGuide %d, CanSetGuideRates %d, CanMoveAxis %d %d, TrackingRates %d\n", mount->can_park, mount->can_unpark, mount->can_set_park, mount->can_find_home, mount->can_sync, mount->can_slew_async, mount->can_set_tracking, mount->can_pulse_guide, mount->can_set_guide_rates, mount->can_move[0], mount->can_move[1], mount->track_rates);
	printf("    found %s, tracking %s, TrackingRate %d, SideOfPier %s\n", mount->found_parked ? "parked" : "unparked", mount->found_tracking ? "on" : "off", mount->found_track_rate, mount->has_side ? hw_side_name(mount->found_side) : "not implemented");
	bool motion = !mount->can_park || mount->can_unpark || !mount->found_parked;
	hw_add(device, "connect", hw_connect);
	hw_add(device, "site_time", hw_mount_site_time);
	hw_add_if(device, mount->can_park && mount->can_unpark && mount->can_slew_async, "first_slew_from_park", hw_mount_first_slew_from_park, "needs CanPark, CanUnpark and CanSlewAsync");
	hw_add_if(device, mount->can_slew_async && motion, "settle_time", hw_mount_settle_time, "needs gotos (CanSlewAsync)");
	hw_add_if(device, mount->can_set_tracking && motion, "tracking", hw_mount_tracking, mount->can_set_tracking ? "the telescope is parked and can not unpark" : "CanSetTracking is false");
	hw_add_if(device, mount->track_rates > 1, "tracking_rates", hw_mount_tracking_rates, "TrackingRates has fewer than two rates");
	hw_add_if(device, mount->has_guide_rates, "guide_rates", hw_mount_guide_rates, "GuideRateRightAscension / GuideRateDeclination not implemented");
	hw_add_if(device, mount->can_slew_async && motion, "slew", hw_mount_slew, mount->can_slew_async ? "the telescope is parked and can not unpark" : "CanSlewAsync is false");
	hw_add_if(device, mount->has_side && mount->can_slew_async && motion, "side_of_pier", hw_mount_side_of_pier, mount->has_side ? "needs slews" : "SideOfPier not implemented");
	hw_add_if(device, mount->can_slew_async && motion, "abort", hw_mount_abort, "needs a slew to abort (CanSlewAsync)");
	hw_add_if(device, mount->can_move[0] && mount->can_move[1] && mount->can_slew_async && motion, "axes_convention", hw_mount_axes_convention, "needs CanMoveAxis on both axes and a goto");
	hw_add_if(device, mount->can_move[0] && motion, "manual_motion_ra", hw_mount_motion_ra, "CanMoveAxis(0) is false");
	hw_add_if(device, mount->can_move[1] && motion && mount->can_slew_async, "manual_motion_dec", hw_mount_motion_dec, mount->can_move[1] ? "needs slews to both sides of the pier" : "CanMoveAxis(1) is false");
	hw_add_if(device, mount->can_pulse_guide && motion, "pulse_guide", hw_mount_pulse_guide, "CanPulseGuide is false");
	hw_add_if(device, mount->can_sync && motion, "sync", hw_mount_sync, "CanSync is false");
	hw_add_if(device, mount->can_find_home && motion, "find_home", hw_mount_find_home, "CanFindHome is false");
	hw_add_if(device, mount->can_set_park && mount->can_park && mount->can_unpark && mount->can_slew_async, "set_park", hw_mount_set_park, mount->can_set_park ? "needs CanPark, CanUnpark and CanSlewAsync to set the park position back" : "CanSetPark is false");
	hw_add_if(device, mount->can_park, "park_unpark", hw_mount_park_unpark, "CanPark is false");
	hw_add(device, "restore", hw_mount_restore);
	hw_add(device, "disconnect", hw_disconnect);
}

// ---------------------------------------------------------------------------- camera

static pthread_mutex_t hw_image_mutex = PTHREAD_MUTEX_INITIALIZER;
static char hw_image_device[INDIGO_NAME_SIZE];
static unsigned char *hw_image = NULL;
static size_t hw_image_size = 0;
static unsigned hw_image_count = 0;

static indigo_result hw_image_update(indigo_client *client, indigo_device *device, indigo_property *property, const char *message) {
	(void)client;
	(void)device;
	(void)message;
	pthread_mutex_lock(&hw_image_mutex);
	if (!strcmp(property->device, hw_image_device) && !strcmp(property->name, CCD_IMAGE_PROPERTY_NAME) && property->state == INDIGO_OK_STATE && property->items[0].blob.value != NULL) {
		hw_image = indigo_safe_realloc(hw_image, property->items[0].blob.size);
		memcpy(hw_image, property->items[0].blob.value, property->items[0].blob.size);
		hw_image_size = property->items[0].blob.size;
		hw_image_count++;
	}
	pthread_mutex_unlock(&hw_image_mutex);
	return INDIGO_OK;
}

static indigo_client hw_image_client = {
	"system_alpaca hardware image client", false, NULL, INDIGO_OK, INDIGO_VERSION_CURRENT, NULL, NULL, NULL, hw_image_update, NULL, NULL, NULL, false, false
};

static unsigned hw_images(void) {
	pthread_mutex_lock(&hw_image_mutex);
	unsigned result = hw_image_count;
	pthread_mutex_unlock(&hw_image_mutex);
	return result;
}

// The last image is a raw image of width x height whose pixels are not all the same.
static bool hw_image_is(int width, int height) {
	bool result = false;
	pthread_mutex_lock(&hw_image_mutex);
	indigo_raw_header header = { 0 };
	if (hw_image != NULL && hw_image_size >= sizeof(header)) {
		memcpy(&header, hw_image, sizeof(header));
		int bytes = header.signature == INDIGO_RAW_MONO16 ? 2 : header.signature == INDIGO_RAW_MONO8 ? 1 : header.signature == INDIGO_RAW_RGB24 ? 3 : header.signature == INDIGO_RAW_RGB48 ? 6 : 0;
		size_t count = (size_t)header.width * (size_t)header.height;
		unsigned minimum = UINT32_MAX, maximum = 0;
		double sum = 0;
		if (bytes > 0 && hw_image_size >= sizeof(header) + count * (size_t)bytes) {
			const unsigned char *pixel = hw_image + sizeof(header);
			int step = bytes == 6 ? 2 : bytes == 3 ? 1 : bytes;
			for (size_t i = 0; i < count * (size_t)(bytes / step); i++, pixel += step) {
				unsigned value = step == 2 ? (unsigned)(pixel[0] | pixel[1] << 8) : pixel[0];
				minimum = value < minimum ? value : minimum;
				maximum = value > maximum ? value : maximum;
				sum += value;
			}
			printf("    image %08x %u x %u, %d byte(s) per pixel, min %u, max %u, mean %.1f\n", header.signature, header.width, header.height, bytes, minimum, maximum, sum / (double)(count * (size_t)(bytes / step)));
			result = (int)header.width == width && (int)header.height == height && maximum > minimum;
		} else {
			fprintf(stderr, "    image of %lu bytes, signature %08x, %u x %u is not a raw image\n", (unsigned long)hw_image_size, header.signature, header.width, header.height);
		}
	} else {
		fprintf(stderr, "    no image\n");
	}
	pthread_mutex_unlock(&hw_image_mutex);
	return result;
}

// Expose and wait for exactly one image.
static bool hw_expose(hw_device *device, double duration) {
	unsigned images = hw_images();
	int mark = sa_message_mark();
	unsigned revision = sa_revision(device->proxy, CCD_EXPOSURE_PROPERTY_NAME);
	double started = indigo_monotonic_time();
	if (indigo_change_number_property_1(&sa_client, device->proxy, CCD_EXPOSURE_PROPERTY_NAME, CCD_EXPOSURE_ITEM_NAME, duration) != INDIGO_OK) {
		return false;
	}
	if (!SA_WAIT(sa_state_after(device->proxy, CCD_EXPOSURE_PROPERTY_NAME, INDIGO_OK_STATE, revision) && sa_state(device->proxy, CCD_EXPOSURE_PROPERTY_NAME) == INDIGO_OK_STATE && hw_images() == images + 1, duration + HW_MOTION)) {
		fprintf(stderr, "    exposure of %g s ended with CCD_EXPOSURE in state %d, %u image(s)\n", duration, sa_state(device->proxy, CCD_EXPOSURE_PROPERTY_NAME), hw_images() - images);
		hw_print_messages(mark);
		return false;
	}
	printf("    exposure of %g s: image after %.2f s\n", duration, indigo_monotonic_time() - started);
	return sa_state_after(device->proxy, CCD_EXPOSURE_PROPERTY_NAME, INDIGO_BUSY_STATE, revision) && sa_state(device->proxy, CCD_IMAGE_PROPERTY_NAME) == INDIGO_OK_STATE;
}

static double hw_exposure_time(hw_device *device) {
	return fmax(device->camera.exposure_min, fmin(1.0, device->camera.exposure_max));
}

static void hw_camera_geometry(hw_device *device) {
	hw_camera *camera = &device->camera;
	printf("    CameraXSize %d, CameraYSize %d, MaxBinX %d, MaxBinY %d, PixelSizeX %g, PixelSizeY %g, MaxADU %d, SensorName '%s'\n", camera->width, camera->height, camera->max_bin_x, camera->max_bin_y, hw_double(device, "pixelsizex"), hw_double(device, "pixelsizey"), hw_int(device, "maxadu"), sa_text(device->proxy, "X_ALPACA_SENSOR", "NAME"));
	HW_CHECK(sa_number(device->proxy, CCD_INFO_PROPERTY_NAME, CCD_INFO_WIDTH_ITEM_NAME) == camera->width && sa_number(device->proxy, CCD_INFO_PROPERTY_NAME, CCD_INFO_HEIGHT_ITEM_NAME) == camera->height);
	HW_CHECK(sa_number(device->proxy, CCD_INFO_PROPERTY_NAME, CCD_INFO_MAX_HORIZONTAL_BIN_ITEM_NAME) == camera->max_bin_x && sa_number(device->proxy, CCD_INFO_PROPERTY_NAME, CCD_INFO_MAX_VERTICAL_BIN_ITEM_NAME) == camera->max_bin_y);
	HW_CHECK(fabs(sa_number(device->proxy, CCD_INFO_PROPERTY_NAME, CCD_INFO_PIXEL_WIDTH_ITEM_NAME) - hw_double(device, "pixelsizex")) < 0.01);
	HW_CHECK(sa_number(device->proxy, CCD_FRAME_PROPERTY_NAME, CCD_FRAME_WIDTH_ITEM_NAME) > 0 && sa_number(device->proxy, CCD_FRAME_PROPERTY_NAME, CCD_FRAME_WIDTH_ITEM_NAME) <= camera->width);
	HW_CHECK(sa_number(device->proxy, CCD_BIN_PROPERTY_NAME, CCD_BIN_HORIZONTAL_ITEM_NAME) == hw_int(device, "binx") && sa_number(device->proxy, CCD_BIN_PROPERTY_NAME, CCD_BIN_VERTICAL_ITEM_NAME) == hw_int(device, "biny"));
cleanup:
	return;
}

static bool hw_camera_bin(hw_device *device, double x, double y) {
	static const char *items[] = { CCD_BIN_HORIZONTAL_ITEM_NAME, CCD_BIN_VERTICAL_ITEM_NAME };
	const double values[] = { x, y };
	// the driver sends the binning to the camera with the next exposure; the camera is checked after it
	return hw_set_numbers(device->proxy, CCD_BIN_PROPERTY_NAME, 2, items, values, HW_ANSWER) == INDIGO_OK_STATE && sa_number(device->proxy, CCD_BIN_PROPERTY_NAME, CCD_BIN_HORIZONTAL_ITEM_NAME) == x && sa_number(device->proxy, CCD_BIN_PROPERTY_NAME, CCD_BIN_VERTICAL_ITEM_NAME) == y;
}

static bool hw_camera_full_frame(hw_device *device) {
	static const char *items[] = { CCD_FRAME_LEFT_ITEM_NAME, CCD_FRAME_TOP_ITEM_NAME, CCD_FRAME_WIDTH_ITEM_NAME, CCD_FRAME_HEIGHT_ITEM_NAME };
	const double values[] = { 0, 0, device->camera.width, device->camera.height };
	return hw_set_numbers(device->proxy, CCD_FRAME_PROPERTY_NAME, 4, items, values, HW_ANSWER) == INDIGO_OK_STATE;
}

static void hw_camera_exposure(hw_device *device) {
	HW_CHECK(hw_set_switch(device->proxy, CCD_IMAGE_FORMAT_PROPERTY_NAME, CCD_IMAGE_FORMAT_RAW_ITEM_NAME, true, HW_ANSWER) == INDIGO_OK_STATE);
	HW_CHECK(hw_set_switch(device->proxy, CCD_FRAME_TYPE_PROPERTY_NAME, CCD_FRAME_TYPE_LIGHT_ITEM_NAME, true, HW_ANSWER) == INDIGO_OK_STATE);
	HW_CHECK(hw_camera_bin(device, 1, 1));
	HW_CHECK(hw_camera_full_frame(device));
	double duration = hw_exposure_time(device);
	HW_CHECK(hw_expose(device, duration));
	HW_CHECK(hw_image_is(device->camera.width, device->camera.height));
	HW_CHECK(hw_int(device, "binx") == 1 && hw_int(device, "biny") == 1 && hw_int(device, "numx") == device->camera.width && hw_int(device, "numy") == device->camera.height);
	printf("    LastExposureDuration %g s\n", hw_double(device, "lastexposureduration"));
	// a second exposure right after the first one
	HW_CHECK(hw_expose(device, duration));
cleanup:
	return;
}

// Binning 2 x 2 (or 2 x 1, 1 x 2 for a camera that has it only on one axis) and a subframe: the image has the binned size.
static void hw_camera_binning(hw_device *device) {
	hw_camera *camera = &device->camera;
	static const char *items[] = { CCD_FRAME_LEFT_ITEM_NAME, CCD_FRAME_TOP_ITEM_NAME, CCD_FRAME_WIDTH_ITEM_NAME, CCD_FRAME_HEIGHT_ITEM_NAME };
	int x = camera->max_bin_x >= 2 ? 2 : 1, y = camera->max_bin_y >= 2 ? 2 : 1;
	if (!camera->can_asymmetric && x != y) {
		x = y = 1;
	}
	HW_CHECK(hw_set_switch(device->proxy, CCD_IMAGE_FORMAT_PROPERTY_NAME, CCD_IMAGE_FORMAT_RAW_ITEM_NAME, true, HW_ANSWER) == INDIGO_OK_STATE);
	HW_CHECK(x > 1 || y > 1);
	HW_CHECK(hw_camera_bin(device, x, y));
	// a centred subframe of half the sensor, on whole binned pixels
	int width = (camera->width / 2) / (2 * x) * (2 * x), height = (camera->height / 2) / (2 * y) * (2 * y);
	int left = (camera->width / 4) / x * x, top = (camera->height / 4) / y * y;
	const double values[] = { left, top, width, height };
	HW_CHECK(hw_set_numbers(device->proxy, CCD_FRAME_PROPERTY_NAME, 4, items, values, HW_ANSWER) == INDIGO_OK_STATE);
	HW_CHECK(hw_expose(device, hw_exposure_time(device)));
	printf("    binning %d x %d, subframe %d, %d, %d x %d: BinX %d, BinY %d, StartX %d, StartY %d, NumX %d, NumY %d\n", x, y, left, top, width, height, hw_int(device, "binx"), hw_int(device, "biny"), hw_int(device, "startx"), hw_int(device, "starty"), hw_int(device, "numx"), hw_int(device, "numy"));
	HW_CHECK(hw_int(device, "binx") == x && hw_int(device, "biny") == y && hw_int(device, "startx") == left / x && hw_int(device, "starty") == top / y && hw_int(device, "numx") == width / x && hw_int(device, "numy") == height / y);
	HW_CHECK(hw_image_is(width / x, height / y));
cleanup:
	if (!hw_camera_bin(device, camera->found_bin_x, camera->found_bin_y) || !hw_camera_full_frame(device)) {
		fprintf(stderr, "    binning and frame could not be restored\n");
		indigo_test_failures++;
	}
	return;
}

static void hw_camera_abort(hw_device *device) {
	unsigned images = hw_images();
	double duration = fmin(20, device->camera.exposure_max);
	unsigned revision = sa_revision(device->proxy, CCD_EXPOSURE_PROPERTY_NAME);
	HW_CHECK(indigo_change_number_property_1(&sa_client, device->proxy, CCD_EXPOSURE_PROPERTY_NAME, CCD_EXPOSURE_ITEM_NAME, duration) == INDIGO_OK);
	HW_CHECK(SA_WAIT(hw_int(device, "camerastate") == 2, HW_ANSWER));
	HW_CHECK(hw_set_switch(device->proxy, CCD_ABORT_EXPOSURE_PROPERTY_NAME, CCD_ABORT_EXPOSURE_ITEM_NAME, true, HW_ANSWER) == INDIGO_OK_STATE);
	HW_CHECK(SA_WAIT(sa_state(device->proxy, CCD_EXPOSURE_PROPERTY_NAME) != INDIGO_BUSY_STATE, HW_ANSWER));
	HW_CHECK(sa_state_after(device->proxy, CCD_EXPOSURE_PROPERTY_NAME, INDIGO_ALERT_STATE, revision));
	HW_CHECK(SA_WAIT(hw_int(device, "camerastate") == 0, HW_ANSWER));
	printf("    %g s exposure aborted: CameraState idle, ImageReady %d\n", duration, hw_bool(device, "imageready"));
	HW_CHECK(hw_images() == images);
	// the camera takes the next exposure
	HW_CHECK(hw_expose(device, hw_exposure_time(device)));
cleanup:
	return;
}

static void hw_camera_cooler(hw_device *device) {
	bool found = hw_bool(device, "cooleron");
	printf("    CoolerOn %d, CCD_COOLER ON %d\n", found, sa_switch(device->proxy, CCD_COOLER_PROPERTY_NAME, CCD_COOLER_ON_ITEM_NAME));
	HW_CHECK(SA_WAIT(sa_switch(device->proxy, CCD_COOLER_PROPERTY_NAME, CCD_COOLER_ON_ITEM_NAME) == found, HW_ANSWER));
	for (int i = 0; i < 2; i++) {
		bool on = i == 0 ? !found : found;
		HW_CHECK(hw_set_switch(device->proxy, CCD_COOLER_PROPERTY_NAME, on ? CCD_COOLER_ON_ITEM_NAME : CCD_COOLER_OFF_ITEM_NAME, true, HW_ANSWER) == INDIGO_OK_STATE);
		HW_CHECK(SA_WAIT(hw_bool(device, "cooleron") == on, HW_ANSWER));
		printf("    cooler %s\n", on ? "on" : "off");
	}
cleanup:
	return;
}

static void hw_camera_temperature(hw_device *device) {
	double temperature = hw_double(device, "ccdtemperature");
	printf("    CCDTemperature %.2f, CCD_TEMPERATURE %.2f (%s)\n", temperature, sa_number(device->proxy, CCD_TEMPERATURE_PROPERTY_NAME, CCD_TEMPERATURE_ITEM_NAME), sa_perm(device->proxy, CCD_TEMPERATURE_PROPERTY_NAME) == INDIGO_RW_PERM ? "set point writable" : "read only");
	HW_CHECK(SA_WAIT(fabs(sa_number(device->proxy, CCD_TEMPERATURE_PROPERTY_NAME, CCD_TEMPERATURE_ITEM_NAME) - hw_double(device, "ccdtemperature")) < 1, HW_ANSWER));
	if (sa_perm(device->proxy, CCD_TEMPERATURE_PROPERTY_NAME) == INDIGO_RW_PERM) {
		bool cooler = hw_bool(device, "cooleron");
		double found = hw_double(device, "setccdtemperature"), min = 0, max = 0, step = 0;
		HW_CHECK(!isnan(found) && hw_number_range(device->proxy, CCD_TEMPERATURE_PROPERTY_NAME, CCD_TEMPERATURE_ITEM_NAME, &min, &max, &step));
		double target = found + 5 <= max ? found + 5 : found - 5;
		HW_CHECK(hw_set_number(device->proxy, CCD_TEMPERATURE_PROPERTY_NAME, CCD_TEMPERATURE_ITEM_NAME, target, HW_MOTION) >= 0);
		HW_CHECK(SA_WAIT(fabs(hw_double(device, "setccdtemperature") - target) < 0.1, HW_ANSWER));
		printf("    set point %.1f -> %.1f\n", found, target);
		HW_CHECK(hw_set_number(device->proxy, CCD_TEMPERATURE_PROPERTY_NAME, CCD_TEMPERATURE_ITEM_NAME, found, HW_MOTION) >= 0);
		HW_CHECK(SA_WAIT(fabs(hw_double(device, "setccdtemperature") - found) < 0.1, HW_ANSWER));
		if (sa_defined(device->proxy, CCD_COOLER_PROPERTY_NAME) && hw_bool(device, "cooleron") != cooler) {
			HW_CHECK(hw_set_switch(device->proxy, CCD_COOLER_PROPERTY_NAME, cooler ? CCD_COOLER_ON_ITEM_NAME : CCD_COOLER_OFF_ITEM_NAME, true, HW_ANSWER) == INDIGO_OK_STATE);
		}
	}
	if (sa_defined(device->proxy, CCD_COOLER_POWER_PROPERTY_NAME)) {
		printf("    CoolerPower %.1f, CCD_COOLER_POWER %.1f\n", hw_double(device, "coolerpower"), sa_number(device->proxy, CCD_COOLER_POWER_PROPERTY_NAME, CCD_COOLER_POWER_ITEM_NAME));
		HW_CHECK(SA_WAIT(fabs(sa_number(device->proxy, CCD_COOLER_POWER_PROPERTY_NAME, CCD_COOLER_POWER_ITEM_NAME) - hw_double(device, "coolerpower")) < 5, HW_ANSWER));
	}
cleanup:
	return;
}

// Gain or offset: a value in a range (CCD_GAIN / CCD_OFFSET) or an index into a list of names (X_ALPACA_GAIN / X_ALPACA_OFFSET).
static void hw_camera_control(hw_device *device, const char *member, const char *number_property, const char *number_item, const char *list_property) {
	int found = hw_int(device, member);
	printf("    %s %d\n", member, found);
	if (sa_defined(device->proxy, list_property)) {
		int count = sa_item_count(device->proxy, list_property);
		char item[INDIGO_NAME_SIZE];
		HW_CHECK(count > 1 && found >= 0 && found < count);
		HW_CHECK(SA_WAIT(sa_switch(device->proxy, list_property, sa_item_name(device->proxy, list_property, found)), HW_ANSWER));
		int other = found == 0 ? 1 : 0;
		snprintf(item, sizeof(item), "%s", sa_item_name(device->proxy, list_property, other));
		HW_CHECK(hw_set_switch(device->proxy, list_property, item, true, HW_ANSWER) == INDIGO_OK_STATE && SA_WAIT(hw_int(device, member) == other, HW_ANSWER));
		printf("    %s.%s: %s %d\n", list_property, item, member, other);
		snprintf(item, sizeof(item), "%s", sa_item_name(device->proxy, list_property, found));
		HW_CHECK(hw_set_switch(device->proxy, list_property, item, true, HW_ANSWER) == INDIGO_OK_STATE && SA_WAIT(hw_int(device, member) == found, HW_ANSWER));
	} else {
		double min = 0, max = 0, step = 0;
		HW_CHECK(hw_number_range(device->proxy, number_property, number_item, &min, &max, &step));
		HW_CHECK(SA_WAIT(sa_number(device->proxy, number_property, number_item) == hw_int(device, member), HW_ANSWER));
		double other = found + 1 <= max ? found + 1 : found - 1;
		HW_CHECK(other >= min);
		HW_CHECK(hw_set_number(device->proxy, number_property, number_item, other, HW_ANSWER) == INDIGO_OK_STATE && SA_WAIT(hw_int(device, member) == (int)other, HW_ANSWER));
		printf("    %s %g (range %g .. %g)\n", number_property, other, min, max);
		HW_CHECK(hw_set_number(device->proxy, number_property, number_item, found, HW_ANSWER) == INDIGO_OK_STATE && SA_WAIT(hw_int(device, member) == found, HW_ANSWER));
	}
cleanup:
	return;
}

static void hw_camera_gain(hw_device *device) {
	hw_camera_control(device, "gain", CCD_GAIN_PROPERTY_NAME, CCD_GAIN_ITEM_NAME, "X_ALPACA_GAIN");
}

static void hw_camera_offset(hw_device *device) {
	hw_camera_control(device, "offset", CCD_OFFSET_PROPERTY_NAME, CCD_OFFSET_ITEM_NAME, "X_ALPACA_OFFSET");
}

static void hw_camera_readout_modes(hw_device *device) {
	char item[INDIGO_NAME_SIZE];
	int found = hw_int(device, "readoutmode");
	int count = hw_array_size(device, "readoutmodes");
	HW_CHECK(count > 1 && found >= 0);
	for (int i = 0; i <= count; i++) {
		int mode = i < count ? i : found;
		snprintf(item, sizeof(item), "MODE_%d", mode);
		HW_CHECK(sa_has_item(device->proxy, CCD_MODE_PROPERTY_NAME, item));
		HW_CHECK(hw_set_switch(device->proxy, CCD_MODE_PROPERTY_NAME, item, true, HW_ANSWER) == INDIGO_OK_STATE && SA_WAIT(hw_int(device, "readoutmode") == mode, HW_ANSWER));
		printf("    CCD_MODE.%s: ReadoutMode %d\n", item, mode);
	}
cleanup:
	return;
}

static void hw_camera_fast_readout(hw_device *device) {
	bool found = hw_bool(device, "fastreadout");
	for (int i = 0; i < 2; i++) {
		bool fast = i == 0 ? !found : found;
		HW_CHECK(hw_set_switch(device->proxy, CCD_READ_MODE_PROPERTY_NAME, fast ? CCD_READ_MODE_HIGH_SPEED_ITEM_NAME : CCD_READ_MODE_LOW_NOISE_ITEM_NAME, true, HW_ANSWER) == INDIGO_OK_STATE);
		HW_CHECK(SA_WAIT(hw_bool(device, "fastreadout") == fast, HW_ANSWER));
		printf("    FastReadout %d\n", fast);
	}
cleanup:
	return;
}

static void hw_probe_camera(hw_device *device) {
	hw_camera *camera = &device->camera;
	camera->can_abort = hw_bool(device, "canabortexposure");
	camera->can_stop = hw_bool(device, "canstopexposure");
	camera->can_pulse_guide = hw_bool(device, "canpulseguide");
	camera->can_asymmetric = hw_bool(device, "canasymmetricbin");
	camera->width = hw_int(device, "cameraxsize");
	camera->height = hw_int(device, "cameraysize");
	camera->max_bin_x = hw_int(device, "maxbinx");
	camera->max_bin_y = hw_int(device, "maxbiny");
	camera->found_bin_x = hw_int(device, "binx");
	camera->found_bin_y = hw_int(device, "biny");
	if (!hw_read_double(device, "exposuremin", &camera->exposure_min)) {
		camera->exposure_min = 0.001;
	}
	if (!hw_read_double(device, "exposuremax", &camera->exposure_max)) {
		camera->exposure_max = 3600;
	}
	if (camera->can_pulse_guide) {
		snprintf(device->guider, sizeof(device->guider), "%s (guider)", device->proxy);
	}
	bool has_cooler = sa_defined(device->proxy, CCD_COOLER_PROPERTY_NAME);
	bool has_temperature = sa_defined(device->proxy, CCD_TEMPERATURE_PROPERTY_NAME);
	bool has_gain = sa_defined(device->proxy, CCD_GAIN_PROPERTY_NAME) || sa_defined(device->proxy, "X_ALPACA_GAIN");
	bool has_offset = sa_defined(device->proxy, CCD_OFFSET_PROPERTY_NAME) || sa_defined(device->proxy, "X_ALPACA_OFFSET");
	int readout_modes = hw_array_size(device, "readoutmodes");
	bool fast_readout = hw_bool(device, "canfastreadout");
	printf("    CanAbortExposure %d, CanStopExposure %d, CanPulseGuide %d, CanAsymmetricBin %d, CanFastReadout %d, ReadoutModes %d, ExposureMin %g, ExposureMax %g; CoolerOn %s, CCDTemperature %s, Gain %s, Offset %s\n", camera->can_abort, camera->can_stop, camera->can_pulse_guide, camera->can_asymmetric, fast_readout, readout_modes, camera->exposure_min, camera->exposure_max, has_cooler ? "yes" : "no", has_temperature ? "yes" : "no", has_gain ? "yes" : "no", has_offset ? "yes" : "no");
	hw_add(device, "connect", hw_connect);
	hw_add(device, "geometry", hw_camera_geometry);
	hw_add(device, "exposure", hw_camera_exposure);
	hw_add_if(device, camera->max_bin_x > 1 || camera->max_bin_y > 1, "binning", hw_camera_binning, "MaxBinX and MaxBinY are 1");
	hw_add_if(device, camera->can_abort || camera->can_stop, "abort", hw_camera_abort, "CanAbortExposure and CanStopExposure are false");
	hw_add_if(device, has_cooler, "cooler", hw_camera_cooler, "CoolerOn not implemented");
	hw_add_if(device, has_temperature, "temperature", hw_camera_temperature, "CCDTemperature not implemented");
	hw_add_if(device, has_gain, "gain", hw_camera_gain, "Gain not implemented");
	hw_add_if(device, has_offset, "offset", hw_camera_offset, "Offset not implemented");
	hw_add_if(device, readout_modes > 1, "readout_modes", hw_camera_readout_modes, "fewer than two ReadoutModes");
	hw_add_if(device, fast_readout, "fast_readout", hw_camera_fast_readout, "CanFastReadout is false");
	hw_add_if(device, camera->can_pulse_guide, "pulse_guide", hw_guide, "CanPulseGuide is false");
	hw_add(device, "disconnect", hw_disconnect);
}

// ---------------------------------------------------------------------------- focuser

static bool hw_focuser_settled(hw_device *device, const char *property, unsigned revision) {
	return sa_state_after(device->proxy, property, INDIGO_OK_STATE, revision) && sa_state(device->proxy, property) == INDIGO_OK_STATE && (!device->focuser.absolute || sa_state(device->proxy, FOCUSER_POSITION_PROPERTY_NAME) == INDIGO_OK_STATE);
}

static bool hw_focuser_move_to(hw_device *device, int position) {
	int mark = sa_message_mark();
	unsigned revision = sa_revision(device->proxy, FOCUSER_POSITION_PROPERTY_NAME);
	double started = indigo_monotonic_time();
	if (indigo_change_number_property_1(&sa_client, device->proxy, FOCUSER_POSITION_PROPERTY_NAME, FOCUSER_POSITION_ITEM_NAME, position) != INDIGO_OK || !SA_WAIT(hw_focuser_settled(device, FOCUSER_POSITION_PROPERTY_NAME, revision), HW_MOTION)) {
		fprintf(stderr, "    move to %d ended in state %d\n", position, sa_state(device->proxy, FOCUSER_POSITION_PROPERTY_NAME));
		hw_print_messages(mark);
		return false;
	}
	printf("    move to %d: FOCUSER_POSITION %g, Position %d, IsMoving %d after %.1f s\n", position, sa_number(device->proxy, FOCUSER_POSITION_PROPERTY_NAME, FOCUSER_POSITION_ITEM_NAME), hw_int(device, "position"), hw_bool(device, "ismoving"), indigo_monotonic_time() - started);
	return sa_number(device->proxy, FOCUSER_POSITION_PROPERTY_NAME, FOCUSER_POSITION_ITEM_NAME) == position && hw_int(device, "position") == position && !hw_bool(device, "ismoving");
}

static int hw_focuser_delta(hw_device *device) {
	int range = device->focuser.max_increment < device->focuser.max_step ? device->focuser.max_increment : device->focuser.max_step;
	return range / 50 > 10 ? range / 50 : 10;
}

// A focuser in the automatic (temperature compensation) mode has no motion properties: it is switched to manual for the motion cases.
static bool hw_focuser_manual(hw_device *device) {
	if (!sa_defined(device->proxy, FOCUSER_MODE_PROPERTY_NAME) || sa_switch(device->proxy, FOCUSER_MODE_PROPERTY_NAME, FOCUSER_MODE_MANUAL_ITEM_NAME)) {
		return true;
	}
	return hw_set_switch(device->proxy, FOCUSER_MODE_PROPERTY_NAME, FOCUSER_MODE_MANUAL_ITEM_NAME, true, HW_ANSWER) == INDIGO_OK_STATE && SA_WAIT(sa_defined(device->proxy, FOCUSER_STEPS_PROPERTY_NAME), HW_ANSWER);
}

static void hw_focuser_readback(hw_device *device) {
	hw_focuser *focuser = &device->focuser;
	printf("    Absolute %d, MaxStep %d, MaxIncrement %d, Position %d, StepSize %g, TempCompAvailable %d, TempComp %d\n", focuser->absolute, focuser->max_step, focuser->max_increment, hw_int(device, "position"), hw_double(device, "stepsize"), focuser->temp_comp_available, hw_bool(device, "tempcomp"));
	if (focuser->absolute) {
		HW_CHECK(SA_WAIT(sa_number(device->proxy, FOCUSER_POSITION_PROPERTY_NAME, FOCUSER_POSITION_ITEM_NAME) == hw_int(device, "position"), HW_ANSWER));
		HW_CHECK(sa_number(device->proxy, FOCUSER_LIMITS_PROPERTY_NAME, FOCUSER_LIMITS_MAX_POSITION_ITEM_NAME) == focuser->max_step);
	} else {
		HW_CHECK(!sa_defined(device->proxy, FOCUSER_POSITION_PROPERTY_NAME));
	}
	if (!isnan(hw_double(device, "stepsize"))) {
		HW_CHECK(fabs(sa_number(device->proxy, "X_ALPACA_STEP_SIZE", "STEP_SIZE") - hw_double(device, "stepsize")) < 1e-6);
	}
cleanup:
	return;
}

static void hw_focuser_absolute(hw_device *device) {
	hw_focuser *focuser = &device->focuser;
	HW_CHECK(hw_focuser_manual(device));
	int position = hw_int(device, "position"), delta = hw_focuser_delta(device);
	int target = position + delta <= focuser->max_step ? position + delta : position - delta;
	HW_CHECK(hw_focuser_move_to(device, target));
	HW_CHECK(hw_focuser_move_to(device, position));
cleanup:
	return;
}

static bool hw_focuser_steps(hw_device *device, bool inward, int steps) {
	int mark = sa_message_mark();
	if (hw_set_switch(device->proxy, FOCUSER_DIRECTION_PROPERTY_NAME, inward ? FOCUSER_DIRECTION_MOVE_INWARD_ITEM_NAME : FOCUSER_DIRECTION_MOVE_OUTWARD_ITEM_NAME, true, HW_ANSWER) != INDIGO_OK_STATE) {
		return false;
	}
	unsigned revision = sa_revision(device->proxy, FOCUSER_STEPS_PROPERTY_NAME);
	if (indigo_change_number_property_1(&sa_client, device->proxy, FOCUSER_STEPS_PROPERTY_NAME, FOCUSER_STEPS_ITEM_NAME, steps) != INDIGO_OK || !SA_WAIT(hw_focuser_settled(device, FOCUSER_STEPS_PROPERTY_NAME, revision), HW_MOTION)) {
		fprintf(stderr, "    %d steps %s ended in state %d\n", steps, inward ? "in" : "out", sa_state(device->proxy, FOCUSER_STEPS_PROPERTY_NAME));
		hw_print_messages(mark);
		return false;
	}
	return SA_WAIT(!hw_bool(device, "ismoving"), HW_ANSWER);
}

static void hw_focuser_relative(hw_device *device) {
	hw_focuser *focuser = &device->focuser;
	HW_CHECK(hw_focuser_manual(device));
	int delta = hw_focuser_delta(device);
	if (focuser->absolute) {
		int position = hw_int(device, "position");
		bool inward = position - delta >= 0;
		HW_CHECK(hw_focuser_steps(device, inward, delta));
		printf("    %d steps %s: Position %d -> %d\n", delta, inward ? "in" : "out", position, hw_int(device, "position"));
		HW_CHECK(hw_int(device, "position") == position + (inward ? -delta : delta));
		HW_CHECK(SA_WAIT(sa_number(device->proxy, FOCUSER_POSITION_PROPERTY_NAME, FOCUSER_POSITION_ITEM_NAME) == hw_int(device, "position"), HW_ANSWER));
		HW_CHECK(hw_focuser_steps(device, !inward, delta));
		HW_CHECK(hw_int(device, "position") == position);
	} else {
		HW_CHECK(hw_focuser_steps(device, false, delta));
		HW_CHECK(hw_focuser_steps(device, true, delta));
		printf("    %d steps out and in\n", delta);
	}
cleanup:
	return;
}

static void hw_focuser_halt(hw_device *device) {
	hw_focuser *focuser = &device->focuser;
	HW_CHECK(hw_focuser_manual(device));
	int position = hw_int(device, "position");
	unsigned revision = 0;
	if (focuser->absolute) {
		int target = position < focuser->max_step / 2 ? position + focuser->max_increment : position - focuser->max_increment;
		target = target < 0 ? 0 : target > focuser->max_step ? focuser->max_step : target;
		revision = sa_revision(device->proxy, FOCUSER_POSITION_PROPERTY_NAME);
		HW_CHECK(indigo_change_number_property_1(&sa_client, device->proxy, FOCUSER_POSITION_PROPERTY_NAME, FOCUSER_POSITION_ITEM_NAME, target) == INDIGO_OK);
	} else {
		HW_CHECK(hw_set_switch(device->proxy, FOCUSER_DIRECTION_PROPERTY_NAME, FOCUSER_DIRECTION_MOVE_OUTWARD_ITEM_NAME, true, HW_ANSWER) == INDIGO_OK_STATE);
		revision = sa_revision(device->proxy, FOCUSER_STEPS_PROPERTY_NAME);
		HW_CHECK(indigo_change_number_property_1(&sa_client, device->proxy, FOCUSER_STEPS_PROPERTY_NAME, FOCUSER_STEPS_ITEM_NAME, focuser->max_increment) == INDIGO_OK);
	}
	if (!SA_WAIT(hw_bool(device, "ismoving"), HW_ANSWER)) {
		fprintf(stderr, "    the focuser was never seen moving, Halt can not be exercised\n");
		HW_CHECK(false);
	}
	HW_CHECK(hw_set_switch(device->proxy, FOCUSER_ABORT_MOTION_PROPERTY_NAME, FOCUSER_ABORT_MOTION_ITEM_NAME, true, HW_ANSWER) == INDIGO_OK_STATE);
	HW_CHECK(SA_WAIT(!hw_bool(device, "ismoving"), HW_ANSWER));
	const char *property = focuser->absolute ? FOCUSER_POSITION_PROPERTY_NAME : FOCUSER_STEPS_PROPERTY_NAME;
	HW_CHECK(SA_WAIT(sa_state(device->proxy, property) != INDIGO_BUSY_STATE, HW_ANSWER));
	printf("    halted: %s state %d", property, sa_state(device->proxy, property));
	if (focuser->absolute) {
		printf(", Position %d (from %d)", hw_int(device, "position"), position);
		HW_CHECK(SA_WAIT(sa_number(device->proxy, FOCUSER_POSITION_PROPERTY_NAME, FOCUSER_POSITION_ITEM_NAME) == hw_int(device, "position"), HW_ANSWER));
	}
	printf("\n");
	HW_CHECK(sa_state_after(device->proxy, property, INDIGO_ALERT_STATE, revision));
	if (focuser->absolute) {
		HW_CHECK(hw_focuser_move_to(device, position));
	}
cleanup:
	return;
}

static void hw_focuser_temperature(hw_device *device) {
	double temperature = hw_double(device, "temperature");
	printf("    Temperature %.2f, FOCUSER_TEMPERATURE %.2f\n", temperature, sa_number(device->proxy, FOCUSER_TEMPERATURE_PROPERTY_NAME, FOCUSER_TEMPERATURE_ITEM_NAME));
	HW_CHECK(temperature > -60 && temperature < 70);
	HW_CHECK(SA_WAIT(fabs(sa_number(device->proxy, FOCUSER_TEMPERATURE_PROPERTY_NAME, FOCUSER_TEMPERATURE_ITEM_NAME) - hw_double(device, "temperature")) < 0.5, HW_ANSWER));
cleanup:
	return;
}

static void hw_focuser_temp_comp(hw_device *device) {
	bool found = hw_bool(device, "tempcomp");
	for (int i = 0; i < 2; i++) {
		bool on = i == 0 ? !found : found;
		HW_CHECK(hw_set_switch(device->proxy, FOCUSER_MODE_PROPERTY_NAME, on ? FOCUSER_MODE_AUTOMATIC_ITEM_NAME : FOCUSER_MODE_MANUAL_ITEM_NAME, true, HW_ANSWER) == INDIGO_OK_STATE);
		HW_CHECK(SA_WAIT(hw_bool(device, "tempcomp") == on, HW_ANSWER));
		printf("    TempComp %d\n", on);
	}
cleanup:
	return;
}

static void hw_focuser_restore(hw_device *device) {
	hw_focuser *focuser = &device->focuser;
	if (focuser->absolute && hw_int(device, "position") != focuser->found_position) {
		HW_CHECK(hw_focuser_manual(device));
		HW_CHECK(hw_focuser_move_to(device, focuser->found_position));
	}
	if (focuser->temp_comp_available && hw_bool(device, "tempcomp") != focuser->found_temp_comp) {
		HW_CHECK(hw_set_switch(device->proxy, FOCUSER_MODE_PROPERTY_NAME, focuser->found_temp_comp ? FOCUSER_MODE_AUTOMATIC_ITEM_NAME : FOCUSER_MODE_MANUAL_ITEM_NAME, true, HW_ANSWER) == INDIGO_OK_STATE);
	}
	printf("    position %d, TempComp %d, as found\n", hw_int(device, "position"), hw_bool(device, "tempcomp"));
cleanup:
	return;
}

static void hw_probe_focuser(hw_device *device) {
	hw_focuser *focuser = &device->focuser;
	focuser->absolute = hw_bool(device, "absolute");
	focuser->max_step = hw_int(device, "maxstep");
	focuser->max_increment = hw_int(device, "maxincrement");
	focuser->temp_comp_available = hw_bool(device, "tempcompavailable");
	focuser->found_temp_comp = hw_bool(device, "tempcomp");
	focuser->found_position = hw_int(device, "position");
	focuser->has_temperature = !isnan(hw_double(device, "temperature"));
	printf("    Absolute %d, MaxStep %d, MaxIncrement %d, TempCompAvailable %d, Temperature %s\n", focuser->absolute, focuser->max_step, focuser->max_increment, focuser->temp_comp_available, focuser->has_temperature ? "implemented" : "not implemented");
	hw_add(device, "connect", hw_connect);
	hw_add(device, "readback", hw_focuser_readback);
	hw_add_if(device, focuser->absolute, "absolute_move", hw_focuser_absolute, "relative focuser (Absolute is false)");
	hw_add(device, "relative_move", hw_focuser_relative);
	hw_add_if(device, sa_defined(device->proxy, FOCUSER_ABORT_MOTION_PROPERTY_NAME) || focuser->found_temp_comp, "halt", hw_focuser_halt, "Halt not implemented");
	hw_add_if(device, focuser->has_temperature, "temperature", hw_focuser_temperature, "Temperature not implemented");
	hw_add_if(device, focuser->temp_comp_available, "temp_comp", hw_focuser_temp_comp, "TempCompAvailable is false");
	hw_add(device, "restore", hw_focuser_restore);
	hw_add(device, "disconnect", hw_disconnect);
}

// ---------------------------------------------------------------------------- filter wheel

static void hw_wheel_names(hw_device *device) {
	char item[INDIGO_NAME_SIZE];
	int error_number = -1;
	const alpaca_json_value *names = hw_get(device, "names", NULL, &error_number);
	HW_CHECK(error_number == 0 && alpaca_json_size(names) == device->wheel.slots);
	HW_CHECK(sa_item_count(device->proxy, WHEEL_SLOT_NAME_PROPERTY_NAME) == device->wheel.slots);
	for (int i = 0; i < device->wheel.slots; i++) {
		const char *name = NULL;
		HW_CHECK(alpaca_json_get_string(alpaca_json_array_get(names, i), &name));
		snprintf(item, sizeof(item), WHEEL_SLOT_NAME_ITEM_NAME, i + 1);
		printf("    slot %d: '%s'", i + 1, name);
		HW_CHECK(!strcmp(sa_text(device->proxy, WHEEL_SLOT_NAME_PROPERTY_NAME, item), name));
	}
	printf("\n");
	const alpaca_json_value *offsets = hw_get(device, "focusoffsets", NULL, &error_number);
	if (error_number == 0 && alpaca_json_size(offsets) == device->wheel.slots) {
		for (int i = 0; i < device->wheel.slots; i++) {
			int64_t offset = 0;
			HW_CHECK(alpaca_json_get_int(alpaca_json_array_get(offsets, i), &offset));
			snprintf(item, sizeof(item), WHEEL_SLOT_OFFSET_ITEM_NAME, i + 1);
			printf("    offset %d: %lld", i + 1, (long long)offset);
			HW_CHECK(sa_number(device->proxy, WHEEL_SLOT_OFFSET_PROPERTY_NAME, item) == (double)offset);
		}
		printf("\n");
	} else {
		printf("    FocusOffsets not usable (ErrorNumber %d)\n", error_number);
	}
cleanup:
	return;
}

static bool hw_wheel_move(hw_device *device, int slot) {
	int mark = sa_message_mark();
	unsigned revision = sa_revision(device->proxy, WHEEL_SLOT_PROPERTY_NAME);
	double started = indigo_monotonic_time();
	int state = hw_set_number(device->proxy, WHEEL_SLOT_PROPERTY_NAME, WHEEL_SLOT_ITEM_NAME, slot, HW_MOTION);
	int position = hw_int(device, "position");
	printf("    slot %d: state %d, Position %d, %.1f s\n", slot, state, position, indigo_monotonic_time() - started);
	if (state != INDIGO_OK_STATE || !sa_state_after(device->proxy, WHEEL_SLOT_PROPERTY_NAME, INDIGO_OK_STATE, revision)) {
		hw_print_messages(mark);
		return false;
	}
	return position == slot - 1 && sa_number(device->proxy, WHEEL_SLOT_PROPERTY_NAME, WHEEL_SLOT_ITEM_NAME) == slot;
}

static void hw_wheel_slots(hw_device *device) {
	for (int slot = 1; slot <= device->wheel.slots; slot++) {
		HW_CHECK(hw_wheel_move(device, slot));
	}
	HW_CHECK(hw_wheel_move(device, device->wheel.found_slot + 1));
cleanup:
	return;
}

static void hw_probe_wheel(hw_device *device) {
	device->wheel.found_slot = hw_int(device, "position");
	device->wheel.slots = hw_array_size(device, "names");
	if (device->wheel.slots <= 0) {
		device->wheel.slots = hw_array_size(device, "focusoffsets");
	}
	printf("    %d slots, Position %d\n", device->wheel.slots, device->wheel.found_slot);
	hw_add(device, "connect", hw_connect);
	hw_add_if(device, hw_array_size(device, "names") > 0, "names_offsets", hw_wheel_names, "Names not usable");
	hw_add_if(device, device->wheel.slots > 1 && device->wheel.found_slot >= 0, "every_slot", hw_wheel_slots, "fewer than two slots or no position");
	hw_add(device, "disconnect", hw_disconnect);
}

// ---------------------------------------------------------------------------- rotator

static bool hw_rotator_settled(hw_device *device, const char *property, unsigned revision) {
	return sa_state_after(device->proxy, property, INDIGO_OK_STATE, revision) && sa_state(device->proxy, property) == INDIGO_OK_STATE && sa_state(device->proxy, ROTATOR_POSITION_PROPERTY_NAME) == INDIGO_OK_STATE;
}

static bool hw_rotator_request(hw_device *device, const char *property, const char *item, double value, double expected) {
	int mark = sa_message_mark();
	unsigned revision = sa_revision(device->proxy, property);
	double tolerance = fmax(0.1, hw_double(device, "stepsize"));
	if (indigo_change_number_property_1(&sa_client, device->proxy, property, item, value) != INDIGO_OK || !SA_WAIT(hw_rotator_settled(device, property, revision), HW_MOTION)) {
		fprintf(stderr, "    %s %g ended in state %d\n", property, value, sa_state(device->proxy, property));
		hw_print_messages(mark);
		return false;
	}
	double position = hw_double(device, "position");
	printf("    %s %g: Position %.3f, ROTATOR_POSITION %.3f, MechanicalPosition %.3f\n", property, value, position, sa_number(device->proxy, ROTATOR_POSITION_PROPERTY_NAME, ROTATOR_POSITION_ITEM_NAME), hw_double(device, "mechanicalposition"));
	return fabs(hw_angle_difference(position, expected)) < tolerance && SA_WAIT(fabs(hw_angle_difference(sa_number(device->proxy, ROTATOR_POSITION_PROPERTY_NAME, ROTATOR_POSITION_ITEM_NAME), hw_double(device, "position"))) < 0.01, HW_ANSWER) && !hw_bool(device, "ismoving");
}

static void hw_rotator_readback(hw_device *device) {
	printf("    Position %.3f, MechanicalPosition %.3f, StepSize %g, Reverse %d, CanReverse %d\n", hw_double(device, "position"), hw_double(device, "mechanicalposition"), hw_double(device, "stepsize"), hw_bool(device, "reverse"), device->rotator.can_reverse);
	HW_CHECK(SA_WAIT(fabs(hw_angle_difference(sa_number(device->proxy, ROTATOR_POSITION_PROPERTY_NAME, ROTATOR_POSITION_ITEM_NAME), hw_double(device, "position"))) < 0.01, HW_ANSWER));
	if (device->rotator.has_mechanical) {
		HW_CHECK(SA_WAIT(fabs(hw_angle_difference(sa_number(device->proxy, ROTATOR_RAW_POSITION_PROPERTY_NAME, ROTATOR_RAW_POSITION_ITEM_NAME), hw_double(device, "mechanicalposition"))) < 0.01, HW_ANSWER));
	}
cleanup:
	return;
}

static void hw_rotator_moves(hw_device *device) {
	double position = hw_double(device, "position");
	HW_CHECK(hw_rotator_request(device, ROTATOR_POSITION_PROPERTY_NAME, ROTATOR_POSITION_ITEM_NAME, hw_angle(position + 10), hw_angle(position + 10)));
	HW_CHECK(hw_rotator_request(device, ROTATOR_RELATIVE_MOVE_PROPERTY_NAME, ROTATOR_RELATIVE_MOVE_ITEM_NAME, -5, hw_angle(position + 5)));
	HW_CHECK(hw_rotator_request(device, ROTATOR_POSITION_PROPERTY_NAME, ROTATOR_POSITION_ITEM_NAME, position, position));
cleanup:
	return;
}

static void hw_rotator_mechanical(hw_device *device) {
	double mechanical = hw_double(device, "mechanicalposition"), position = hw_double(device, "position");
	HW_CHECK(!isnan(mechanical));
	HW_CHECK(hw_rotator_request(device, "X_ALPACA_MECHANICAL_POSITION", "POSITION", hw_angle(mechanical + 10), hw_angle(position + 10)));
	HW_CHECK(fabs(hw_angle_difference(hw_double(device, "mechanicalposition"), mechanical + 10)) < fmax(0.1, hw_double(device, "stepsize")));
	HW_CHECK(hw_rotator_request(device, "X_ALPACA_MECHANICAL_POSITION", "POSITION", mechanical, position));
cleanup:
	return;
}

static void hw_rotator_reverse(hw_device *device) {
	bool found = hw_bool(device, "reverse");
	for (int i = 0; i < 2; i++) {
		bool reverse = i == 0 ? !found : found;
		HW_CHECK(hw_set_switch(device->proxy, ROTATOR_DIRECTION_PROPERTY_NAME, reverse ? ROTATOR_DIRECTION_REVERSED_ITEM_NAME : ROTATOR_DIRECTION_NORMAL_ITEM_NAME, true, HW_ANSWER) == INDIGO_OK_STATE);
		HW_CHECK(SA_WAIT(hw_bool(device, "reverse") == reverse, HW_ANSWER));
		printf("    Reverse %d\n", reverse);
	}
cleanup:
	return;
}

// Sync to 10 degrees more, then back: the mechanical position does not change.
static void hw_rotator_sync(hw_device *device) {
	double position = hw_double(device, "position"), mechanical = hw_double(device, "mechanicalposition");
	HW_CHECK(hw_set_switch(device->proxy, ROTATOR_ON_POSITION_SET_PROPERTY_NAME, ROTATOR_ON_POSITION_SET_SYNC_ITEM_NAME, true, HW_ANSWER) == INDIGO_OK_STATE);
	for (int i = 0; i < 2; i++) {
		double target = i == 0 ? hw_angle(position + 10) : position;
		HW_CHECK(hw_set_number(device->proxy, ROTATOR_POSITION_PROPERTY_NAME, ROTATOR_POSITION_ITEM_NAME, target, HW_ANSWER) == INDIGO_OK_STATE);
		printf("    sync to %.3f: Position %.3f, MechanicalPosition %.3f\n", target, hw_double(device, "position"), hw_double(device, "mechanicalposition"));
		HW_CHECK(fabs(hw_angle_difference(hw_double(device, "position"), target)) < 0.01 && fabs(hw_angle_difference(hw_double(device, "mechanicalposition"), mechanical)) < 0.01);
		HW_CHECK(SA_WAIT(fabs(hw_angle_difference(sa_number(device->proxy, ROTATOR_POSITION_PROPERTY_NAME, ROTATOR_POSITION_ITEM_NAME), target)) < 0.01, HW_ANSWER));
	}
cleanup:
	hw_set_switch(device->proxy, ROTATOR_ON_POSITION_SET_PROPERTY_NAME, ROTATOR_ON_POSITION_SET_GOTO_ITEM_NAME, true, HW_ANSWER);
	return;
}

static void hw_rotator_halt(hw_device *device) {
	double position = hw_double(device, "position");
	unsigned revision = sa_revision(device->proxy, ROTATOR_POSITION_PROPERTY_NAME);
	HW_CHECK(indigo_change_number_property_1(&sa_client, device->proxy, ROTATOR_POSITION_PROPERTY_NAME, ROTATOR_POSITION_ITEM_NAME, hw_angle(position + 170)) == INDIGO_OK);
	if (!SA_WAIT(hw_bool(device, "ismoving"), HW_ANSWER)) {
		fprintf(stderr, "    the rotator was never seen moving, Halt can not be exercised\n");
		HW_CHECK(false);
	}
	HW_CHECK(hw_set_switch(device->proxy, ROTATOR_ABORT_MOTION_PROPERTY_NAME, ROTATOR_ABORT_MOTION_ITEM_NAME, true, HW_ANSWER) == INDIGO_OK_STATE);
	HW_CHECK(SA_WAIT(sa_state(device->proxy, ROTATOR_POSITION_PROPERTY_NAME) != INDIGO_BUSY_STATE, HW_MOTION) && SA_WAIT(!hw_bool(device, "ismoving"), HW_ANSWER));
	printf("    halted at %.3f (from %.3f toward %.3f), ROTATOR_POSITION state %d\n", hw_double(device, "position"), position, hw_angle(position + 170), sa_state(device->proxy, ROTATOR_POSITION_PROPERTY_NAME));
	HW_CHECK(sa_state_after(device->proxy, ROTATOR_POSITION_PROPERTY_NAME, INDIGO_ALERT_STATE, revision));
	HW_CHECK(fabs(hw_angle_difference(hw_double(device, "position"), position + 170)) > 1);
	HW_CHECK(SA_WAIT(fabs(hw_angle_difference(sa_number(device->proxy, ROTATOR_POSITION_PROPERTY_NAME, ROTATOR_POSITION_ITEM_NAME), hw_double(device, "position"))) < 0.01, HW_ANSWER));
	HW_CHECK(hw_rotator_request(device, ROTATOR_POSITION_PROPERTY_NAME, ROTATOR_POSITION_ITEM_NAME, position, position));
cleanup:
	return;
}

static void hw_rotator_restore(hw_device *device) {
	hw_rotator *rotator = &device->rotator;
	if (rotator->can_reverse && hw_bool(device, "reverse") != rotator->found_reverse) {
		HW_CHECK(hw_set_switch(device->proxy, ROTATOR_DIRECTION_PROPERTY_NAME, rotator->found_reverse ? ROTATOR_DIRECTION_REVERSED_ITEM_NAME : ROTATOR_DIRECTION_NORMAL_ITEM_NAME, true, HW_ANSWER) == INDIGO_OK_STATE);
	}
	if (fabs(hw_angle_difference(hw_double(device, "position"), rotator->found_position)) >= 0.01) {
		HW_CHECK(hw_rotator_request(device, ROTATOR_POSITION_PROPERTY_NAME, ROTATOR_POSITION_ITEM_NAME, rotator->found_position, rotator->found_position));
	}
	printf("    position %.3f, Reverse %d, as found\n", hw_double(device, "position"), hw_bool(device, "reverse"));
cleanup:
	return;
}

static void hw_probe_rotator(hw_device *device) {
	hw_rotator *rotator = &device->rotator;
	rotator->can_reverse = hw_bool(device, "canreverse");
	rotator->found_reverse = hw_bool(device, "reverse");
	rotator->found_position = hw_double(device, "position");
	rotator->has_mechanical = device->interface_version >= 3 && !isnan(hw_double(device, "mechanicalposition"));
	printf("    CanReverse %d, MechanicalPosition %s, Position %.3f\n", rotator->can_reverse, rotator->has_mechanical ? "implemented" : "not implemented", rotator->found_position);
	hw_add(device, "connect", hw_connect);
	hw_add(device, "readback", hw_rotator_readback);
	hw_add(device, "moves", hw_rotator_moves);
	hw_add_if(device, rotator->can_reverse, "reverse", hw_rotator_reverse, "CanReverse is false");
	hw_add_if(device, sa_defined(device->proxy, "X_ALPACA_MECHANICAL_POSITION"), "mechanical_move", hw_rotator_mechanical, "MoveMechanical needs interface version 3 and MechanicalPosition");
	hw_add_if(device, sa_defined(device->proxy, ROTATOR_ON_POSITION_SET_PROPERTY_NAME), "sync", hw_rotator_sync, "Sync needs interface version 3");
	hw_add_if(device, sa_defined(device->proxy, ROTATOR_ABORT_MOTION_PROPERTY_NAME), "halt", hw_rotator_halt, "Halt not implemented");
	hw_add(device, "restore", hw_rotator_restore);
	hw_add(device, "disconnect", hw_disconnect);
}

// ---------------------------------------------------------------------------- dome

static bool hw_dome_azimuth(hw_device *device, double azimuth) {
	int mark = sa_message_mark();
	unsigned revision = sa_revision(device->proxy, DOME_HORIZONTAL_COORDINATES_PROPERTY_NAME);
	double started = indigo_monotonic_time();
	int state = hw_set_number(device->proxy, DOME_HORIZONTAL_COORDINATES_PROPERTY_NAME, DOME_HORIZONTAL_COORDINATES_AZ_ITEM_NAME, azimuth, HW_MOTION);
	printf("    azimuth %.1f: state %d, Azimuth %.2f after %.1f s\n", azimuth, state, hw_double(device, "azimuth"), indigo_monotonic_time() - started);
	if (state != INDIGO_OK_STATE || !sa_state_after(device->proxy, DOME_HORIZONTAL_COORDINATES_PROPERTY_NAME, INDIGO_BUSY_STATE, revision)) {
		hw_print_messages(mark);
		return false;
	}
	return fabs(hw_angle_difference(hw_double(device, "azimuth"), azimuth)) < 1 && SA_WAIT(fabs(hw_angle_difference(sa_number(device->proxy, DOME_HORIZONTAL_COORDINATES_PROPERTY_NAME, DOME_HORIZONTAL_COORDINATES_AZ_ITEM_NAME), hw_double(device, "azimuth"))) < 1, HW_ANSWER);
}

// The driver refuses slews of a parked dome; DOME_PARK UNPARKED sends nothing (Alpaca has no unpark) and lets the next slew leave the park position.
static bool hw_dome_unparked(hw_device *device) {
	if (!device->dome.can_park || !sa_switch(device->proxy, DOME_PARK_PROPERTY_NAME, DOME_PARK_PARKED_ITEM_NAME)) {
		return true;
	}
	return hw_set_switch(device->proxy, DOME_PARK_PROPERTY_NAME, DOME_PARK_UNPARKED_ITEM_NAME, true, HW_ANSWER) == INDIGO_OK_STATE;
}

static void hw_dome_readback(hw_device *device) {
	int shutter = hw_int(device, "shutterstatus");
	printf("    Azimuth %.2f, Altitude %.2f, ShutterStatus %d, AtPark %d, AtHome %d, Slewing %d, Slaved %d\n", hw_double(device, "azimuth"), hw_double(device, "altitude"), shutter, hw_bool(device, "atpark"), hw_bool(device, "athome"), hw_bool(device, "slewing"), hw_bool(device, "slaved"));
	if (device->dome.can_set_azimuth) {
		HW_CHECK(SA_WAIT(fabs(hw_angle_difference(sa_number(device->proxy, DOME_HORIZONTAL_COORDINATES_PROPERTY_NAME, DOME_HORIZONTAL_COORDINATES_AZ_ITEM_NAME), hw_double(device, "azimuth"))) < 1, HW_ANSWER));
	}
	if (device->dome.can_set_shutter && (shutter == 0 || shutter == 1)) {
		HW_CHECK(SA_WAIT(sa_switch(device->proxy, DOME_SHUTTER_PROPERTY_NAME, hw_int(device, "shutterstatus") == 0 ? DOME_SHUTTER_OPENED_ITEM_NAME : DOME_SHUTTER_CLOSED_ITEM_NAME), HW_ANSWER));
	}
	if (device->dome.can_park) {
		HW_CHECK(SA_WAIT(sa_switch(device->proxy, DOME_PARK_PROPERTY_NAME, DOME_PARK_PARKED_ITEM_NAME) == hw_bool(device, "atpark"), HW_ANSWER));
	}
	if (device->dome.can_slave) {
		HW_CHECK(SA_WAIT(sa_switch(device->proxy, "X_ALPACA_DOME_SLAVED", "ENABLED") == hw_bool(device, "slaved"), HW_ANSWER));
	}
cleanup:
	return;
}

static void hw_dome_slews(hw_device *device) {
	double azimuth = hw_double(device, "azimuth");
	HW_CHECK(hw_dome_unparked(device));
	HW_CHECK(hw_dome_azimuth(device, hw_angle(azimuth + 30)));
	HW_CHECK(hw_dome_azimuth(device, hw_angle(azimuth)));
cleanup:
	return;
}

static void hw_dome_altitude(hw_device *device) {
	static const char *items[] = { DOME_HORIZONTAL_COORDINATES_AZ_ITEM_NAME, DOME_HORIZONTAL_COORDINATES_ALT_ITEM_NAME };
	double azimuth = hw_double(device, "azimuth"), altitude = hw_double(device, "altitude");
	HW_CHECK(hw_dome_unparked(device));
	for (int i = 0; i < 2; i++) {
		double values[] = { azimuth, i == 0 ? (altitude > 45 ? altitude - 20 : altitude + 20) : altitude };
		HW_CHECK(hw_set_numbers(device->proxy, DOME_HORIZONTAL_COORDINATES_PROPERTY_NAME, 2, items, values, HW_MOTION) == INDIGO_OK_STATE);
		printf("    altitude %.1f: Altitude %.2f\n", values[1], hw_double(device, "altitude"));
		HW_CHECK(fabs(hw_double(device, "altitude") - values[1]) < 1);
	}
cleanup:
	return;
}

static void hw_dome_abort(hw_device *device) {
	double azimuth = hw_double(device, "azimuth");
	HW_CHECK(hw_dome_unparked(device));
	unsigned revision = sa_revision(device->proxy, DOME_HORIZONTAL_COORDINATES_PROPERTY_NAME);
	HW_CHECK(indigo_change_number_property_1(&sa_client, device->proxy, DOME_HORIZONTAL_COORDINATES_PROPERTY_NAME, DOME_HORIZONTAL_COORDINATES_AZ_ITEM_NAME, hw_angle(azimuth + 170)) == INDIGO_OK);
	HW_CHECK(SA_WAIT(hw_bool(device, "slewing"), HW_ANSWER));
	HW_CHECK(hw_set_switch(device->proxy, DOME_ABORT_MOTION_PROPERTY_NAME, DOME_ABORT_MOTION_ITEM_NAME, true, HW_ANSWER) == INDIGO_OK_STATE);
	HW_CHECK(SA_WAIT(sa_state(device->proxy, DOME_HORIZONTAL_COORDINATES_PROPERTY_NAME) != INDIGO_BUSY_STATE, HW_MOTION) && SA_WAIT(!hw_bool(device, "slewing"), HW_ANSWER));
	printf("    AbortSlew: Azimuth %.2f (from %.2f toward %.2f), state %d\n", hw_double(device, "azimuth"), azimuth, hw_angle(azimuth + 170), sa_state(device->proxy, DOME_HORIZONTAL_COORDINATES_PROPERTY_NAME));
	HW_CHECK(sa_state_after(device->proxy, DOME_HORIZONTAL_COORDINATES_PROPERTY_NAME, INDIGO_ALERT_STATE, revision));
	HW_CHECK(fabs(hw_angle_difference(hw_double(device, "azimuth"), azimuth + 170)) > 1);
	HW_CHECK(hw_dome_azimuth(device, azimuth));
cleanup:
	return;
}

static void hw_dome_find_home(hw_device *device) {
	HW_CHECK(hw_dome_unparked(device));
	HW_CHECK(hw_set_switch(device->proxy, DOME_HOME_PROPERTY_NAME, DOME_HOME_ITEM_NAME, true, HW_MOTION) == INDIGO_OK_STATE);
	HW_CHECK(SA_WAIT(hw_bool(device, "athome"), HW_ANSWER));
	printf("    FindHome: AtHome, Azimuth %.2f\n", hw_double(device, "azimuth"));
cleanup:
	return;
}

static void hw_dome_park(hw_device *device) {
	HW_CHECK(hw_dome_unparked(device));
	if (device->dome.can_set_azimuth) {
		HW_CHECK(hw_dome_azimuth(device, hw_angle(hw_double(device, "azimuth") + 20)));
	}
	HW_CHECK(hw_set_switch(device->proxy, DOME_PARK_PROPERTY_NAME, DOME_PARK_PARKED_ITEM_NAME, true, HW_MOTION) == INDIGO_OK_STATE);
	HW_CHECK(SA_WAIT(hw_bool(device, "atpark") && sa_switch(device->proxy, DOME_PARK_PROPERTY_NAME, DOME_PARK_PARKED_ITEM_NAME), HW_ANSWER));
	printf("    Park: AtPark, Azimuth %.2f\n", hw_double(device, "azimuth"));
	if (device->dome.can_set_azimuth) {
		// a slew leaves the park position (Alpaca has no unpark)
		HW_CHECK(hw_dome_unparked(device));
		HW_CHECK(hw_dome_azimuth(device, hw_angle(hw_double(device, "azimuth") + 20)));
		HW_CHECK(SA_WAIT(!hw_bool(device, "atpark"), HW_ANSWER));
	}
cleanup:
	return;
}

static void hw_dome_set_park(hw_device *device) {
	double original = NAN;
	HW_CHECK(hw_set_switch(device->proxy, DOME_PARK_PROPERTY_NAME, DOME_PARK_PARKED_ITEM_NAME, true, HW_MOTION) == INDIGO_OK_STATE);
	original = hw_double(device, "azimuth");
	HW_CHECK(hw_dome_unparked(device));
	HW_CHECK(hw_dome_azimuth(device, hw_angle(original + 40)));
	HW_CHECK(hw_set_switch(device->proxy, "X_ALPACA_DOME_PARK_SET", "CURRENT", true, HW_ANSWER) == INDIGO_OK_STATE);
	HW_CHECK(hw_dome_azimuth(device, hw_angle(original)));
	HW_CHECK(hw_set_switch(device->proxy, DOME_PARK_PROPERTY_NAME, DOME_PARK_PARKED_ITEM_NAME, true, HW_MOTION) == INDIGO_OK_STATE);
	HW_CHECK(SA_WAIT(hw_bool(device, "atpark"), HW_ANSWER));
	printf("    parked at the new park position: Azimuth %.2f (park was %.2f)\n", hw_double(device, "azimuth"), original);
	HW_CHECK(fabs(hw_angle_difference(hw_double(device, "azimuth"), original + 40)) < 1);
cleanup:
	if (!isnan(original)) {
		if (!hw_dome_unparked(device) || !hw_dome_azimuth(device, original) || hw_set_switch(device->proxy, "X_ALPACA_DOME_PARK_SET", "CURRENT", true, HW_ANSWER) != INDIGO_OK_STATE) {
			fprintf(stderr, "    the park position could not be set back to %.2f\n", original);
			indigo_test_failures++;
		} else {
			printf("    park position set back to %.2f\n", original);
		}
	}
	return;
}

static void hw_dome_sync(hw_device *device) {
	double azimuth = hw_double(device, "azimuth");
	HW_CHECK(hw_dome_unparked(device));
	HW_CHECK(hw_set_switch(device->proxy, DOME_ON_COORDINATES_SET_PROPERTY_NAME, DOME_ON_COORDINATES_SET_SYNC_ITEM_NAME, true, HW_ANSWER) == INDIGO_OK_STATE);
	for (int i = 0; i < 2; i++) {
		double target = i == 0 ? hw_angle(azimuth + 5) : azimuth;
		HW_CHECK(hw_set_number(device->proxy, DOME_HORIZONTAL_COORDINATES_PROPERTY_NAME, DOME_HORIZONTAL_COORDINATES_AZ_ITEM_NAME, target, HW_ANSWER) == INDIGO_OK_STATE);
		printf("    sync to %.2f: Azimuth %.2f\n", target, hw_double(device, "azimuth"));
		HW_CHECK(fabs(hw_angle_difference(hw_double(device, "azimuth"), target)) < 0.5);
	}
cleanup:
	hw_set_switch(device->proxy, DOME_ON_COORDINATES_SET_PROPERTY_NAME, DOME_ON_COORDINATES_SET_GOTO_ITEM_NAME, true, HW_ANSWER);
	return;
}

static bool hw_dome_shutter_to(hw_device *device, bool open) {
	int mark = sa_message_mark();
	int state = hw_set_switch(device->proxy, DOME_SHUTTER_PROPERTY_NAME, open ? DOME_SHUTTER_OPENED_ITEM_NAME : DOME_SHUTTER_CLOSED_ITEM_NAME, true, HW_MOTION);
	printf("    shutter %s: state %d, ShutterStatus %d\n", open ? "open" : "closed", state, hw_int(device, "shutterstatus"));
	if (state != INDIGO_OK_STATE) {
		hw_print_messages(mark);
		return false;
	}
	return hw_int(device, "shutterstatus") == (open ? 0 : 1);
}

static void hw_dome_shutter(hw_device *device) {
	bool open = device->dome.found_shutter == 0;
	HW_CHECK(hw_dome_shutter_to(device, !open));
	HW_CHECK(hw_dome_shutter_to(device, open));
cleanup:
	return;
}

static void hw_dome_restore(hw_device *device) {
	hw_dome *dome = &device->dome;
	if (dome->can_set_shutter && (dome->found_shutter == 0 || dome->found_shutter == 1) && hw_int(device, "shutterstatus") != dome->found_shutter) {
		HW_CHECK(hw_dome_shutter_to(device, dome->found_shutter == 0));
	}
	if (dome->found_parked && dome->can_park) {
		if (!hw_bool(device, "atpark")) {
			HW_CHECK(hw_set_switch(device->proxy, DOME_PARK_PROPERTY_NAME, DOME_PARK_PARKED_ITEM_NAME, true, HW_MOTION) == INDIGO_OK_STATE);
		}
	} else if (dome->can_set_azimuth && fabs(hw_angle_difference(hw_double(device, "azimuth"), dome->found_azimuth)) > 1) {
		HW_CHECK(hw_dome_unparked(device));
		HW_CHECK(hw_dome_azimuth(device, dome->found_azimuth));
	}
	printf("    Azimuth %.2f, AtPark %d, ShutterStatus %d, as found\n", hw_double(device, "azimuth"), hw_bool(device, "atpark"), hw_int(device, "shutterstatus"));
cleanup:
	return;
}

static void hw_probe_dome(hw_device *device) {
	hw_dome *dome = &device->dome;
	dome->can_set_azimuth = hw_bool(device, "cansetazimuth");
	dome->can_set_altitude = hw_bool(device, "cansetaltitude");
	dome->can_sync = hw_bool(device, "cansyncazimuth");
	dome->can_park = hw_bool(device, "canpark");
	dome->can_set_park = hw_bool(device, "cansetpark");
	dome->can_find_home = hw_bool(device, "canfindhome");
	dome->can_set_shutter = hw_bool(device, "cansetshutter");
	dome->can_slave = hw_bool(device, "canslave");
	dome->found_azimuth = hw_double(device, "azimuth");
	dome->found_shutter = hw_int(device, "shutterstatus");
	dome->found_parked = hw_bool(device, "atpark");
	printf("    CanSetAzimuth %d, CanSetAltitude %d, CanSyncAzimuth %d, CanPark %d, CanSetPark %d, CanFindHome %d, CanSetShutter %d, CanSlave %d; found Azimuth %.2f, ShutterStatus %d, AtPark %d\n", dome->can_set_azimuth, dome->can_set_altitude, dome->can_sync, dome->can_park, dome->can_set_park, dome->can_find_home, dome->can_set_shutter, dome->can_slave, dome->found_azimuth, dome->found_shutter, dome->found_parked);
	hw_add(device, "connect", hw_connect);
	hw_add(device, "readback", hw_dome_readback);
	hw_add_if(device, dome->can_set_azimuth, "azimuth", hw_dome_slews, "CanSetAzimuth is false");
	hw_add_if(device, dome->can_set_altitude, "altitude", hw_dome_altitude, "CanSetAltitude is false");
	hw_add_if(device, dome->can_set_azimuth, "abort", hw_dome_abort, "needs an azimuth slew to abort (CanSetAzimuth)");
	hw_add_if(device, dome->can_find_home, "find_home", hw_dome_find_home, "CanFindHome is false");
	hw_add_if(device, dome->can_park, "park", hw_dome_park, "CanPark is false");
	hw_add_if(device, dome->can_set_park && dome->can_park && dome->can_set_azimuth, "set_park", hw_dome_set_park, dome->can_set_park ? "needs CanPark and CanSetAzimuth to set the park position back" : "CanSetPark is false");
	hw_add_if(device, dome->can_sync, "sync", hw_dome_sync, "CanSyncAzimuth is false");
	hw_add_if(device, dome->can_set_shutter && (dome->found_shutter == 0 || dome->found_shutter == 1), "shutter", hw_dome_shutter, dome->can_set_shutter ? "the shutter is neither open nor closed" : "CanSetShutter is false");
	hw_add(device, "restore", hw_dome_restore);
	hw_add(device, "disconnect", hw_disconnect);
}

// ---------------------------------------------------------------------------- cover calibrator

static bool hw_cover_to(hw_device *device, bool open) {
	int mark = sa_message_mark();
	double started = indigo_monotonic_time();
	int state = hw_set_switch(device->proxy, AUX_COVER_PROPERTY_NAME, open ? AUX_COVER_OPEN_ITEM_NAME : AUX_COVER_CLOSE_ITEM_NAME, true, HW_MOTION);
	printf("    cover %s: state %d, CoverState %d after %.1f s\n", open ? "open" : "closed", state, hw_int(device, "coverstate"), indigo_monotonic_time() - started);
	if (state != INDIGO_OK_STATE) {
		hw_print_messages(mark);
		return false;
	}
	return hw_int(device, "coverstate") == (open ? 3 : 1) && sa_switch(device->proxy, AUX_COVER_PROPERTY_NAME, open ? AUX_COVER_OPEN_ITEM_NAME : AUX_COVER_CLOSE_ITEM_NAME);
}

static void hw_cover_readback(hw_device *device) {
	int cover = hw_int(device, "coverstate"), calibrator = hw_int(device, "calibratorstate");
	printf("    CoverState %d, CalibratorState %d, Brightness %d, MaxBrightness %d\n", cover, calibrator, hw_int(device, "brightness"), device->cover.max_brightness);
	if (cover == 1 || cover == 3) {
		HW_CHECK(SA_WAIT(sa_switch(device->proxy, AUX_COVER_PROPERTY_NAME, cover == 3 ? AUX_COVER_OPEN_ITEM_NAME : AUX_COVER_CLOSE_ITEM_NAME), HW_ANSWER));
	}
	if (calibrator == 1 || calibrator == 3) {
		HW_CHECK(SA_WAIT(sa_switch(device->proxy, AUX_LIGHT_SWITCH_PROPERTY_NAME, calibrator == 3 ? AUX_LIGHT_SWITCH_ON_ITEM_NAME : AUX_LIGHT_SWITCH_OFF_ITEM_NAME), HW_ANSWER));
	}
cleanup:
	return;
}

static void hw_cover_open_close(hw_device *device) {
	bool open = device->cover.found_cover == 3;
	HW_CHECK(hw_cover_to(device, !open));
	HW_CHECK(hw_cover_to(device, open));
cleanup:
	return;
}

static void hw_cover_halt(hw_device *device) {
	bool open = hw_int(device, "coverstate") == 3;
	unsigned revision = sa_revision(device->proxy, AUX_COVER_PROPERTY_NAME);
	HW_CHECK(indigo_change_switch_property_1(&sa_client, device->proxy, AUX_COVER_PROPERTY_NAME, open ? AUX_COVER_CLOSE_ITEM_NAME : AUX_COVER_OPEN_ITEM_NAME, true) == INDIGO_OK);
	HW_CHECK(SA_WAIT(hw_int(device, "coverstate") == 2 || (device->interface_version >= 2 && hw_bool(device, "covermoving")), HW_ANSWER));
	HW_CHECK(hw_set_switch(device->proxy, "X_ALPACA_COVER_ABORT_MOTION", "ABORT_MOTION", true, HW_ANSWER) == INDIGO_OK_STATE);
	HW_CHECK(SA_WAIT(sa_state(device->proxy, AUX_COVER_PROPERTY_NAME) != INDIGO_BUSY_STATE, HW_MOTION));
	printf("    HaltCover: CoverState %d, AUX_COVER state %d\n", hw_int(device, "coverstate"), sa_state(device->proxy, AUX_COVER_PROPERTY_NAME));
	HW_CHECK(hw_int(device, "coverstate") != 2);
	HW_CHECK(sa_state_after(device->proxy, AUX_COVER_PROPERTY_NAME, INDIGO_ALERT_STATE, revision) || hw_int(device, "coverstate") == (open ? 1 : 3));
	HW_CHECK(hw_cover_to(device, open));
cleanup:
	return;
}

static bool hw_light(hw_device *device, bool on) {
	int mark = sa_message_mark();
	int state = hw_set_switch(device->proxy, AUX_LIGHT_SWITCH_PROPERTY_NAME, on ? AUX_LIGHT_SWITCH_ON_ITEM_NAME : AUX_LIGHT_SWITCH_OFF_ITEM_NAME, true, HW_MOTION);
	printf("    calibrator %s: state %d, CalibratorState %d, Brightness %d\n", on ? "on" : "off", state, hw_int(device, "calibratorstate"), hw_int(device, "brightness"));
	if (state != INDIGO_OK_STATE) {
		hw_print_messages(mark);
		return false;
	}
	return hw_int(device, "calibratorstate") == (on ? 3 : 1);
}

static void hw_cover_calibrator(hw_device *device) {
	hw_cover *cover = &device->cover;
	bool intensity = sa_defined(device->proxy, AUX_LIGHT_INTENSITY_PROPERTY_NAME);
	int brightness = cover->max_brightness > 1 ? cover->max_brightness / 2 : 1;
	if (intensity) {
		HW_CHECK(hw_set_number(device->proxy, AUX_LIGHT_INTENSITY_PROPERTY_NAME, AUX_LIGHT_INTENSITY_ITEM_NAME, brightness, HW_MOTION) == INDIGO_OK_STATE);
	}
	HW_CHECK(hw_light(device, true));
	if (intensity) {
		HW_CHECK(hw_int(device, "brightness") == brightness);
		int other = brightness > 1 ? brightness / 2 : cover->max_brightness;
		HW_CHECK(hw_set_number(device->proxy, AUX_LIGHT_INTENSITY_PROPERTY_NAME, AUX_LIGHT_INTENSITY_ITEM_NAME, other, HW_MOTION) == INDIGO_OK_STATE);
		HW_CHECK(SA_WAIT(hw_int(device, "brightness") == other && hw_int(device, "calibratorstate") == 3, HW_MOTION));
		printf("    brightness %d while on\n", other);
	}
	HW_CHECK(hw_light(device, false));
cleanup:
	return;
}

static void hw_cover_restore(hw_device *device) {
	hw_cover *cover = &device->cover;
	if ((cover->found_cover == 1 || cover->found_cover == 3) && hw_int(device, "coverstate") != cover->found_cover) {
		HW_CHECK(hw_cover_to(device, cover->found_cover == 3));
	}
	if (cover->found_calibrator == 3) {
		if (sa_defined(device->proxy, AUX_LIGHT_INTENSITY_PROPERTY_NAME)) {
			HW_CHECK(hw_set_number(device->proxy, AUX_LIGHT_INTENSITY_PROPERTY_NAME, AUX_LIGHT_INTENSITY_ITEM_NAME, cover->found_brightness, HW_MOTION) == INDIGO_OK_STATE);
		}
		if (hw_int(device, "calibratorstate") != 3) {
			HW_CHECK(hw_light(device, true));
		}
	} else if (cover->found_calibrator == 1 && hw_int(device, "calibratorstate") != 1) {
		HW_CHECK(hw_light(device, false));
	}
	printf("    CoverState %d, CalibratorState %d, Brightness %d, as found\n", hw_int(device, "coverstate"), hw_int(device, "calibratorstate"), hw_int(device, "brightness"));
cleanup:
	return;
}

static void hw_probe_covercalibrator(hw_device *device) {
	hw_cover *cover = &device->cover;
	cover->found_cover = hw_int(device, "coverstate");
	cover->found_calibrator = hw_int(device, "calibratorstate");
	cover->found_brightness = hw_int(device, "brightness");
	cover->max_brightness = hw_int(device, "maxbrightness");
	bool has_cover = cover->found_cover > 0;
	bool has_calibrator = cover->found_calibrator > 0;
	printf("    CoverState %d, CalibratorState %d, Brightness %d, MaxBrightness %d\n", cover->found_cover, cover->found_calibrator, cover->found_brightness, cover->max_brightness);
	hw_add(device, "connect", hw_connect);
	hw_add(device, "readback", hw_cover_readback);
	hw_add_if(device, has_cover && (cover->found_cover == 1 || cover->found_cover == 3), "cover_open_close", hw_cover_open_close, has_cover ? "the cover is neither open nor closed" : "CoverState is NotPresent");
	hw_add_if(device, has_cover && sa_defined(device->proxy, "X_ALPACA_COVER_ABORT_MOTION") && (cover->found_cover == 1 || cover->found_cover == 3), "cover_halt", hw_cover_halt, has_cover ? "HaltCover not implemented" : "CoverState is NotPresent");
	hw_add_if(device, has_calibrator, "calibrator", hw_cover_calibrator, "CalibratorState is NotPresent");
	hw_add(device, "restore", hw_cover_restore);
	hw_add(device, "disconnect", hw_disconnect);
}

// ---------------------------------------------------------------------------- switch

// The property and item of the proxy that shows Alpaca switch id, from X_ALPACA_SWITCH_INFO ("<property>.<item>: <description>").
static bool hw_switch_item(hw_device *device, int id, char *property, char *item) {
	char name[INDIGO_NAME_SIZE], text[SA_TEXT_SIZE];
	snprintf(name, sizeof(name), "SWITCH_%d", id);
	snprintf(text, sizeof(text), "%s", sa_text(device->proxy, "X_ALPACA_SWITCH_INFO", name));
	char *dot = strchr(text, '.'), *colon = strstr(text, ": ");
	if (dot == NULL) {
		return false;
	}
	*dot = 0;
	if (colon != NULL) {
		*colon = 0;
	}
	snprintf(property, INDIGO_NAME_SIZE, "%s", text);
	snprintf(item, INDIGO_NAME_SIZE, "%s", dot + 1);
	return true;
}

static bool hw_switch_value(hw_device *device, int id, double *value) {
	char query[32];
	snprintf(query, sizeof(query), "Id=%d", id);
	return hw_read_double_q(device, "getswitchvalue", query, value);
}

// The proxy shows the value of the switch: a boolean outlet as its switch item, anything else as a number.
static bool hw_switch_shows(hw_device *device, const char *property, const char *item, double value) {
	if (!strcmp(property, AUX_GPIO_OUTLETS_PROPERTY_NAME)) {
		return sa_switch(device->proxy, property, item) == (value != 0);
	}
	return fabs(sa_number(device->proxy, property, item) - value) < 1e-6;
}

static void hw_switch_read(hw_device *device) {
	char property[INDIGO_NAME_SIZE], item[INDIGO_NAME_SIZE], name[INDIGO_VALUE_SIZE];
	for (int id = 0; id < device->sw.max_switch; id++) {
		double value = NAN;
		bool can_write = false;
		char query[32];
		snprintf(query, sizeof(query), "Id=%d", id);
		hw_read_bool_q(device, "canwrite", query, &can_write);
		int error_number = -1;
		const char *text = "";
		const alpaca_json_value *json = hw_get(device, "getswitchname", query, &error_number);
		if (error_number != 0 || !alpaca_json_get_string(json, &text)) {
			text = "";
		}
		snprintf(name, sizeof(name), "%s", text);
		HW_CHECK(hw_switch_value(device, id, &value));
		HW_CHECK(hw_switch_item(device, id, property, item));
		printf("    switch %d '%s' (%s): %g, %s.%s\n", id, name, can_write ? "writable" : "read only", value, property, item);
		HW_CHECK(SA_WAIT(hw_switch_value(device, id, &value) && hw_switch_shows(device, property, item, value), HW_ANSWER));
	}
cleanup:
	return;
}

static bool hw_switch_set(hw_device *device, int id, const char *property, const char *item, double value) {
	int mark = sa_message_mark();
	int state = !strcmp(property, AUX_GPIO_OUTLETS_PROPERTY_NAME) ? hw_set_switch(device->proxy, property, item, value != 0, HW_MOTION) : hw_set_number(device->proxy, property, item, value, HW_MOTION);
	double read = NAN;
	bool done = state == INDIGO_OK_STATE && SA_WAIT(hw_switch_value(device, id, &read) && fabs(read - value) < 1e-6, HW_ANSWER) && SA_WAIT(hw_switch_shows(device, property, item, value), HW_ANSWER);
	printf("    switch %d set to %g: state %d, GetSwitchValue %g\n", id, value, state, read);
	if (!done) {
		hw_print_messages(mark);
	}
	return done;
}

static void hw_switch_write(hw_device *device) {
	char property[INDIGO_NAME_SIZE], item[INDIGO_NAME_SIZE], query[32];
	int written = 0;
	for (int id = 0; id < device->sw.max_switch; id++) {
		bool can_write = false, can_async = false;
		double value = NAN, min = 0, max = 1, step = 1;
		snprintf(query, sizeof(query), "Id=%d", id);
		if (!hw_read_bool_q(device, "canwrite", query, &can_write) || !can_write) {
			continue;
		}
		if (device->interface_version >= 3) {
			hw_read_bool_q(device, "canasync", query, &can_async);
		}
		HW_CHECK(hw_switch_value(device, id, &value) && hw_switch_item(device, id, property, item));
		hw_read_double_q(device, "minswitchvalue", query, &min);
		hw_read_double_q(device, "maxswitchvalue", query, &max);
		hw_read_double_q(device, "switchstep", query, &step);
		double other = !strcmp(property, AUX_GPIO_OUTLETS_PROPERTY_NAME) ? (value != 0 ? 0 : 1) : (value + step <= max ? value + step : value - step);
		printf("    switch %d (%s.%s, %g .. %g step %g%s): %g -> %g -> %g\n", id, property, item, min, max, step, can_async ? ", asynchronous" : "", value, other, value);
		HW_CHECK(hw_switch_set(device, id, property, item, other));
		HW_CHECK(hw_switch_set(device, id, property, item, value));
		if (can_async) {
			bool complete = false;
			HW_CHECK(hw_read_bool_q(device, "statechangecomplete", query, &complete) && complete);
		}
		written++;
	}
	printf("    %d writable switch(es) changed and restored\n", written);
	HW_CHECK(written > 0);
cleanup:
	return;
}

static void hw_probe_switch(hw_device *device) {
	char query[32];
	int writable = 0;
	device->sw.max_switch = hw_int(device, "maxswitch");
	for (int id = 0; id < device->sw.max_switch; id++) {
		bool can_write = false;
		snprintf(query, sizeof(query), "Id=%d", id);
		writable += hw_read_bool_q(device, "canwrite", query, &can_write) && can_write;
	}
	printf("    MaxSwitch %d, %d writable\n", device->sw.max_switch, writable);
	hw_add(device, "connect", hw_connect);
	hw_add_if(device, device->sw.max_switch > 0, "read_all", hw_switch_read, "MaxSwitch is 0");
	hw_add_if(device, writable > 0, "write", hw_switch_write, "no switch is writable");
	hw_add(device, "disconnect", hw_disconnect);
}

// ---------------------------------------------------------------------------- observing conditions

typedef struct {
	const char *item;
	const char *member;
	double min, max;
} hw_sensor;

static const hw_sensor hw_sensors[] = {
	{ AUX_WEATHER_TEMPERATURE_ITEM_NAME, "temperature", -60, 60 },
	{ AUX_WEATHER_HUMIDITY_ITEM_NAME, "humidity", 0, 100 },
	{ AUX_WEATHER_DEWPOINT_ITEM_NAME, "dewpoint", -80, 60 },
	{ AUX_WEATHER_PRESSURE_ITEM_NAME, "pressure", 300, 1100 },
	{ AUX_WEATHER_WIND_SPEED_ITEM_NAME, "windspeed", 0, 100 },
	{ AUX_WEATHER_WIND_DIRECTION_ITEM_NAME, "winddirection", 0, 360 },
	{ "X_WIND_GUST", "windgust", 0, 150 },
	{ "X_RAIN_RATE", "rainrate", 0, 500 },
	{ "X_CLOUD_COVER", "cloudcover", 0, 100 },
	{ AUX_WEATHER_SKY_TEMPERATURE_ITEM_NAME, "skytemperature", -100, 60 },
	{ AUX_WEATHER_SKY_BRIGHTNESS_ITEM_NAME, "skyquality", -5, 30 },
	{ "X_SKY_ILLUMINANCE", "skybrightness", 0, 200000 },
	{ "X_STAR_FWHM", "starfwhm", 0, 60 }
};

static void hw_weather_sensors(hw_device *device) {
	int count = 0;
	for (int i = 0; i < (int)ARRAY_SIZE(hw_sensors); i++) {
		const hw_sensor *sensor = hw_sensors + i;
		double value = NAN;
		if (!hw_read_double(device, sensor->member, &value)) {
			HW_CHECK(!sa_has_item(device->proxy, AUX_WEATHER_PROPERTY_NAME, sensor->item));
			continue;
		}
		count++;
		HW_CHECK(sa_has_item(device->proxy, AUX_WEATHER_PROPERTY_NAME, sensor->item));
		printf("    %s %g, %s %g ('%s')\n", sensor->member, value, sensor->item, sa_number(device->proxy, AUX_WEATHER_PROPERTY_NAME, sensor->item), sa_text(device->proxy, "X_ALPACA_WEATHER_SENSORS", sensor->item));
		if (value < sensor->min || value > sensor->max) {
			fprintf(stderr, "    %s %g is outside the plausible range %g .. %g\n", sensor->member, value, sensor->min, sensor->max);
			HW_CHECK(false);
		}
		HW_CHECK(SA_WAIT(fabs(sa_number(device->proxy, AUX_WEATHER_PROPERTY_NAME, sensor->item) - hw_double(device, sensor->member)) <= 0.05 * fabs(value) + 0.5, HW_ANSWER));
	}
	printf("    %d sensor(s) implemented\n", count);
	HW_CHECK(count > 0);
	HW_CHECK(SA_WAIT(sa_state(device->proxy, AUX_WEATHER_PROPERTY_NAME) == INDIGO_OK_STATE, HW_ANSWER));
	if (sa_defined(device->proxy, "X_ALPACA_WEATHER_AGE")) {
		printf("    X_ALPACA_WEATHER_AGE %g s\n", sa_number(device->proxy, "X_ALPACA_WEATHER_AGE", "AGE"));
	}
cleanup:
	return;
}

static void hw_weather_average_period(hw_device *device) {
	double found = hw_double(device, "averageperiod");
	HW_CHECK(!isnan(found));
	HW_CHECK(SA_WAIT(fabs(sa_number(device->proxy, "X_ALPACA_WEATHER_AVERAGE_PERIOD", "PERIOD") - hw_double(device, "averageperiod")) < 1e-6, HW_ANSWER));
	double other = found == 0 ? 0.5 : 0;
	int mark = sa_message_mark();
	int state = hw_set_number(device->proxy, "X_ALPACA_WEATHER_AVERAGE_PERIOD", "PERIOD", other, HW_ANSWER);
	double read = hw_double(device, "averageperiod");
	printf("    AveragePeriod %g -> %g: state %d, AveragePeriod %g\n", found, other, state, read);
	if (state == INDIGO_ALERT_STATE && fabs(read - found) < 1e-6 && found == 0) {
		// a device without averaging accepts only 0 (InvalidValue for anything else), which the driver reports
		hw_print_messages(mark);
		printf("    the device accepts only an AveragePeriod of 0\n");
	} else {
		HW_CHECK(state == INDIGO_OK_STATE && fabs(read - other) < 1e-6);
		HW_CHECK(hw_set_number(device->proxy, "X_ALPACA_WEATHER_AVERAGE_PERIOD", "PERIOD", found, HW_ANSWER) == INDIGO_OK_STATE);
		HW_CHECK(fabs(hw_double(device, "averageperiod") - found) < 1e-6);
	}
cleanup:
	return;
}

static void hw_weather_refresh(hw_device *device) {
	HW_CHECK(hw_set_switch(device->proxy, "X_ALPACA_WEATHER_REFRESH", "REFRESH", true, HW_ANSWER) == INDIGO_OK_STATE);
	HW_CHECK(SA_WAIT(sa_state(device->proxy, AUX_WEATHER_PROPERTY_NAME) == INDIGO_OK_STATE, HW_ANSWER));
	printf("    Refresh answered OK\n");
cleanup:
	return;
}

static void hw_probe_observingconditions(hw_device *device) {
	hw_add(device, "connect", hw_connect);
	hw_add(device, "sensors", hw_weather_sensors);
	hw_add_if(device, sa_defined(device->proxy, "X_ALPACA_WEATHER_AVERAGE_PERIOD"), "average_period", hw_weather_average_period, "AveragePeriod not implemented");
	hw_add_if(device, sa_defined(device->proxy, "X_ALPACA_WEATHER_REFRESH"), "refresh", hw_weather_refresh, "Refresh not implemented");
	hw_add(device, "disconnect", hw_disconnect);
}

// ---------------------------------------------------------------------------- safety monitor

static void hw_safety_is_safe(hw_device *device) {
	bool safe = false;
	HW_CHECK(hw_read_bool(device, "issafe", &safe));
	printf("    IsSafe %d, X_ALPACA_SAFETY.SAFE %d, state %d\n", safe, sa_light(device->proxy, "X_ALPACA_SAFETY", "SAFE"), sa_state(device->proxy, "X_ALPACA_SAFETY"));
	HW_CHECK(SA_WAIT(hw_read_bool(device, "issafe", &safe) && sa_state(device->proxy, "X_ALPACA_SAFETY") == INDIGO_OK_STATE && sa_light(device->proxy, "X_ALPACA_SAFETY", "SAFE") == (safe ? INDIGO_OK_STATE : INDIGO_ALERT_STATE), HW_ANSWER));
cleanup:
	return;
}

static void hw_probe_safetymonitor(hw_device *device) {
	hw_add(device, "connect", hw_connect);
	hw_add(device, "is_safe", hw_safety_is_safe);
	hw_add(device, "disconnect", hw_disconnect);
}

// ---------------------------------------------------------------------------- discovery and selection

static bool hw_write_config(const char *targets) {
	FILE *file = sa_open_config();
	if (file == NULL) {
		return false;
	}
	fprintf(file, "<newSwitchVector device='" SA_BRIDGE "' name='X_ALPACA_DISCOVERY'>\n<oneSwitch name='ENABLED'>Off</oneSwitch>\n<oneSwitch name='DISABLED'>On</oneSwitch>\n</newSwitchVector>\n");
	fprintf(file, "<newNumberVector device='" SA_BRIDGE "' name='X_ALPACA_DISCOVERY_SETTINGS'>\n<oneNumber name='INTERVAL'>3600</oneNumber>\n<oneNumber name='TIMEOUT'>1000</oneNumber>\n<oneNumber name='POLLS'>2</oneNumber>\n<oneNumber name='RETENTION'>3</oneNumber>\n</newNumberVector>\n");
	fprintf(file, "<newTextVector device='" SA_BRIDGE "' name='X_ALPACA_DISCOVERY_TARGETS'>\n<oneText name='TARGETS'>%s</oneText>\n</newTextVector>\n", targets);
	fclose(file);
	return true;
}

static bool hw_driver_start(void) {
	if (hw_start() != INDIGO_OK) {
		return false;
	}
	if (indigo_attach_client(&sa_client) != INDIGO_OK || indigo_system_alpaca(INDIGO_DRIVER_INIT, NULL) != INDIGO_OK) {
		return false;
	}
	sa_driver_running = true;
	return SA_WAIT(sa_defined(SA_BRIDGE, "X_ALPACA_DEVICES") && sa_state(SA_BRIDGE, CONFIG_PROPERTY_NAME) != INDIGO_BUSY_STATE, SA_TIMEOUT);
}

static bool hw_matches(const char *filter, const char *name, const char *unique_id) {
	char copy[1024];
	if (filter == NULL || !*filter) {
		return true;
	}
	snprintf(copy, sizeof(copy), "%s", filter);
	for (char *token = strtok(copy, ","); token != NULL; token = strtok(NULL, ",")) {
		while (*token == ' ') {
			token++;
		}
		if (*token && (strcasestr(name, token) != NULL || strcasestr(unique_id, token) != NULL)) {
			return true;
		}
	}
	return false;
}

static hw_server *hw_server_for(const char *host, int port, const char *name) {
	for (int i = 0; i < hw_server_count; i++) {
		if (!strcmp(hw_servers[i].host, host) && hw_servers[i].port == port) {
			return hw_servers + i;
		}
	}
	if (hw_server_count == HW_MAX_SERVERS) {
		return NULL;
	}
	hw_server *server = hw_servers + hw_server_count++;
	snprintf(server->host, sizeof(server->host), "%s", host);
	server->port = port;
	snprintf(server->name, sizeof(server->name), "%s", name);
	server->http = alpaca_http_connection_create(host, port);
	alpaca_http_response_init(&server->response, 64 * 1024 * 1024);
	return server;
}

// Print the servers and devices the driver lists, and take the devices that match the filter.
static int hw_collect(const char *filter, char unselected[][INDIGO_NAME_SIZE], int *unselected_count) {
	typedef struct {
		char name[INDIGO_NAME_SIZE];
		char label[INDIGO_VALUE_SIZE];
		char text[SA_TEXT_SIZE];
	} row;
	static row rows[128];
	int count = 0;
	pthread_mutex_lock(&sa_cache_mutex);
	sa_cache_entry *servers = sa_cache_find(SA_BRIDGE, "X_ALPACA_SERVER_STATUS");
	printf("Alpaca servers:\n");
	for (int i = 0; servers != NULL && i < servers->property->count; i++) {
		printf("  %s '%s': %s\n", servers->property->items[i].name, servers->property->items[i].label, indigo_get_text_item_value(servers->property->items + i));
	}
	sa_cache_entry *status = sa_cache_find(SA_BRIDGE, "X_ALPACA_DEVICE_STATUS");
	sa_cache_entry *list = sa_cache_find(SA_BRIDGE, "X_ALPACA_DEVICES");
	for (int i = 0; status != NULL && i < status->property->count && count < 128; i++) {
		row *r = rows + count++;
		snprintf(r->name, sizeof(r->name), "%s", status->property->items[i].name);
		snprintf(r->text, sizeof(r->text), "%s", indigo_get_text_item_value(status->property->items + i));
		r->label[0] = 0;
		for (int j = 0; list != NULL && j < list->property->count; j++) {
			if (!strcmp(list->property->items[j].name, r->name)) {
				snprintf(r->label, sizeof(r->label), "%s", list->property->items[j].label);
			}
		}
	}
	pthread_mutex_unlock(&sa_cache_mutex);
	printf("Alpaca devices:\n");
	*unselected_count = 0;
	for (int i = 0; i < count; i++) {
		row *r = rows + i;
		char state[32] = { 0 }, type[32] = { 0 }, host[64] = { 0 }, unique_id[INDIGO_NAME_SIZE] = { 0 }, needle[64];
		int number = 0, port = 0;
		printf("  %s: %s\n", r->label, r->text);
		if (sscanf(r->text, "%31[^:]: %31s #%d at %63[^:]:%d, UniqueID %127[^,]", state, type, &number, host, &port, unique_id) != 6) {
			printf("    not tested: not listed by a server\n");
			continue;
		}
		snprintf(needle, sizeof(needle), " (%s) @ ", type);
		char *at = strstr(r->label, needle);
		char device_name[INDIGO_NAME_SIZE] = { 0 }, server_name[INDIGO_NAME_SIZE] = { 0 };
		if (at != NULL) {
			snprintf(device_name, sizeof(device_name), "%.*s", (int)(at - r->label), r->label);
			snprintf(server_name, sizeof(server_name), "%s", at + strlen(needle));
		} else {
			snprintf(device_name, sizeof(device_name), "%s", r->label);
		}
		if (strcmp(state, "ATTACHED") && strcmp(state, "AVAILABLE")) {
			printf("    not tested: %s\n", state);
			continue;
		}
		if (!hw_matches(filter, device_name, unique_id)) {
			printf("    not tested: not selected by SYSTEM_ALPACA_HW_DEVICES\n");
			snprintf(unselected[(*unselected_count)++], INDIGO_NAME_SIZE, "%s", unique_id);
			continue;
		}
		if (hw_device_count == HW_MAX_DEVICES) {
			printf("    not tested: more than %d devices\n", HW_MAX_DEVICES);
			continue;
		}
		hw_device *device = hw_devices + hw_device_count++;
		memset(device, 0, sizeof(*device));
		snprintf(device->key, sizeof(device->key), "%s", r->name);
		snprintf(device->device_name, sizeof(device->device_name), "%s", device_name);
		snprintf(device->type, sizeof(device->type), "%s", type);
		snprintf(device->unique_id, sizeof(device->unique_id), "%s", unique_id);
		for (int j = 0; type[j] && j < (int)sizeof(device->url_type) - 1; j++) {
			device->url_type[j] = (char)tolower((unsigned char)type[j]);
		}
		device->number = number;
		device->server = hw_server_for(host, port, server_name);
	}
	return hw_device_count;
}

// Name of the proxy, from the status of its key in X_ALPACA_DEVICE_STATUS; the case prefix is "<class>_<proxy name without ALPACA>".
static bool hw_proxy_ready(hw_device *device) {
	if (!SA_WAIT(sa_device_status_is(device->key, "ATTACHED") && *sa_proxy_name(device->key), HW_ANSWER)) {
		return false;
	}
	snprintf(device->proxy, sizeof(device->proxy), "%s", sa_proxy_name(device->key));
	const char *name = !strncmp(device->proxy, "ALPACA ", 7) ? device->proxy + 7 : device->proxy;
	size_t length = (size_t)snprintf(device->prefix, sizeof(device->prefix), "%s_", device->url_type);
	for (const char *c = name; *c && length < sizeof(device->prefix) - 1; c++) {
		char lower = (char)tolower((unsigned char)*c);
		if (isalnum((unsigned char)lower)) {
			device->prefix[length++] = lower;
		} else if (device->prefix[length - 1] != '_') {
			device->prefix[length++] = '_';
		}
	}
	while (length > 0 && device->prefix[length - 1] == '_') {
		length--;
	}
	device->prefix[length] = 0;
	return SA_WAIT(sa_defined(device->proxy, CONNECTION_PROPERTY_NAME), HW_ANSWER);
}

// Connect the device once, find out what it advertises and register its cases.
static void hw_probe(hw_device *device) {
	printf("\n%s: %s #%d '%s' on '%s' %s:%d, UniqueID %s\n", device->proxy, device->type, device->number, device->device_name, device->server->name, device->server->host, device->server->port, device->unique_id);
	device->found_connected = hw_alpaca_connected(device);
	device->interface_version = hw_int(device, "interfaceversion");
	printf("    interface version %d, %s before the run\n", device->interface_version, device->found_connected ? "connected (for another client)" : "not connected");
	device->connected = hw_connect_proxy(device->proxy);
	if (!device->connected) {
		hw_add(device, "connect", hw_connect);
		hw_skip(device, "all_functions", "the device did not connect");
		return;
	}
	if (!strcmp(device->url_type, "telescope")) {
		hw_probe_telescope(device);
	} else if (!strcmp(device->url_type, "camera")) {
		hw_probe_camera(device);
	} else if (!strcmp(device->url_type, "focuser")) {
		hw_probe_focuser(device);
	} else if (!strcmp(device->url_type, "filterwheel")) {
		hw_probe_wheel(device);
	} else if (!strcmp(device->url_type, "rotator")) {
		hw_probe_rotator(device);
	} else if (!strcmp(device->url_type, "dome")) {
		hw_probe_dome(device);
	} else if (!strcmp(device->url_type, "covercalibrator")) {
		hw_probe_covercalibrator(device);
	} else if (!strcmp(device->url_type, "switch")) {
		hw_probe_switch(device);
	} else if (!strcmp(device->url_type, "observingconditions")) {
		hw_probe_observingconditions(device);
	} else if (!strcmp(device->url_type, "safetymonitor")) {
		hw_probe_safetymonitor(device);
	} else {
		hw_add(device, "connect", hw_connect);
		hw_add(device, "disconnect", hw_disconnect);
	}
	for (int i = 0; i < hw_step_count; i++) {
		if (hw_steps[i].device == device && *hw_steps[i].reason) {
			printf("    SKIP %s: %s\n", hw_steps[i].name, hw_steps[i].reason);
		}
	}
}

// A device that was connected for another client before the run is connected again (D5 disconnected it for every client).
static void hw_give_back(hw_device *device) {
	if (device->found_connected && !device->alpaca_restored && device->server != NULL && !hw_alpaca_connected(device)) {
		int error_number = hw_put(device, "connected", "Connected=True");
		device->alpaca_restored = true;
		printf("%s was connected before the run: Connected=True sent again, ErrorNumber %d, Connected %d\n", device->proxy, error_number, hw_alpaca_connected(device));
	}
}

static void hw_print_summary(void) {
	printf("\nSummary per device:\n");
	for (int d = 0; d < hw_device_count; d++) {
		hw_device *device = hw_devices + d;
		int passed = 0, failed = 0, skipped = 0;
		printf("  %s (%s '%s' on '%s' %s:%d)\n", device->proxy, device->type, device->device_name, device->server->name, device->server->host, device->server->port);
		for (int i = 0; i < hw_step_count; i++) {
			hw_step *step = hw_steps + i;
			if (step->device != device) {
				continue;
			}
			if (*step->reason) {
				printf("    SKIP %-22s %s\n", step->function, step->reason);
				skipped++;
			} else {
				printf("    %s %s\n", step->result > 0 ? "PASS" : step->result < 0 ? "FAIL" : "----", step->function);
				passed += step->result > 0;
				failed += step->result < 0;
			}
		}
		printf("    %d passed, %d failed, %d skipped\n", passed, failed, skipped);
		if (!strcmp(device->url_type, "telescope") && (device->mount.axes != NULL || device->mount.settle > 0)) {
			printf("    settings the telescope needs: X_ALPACA_MOUNT_AXES.%s, X_ALPACA_SETTLE_TIME %.1f s\n", device->mount.axes != NULL ? device->mount.axes : "MECHANICAL (not measured)", device->mount.settle);
		}
	}
}

int main(int argc, char **argv) {
	static char unselected[128][INDIGO_NAME_SIZE];
	static indigo_test_case cases[HW_MAX_STEPS];
	const char *ids[128];
	int unselected_count = 0, case_count = 0, result = 1;
	if (argc < 2 || strcmp(argv[1], "--run")) {
		fprintf(stderr, "system_alpaca hardware test: run explicitly with --run (or make test-system-alpaca-hw).\n");
		fprintf(stderr, "Every function of every Alpaca device found is exercised. A TELESCOPE MOVES; domes, covers and rotators move.\n");
		return 2;
	}
	setvbuf(stdout, NULL, _IOLBF, 0);
	if (!indigo_test_use_private_home()) {
		return 1;
	}
	for (int i = 2; i < argc; i++) {
		if (!strcmp(argv[i], "--debug")) {
			indigo_set_log_level(INDIGO_LOG_DEBUG);
		}
	}
	const char *port = hw_port("SYSTEM_ALPACA_HW_PORT");
	const char *filter = getenv("SYSTEM_ALPACA_HW_DEVICES");
	printf("%s: servers %s, devices %s\n", SUITE_NAME, port != NULL ? port : "by broadcast discovery", filter != NULL && *filter ? filter : "all");
	// with explicit servers the discovery request goes to a loopback port nobody listens on, so nothing is broadcast
	SA_CHECK(hw_write_config(port != NULL ? "127.0.0.1:9" : ""));
	SA_CHECK(hw_driver_start());
	if (port != NULL) {
		char copy[1024];
		snprintf(copy, sizeof(copy), "%s", port);
		for (char *token = strtok(copy, ", "); token != NULL; token = strtok(NULL, ", ")) {
			int state = sa_set_text("X_ALPACA_SERVERS", "ADD", token);
			printf("server %s added: state %d\n", token, state);
			SA_CHECK(state == INDIGO_OK_STATE);
		}
	}
	SA_CHECK(sa_discover());
	// a discovery cycle attaches every device found (D15); give the attach a moment to settle
	SA_WAIT(sa_status_count("ATTACHED") > 0 && sa_status_count("ATTACHED") + sa_status_count("UNSUPPORTED") + sa_status_count("FAILED") == sa_item_count(SA_BRIDGE, "X_ALPACA_DEVICE_STATUS"), HW_ANSWER);
	if (hw_collect(filter, unselected, &unselected_count) == 0) {
		fprintf(stderr, "%s: no Alpaca device to test was found\n", SUITE_NAME);
		goto cleanup;
	}
	if (unselected_count > 0) {
		for (int i = 0; i < unselected_count; i++) {
			ids[i] = unselected[i];
		}
		SA_CHECK(sa_switch_off(ids, unselected_count));
	}
	for (int d = 0; d < hw_device_count; d++) {
		if (!hw_proxy_ready(hw_devices + d)) {
			fprintf(stderr, "'%s' got no proxy device: %s\n", hw_devices[d].device_name, sa_device_status(hw_devices[d].key));
			snprintf(hw_devices[d].proxy, sizeof(hw_devices[d].proxy), "%s", hw_devices[d].device_name);
			snprintf(hw_devices[d].prefix, sizeof(hw_devices[d].prefix), "%s_unattached_%d", hw_devices[d].url_type, d);
			hw_skip(hw_devices + d, "all_functions", "no proxy device was attached");
			continue;
		}
		hw_probe(hw_devices + d);
	}
	SA_CHECK(indigo_attach_client(&hw_image_client) == INDIGO_OK);
	for (int i = 0; i < hw_step_count; i++) {
		if (hw_steps[i].run != NULL) {
			cases[case_count++] = (indigo_test_case){ hw_steps[i].name, hw_run_step };
		}
	}
	printf("\n%d case(s) for %d device(s)\n", case_count, hw_device_count);
	// every case is tagged with its proxy device before any case runs, so the recorded run gets one line per device (with the model the
	// device record of the proxy gives it, the Alpaca Description) and the counts of that device's own cases
	for (int i = 0; i < hw_step_count; i++) {
		if (hw_steps[i].run != NULL) {
			char title[INDIGO_NAME_SIZE + 64];
			snprintf(title, sizeof(title), "%s: %s", SUITE_NAME, hw_steps[i].device->proxy);
			hw_record_case_device(title, hw_steps[i].name, "indigo_system_alpaca", hw_steps[i].device->proxy);
		}
	}
	for (int d = 0; d < hw_device_count; d++) {
		pthread_mutex_lock(&hw_image_mutex);
		snprintf(hw_image_device, sizeof(hw_image_device), "%s", hw_devices[d].proxy);
		pthread_mutex_unlock(&hw_image_mutex);
		int first = -1, count = 0;
		for (int i = 0; i < case_count; i++) {
			for (int s = 0; s < hw_step_count; s++) {
				if (hw_steps[s].run != NULL && hw_steps[s].name == cases[i].name && hw_steps[s].device == hw_devices + d) {
					first = first < 0 ? i : first;
					count++;
				}
			}
		}
		if (count > 0) {
			char title[INDIGO_NAME_SIZE + 64];
			snprintf(title, sizeof(title), "%s: %s", SUITE_NAME, hw_devices[d].proxy);
			if (indigo_run_tests(title, cases + first, count) != 0) {
				result = 1;
			}
		}
		hw_give_back(hw_devices + d);
	}
	hw_print_summary();
	result = 0;
	for (int i = 0; i < hw_step_count; i++) {
		result |= hw_steps[i].run != NULL && hw_steps[i].result <= 0;
	}
cleanup:
	indigo_detach_client(&hw_image_client);
	for (int d = 0; d < hw_device_count; d++) {
		if (*hw_devices[d].guider && sa_defined(hw_devices[d].guider, CONNECTION_PROPERTY_NAME) && sa_is_connected(hw_devices[d].guider)) {
			hw_disconnect_proxy(hw_devices[d].guider);
		}
		if (sa_defined(hw_devices[d].proxy, CONNECTION_PROPERTY_NAME) && !sa_is_disconnected(hw_devices[d].proxy)) {
			hw_disconnect_proxy(hw_devices[d].proxy);
		}
		hw_give_back(hw_devices + d);
	}
	sa_end();
	for (int s = 0; s < hw_server_count; s++) {
		alpaca_http_connection_free(hw_servers[s].http);
		alpaca_http_response_free(&hw_servers[s].response);
	}
	alpaca_json_free(hw_reply);
	indigo_safe_free(hw_image);
	indigo_test_remove_private_home();
	return indigo_test_failures != 0 ? 1 : result;
}
