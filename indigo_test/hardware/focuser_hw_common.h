// Copyright (c) 2026 INDIGO initiative
// All rights reserved.
//
// You may use this software under the terms of 'INDIGO Astronomy
// open-source license' (see LICENSE.md).
//
// THIS SOFTWARE IS PROVIDED BY THE AUTHORS 'AS IS' AND ANY EXPRESS
// OR IMPLIED WARRANTIES, INCLUDING, BUT NOT LIMITED TO, THE IMPLIED
// WARRANTIES OF MERCHANTABILITY AND FITNESS FOR A PARTICULAR PURPOSE
// ARE DISCLAIMED. IN NO EVENT SHALL THE AUTHOR BE LIABLE FOR ANY
// DIRECT, INDIRECT, INCIDENTAL, SPECIAL, EXEMPLARY, OR CONSEQUENTIAL
// DAMAGES (INCLUDING, BUT NOT LIMITED TO, PROCUREMENT OF SUBSTITUTE
// GOODS OR SERVICES; LOSS OF USE, DATA, OR PROFITS; OR BUSINESS
// INTERRUPTION) HOWEVER CAUSED AND ON ANY THEORY OF LIABILITY,
// WHETHER IN CONTRACT, STRICT LIABILITY, OR TORT (INCLUDING
// NEGLIGENCE OR OTHERWISE) ARISING IN ANY WAY OUT OF THE USE OF THIS
// SOFTWARE, EVEN IF ADVISED OF THE POSSIBILITY OF SUCH DAMAGE.

// Code is generated by AI

// Focuser helpers shared by the focuser hardware suites: absolute and relative moves that wait for the
// request to settle, abort and number/switch requests, on top of hardware_test_common.h.

#ifndef focuser_hw_common_h
#define focuser_hw_common_h

#include <math.h>
#include "hardware_test_common.h"

static double focuser_hw_value(int d, const char *property, const char *item) {
	double value = NAN;
	hw_number_item(d, property, item, &value);
	return value;
}

static double focuser_hw_position(int d) {
	return focuser_hw_value(d, FOCUSER_POSITION_PROPERTY_NAME, FOCUSER_POSITION_ITEM_NAME);
}

static bool focuser_hw_switch_is(int d, const char *property, const char *item) {
	bool value = false;
	return hw_switch_item(d, property, item, &value) && value;
}

// Waits until a property is not BUSY, whatever state it ends in.
static bool focuser_hw_idle(int d, const char *property, double timeout) {
	double deadline = indigo_monotonic_time() + timeout;
	while (indigo_monotonic_time() < deadline) {
		if (hw_property_state(d, property) != INDIGO_BUSY_STATE) {
			return true;
		}
		indigo_usleep(10000);
	}
	fprintf(stderr, "    timeout: %s stays BUSY\n", property);
	return false;
}

// Waits for a request published after revision `before` to leave BUSY and checks the state it ends in.
static bool focuser_hw_settles(int d, const char *property, unsigned before, indigo_property_state expected, double timeout) {
	double deadline = indigo_monotonic_time() + timeout;
	while (indigo_monotonic_time() < deadline) {
		indigo_property_state state = hw_property_state(d, property);
		if (hw_revision(d, property) > before && state != INDIGO_BUSY_STATE) {
			if (state != expected) {
				fprintf(stderr, "    %s ended in state %d, expected %d\n", property, state, expected);
			}
			return state == expected;
		}
		indigo_usleep(10000);
	}
	fprintf(stderr, "    timeout: %s did not settle (state %d)\n", property, hw_property_state(d, property));
	return false;
}

// An absolute move that ends in the expected state; an OK move has to end at the target.
static bool focuser_hw_goto(int d, double target, indigo_property_state expected, double timeout) {
	if (!focuser_hw_idle(d, FOCUSER_POSITION_PROPERTY_NAME, timeout)) {
		return false;
	}
	unsigned before = hw_revision(d, FOCUSER_POSITION_PROPERTY_NAME);
	hw_request_number(d, FOCUSER_POSITION_PROPERTY_NAME, FOCUSER_POSITION_ITEM_NAME, target);
	if (!focuser_hw_settles(d, FOCUSER_POSITION_PROPERTY_NAME, before, expected, timeout)) {
		return false;
	}
	if (expected == INDIGO_OK_STATE && focuser_hw_position(d) != target) {
		fprintf(stderr, "    position %g, expected %g\n", focuser_hw_position(d), target);
		return false;
	}
	return true;
}

// A relative move; FOCUSER_DIRECTION is set first.
static bool focuser_hw_steps(int d, bool outward, double steps, indigo_property_state expected, double timeout) {
	if (!focuser_hw_idle(d, FOCUSER_STEPS_PROPERTY_NAME, timeout) || !focuser_hw_idle(d, FOCUSER_POSITION_PROPERTY_NAME, timeout)) {
		return false;
	}
	if (!hw_set_switch(d, FOCUSER_DIRECTION_PROPERTY_NAME, outward ? FOCUSER_DIRECTION_MOVE_OUTWARD_ITEM_NAME : FOCUSER_DIRECTION_MOVE_INWARD_ITEM_NAME, INDIGO_OK_STATE, timeout)) {
		return false;
	}
	unsigned before = hw_revision(d, FOCUSER_STEPS_PROPERTY_NAME);
	hw_request_number(d, FOCUSER_STEPS_PROPERTY_NAME, FOCUSER_STEPS_ITEM_NAME, steps);
	return focuser_hw_settles(d, FOCUSER_STEPS_PROPERTY_NAME, before, expected, timeout) && focuser_hw_idle(d, FOCUSER_POSITION_PROPERTY_NAME, timeout);
}

// Starts an absolute move and returns once it is BUSY.
static bool focuser_hw_start_goto(int d, double target, double timeout) {
	if (!focuser_hw_idle(d, FOCUSER_POSITION_PROPERTY_NAME, timeout)) {
		return false;
	}
	unsigned before = hw_revision(d, FOCUSER_POSITION_PROPERTY_NAME);
	hw_request_number(d, FOCUSER_POSITION_PROPERTY_NAME, FOCUSER_POSITION_ITEM_NAME, target);
	return hw_wait_state(d, FOCUSER_POSITION_PROPERTY_NAME, before, INDIGO_BUSY_STATE, timeout);
}

static bool focuser_hw_abort(int d, double timeout) {
	return hw_set_switch(d, FOCUSER_ABORT_MOTION_PROPERTY_NAME, FOCUSER_ABORT_MOTION_ITEM_NAME, INDIGO_OK_STATE, timeout);
}

// A number request that settles in the expected state.
static bool focuser_hw_set_number(int d, const char *property, const char *item, double value, indigo_property_state expected, double timeout) {
	if (!focuser_hw_idle(d, property, timeout)) {
		return false;
	}
	unsigned before = hw_revision(d, property);
	hw_request_number(d, property, item, value);
	return focuser_hw_settles(d, property, before, expected, timeout);
}

// A switch request that settles OK with the item on.
static bool focuser_hw_set_switch(int d, const char *property, const char *item, double timeout) {
	if (!focuser_hw_idle(d, property, timeout)) {
		return false;
	}
	unsigned before = hw_revision(d, property);
	hw_request_switch(d, property, item, true);
	return focuser_hw_settles(d, property, before, INDIGO_OK_STATE, timeout) && focuser_hw_switch_is(d, property, item);
}

#endif /* focuser_hw_common_h */
