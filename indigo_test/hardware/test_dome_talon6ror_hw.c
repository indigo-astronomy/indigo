// Copyright (c) 2026 INDIGO initiative
// All rights reserved.
//
// You may use this software under the terms of 'INDIGO Astronomy
// open-source license' (see LICENSE.md).
//
// THIS SOFTWARE IS PROVIDED BY THE AUTHORS 'AS IS' AND ANY EXPRESS
// OR IMPLIED WARRANTIES, INCLUDING, BUT NOT LIMITED TO, THE IMPLIED
// WARRANTIES OF MERCHANTABILITY AND FITNESS FOR A PARTICULAR PURPOSE
// ARE DISCLAIMED. IN NO EVENT SHALL THE AUTHOR BE LIABLE FOR ANY
// DIRECT, INDIRECT, INCIDENTAL, SPECIAL, EXEMPLARY, OR CONSEQUENTIAL
// DAMAGES (INCLUDING, BUT NOT LIMITED TO, PROCUREMENT OF SUBSTITUTE
// GOODS OR SERVICES; LOSS OF USE, DATA, OR PROFITS; OR BUSINESS
// INTERRUPTION) HOWEVER CAUSED AND ON ANY THEORY OF LIABILITY,
// WHETHER IN CONTRACT, STRICT LIABILITY, OR TORT (INCLUDING
// NEGLIGENCE OR OTHERWISE) ARISING IN ANY WAY OUT OF THE USE OF THIS
// SOFTWARE, EVEN IF ADVISED OF THE POSSIBILITY OF SUCH DAMAGE.

// Code is generated by AI

// Opt-in acceptance test for a physically connected Talon6 roll-off roof controller, or for the Arduino
// sketch dome_talon6ror_simulator.ino running on a board. It reads the firmware, the configuration, the
// status and the sensors, opens and closes the roof, aborts an opening and closes the roof from where it
// stopped, writes a delay to the configuration and reads it back, reconnects and runs driver INIT/SHUTDOWN.
//
// THE ROOF MOVES. The session returns the roof to the state it found and writes back the configuration it
// found.
//
// The port comes from TALON6_HW_PORT.

#include <math.h>
#include <stdlib.h>
#include <indigo_drivers/dome_talon6ror/indigo_dome_talon6ror.h>
#include "dome_hw_common.h"

#define DEVICE_NAME "Talon6 ROR"

#define SHORT_TIMEOUT 15.0
#define MOTION_TIMEOUT 180.0

static int roof = -1;
static const char *serial_port = NULL;
static bool state_captured = false, roof_was_open = false;
static double initial_park_delay = 0;

static bool select_port(void) {
	if (serial_port == NULL || !*serial_port) {
		fprintf(stderr, "    set TALON6_HW_PORT to the controller's port\n");
		return false;
	}
	printf("Using port %s\n", serial_port);
	return hw_set_text(roof, DEVICE_PORT_PROPERTY_NAME, DEVICE_PORT_ITEM_NAME, serial_port, INDIGO_OK_STATE, SHORT_TIMEOUT);
}

static double value_of(const char *property, const char *item) {
	double value = NAN;
	hw_number_item(roof, property, item, &value);
	return value;
}

// The status poll defines the sensors and reports the supply voltage.
static bool wait_for_first_poll(void) {
	double deadline = indigo_monotonic_time() + SHORT_TIMEOUT;
	while (indigo_monotonic_time() < deadline) {
		if (hw_property_defined(roof, "X_SENSORS") && value_of("X_STATUS_PROPERTY", "VOLTAGE") > 0) {
			indigo_usleep(1000000);
			return true;
		}
		indigo_usleep(10000);
	}
	fprintf(stderr, "    no status was read\n");
	return false;
}

static bool set_park_delay(double value) {
	if (!dome_hw_idle(roof, "X_DELAY_CONF", SHORT_TIMEOUT)) {
		return false;
	}
	unsigned before = hw_revision(roof, "X_DELAY_CONF");
	indigo_change_number_property_1(&hw_client, DEVICE_NAME, "X_DELAY_CONF", "PARK", value);
	return dome_hw_settles(roof, "X_DELAY_CONF", before, INDIGO_OK_STATE, SHORT_TIMEOUT) && value_of("X_DELAY_CONF", "PARK") == value;
}

static bool capture_state(void) {
	if (!wait_for_first_poll() || !dome_hw_idle(roof, DOME_SHUTTER_PROPERTY_NAME, MOTION_TIMEOUT)) {
		return false;
	}
	roof_was_open = dome_hw_switch_is(roof, DOME_SHUTTER_PROPERTY_NAME, DOME_SHUTTER_OPENED_ITEM_NAME);
	initial_park_delay = value_of("X_DELAY_CONF", "PARK");
	printf("    roof %s, position %g, park delay %g\n", roof_was_open ? "open" : dome_hw_switch_is(roof, DOME_SHUTTER_PROPERTY_NAME, DOME_SHUTTER_CLOSED_ITEM_NAME) ? "closed" : "between", value_of("X_POSITION_PROPERTY", "POSITION"), initial_park_delay);
	return !isnan(initial_park_delay);
}

static void restore_initial_state(void) {
	if (roof < 0 || !state_captured || !hw_connected(roof)) {
		return;
	}
	if (value_of("X_DELAY_CONF", "PARK") != initial_park_delay) {
		set_park_delay(initial_park_delay);
	}
	if (!dome_hw_switch_is(roof, DOME_SHUTTER_PROPERTY_NAME, roof_was_open ? DOME_SHUTTER_OPENED_ITEM_NAME : DOME_SHUTTER_CLOSED_ITEM_NAME)) {
		dome_hw_open_close(roof, DOME_SHUTTER_PROPERTY_NAME, roof_was_open, INDIGO_OK_STATE, MOTION_TIMEOUT);
	}
}

static void talon6_publishes_the_property_contract(void) {
	char firmware[INDIGO_VALUE_SIZE] = "";
	ASSERT_TRUE((hw_device_interface(roof) & INDIGO_INTERFACE_DOME) != 0);
	ASSERT_TRUE(hw_text_item(roof, INFO_PROPERTY_NAME, INFO_DEVICE_FW_REVISION_ITEM_NAME, firmware, sizeof(firmware)));
	double voltage = value_of("X_STATUS_PROPERTY", "VOLTAGE");
	printf("    firmware %s, %.2f V, KP %g, full travel %g\n", firmware, voltage, value_of("X_MOTOR_CONF", "KP"), value_of("X_MOTOR_CONF", "FULL_ENC"));
	ASSERT_TRUE(*firmware && strcmp(firmware, "Unknown"));
	ASSERT_TRUE(voltage > 5 && voltage < 30);
	static const char *properties[] = { "X_SENSORS", "X_MOTOR_CONF", "X_DELAY_CONF", "X_CLOSE_COND", "X_TIMER_COND", "X_POSITION_PROPERTY", "X_STATUS_PROPERTY" };
	for (int i = 0; i < ARRAY_SIZE(properties); i++) {
		ASSERT_TRUE(hw_property_defined(roof, properties[i]));
	}
	ASSERT_TRUE(value_of("X_MOTOR_CONF", "FULL_ENC") > 0);
	ASSERT_TRUE(hw_property_hidden(roof, DOME_HORIZONTAL_COORDINATES_PROPERTY_NAME));
}

// The open and close sensors follow the roof.
static void talon6_opens_and_closes_the_roof(void) {
	bool open = dome_hw_switch_is(roof, DOME_SHUTTER_PROPERTY_NAME, DOME_SHUTTER_OPENED_ITEM_NAME);
	for (int i = 0; i < 2; i++) {
		open = !open;
		ASSERT_TRUE(dome_hw_open_close(roof, DOME_SHUTTER_PROPERTY_NAME, open, INDIGO_OK_STATE, MOTION_TIMEOUT));
		indigo_usleep(1500000);
		indigo_property_state sensor = INDIGO_IDLE_STATE;
		ASSERT_TRUE(hw_light_item(roof, "X_SENSORS", open ? "OPEN_SENSOR" : "CLOSE_SENSOR", &sensor));
		printf("    roof %s at %g, sensor state %d\n", open ? "open" : "closed", value_of("X_POSITION_PROPERTY", "POSITION"), sensor);
		ASSERT_EQ_INT(INDIGO_OK_STATE, sensor);
		ASSERT_TRUE(open ? value_of("X_POSITION_PROPERTY", "POSITION") > 0 : value_of("X_POSITION_PROPERTY", "POSITION") == 0);
	}
}

// An aborted opening leaves the roof between the ends with no shutter state; it closes from there.
static void talon6_aborts_an_opening(void) {
	if (dome_hw_switch_is(roof, DOME_SHUTTER_PROPERTY_NAME, DOME_SHUTTER_OPENED_ITEM_NAME)) {
		ASSERT_TRUE(dome_hw_open_close(roof, DOME_SHUTTER_PROPERTY_NAME, false, INDIGO_OK_STATE, MOTION_TIMEOUT));
	}
	unsigned before = hw_revision(roof, DOME_SHUTTER_PROPERTY_NAME);
	indigo_change_switch_property_1(&hw_client, DEVICE_NAME, DOME_SHUTTER_PROPERTY_NAME, DOME_SHUTTER_OPENED_ITEM_NAME, true);
	ASSERT_TRUE(hw_wait_state(roof, DOME_SHUTTER_PROPERTY_NAME, before, INDIGO_BUSY_STATE, SHORT_TIMEOUT));
	indigo_usleep(4000000);
	ASSERT_TRUE(dome_hw_abort(roof, SHORT_TIMEOUT));
	ASSERT_TRUE(dome_hw_idle(roof, DOME_SHUTTER_PROPERTY_NAME, SHORT_TIMEOUT));
	indigo_usleep(2000000);
	double stopped = value_of("X_POSITION_PROPERTY", "POSITION");
	printf("    stopped at %g of %g, shutter state %d\n", stopped, value_of("X_MOTOR_CONF", "FULL_ENC"), hw_property_state(roof, DOME_SHUTTER_PROPERTY_NAME));
	ASSERT_TRUE(stopped > 0);
	ASSERT_TRUE(!dome_hw_switch_is(roof, DOME_SHUTTER_PROPERTY_NAME, DOME_SHUTTER_OPENED_ITEM_NAME));
	indigo_usleep(2000000);
	ASSERT_TRUE(value_of("X_POSITION_PROPERTY", "POSITION") == stopped);
	ASSERT_TRUE(dome_hw_open_close(roof, DOME_SHUTTER_PROPERTY_NAME, false, INDIGO_OK_STATE, MOTION_TIMEOUT));
}

// A configuration write is confirmed by the configuration the controller sends back.
static void talon6_writes_the_configuration(void) {
	double value = initial_park_delay >= 100 ? initial_park_delay - 7 : initial_park_delay + 7;
	ASSERT_TRUE(set_park_delay(value));
	ASSERT_TRUE(hw_disconnect(roof, SHORT_TIMEOUT));
	ASSERT_TRUE(hw_connect(roof, SHORT_TIMEOUT));
	ASSERT_TRUE(wait_for_first_poll());
	ASSERT_TRUE(value_of("X_DELAY_CONF", "PARK") == value);
	ASSERT_TRUE(set_park_delay(initial_park_delay));
}

static void talon6_reconnects(void) {
	ASSERT_TRUE(hw_disconnect(roof, SHORT_TIMEOUT));
	ASSERT_TRUE(hw_property_hidden(roof, DOME_SHUTTER_PROPERTY_NAME));
	ASSERT_TRUE(hw_connect(roof, SHORT_TIMEOUT));
	ASSERT_TRUE(wait_for_first_poll());
	ASSERT_TRUE(dome_hw_switch_is(roof, DOME_SHUTTER_PROPERTY_NAME, DOME_SHUTTER_CLOSED_ITEM_NAME));
}

static void talon6_rejects_shutdown_while_connected(void) {
	ASSERT_EQ_INT(INDIGO_BUSY, indigo_dome_talon6ror(INDIGO_DRIVER_SHUTDOWN, NULL));
	ASSERT_TRUE(hw_connected(roof));
}

static void talon6_reinitializes(void) {
	ASSERT_TRUE(hw_disconnect(roof, SHORT_TIMEOUT));
	ASSERT_EQ_INT(INDIGO_OK, indigo_dome_talon6ror(INDIGO_DRIVER_SHUTDOWN, NULL));
	ASSERT_EQ_INT(-1, hw_device_index(DEVICE_NAME));
	ASSERT_EQ_INT(INDIGO_OK, indigo_dome_talon6ror(INDIGO_DRIVER_INIT, NULL));
	roof = hw_wait_for_device(DEVICE_NAME, SHORT_TIMEOUT);
	ASSERT_TRUE(roof >= 0);
	ASSERT_TRUE(select_port());
	ASSERT_TRUE(hw_connect(roof, SHORT_TIMEOUT));
	ASSERT_TRUE(wait_for_first_poll());
}

int main(int argc, char **argv) {
	if (argc < 2 || strcmp(argv[1], "--run")) {
		fprintf(stderr, "Physical Talon6 test: run explicitly with --run (or make test-dome-talon6ror-hw).\n");
		return 2;
	}
	setvbuf(stdout, NULL, _IONBF, 0);
	for (int i = 2; i < argc; i++) {
		if (!strcmp(argv[i], "--debug")) {
			indigo_set_log_level(INDIGO_LOG_DEBUG);
		}
	}
	if (!indigo_test_use_private_home()) {
		return 1;
	}
	serial_port = hw_port("TALON6_HW_PORT");
	const indigo_test_case tests[] = {
		{ "talon6_publishes_the_property_contract", talon6_publishes_the_property_contract },
		{ "talon6_opens_and_closes_the_roof", talon6_opens_and_closes_the_roof },
		{ "talon6_aborts_an_opening", talon6_aborts_an_opening },
		{ "talon6_writes_the_configuration", talon6_writes_the_configuration },
		{ "talon6_reconnects", talon6_reconnects },
		{ "talon6_rejects_shutdown_while_connected", talon6_rejects_shutdown_while_connected },
		{ "talon6_reinitializes", talon6_reinitializes }
	};
	int result = 1;
	bool started = false, initialized = false;
	HW_CHECK(hw_start() == INDIGO_OK);
	started = true;
	HW_CHECK(hw_attach_client("Talon6 hardware test") == INDIGO_OK);
	HW_CHECK(indigo_dome_talon6ror(INDIGO_DRIVER_INIT, NULL) == INDIGO_OK);
	initialized = true;
	roof = hw_wait_for_device(DEVICE_NAME, SHORT_TIMEOUT);
	HW_CHECK(roof >= 0);
	HW_CHECK(select_port());
	HW_CHECK(hw_connect(roof, SHORT_TIMEOUT));
	HW_CHECK(capture_state());
	state_captured = true;
	result = indigo_run_tests("Talon6 hardware", tests, ARRAY_SIZE(tests));
cleanup:
	restore_initial_state();
	if (!hw_disconnect(roof, SHORT_TIMEOUT)) {
		indigo_test_failures++;
	}
	if (initialized && indigo_dome_talon6ror(INDIGO_DRIVER_SHUTDOWN, NULL) != INDIGO_OK) {
		indigo_test_failures++;
	}
	indigo_detach_client(&hw_client);
	if (started) {
		indigo_stop();
	}
	hw_release_properties();
	indigo_test_remove_private_home();
	return indigo_test_failures ? 1 : result;
}
