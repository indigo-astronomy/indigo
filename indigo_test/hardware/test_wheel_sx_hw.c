// Copyright (c) 2026 INDIGO initiative
// All rights reserved.
//
// You may use this software under the terms of 'INDIGO Astronomy
// open-source license' (see LICENSE.md).
//
// THIS SOFTWARE IS PROVIDED BY THE AUTHORS 'AS IS' AND ANY EXPRESS
// OR IMPLIED WARRANTIES, INCLUDING, BUT NOT LIMITED TO, THE IMPLIED
// WARRANTIES OF MERCHANTABILITY AND FITNESS FOR A PARTICULAR PURPOSE
// ARE DISCLAIMED. IN NO EVENT SHALL THE AUTHOR BE LIABLE FOR ANY
// DIRECT, INDIRECT, INCIDENTAL, SPECIAL, EXEMPLARY, OR CONSEQUENTIAL
// DAMAGES (INCLUDING, BUT NOT LIMITED TO, PROCUREMENT OF SUBSTITUTE
// GOODS OR SERVICES; LOSS OF USE, DATA, OR PROFITS; OR BUSINESS
// INTERRUPTION) HOWEVER CAUSED AND ON ANY THEORY OF LIABILITY,
// WHETHER IN CONTRACT, STRICT LIABILITY, OR TORT (INCLUDING
// NEGLIGENCE OR OTHERWISE) ARISING IN ANY WAY OUT OF THE USE OF THIS
// SOFTWARE, EVEN IF ADVISED OF THE POSSIBILITY OF SUCH DAMAGE.

// Code is generated by AI

// Opt-in acceptance test for a physically connected Starlight Xpress filter wheel. It implements
// the wheel hardware acceptance checklist of DRIVER_TESTING_RULES.md against the real wheel:
// discovery and connection, the published property contract, the slot count the wheel reports,
// selection of every slot, the boundary slots and the wrap between them, reselection of the slot
// the wheel already sits on, the BUSY/OK publication of a turn, the overlapping request the
// framework drops, disconnect while the wheel is turning, reconnect, INIT/SHUTDOWN and the
// SHUTDOWN refusal while a device is still connected.
//
// The wheel physically turns. Every scenario is bounded by the slot count the wheel itself
// reports and the session returns the wheel to the slot it was on when the test started, so no
// filter is left in an unexpected position.
//
// The wheel has no calibration or reset command, so that row of the class standard does not apply.
//
// --hotplug adds the transport loss scenarios. They need an operator: the test asks for the USB
// cable to be pulled while the wheel is idle and again while it is turning, and for it to be
// plugged back in afterwards.

#include <math.h>
#include <pthread.h>
#include <stdlib.h>
#include <string.h>
#include <unistd.h>
#include <indigo/indigo_bus.h>
#include <indigo/indigo_client.h>
#include <indigo/indigo_driver.h>
#include <indigo/indigo_names.h>
#include <indigo/indigo_timer.h>
#include <indigo_drivers/wheel_sx/indigo_wheel_sx.h>
#include "../test_runner.h"

#define ARRAY_SIZE(a) (sizeof(a) / sizeof((a)[0]))
#define MAX_DEVICES 4
#define MAX_PROPERTIES 32

// The hot-plug handler names the wheel after the USB path it was found on, so only the prefix is
// known in advance.
#define WHEEL_DEVICE_PREFIX "SX Filter Wheel"

// One HID transaction plus the driver's own connection work.
#define SHORT_TIMEOUT 15.0
// A full turn of the largest wheel, with the driver polling every half second.
#define MOTION_TIMEOUT 70.0
// How long an operator is given to pull or reconnect the cable.
#define CABLE_TIMEOUT 300.0

#define CHECK(condition) do { if (!(condition)) { fprintf(stderr, "%s:%d: %s\n", __FILE__, __LINE__, #condition); indigo_test_failures++; goto cleanup; } } while (0)

typedef struct {
	char name[INDIGO_NAME_SIZE];
	indigo_device *device;
	unsigned interface;
	bool present;
	indigo_property *properties[MAX_PROPERTIES];
	unsigned revisions[MAX_PROPERTIES];
} observed_device;

static observed_device devices[MAX_DEVICES];
static pthread_mutex_t mutex = PTHREAD_MUTEX_INITIALIZER;
static int wheel = -1;
static indigo_client client;
// The slot count and the slot the wheel was on when the session started. Every scenario works
// within that count and the session restores that slot before it disconnects.
static int slot_count, initial_slot;
static bool run_hotplug = false;

static int slot(int d, const char *name) {
	for (int p = 0; p < MAX_PROPERTIES; p++) {
		if (devices[d].properties[p] && !strcmp(devices[d].properties[p]->name, name)) {
			return p;
		}
	}
	return -1;
}

static indigo_result observe(indigo_device *device, indigo_property *property, const char *message) {
	pthread_mutex_lock(&mutex);
	int d;
	for (d = 0; d < MAX_DEVICES; d++) {
		if (!*devices[d].name || !strcmp(devices[d].name, property->device)) {
			break;
		}
	}
	if (d < MAX_DEVICES) {
		snprintf(devices[d].name, INDIGO_NAME_SIZE, "%s", property->device);
		devices[d].device = device;
		devices[d].present = true;
		if (!strcmp(property->name, INFO_PROPERTY_NAME)) {
			for (int i = 0; i < property->count; i++) {
				if (!strcmp(property->items[i].name, INFO_DEVICE_INTERFACE_ITEM_NAME)) {
					devices[d].interface = (unsigned)strtoul(property->items[i].text.value, NULL, 10);
				}
			}
		}
		int p = slot(d, property->name);
		if (p < 0) {
			for (p = 0; p < MAX_PROPERTIES && devices[d].properties[p]; p++) { }
		}
		if (p < MAX_PROPERTIES) {
			indigo_release_property(devices[d].properties[p]);
			devices[d].properties[p] = indigo_copy_property(NULL, property);
			devices[d].revisions[p]++;
		}
	}
	pthread_mutex_unlock(&mutex);
	if (message && *message) {
		fprintf(stderr, "    %s %s: %s\n", property->device, property->name, message);
	}
	return INDIGO_OK;
}

static indigo_result define_property(indigo_client *client, indigo_device *device, indigo_property *property, const char *message) {
	return observe(device, property, message);
}

static indigo_result update_property(indigo_client *client, indigo_device *device, indigo_property *property, const char *message) {
	return observe(device, property, message);
}

static indigo_result report_message(indigo_client *client, indigo_device *device, indigo_property *property, const char *message) {
	if (message && *message) {
		fprintf(stderr, "    message: %s\n", message);
	}
	return INDIGO_OK;
}

static indigo_result delete_property(indigo_client *client, indigo_device *device, indigo_property *property, const char *message) {
	pthread_mutex_lock(&mutex);
	for (int d = 0; d < MAX_DEVICES; d++) {
		if (strcmp(devices[d].name, property->device)) {
			continue;
		}
		if (*property->name) {
			int p = slot(d, property->name);
			if (p >= 0) {
				indigo_release_property(devices[d].properties[p]);
				devices[d].properties[p] = NULL;
				devices[d].revisions[p] = 0;
			}
		} else {
			devices[d].present = false;
			for (int p = 0; p < MAX_PROPERTIES; p++) {
				indigo_release_property(devices[d].properties[p]);
				devices[d].properties[p] = NULL;
				devices[d].revisions[p] = 0;
			}
		}
	}
	pthread_mutex_unlock(&mutex);
	return INDIGO_OK;
}

// The wheel is found by the name prefix the hot-plug handler builds, because the USB path suffix
// depends on which port the wheel is plugged into.
static int wheel_index(void) {
	pthread_mutex_lock(&mutex);
	int result = -1;
	for (int d = 0; d < MAX_DEVICES; d++) {
		if (devices[d].present && !strncmp(devices[d].name, WHEEL_DEVICE_PREFIX, strlen(WHEEL_DEVICE_PREFIX))) {
			result = d;
		}
	}
	pthread_mutex_unlock(&mutex);
	return result;
}

static unsigned revision(int d, const char *name) {
	pthread_mutex_lock(&mutex);
	int p = slot(d, name);
	unsigned result = p < 0 ? 0 : devices[d].revisions[p];
	pthread_mutex_unlock(&mutex);
	return result;
}

static bool property_defined(int d, const char *name) {
	pthread_mutex_lock(&mutex);
	bool found = slot(d, name) >= 0;
	pthread_mutex_unlock(&mutex);
	return found;
}

static bool property_hidden(int d, const char *name) {
	if (property_defined(d, name)) {
		fprintf(stderr, "    %s is published but should stay hidden\n", name);
		return false;
	}
	return true;
}

static int property_count(int d, const char *name) {
	pthread_mutex_lock(&mutex);
	int p = slot(d, name);
	int result = p < 0 ? -1 : devices[d].properties[p]->count;
	pthread_mutex_unlock(&mutex);
	return result;
}

static bool number_item(int d, const char *name, const char *item, double *value, double *min, double *max) {
	pthread_mutex_lock(&mutex);
	int p = slot(d, name);
	bool found = false;
	if (p >= 0) {
		indigo_property *property = devices[d].properties[p];
		for (int i = 0; i < property->count && !found; i++) {
			if (!strcmp(property->items[i].name, item)) {
				if (value != NULL) {
					*value = property->items[i].number.value;
				}
				if (min != NULL) {
					*min = property->items[i].number.min;
				}
				if (max != NULL) {
					*max = property->items[i].number.max;
				}
				found = true;
			}
		}
	}
	pthread_mutex_unlock(&mutex);
	if (!found) {
		fprintf(stderr, "    missing number item %s.%s\n", name, item);
	}
	return found;
}

static bool switch_item(int d, const char *name, const char *item, bool *value) {
	pthread_mutex_lock(&mutex);
	int p = slot(d, name);
	bool found = false;
	if (p >= 0) {
		indigo_property *property = devices[d].properties[p];
		for (int i = 0; i < property->count && !found; i++) {
			if (!strcmp(property->items[i].name, item)) {
				*value = property->items[i].sw.value;
				found = true;
			}
		}
	}
	pthread_mutex_unlock(&mutex);
	if (!found) {
		fprintf(stderr, "    missing switch item %s.%s\n", name, item);
	}
	return found;
}

static bool text_item(int d, const char *name, const char *item, char *value, size_t size) {
	pthread_mutex_lock(&mutex);
	int p = slot(d, name);
	bool found = false;
	if (p >= 0) {
		indigo_property *property = devices[d].properties[p];
		for (int i = 0; i < property->count && !found; i++) {
			if (!strcmp(property->items[i].name, item)) {
				snprintf(value, size, "%s", property->items[i].text.value);
				found = true;
			}
		}
	}
	pthread_mutex_unlock(&mutex);
	if (!found) {
		fprintf(stderr, "    missing text item %s.%s\n", name, item);
	}
	return found;
}

static indigo_property_state property_state(int d, const char *name) {
	pthread_mutex_lock(&mutex);
	int p = slot(d, name);
	indigo_property_state state = p < 0 ? INDIGO_IDLE_STATE : devices[d].properties[p]->state;
	pthread_mutex_unlock(&mutex);
	return state;
}

// Waits for a newer revision of the property in the requested state. The revision gate is required
// because the driver republishes WHEEL_SLOT from its movement finalizer, so a state the property
// already had before the request must not satisfy the wait.
static bool wait_state(int d, const char *name, unsigned after, indigo_property_state state, double timeout) {
	double deadline = indigo_monotonic_time() + timeout;
	while (indigo_monotonic_time() < deadline) {
		pthread_mutex_lock(&mutex);
		int p = slot(d, name);
		bool ready = p >= 0 && devices[d].revisions[p] > after && devices[d].properties[p]->state == state;
		pthread_mutex_unlock(&mutex);
		if (ready) {
			return true;
		}
		indigo_usleep(10000);
	}
	fprintf(stderr, "    timeout: %s %s expected state %d, last published state %d\n", d < 0 ? "?" : devices[d].name, name, state, property_state(d, name));
	return false;
}

// Waits for the property to settle in the requested state regardless of how many revisions it took
// to get there. Used where the driver publishes BUSY first and the scenario only cares about the
// terminal state.
static bool wait_settled(int d, const char *name, indigo_property_state state, double timeout) {
	double deadline = indigo_monotonic_time() + timeout;
	while (indigo_monotonic_time() < deadline) {
		if (property_state(d, name) == state) {
			return true;
		}
		indigo_usleep(10000);
	}
	fprintf(stderr, "    timeout: %s %s did not settle in state %d (state %d)\n", devices[d].name, name, state, property_state(d, name));
	return false;
}

static bool set_switch(int d, const char *name, const char *item, indigo_property_state expected, double timeout) {
	unsigned before = revision(d, name);
	indigo_change_switch_property_1(&client, devices[d].name, name, item, true);
	return wait_state(d, name, before, expected, timeout);
}

static bool connect_device(int d, double timeout) {
	if (d < 0) {
		fprintf(stderr, "    device not present\n");
		return false;
	}
	// The framework ignores a connection request for a device that is already connected, so it
	// never publishes anything a revision gated wait could see.
	bool connected = false;
	if (switch_item(d, CONNECTION_PROPERTY_NAME, CONNECTION_CONNECTED_ITEM_NAME, &connected) && connected) {
		return true;
	}
	if (!set_switch(d, CONNECTION_PROPERTY_NAME, CONNECTION_CONNECTED_ITEM_NAME, INDIGO_OK_STATE, timeout)) {
		return false;
	}
	return switch_item(d, CONNECTION_PROPERTY_NAME, CONNECTION_CONNECTED_ITEM_NAME, &connected) && connected;
}

static bool disconnect_device(int d) {
	if (d < 0 || !devices[d].present) {
		return true;
	}
	bool connected = false;
	if (!switch_item(d, CONNECTION_PROPERTY_NAME, CONNECTION_CONNECTED_ITEM_NAME, &connected) || !connected) {
		return true;
	}
	return set_switch(d, CONNECTION_PROPERTY_NAME, CONNECTION_DISCONNECTED_ITEM_NAME, INDIGO_OK_STATE, SHORT_TIMEOUT);
}

static bool wait_presence(double timeout) {
	double deadline = indigo_monotonic_time() + timeout;
	while (indigo_monotonic_time() < deadline) {
		wheel = wheel_index();
		if (wheel >= 0 && property_defined(wheel, CONNECTION_PROPERTY_NAME)) {
			return true;
		}
		indigo_usleep(10000);
	}
	fprintf(stderr, "    the driver did not publish a Starlight Xpress filter wheel\n");
	return false;
}

static int current_slot(void) {
	double value = 0;
	if (!number_item(wheel, WHEEL_SLOT_PROPERTY_NAME, WHEEL_SLOT_ITEM_NAME, &value, NULL, NULL)) {
		return -1;
	}
	return (int)lround(value);
}

// Requests a slot and waits until the driver reports the wheel arrived there. Returns the number of
// WHEEL_SLOT publications the request produced, so a scenario can tell a turn that was polled from
// a selection the driver answered without talking to the wheel.
static int select_slot(int target, double timeout) {
	unsigned before = revision(wheel, WHEEL_SLOT_PROPERTY_NAME);
	indigo_change_number_property_1(&client, devices[wheel].name, WHEEL_SLOT_PROPERTY_NAME, WHEEL_SLOT_ITEM_NAME, target);
	if (!wait_state(wheel, WHEEL_SLOT_PROPERTY_NAME, before, INDIGO_OK_STATE, timeout)) {
		return -1;
	}
	int reached = current_slot();
	if (reached != target) {
		fprintf(stderr, "    wheel reported OK at slot %d but slot %d was requested\n", reached, target);
		return -1;
	}
	return (int)(revision(wheel, WHEEL_SLOT_PROPERTY_NAME) - before);
}

static void prompt(const char *action, const char *context) {
	printf("\n\a================================================================\n");
	printf(">>> %s the USB cable of '%s' NOW (%s)\n", action, devices[wheel].name, context);
	printf("================================================================\n");
}

static bool wait_for_presence_change(bool present, double timeout) {
	double reported = 0;
	for (double waited = 0; waited < timeout; waited += 0.1) {
		pthread_mutex_lock(&mutex);
		bool current = devices[wheel].present;
		pthread_mutex_unlock(&mutex);
		if (current == present) {
			printf("    '%s' %s\n", devices[wheel].name, present ? "is back" : "is gone");
			return true;
		}
		if (waited - reported >= 10) {
			reported = waited;
			printf("    still waiting for the wheel to %s ... %.0f s\n", present ? "come back" : "disappear", waited);
		}
		indigo_usleep(100000);
	}
	fprintf(stderr, "    timeout waiting for the wheel to %s\n", present ? "come back" : "disappear");
	return false;
}

// Brings the wheel back to a known slot before a scenario starts, waiting out a turn an earlier
// scenario may have left running. Keeps one failing scenario from cascading into the next.
static bool settle_at(int target) {
	wait_settled(wheel, WHEEL_SLOT_PROPERTY_NAME, INDIGO_OK_STATE, MOTION_TIMEOUT);
	if (current_slot() == target) {
		return true;
	}
	return select_slot(target, MOTION_TIMEOUT) > 0;
}

static void sx_reports_identity_and_capabilities(void) {
	indigo_driver_info info = { 0 };
	ASSERT_TRUE(indigo_wheel_sx(INDIGO_DRIVER_INFO, &info) == INDIGO_OK);
	ASSERT_STREQ("Starlight Xpress Filter Wheel", info.description);
	ASSERT_EQ_INT(INDIGO_DRIVER_API_3, INDIGO_DRIVER_API_GENERATION(info.version));
	ASSERT_TRUE((devices[wheel].interface & INDIGO_INTERFACE_WHEEL) != 0);
	char driver_name[INDIGO_VALUE_SIZE] = "";
	ASSERT_TRUE(text_item(wheel, INFO_PROPERTY_NAME, INFO_DEVICE_DRIVER_ITEM_NAME, driver_name, sizeof(driver_name)));
	ASSERT_STREQ("indigo_wheel_sx", driver_name);
	printf("    wheel '%s' reports %d slots, sitting on slot %d\n", devices[wheel].name, slot_count, initial_slot);
	ASSERT_TRUE(slot_count >= 1);
	ASSERT_TRUE(initial_slot >= 1 && initial_slot <= slot_count);
}

static void sx_publishes_the_property_contract(void) {
	ASSERT_TRUE(property_defined(wheel, INFO_PROPERTY_NAME));
	ASSERT_TRUE(property_defined(wheel, CONFIG_PROPERTY_NAME));
	ASSERT_TRUE(property_defined(wheel, PROFILE_PROPERTY_NAME));
	ASSERT_TRUE(property_defined(wheel, CONNECTION_PROPERTY_NAME));
	ASSERT_TRUE(property_defined(wheel, WHEEL_SLOT_PROPERTY_NAME));
	ASSERT_TRUE(property_defined(wheel, WHEEL_SLOT_NAME_PROPERTY_NAME));
	ASSERT_TRUE(property_defined(wheel, WHEEL_SLOT_OFFSET_PROPERTY_NAME));
	// The wheel is found over HID by vendor and product id, so it has no port properties.
	ASSERT_TRUE(property_hidden(wheel, DEVICE_PORT_PROPERTY_NAME));
	ASSERT_TRUE(property_hidden(wheel, DEVICE_PORTS_PROPERTY_NAME));
	ASSERT_TRUE(property_hidden(wheel, SIMULATION_PROPERTY_NAME));
	// The slot count the wheel reported has to bound the selector and both slot tables.
	double min = 0, max = 0;
	ASSERT_TRUE(number_item(wheel, WHEEL_SLOT_PROPERTY_NAME, WHEEL_SLOT_ITEM_NAME, NULL, &min, &max));
	ASSERT_EQ_INT(1, (int)lround(min));
	ASSERT_EQ_INT(slot_count, (int)lround(max));
	ASSERT_EQ_INT(slot_count, property_count(wheel, WHEEL_SLOT_NAME_PROPERTY_NAME));
	ASSERT_EQ_INT(slot_count, property_count(wheel, WHEEL_SLOT_OFFSET_PROPERTY_NAME));
}

static void sx_selects_every_slot(void) {
	for (int target = 1; target <= slot_count; target++) {
		int publications = select_slot(target, MOTION_TIMEOUT);
		ASSERT_TRUE(publications > 0);
		ASSERT_EQ_INT(target, current_slot());
	}
}

static void sx_selects_the_slot_boundaries(void) {
	// The last slot, then the wrap back to the first one, is the longest travel the wheel can be
	// asked for and the pair of command indices the driver has to get right.
	ASSERT_TRUE(settle_at(1));
	ASSERT_TRUE(select_slot(slot_count, MOTION_TIMEOUT) > 0);
	ASSERT_EQ_INT(slot_count, current_slot());
	ASSERT_TRUE(select_slot(1, MOTION_TIMEOUT) > 0);
	ASSERT_EQ_INT(1, current_slot());
}

static void sx_reselects_the_current_slot(void) {
	ASSERT_TRUE(settle_at(1));
	// A request for the slot the wheel already sits on is answered from the driver's own state:
	// the framework publishes BUSY and the handler publishes OK, with no readback in between.
	ASSERT_EQ_INT(2, select_slot(1, SHORT_TIMEOUT));
	ASSERT_EQ_INT(1, current_slot());
}

static void sx_repeats_a_selection(void) {
	int other = slot_count > 1 ? 2 : 1;
	ASSERT_TRUE(settle_at(1));
	ASSERT_TRUE(select_slot(other, MOTION_TIMEOUT) > 0);
	ASSERT_EQ_INT(other, current_slot());
	ASSERT_TRUE(select_slot(1, MOTION_TIMEOUT) > 0);
	ASSERT_TRUE(select_slot(other, MOTION_TIMEOUT) > 0);
	ASSERT_EQ_INT(other, current_slot());
}

static void sx_publishes_busy_while_turning(void) {
	if (slot_count < 2) {
		printf("    single slot wheel, nothing turns\n");
		return;
	}
	ASSERT_TRUE(settle_at(1));
	unsigned before = revision(wheel, WHEEL_SLOT_PROPERTY_NAME);
	indigo_change_number_property_1(&client, devices[wheel].name, WHEEL_SLOT_PROPERTY_NAME, WHEEL_SLOT_ITEM_NAME, slot_count);
	ASSERT_TRUE(wait_state(wheel, WHEEL_SLOT_PROPERTY_NAME, before, INDIGO_BUSY_STATE, SHORT_TIMEOUT));
	ASSERT_TRUE(wait_settled(wheel, WHEEL_SLOT_PROPERTY_NAME, INDIGO_OK_STATE, MOTION_TIMEOUT));
	ASSERT_EQ_INT(slot_count, current_slot());
}

static void sx_ignores_an_overlapping_request(void) {
	if (slot_count < 3) {
		printf("    fewer than three slots, no overlapping request to place\n");
		return;
	}
	ASSERT_TRUE(settle_at(1));
	unsigned before = revision(wheel, WHEEL_SLOT_PROPERTY_NAME);
	indigo_change_number_property_1(&client, devices[wheel].name, WHEEL_SLOT_PROPERTY_NAME, WHEEL_SLOT_ITEM_NAME, slot_count);
	ASSERT_TRUE(wait_state(wheel, WHEEL_SLOT_PROPERTY_NAME, before, INDIGO_BUSY_STATE, SHORT_TIMEOUT));
	// The framework drops a change request for a property that is still BUSY, so the second slot
	// must never reach the wheel.
	indigo_change_number_property_1(&client, devices[wheel].name, WHEEL_SLOT_PROPERTY_NAME, WHEEL_SLOT_ITEM_NAME, 2);
	ASSERT_TRUE(wait_settled(wheel, WHEEL_SLOT_PROPERTY_NAME, INDIGO_OK_STATE, MOTION_TIMEOUT));
	ASSERT_EQ_INT(slot_count, current_slot());
	// The dropped request must not have moved the wheel afterwards either.
	indigo_usleep(1500000);
	ASSERT_EQ_INT(INDIGO_OK_STATE, property_state(wheel, WHEEL_SLOT_PROPERTY_NAME));
	ASSERT_EQ_INT(slot_count, current_slot());
}

static void sx_disconnects_while_turning(void) {
	if (slot_count < 3) {
		printf("    fewer than three slots, the turn is too short to interrupt\n");
		return;
	}
	ASSERT_TRUE(settle_at(1));
	unsigned before = revision(wheel, WHEEL_SLOT_PROPERTY_NAME);
	indigo_change_number_property_1(&client, devices[wheel].name, WHEEL_SLOT_PROPERTY_NAME, WHEEL_SLOT_ITEM_NAME, slot_count);
	ASSERT_TRUE(wait_state(wheel, WHEEL_SLOT_PROPERTY_NAME, before, INDIGO_BUSY_STATE, SHORT_TIMEOUT));
	// Disconnecting has to cancel the pending readback and release the wheel without waiting for
	// the turn to finish.
	ASSERT_TRUE(disconnect_device(wheel));
	// The wheel carries on turning while the driver holds no handle, so it answers the query of
	// the reconnect with slot 0. That must not refuse the connection: the driver publishes the
	// slot as busy and resolves it once the wheel arrives.
	ASSERT_TRUE(connect_device(wheel, SHORT_TIMEOUT));
	ASSERT_EQ_INT(INDIGO_BUSY_STATE, property_state(wheel, WHEEL_SLOT_PROPERTY_NAME));
	ASSERT_TRUE(wait_settled(wheel, WHEEL_SLOT_PROPERTY_NAME, INDIGO_OK_STATE, MOTION_TIMEOUT));
	// The wheel finished the turn it was commanded before the disconnect, and the driver reports
	// the slot it actually stopped on without having commanded anything itself.
	ASSERT_EQ_INT(slot_count, current_slot());
	ASSERT_TRUE(select_slot(1, MOTION_TIMEOUT) > 0);
}

static void sx_reconnects(void) {
	int target = slot_count > 1 ? 2 : 1;
	ASSERT_TRUE(settle_at(target));
	ASSERT_TRUE(disconnect_device(wheel));
	ASSERT_TRUE(connect_device(wheel, SHORT_TIMEOUT));
	// A reconnect reads the wheel again, so it has to come back on the same slot with the same
	// slot count and the same bounds.
	ASSERT_EQ_INT(target, current_slot());
	double max = 0;
	ASSERT_TRUE(number_item(wheel, WHEEL_SLOT_PROPERTY_NAME, WHEEL_SLOT_ITEM_NAME, NULL, NULL, &max));
	ASSERT_EQ_INT(slot_count, (int)lround(max));
	ASSERT_EQ_INT(slot_count, property_count(wheel, WHEEL_SLOT_NAME_PROPERTY_NAME));
	ASSERT_TRUE(select_slot(1, MOTION_TIMEOUT) > 0);
}

static void sx_rejects_shutdown_while_connected(void) {
	ASSERT_TRUE(connect_device(wheel, SHORT_TIMEOUT));
	ASSERT_TRUE(indigo_wheel_sx(INDIGO_DRIVER_SHUTDOWN, NULL) == INDIGO_BUSY);
	// The refused shutdown must leave the driver fully operational.
	ASSERT_TRUE(select_slot(slot_count, MOTION_TIMEOUT) > 0);
	ASSERT_TRUE(select_slot(1, MOTION_TIMEOUT) > 0);
}

static void sx_reinitializes(void) {
	ASSERT_TRUE(disconnect_device(wheel));
	ASSERT_TRUE(indigo_wheel_sx(INDIGO_DRIVER_SHUTDOWN, NULL) == INDIGO_OK);
	ASSERT_TRUE(indigo_wheel_sx(INDIGO_DRIVER_INIT, NULL) == INDIGO_OK);
	ASSERT_TRUE(wait_presence(SHORT_TIMEOUT));
	ASSERT_TRUE(connect_device(wheel, SHORT_TIMEOUT));
	ASSERT_EQ_INT(slot_count, (int)lround(property_count(wheel, WHEEL_SLOT_NAME_PROPERTY_NAME)));
	ASSERT_TRUE(select_slot(slot_count, MOTION_TIMEOUT) > 0);
	ASSERT_TRUE(select_slot(1, MOTION_TIMEOUT) > 0);
}

static void sx_survives_transport_loss(void) {
	ASSERT_TRUE(settle_at(1));
	prompt("UNPLUG", "the wheel is connected and idle");
	ASSERT_TRUE(wait_for_presence_change(false, CABLE_TIMEOUT));
	prompt("PLUG BACK IN", "the idle removal was detected");
	ASSERT_TRUE(wait_presence(CABLE_TIMEOUT));
	ASSERT_TRUE(wait_for_presence_change(true, CABLE_TIMEOUT));
	ASSERT_TRUE(connect_device(wheel, SHORT_TIMEOUT));
	ASSERT_TRUE(select_slot(slot_count, MOTION_TIMEOUT) > 0);
	ASSERT_TRUE(select_slot(1, MOTION_TIMEOUT) > 0);
}

static void sx_survives_transport_loss_while_turning(void) {
	ASSERT_TRUE(settle_at(1));
	unsigned before = revision(wheel, WHEEL_SLOT_PROPERTY_NAME);
	indigo_change_number_property_1(&client, devices[wheel].name, WHEEL_SLOT_PROPERTY_NAME, WHEEL_SLOT_ITEM_NAME, slot_count);
	ASSERT_TRUE(wait_state(wheel, WHEEL_SLOT_PROPERTY_NAME, before, INDIGO_BUSY_STATE, SHORT_TIMEOUT));
	prompt("UNPLUG", "the wheel is turning");
	ASSERT_TRUE(wait_for_presence_change(false, CABLE_TIMEOUT));
	prompt("PLUG BACK IN", "the removal during the turn was detected");
	ASSERT_TRUE(wait_presence(CABLE_TIMEOUT));
	ASSERT_TRUE(wait_for_presence_change(true, CABLE_TIMEOUT));
	ASSERT_TRUE(connect_device(wheel, SHORT_TIMEOUT));
	ASSERT_TRUE(select_slot(1, MOTION_TIMEOUT) > 0);
}

int main(int argc, char **argv) {
	bool run = false;
	for (int i = 1; i < argc; i++) {
		if (!strcmp(argv[i], "--run")) {
			run = true;
		} else if (!strcmp(argv[i], "--hotplug")) {
			run_hotplug = true;
		} else if (!strcmp(argv[i], "--debug")) {
			indigo_set_log_level(INDIGO_LOG_DEBUG);
		}
	}
	if (!run) {
		fprintf(stderr, "This test operates a physical Starlight Xpress filter wheel. Run with --run [--hotplug] [--debug] (or make test-wheel-sx-hw).\n");
		return 2;
	}
	setvbuf(stdout, NULL, _IONBF, 0);
	client = (indigo_client){ .name = "SX filter wheel hardware test", .version = INDIGO_VERSION_CURRENT, .define_property = define_property, .update_property = update_property, .delete_property = delete_property, .send_message = report_message };
	const indigo_test_case tests[] = {
		{ "sx_reports_identity_and_capabilities", sx_reports_identity_and_capabilities },
		{ "sx_publishes_the_property_contract", sx_publishes_the_property_contract },
		{ "sx_selects_every_slot", sx_selects_every_slot },
		{ "sx_selects_the_slot_boundaries", sx_selects_the_slot_boundaries },
		{ "sx_reselects_the_current_slot", sx_reselects_the_current_slot },
		{ "sx_repeats_a_selection", sx_repeats_a_selection },
		{ "sx_publishes_busy_while_turning", sx_publishes_busy_while_turning },
		{ "sx_ignores_an_overlapping_request", sx_ignores_an_overlapping_request },
		{ "sx_disconnects_while_turning", sx_disconnects_while_turning },
		{ "sx_reconnects", sx_reconnects },
		{ "sx_rejects_shutdown_while_connected", sx_rejects_shutdown_while_connected },
		{ "sx_reinitializes", sx_reinitializes }
	};
	const indigo_test_case hotplug_tests[] = {
		{ "sx_survives_transport_loss", sx_survives_transport_loss },
		{ "sx_survives_transport_loss_while_turning", sx_survives_transport_loss_while_turning }
	};
	int result = 1;
	bool started = false, initialized = false;
	double max = 0;
	CHECK(indigo_start() == INDIGO_OK);
	started = true;
	CHECK(indigo_attach_client(&client) == INDIGO_OK);
	CHECK(indigo_wheel_sx(INDIGO_DRIVER_INIT, NULL) == INDIGO_OK);
	initialized = true;
	CHECK(wait_presence(SHORT_TIMEOUT));
	CHECK(connect_device(wheel, SHORT_TIMEOUT));
	CHECK(number_item(wheel, WHEEL_SLOT_PROPERTY_NAME, WHEEL_SLOT_ITEM_NAME, NULL, NULL, &max));
	slot_count = (int)lround(max);
	initial_slot = current_slot();
	CHECK(slot_count >= 1 && initial_slot >= 1);
	printf("Wheel '%s' with %d slots, starting on slot %d\n", devices[wheel].name, slot_count, initial_slot);
	result = indigo_run_tests("SX filter wheel hardware", tests, ARRAY_SIZE(tests));
	if (run_hotplug) {
		result |= indigo_run_tests("SX filter wheel hardware hot-plug", hotplug_tests, ARRAY_SIZE(hotplug_tests));
	}
cleanup:
	if (wheel >= 0 && devices[wheel].present && initial_slot >= 1) {
		if (settle_at(initial_slot)) {
			printf("Restored the starting slot %d\n", initial_slot);
		} else {
			indigo_test_failures++;
		}
	}
	if (!disconnect_device(wheel)) {
		indigo_test_failures++;
	}
	if (initialized && indigo_wheel_sx(INDIGO_DRIVER_SHUTDOWN, NULL) != INDIGO_OK) {
		indigo_test_failures++;
	}
	indigo_detach_client(&client);
	if (started) {
		indigo_stop();
	}
	for (int d = 0; d < MAX_DEVICES; d++) {
		for (int p = 0; p < MAX_PROPERTIES; p++) {
			indigo_release_property(devices[d].properties[p]);
		}
	}
	return indigo_test_failures ? 1 : result;
}
