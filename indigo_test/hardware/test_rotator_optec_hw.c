// Copyright (c) 2026 INDIGO initiative
// All rights reserved.
//
// You may use this software under the terms of 'INDIGO Astronomy
// open-source license' (see LICENSE.md).
//
// THIS SOFTWARE IS PROVIDED BY THE AUTHORS 'AS IS' AND ANY EXPRESS
// OR IMPLIED WARRANTIES, INCLUDING, BUT NOT LIMITED TO, THE IMPLIED
// WARRANTIES OF MERCHANTABILITY AND FITNESS FOR A PARTICULAR PURPOSE
// ARE DISCLAIMED. IN NO EVENT SHALL THE AUTHOR BE LIABLE FOR ANY
// DIRECT, INDIRECT, INCIDENTAL, SPECIAL, EXEMPLARY, OR CONSEQUENTIAL
// DAMAGES (INCLUDING, BUT NOT LIMITED TO, PROCUREMENT OF SUBSTITUTE
// GOODS OR SERVICES; LOSS OF USE, DATA, OR PROFITS; OR BUSINESS
// INTERRUPTION) HOWEVER CAUSED AND ON ANY THEORY OF LIABILITY,
// WHETHER IN CONTRACT, STRICT LIABILITY, OR TORT (INCLUDING
// NEGLIGENCE OR OTHERWISE) ARISING IN ANY WAY OUT OF THE USE OF THIS
// SOFTWARE, EVEN IF ADVISED OF THE POSSIBILITY OF SUCH DAMAGE.

// Code is generated by AI

// Opt-in acceptance test for a physically connected Optec Pyxis rotator, or for the Arduino sketch
// rotator_optec_simulator.ino running on a board. It connects to an awake Pyxis (as after power-up), checks the values
// read at the connection, moves to absolute position angles (a long move included), homes, makes small steps that
// invalidate the position until the next homing, refuses a request during a move, sets the rate and the direction
// (read back over a reconnect), reconnects and runs driver INIT/SHUTDOWN.
//
// THE ROTATOR TURNS. The session writes back the direction and rate it found and returns to the angle it found.
//
// The port comes from PYXIS_HW_PORT.

#include <math.h>
#include <stdlib.h>
#include <indigo_drivers/rotator_optec/indigo_rotator_optec.h>
#include "focuser_hw_common.h"

#define DEVICE_NAME "Optec Pyxis"

#define SHORT_TIMEOUT 15.0
#define MOVE_TIMEOUT 400.0

static int rotator = -1;
static const char *serial_port = NULL;
static bool state_captured = false, reversed = false;
static double initial_position = 0, initial_rate = 8;

static bool select_port(void) {
	if (serial_port == NULL || !*serial_port) {
		fprintf(stderr, "    set PYXIS_HW_PORT to the rotator's port\n");
		return false;
	}
	printf("Using port %s\n", serial_port);
	return hw_set_text(rotator, DEVICE_PORT_PROPERTY_NAME, DEVICE_PORT_ITEM_NAME, serial_port, INDIGO_OK_STATE, SHORT_TIMEOUT);
}

static double position(void) {
	return focuser_hw_value(rotator, ROTATOR_POSITION_PROPERTY_NAME, ROTATOR_POSITION_ITEM_NAME);
}

// An absolute move that ends in the expected state; an OK move ends at the target.
static bool go(double target, indigo_property_state expected) {
	if (!focuser_hw_idle(rotator, ROTATOR_POSITION_PROPERTY_NAME, MOVE_TIMEOUT)) {
		return false;
	}
	unsigned before = hw_revision(rotator, ROTATOR_POSITION_PROPERTY_NAME);
	hw_request_number(rotator, ROTATOR_POSITION_PROPERTY_NAME, ROTATOR_POSITION_ITEM_NAME, target);
	if (!focuser_hw_settles(rotator, ROTATOR_POSITION_PROPERTY_NAME, before, expected, MOVE_TIMEOUT)) {
		return false;
	}
	if (expected == INDIGO_OK_STATE && position() != target) {
		fprintf(stderr, "    position %g, expected %g\n", position(), target);
		return false;
	}
	return true;
}

static bool home(void) {
	unsigned before = hw_revision(rotator, "X_HOME");
	hw_request_switch(rotator, "X_HOME", "HOME", true);
	return focuser_hw_settles(rotator, "X_HOME", before, INDIGO_OK_STATE, MOVE_TIMEOUT) && focuser_hw_idle(rotator, ROTATOR_POSITION_PROPERTY_NAME, MOVE_TIMEOUT) && hw_property_state(rotator, ROTATOR_POSITION_PROPERTY_NAME) == INDIGO_OK_STATE && position() == 0;
}

static void restore_initial_state(void) {
	if (rotator < 0 || !state_captured || !hw_connected(rotator)) {
		return;
	}
	focuser_hw_idle(rotator, ROTATOR_POSITION_PROPERTY_NAME, MOVE_TIMEOUT);
	focuser_hw_idle(rotator, "X_HOME", MOVE_TIMEOUT);
	focuser_hw_set_switch(rotator, ROTATOR_DIRECTION_PROPERTY_NAME, reversed ? ROTATOR_DIRECTION_REVERSED_ITEM_NAME : ROTATOR_DIRECTION_NORMAL_ITEM_NAME, SHORT_TIMEOUT);
	focuser_hw_set_number(rotator, "X_RATE", "RATE", initial_rate, INDIGO_OK_STATE, SHORT_TIMEOUT);
	if (hw_property_state(rotator, ROTATOR_POSITION_PROPERTY_NAME) == INDIGO_ALERT_STATE) {
		home();
	}
	if (position() != initial_position) {
		go(initial_position, INDIGO_OK_STATE);
	}
}

static void pyxis_publishes_the_values(void) {
	printf("    position %g, %s direction, rate %g\n", initial_position, reversed ? "reversed" : "normal", initial_rate);
	ASSERT_TRUE((hw_device_interface(rotator) & INDIGO_INTERFACE_ROTATOR) != 0);
	ASSERT_TRUE(initial_position >= 0 && initial_position <= 359);
	ASSERT_EQ_INT(INDIGO_OK_STATE, hw_property_state(rotator, ROTATOR_POSITION_PROPERTY_NAME));
	ASSERT_TRUE(!hw_property_defined(rotator, ROTATOR_ABORT_MOTION_PROPERTY_NAME));
}

// Moves to absolute angles; a move to the current angle ends at once. The 120 degree move takes longer than the
// fixed deadline 3.0.0.5 gave every move.
static void pyxis_moves_to_absolute_angles(void) {
	double start = indigo_monotonic_time();
	ASSERT_TRUE(go(120, INDIGO_OK_STATE));
	double elapsed = indigo_monotonic_time() - start;
	ASSERT_TRUE(go(125, INDIGO_OK_STATE));
	ASSERT_TRUE(go(125, INDIGO_OK_STATE));
	ASSERT_TRUE(go(10, INDIGO_OK_STATE));
	printf("    120 degrees in %.1f s\n", elapsed);
}

// Homing ends at angle 0.
static void pyxis_homes(void) {
	ASSERT_TRUE(go(40, INDIGO_OK_STATE));
	ASSERT_TRUE(home());
}

// A request during a move is refused and the move still ends at its target.
static void pyxis_refuses_a_request_during_a_move(void) {
	unsigned before = hw_revision(rotator, ROTATOR_POSITION_PROPERTY_NAME);
	hw_request_number(rotator, ROTATOR_POSITION_PROPERTY_NAME, ROTATOR_POSITION_ITEM_NAME, 60);
	ASSERT_TRUE(hw_wait_state(rotator, ROTATOR_POSITION_PROPERTY_NAME, before, INDIGO_BUSY_STATE, SHORT_TIMEOUT));
	ASSERT_TRUE(focuser_hw_set_number(rotator, "X_RATE", "RATE", initial_rate == 7 ? 9 : 7, INDIGO_ALERT_STATE, SHORT_TIMEOUT));
	ASSERT_EQ_INT((int)initial_rate, (int)focuser_hw_value(rotator, "X_RATE", "RATE"));
	ASSERT_TRUE(focuser_hw_idle(rotator, ROTATOR_POSITION_PROPERTY_NAME, MOVE_TIMEOUT));
	ASSERT_EQ_INT(INDIGO_OK_STATE, hw_property_state(rotator, ROTATOR_POSITION_PROPERTY_NAME));
	ASSERT_EQ_INT(60, (int)position());
}

// Small steps leave the angle unknown: an absolute move is refused until the next homing.
static void pyxis_small_steps_need_homing(void) {
	ASSERT_TRUE(focuser_hw_set_number(rotator, "X_ROTATE", "ROTATE", 5, INDIGO_OK_STATE, SHORT_TIMEOUT));
	ASSERT_TRUE(focuser_hw_set_number(rotator, "X_ROTATE", "ROTATE", -5, INDIGO_OK_STATE, SHORT_TIMEOUT));
	ASSERT_EQ_INT(INDIGO_ALERT_STATE, hw_property_state(rotator, ROTATOR_POSITION_PROPERTY_NAME));
	ASSERT_TRUE(go(30, INDIGO_ALERT_STATE));
	ASSERT_TRUE(home());
	ASSERT_TRUE(go(30, INDIGO_OK_STATE));
}

// The rate and the direction are confirmed and the direction read back from the controller after a reconnect.
static void pyxis_changes_the_settings(void) {
	ASSERT_TRUE(focuser_hw_set_number(rotator, "X_RATE", "RATE", 4, INDIGO_OK_STATE, SHORT_TIMEOUT));
	ASSERT_TRUE(go(50, INDIGO_OK_STATE));
	ASSERT_TRUE(focuser_hw_set_number(rotator, "X_RATE", "RATE", initial_rate, INDIGO_OK_STATE, SHORT_TIMEOUT));
	ASSERT_TRUE(focuser_hw_set_switch(rotator, ROTATOR_DIRECTION_PROPERTY_NAME, reversed ? ROTATOR_DIRECTION_NORMAL_ITEM_NAME : ROTATOR_DIRECTION_REVERSED_ITEM_NAME, SHORT_TIMEOUT));
	ASSERT_TRUE(hw_disconnect(rotator, SHORT_TIMEOUT));
	ASSERT_TRUE(hw_connect(rotator, SHORT_TIMEOUT));
	ASSERT_TRUE(focuser_hw_switch_is(rotator, ROTATOR_DIRECTION_PROPERTY_NAME, reversed ? ROTATOR_DIRECTION_NORMAL_ITEM_NAME : ROTATOR_DIRECTION_REVERSED_ITEM_NAME));
	ASSERT_EQ_INT(50, (int)position());
	ASSERT_TRUE(focuser_hw_set_switch(rotator, ROTATOR_DIRECTION_PROPERTY_NAME, reversed ? ROTATOR_DIRECTION_REVERSED_ITEM_NAME : ROTATOR_DIRECTION_NORMAL_ITEM_NAME, SHORT_TIMEOUT));
}

static void pyxis_reconnects(void) {
	double angle = position();
	ASSERT_TRUE(hw_disconnect(rotator, SHORT_TIMEOUT));
	ASSERT_TRUE(hw_property_hidden(rotator, ROTATOR_POSITION_PROPERTY_NAME));
	ASSERT_TRUE(hw_connect(rotator, SHORT_TIMEOUT));
	ASSERT_EQ_INT((int)angle, (int)position());
	ASSERT_EQ_INT(INDIGO_OK_STATE, hw_property_state(rotator, ROTATOR_POSITION_PROPERTY_NAME));
}

static void pyxis_rejects_shutdown_while_connected(void) {
	ASSERT_EQ_INT(INDIGO_BUSY, indigo_rotator_optec(INDIGO_DRIVER_SHUTDOWN, NULL));
	ASSERT_TRUE(hw_connected(rotator));
}

static void pyxis_reinitializes(void) {
	double angle = position();
	ASSERT_TRUE(hw_disconnect(rotator, SHORT_TIMEOUT));
	ASSERT_EQ_INT(INDIGO_OK, indigo_rotator_optec(INDIGO_DRIVER_SHUTDOWN, NULL));
	ASSERT_EQ_INT(-1, hw_device_index(DEVICE_NAME));
	ASSERT_EQ_INT(INDIGO_OK, indigo_rotator_optec(INDIGO_DRIVER_INIT, NULL));
	rotator = hw_wait_for_device(DEVICE_NAME, SHORT_TIMEOUT);
	ASSERT_TRUE(rotator >= 0);
	ASSERT_TRUE(select_port());
	ASSERT_TRUE(hw_connect(rotator, SHORT_TIMEOUT));
	ASSERT_EQ_INT((int)angle, (int)position());
}

int main(int argc, char **argv) {
	if (argc < 2 || strcmp(argv[1], "--run")) {
		fprintf(stderr, "Physical Pyxis test: run explicitly with --run (or make test-rotator-optec-hw).\n");
		return 2;
	}
	setvbuf(stdout, NULL, _IONBF, 0);
	for (int i = 2; i < argc; i++) {
		if (!strcmp(argv[i], "--debug")) {
			indigo_set_log_level(INDIGO_LOG_DEBUG);
		}
	}
	if (!indigo_test_use_private_home()) {
		return 1;
	}
	serial_port = hw_port("PYXIS_HW_PORT");
	const indigo_test_case tests[] = {
		{ "pyxis_publishes_the_values", pyxis_publishes_the_values },
		{ "pyxis_moves_to_absolute_angles", pyxis_moves_to_absolute_angles },
		{ "pyxis_homes", pyxis_homes },
		{ "pyxis_refuses_a_request_during_a_move", pyxis_refuses_a_request_during_a_move },
		{ "pyxis_small_steps_need_homing", pyxis_small_steps_need_homing },
		{ "pyxis_changes_the_settings", pyxis_changes_the_settings },
		{ "pyxis_reconnects", pyxis_reconnects },
		{ "pyxis_rejects_shutdown_while_connected", pyxis_rejects_shutdown_while_connected },
		{ "pyxis_reinitializes", pyxis_reinitializes }
	};
	int result = 1;
	bool started = false, initialized = false;
	HW_CHECK(hw_start() == INDIGO_OK);
	started = true;
	HW_CHECK(hw_attach_client("Pyxis hardware test") == INDIGO_OK);
	HW_CHECK(indigo_rotator_optec(INDIGO_DRIVER_INIT, NULL) == INDIGO_OK);
	initialized = true;
	rotator = hw_wait_for_device(DEVICE_NAME, SHORT_TIMEOUT);
	HW_CHECK(rotator >= 0);
	HW_CHECK(select_port());
	HW_CHECK(hw_connect(rotator, SHORT_TIMEOUT));
	initial_position = position();
	initial_rate = focuser_hw_value(rotator, "X_RATE", "RATE");
	reversed = focuser_hw_switch_is(rotator, ROTATOR_DIRECTION_PROPERTY_NAME, ROTATOR_DIRECTION_REVERSED_ITEM_NAME);
	state_captured = true;
	result = indigo_run_tests("Pyxis hardware", tests, ARRAY_SIZE(tests));
cleanup:
	restore_initial_state();
	if (!hw_disconnect(rotator, SHORT_TIMEOUT)) {
		indigo_test_failures++;
	}
	if (initialized && indigo_rotator_optec(INDIGO_DRIVER_SHUTDOWN, NULL) != INDIGO_OK) {
		indigo_test_failures++;
	}
	indigo_detach_client(&hw_client);
	if (started) {
		indigo_stop();
	}
	hw_release_properties();
	indigo_test_remove_private_home();
	return indigo_test_failures ? 1 : result;
}
