// Copyright (c) 2026 INDIGO initiative
// All rights reserved.
//
// You may use this software under the terms of 'INDIGO Astronomy
// open-source license' (see LICENSE.md).
//
// THIS SOFTWARE IS PROVIDED BY THE AUTHORS 'AS IS' AND ANY EXPRESS
// OR IMPLIED WARRANTIES, INCLUDING, BUT NOT LIMITED TO, THE IMPLIED
// WARRANTIES OF MERCHANTABILITY AND FITNESS FOR A PARTICULAR PURPOSE
// ARE DISCLAIMED. IN NO EVENT SHALL THE AUTHOR BE LIABLE FOR ANY
// DIRECT, INDIRECT, INCIDENTAL, SPECIAL, EXEMPLARY, OR CONSEQUENTIAL
// DAMAGES (INCLUDING, BUT NOT LIMITED TO, PROCUREMENT OF SUBSTITUTE
// GOODS OR SERVICES; LOSS OF USE, DATA, OR PROFITS; OR BUSINESS
// INTERRUPTION) HOWEVER CAUSED AND ON ANY THEORY OF LIABILITY,
// WHETHER IN CONTRACT, STRICT LIABILITY, OR TORT (INCLUDING
// NEGLIGENCE OR OTHERWISE) ARISING IN ANY WAY OUT OF THE USE OF THIS
// SOFTWARE, EVEN IF ADVISED OF THE POSSIBILITY OF SUCH DAMAGE.

// Code is generated by AI

// Opt-in acceptance test for a physically connected PegasusAstro Pocket Powerbox (PPB, Advance, Micro)
// or Saddle Powerbox, or for the Arduino sketch aux_ppb_simulator.ino running on a board. It checks the
// identified model and its outlet inventory, reads the sensors, switches every outlet, sets the heater
// duty cycles, the dew control mode and (Advance and Micro) the adjustable output voltage, each read
// back from the status poll, stores the outlet states as the power-on default, reboots the box and
// checks the outlets come back in them, reconnects and runs driver INIT/SHUTDOWN.
//
// THE OUTLETS SWITCH OFF AND ON, THE HEATERS RUN AND THE BOX REBOOTS. Disconnect anything that must not
// lose power. The session restores the outlets, heaters, dew mode and DSLR voltage it found and stores
// the outlet states it found as the power-on default.
//
// The port comes from PPB_HW_PORT.

#include <math.h>
#include <stdlib.h>
#include <indigo_drivers/aux_ppb/indigo_aux_ppb.h>
#include "hardware_test_common.h"

#define DEVICE_NAME "Pocket Powerbox"
#define AUX_DSLR_POWER_PROPERTY_NAME "X_DSLR_POWER"
#define AUX_REBOOT_PROPERTY_NAME "X_AUX_REBOOT"

#define SHORT_TIMEOUT 15.0
// The status is polled every 2 s.
#define POLL_TIMEOUT 6.0
#define POLL_PERIOD_US 2000000

static const char * const outlet_items[] = { AUX_POWER_OUTLET_1_ITEM_NAME, AUX_POWER_OUTLET_2_ITEM_NAME };
static const char * const dslr_voltages[] = { "3", "5", "8", "9", "12" };

static int box = -1;
static const char *serial_port = NULL;
static bool state_captured = false, advance = false;
static int outlet_count = 0;
static bool initial_outlets[2];
static double initial_heaters[2];
static bool initial_automatic_dew = false;
static const char *initial_dslr = NULL;

static bool select_port(void) {
	if (serial_port == NULL || !*serial_port) {
		fprintf(stderr, "    set PPB_HW_PORT to the powerbox's serial port\n");
		return false;
	}
	printf("Using port %s\n", serial_port);
	return hw_set_text(box, DEVICE_PORT_PROPERTY_NAME, DEVICE_PORT_ITEM_NAME, serial_port, INDIGO_OK_STATE, SHORT_TIMEOUT);
}

// A value the status poll overwrites with what the box reports has to survive two polls.
static void wait_for_polls(void) {
	indigo_usleep(2 * POLL_PERIOD_US + 500000);
}

static bool outlet_is(int i, bool on) {
	bool value = !on;
	return hw_switch_item(box, AUX_POWER_OUTLET_PROPERTY_NAME, outlet_items[i], &value) && value == on;
}

static bool set_outlet(int i, bool on) {
	return hw_wait_settled(box, AUX_POWER_OUTLET_PROPERTY_NAME, INDIGO_OK_STATE, SHORT_TIMEOUT) && hw_set_switch_value(box, AUX_POWER_OUTLET_PROPERTY_NAME, outlet_items[i], on, INDIGO_OK_STATE, SHORT_TIMEOUT) && outlet_is(i, on);
}

static bool set_heaters(double heater_1, double heater_2) {
	if (!hw_wait_settled(box, AUX_HEATER_OUTLET_PROPERTY_NAME, INDIGO_OK_STATE, SHORT_TIMEOUT)) {
		return false;
	}
	unsigned before = hw_revision(box, AUX_HEATER_OUTLET_PROPERTY_NAME);
	static const char *items[] = { AUX_HEATER_OUTLET_1_ITEM_NAME, AUX_HEATER_OUTLET_2_ITEM_NAME };
	double values[] = { heater_1, heater_2 };
	indigo_change_number_property(&hw_client, DEVICE_NAME, AUX_HEATER_OUTLET_PROPERTY_NAME, 2, items, values);
	return hw_wait_state(box, AUX_HEATER_OUTLET_PROPERTY_NAME, before, INDIGO_OK_STATE, SHORT_TIMEOUT);
}

static bool heaters_are(double heater_1, double heater_2) {
	return hw_wait_number(box, AUX_HEATER_OUTLET_PROPERTY_NAME, AUX_HEATER_OUTLET_1_ITEM_NAME, heater_1, 0, POLL_TIMEOUT) && hw_wait_number(box, AUX_HEATER_OUTLET_PROPERTY_NAME, AUX_HEATER_OUTLET_2_ITEM_NAME, heater_2, 0, POLL_TIMEOUT);
}

static bool set_automatic_dew(bool automatic) {
	bool value = !automatic;
	return hw_wait_settled(box, AUX_DEW_CONTROL_PROPERTY_NAME, INDIGO_OK_STATE, SHORT_TIMEOUT) && hw_set_switch(box, AUX_DEW_CONTROL_PROPERTY_NAME, automatic ? AUX_DEW_CONTROL_AUTOMATIC_ITEM_NAME : AUX_DEW_CONTROL_MANUAL_ITEM_NAME, INDIGO_OK_STATE, SHORT_TIMEOUT) && hw_switch_item(box, AUX_DEW_CONTROL_PROPERTY_NAME, AUX_DEW_CONTROL_AUTOMATIC_ITEM_NAME, &value) && value == automatic;
}

static bool automatic_dew_is(bool automatic) {
	bool value = !automatic;
	return hw_switch_item(box, AUX_DEW_CONTROL_PROPERTY_NAME, AUX_DEW_CONTROL_AUTOMATIC_ITEM_NAME, &value) && value == automatic;
}

static bool dslr_voltage_is(const char *volts) {
	bool value = false;
	return hw_switch_item(box, AUX_DSLR_POWER_PROPERTY_NAME, volts, &value) && value;
}

static bool set_dslr_voltage(const char *volts) {
	return hw_wait_settled(box, AUX_DSLR_POWER_PROPERTY_NAME, INDIGO_OK_STATE, SHORT_TIMEOUT) && hw_set_switch(box, AUX_DSLR_POWER_PROPERTY_NAME, volts, INDIGO_OK_STATE, SHORT_TIMEOUT) && dslr_voltage_is(volts);
}

// The first status poll fills the sensors, the voltage of a powered box is never zero.
static bool wait_for_first_poll(void) {
	double deadline = indigo_monotonic_time() + POLL_TIMEOUT;
	double voltage = 0;
	while (indigo_monotonic_time() < deadline) {
		if (hw_number_item(box, AUX_INFO_PROPERTY_NAME, AUX_INFO_VOLTAGE_ITEM_NAME, &voltage) && voltage > 0) {
			return true;
		}
		indigo_usleep(10000);
	}
	fprintf(stderr, "    no status poll reported a voltage\n");
	return false;
}

static bool capture_state(void) {
	if (!wait_for_first_poll()) {
		return false;
	}
	advance = hw_property_defined(box, AUX_DSLR_POWER_PROPERTY_NAME);
	outlet_count = hw_item_defined(box, AUX_POWER_OUTLET_PROPERTY_NAME, AUX_POWER_OUTLET_2_ITEM_NAME) ? 2 : 1;
	for (int i = 0; i < outlet_count; i++) {
		if (!hw_switch_item(box, AUX_POWER_OUTLET_PROPERTY_NAME, outlet_items[i], initial_outlets + i)) {
			return false;
		}
	}
	if (!hw_number_item(box, AUX_HEATER_OUTLET_PROPERTY_NAME, AUX_HEATER_OUTLET_1_ITEM_NAME, initial_heaters) || !hw_number_item(box, AUX_HEATER_OUTLET_PROPERTY_NAME, AUX_HEATER_OUTLET_2_ITEM_NAME, initial_heaters + 1)) {
		return false;
	}
	if (!hw_switch_item(box, AUX_DEW_CONTROL_PROPERTY_NAME, AUX_DEW_CONTROL_AUTOMATIC_ITEM_NAME, &initial_automatic_dew)) {
		return false;
	}
	if (advance) {
		for (int i = 0; i < ARRAY_SIZE(dslr_voltages); i++) {
			if (dslr_voltage_is(dslr_voltages[i])) {
				initial_dslr = dslr_voltages[i];
			}
		}
	}
	printf("    %d outlet(s) %s%s, heaters %g%% %g%%, %s dew control%s%s\n", outlet_count, initial_outlets[0] ? "on" : "off", outlet_count > 1 ? (initial_outlets[1] ? "/on" : "/off") : "", initial_heaters[0], initial_heaters[1], initial_automatic_dew ? "automatic" : "manual", initial_dslr ? ", DSLR " : "", initial_dslr ? initial_dslr : "");
	return true;
}

static void restore_initial_state(void) {
	if (box < 0 || !state_captured || !hw_connected(box)) {
		return;
	}
	if (initial_dslr != NULL) {
		set_dslr_voltage(initial_dslr);
	}
	set_automatic_dew(initial_automatic_dew);
	if (!initial_automatic_dew) {
		set_heaters(initial_heaters[0], initial_heaters[1]);
	}
	for (int i = 0; i < outlet_count; i++) {
		set_outlet(i, initial_outlets[i]);
	}
}

static void ppb_publishes_the_model_and_its_outlets(void) {
	char model[INDIGO_VALUE_SIZE] = "", firmware[INDIGO_VALUE_SIZE] = "";
	ASSERT_TRUE((hw_device_interface(box) & INDIGO_INTERFACE_AUX_POWERBOX) != 0);
	ASSERT_TRUE((hw_device_interface(box) & INDIGO_INTERFACE_AUX_WEATHER) != 0);
	ASSERT_TRUE(hw_text_item(box, INFO_PROPERTY_NAME, INFO_DEVICE_MODEL_ITEM_NAME, model, sizeof(model)));
	ASSERT_TRUE(hw_text_item(box, INFO_PROPERTY_NAME, INFO_DEVICE_FW_REVISION_ITEM_NAME, firmware, sizeof(firmware)));
	printf("    model %s, firmware %s\n", model, firmware);
	ASSERT_TRUE(!strncmp(model, "PegasusAstro ", 13));
	ASSERT_TRUE(strcmp(firmware, "Unknown") && *firmware);
	bool saddle = !strcmp(model, "PegasusAstro SPB");
	bool is_advance = !strcmp(model, "PegasusAstro PPBA") || !strcmp(model, "PegasusAstro PPBM");
	ASSERT_EQ_INT(saddle ? 1 : 2, outlet_count);
	ASSERT_EQ_INT(is_advance, advance);
	ASSERT_EQ_INT(is_advance, hw_property_defined(box, AUX_POWER_OUTLET_STATE_PROPERTY_NAME));
	ASSERT_TRUE(hw_property_defined(box, AUX_HEATER_OUTLET_PROPERTY_NAME));
	ASSERT_TRUE(hw_property_defined(box, AUX_DEW_CONTROL_PROPERTY_NAME));
	ASSERT_TRUE(hw_property_defined(box, AUX_OUTLET_NAMES_PROPERTY_NAME));
	ASSERT_TRUE(hw_property_defined(box, AUX_SAVE_OUTLET_STATES_AS_DEFAULT_PROPERTY_NAME));
	ASSERT_TRUE(hw_property_defined(box, AUX_REBOOT_PROPERTY_NAME));
}

static void ppb_reports_its_sensors(void) {
	double voltage = 0, current = -1, temperature = -100, humidity = -1, dewpoint = -100;
	ASSERT_TRUE(hw_number_item(box, AUX_INFO_PROPERTY_NAME, AUX_INFO_VOLTAGE_ITEM_NAME, &voltage));
	ASSERT_TRUE(hw_number_item(box, AUX_INFO_PROPERTY_NAME, AUX_INFO_CURRENT_ITEM_NAME, &current));
	ASSERT_TRUE(hw_number_item(box, AUX_WEATHER_PROPERTY_NAME, AUX_WEATHER_TEMPERATURE_ITEM_NAME, &temperature));
	ASSERT_TRUE(hw_number_item(box, AUX_WEATHER_PROPERTY_NAME, AUX_WEATHER_HUMIDITY_ITEM_NAME, &humidity));
	ASSERT_TRUE(hw_number_item(box, AUX_WEATHER_PROPERTY_NAME, AUX_WEATHER_DEWPOINT_ITEM_NAME, &dewpoint));
	printf("    %.1f V, %.2f A, %.1f C, %.0f %%, dewpoint %.1f C\n", voltage, current, temperature, humidity, dewpoint);
	ASSERT_TRUE(voltage > 5 && voltage < 20);
	ASSERT_TRUE(current >= 0 && current < 20);
	ASSERT_TRUE(temperature > -50 && temperature < 70);
	ASSERT_TRUE(humidity >= 0 && humidity <= 100);
	ASSERT_TRUE(dewpoint <= temperature + 0.5);
	ASSERT_EQ_INT(INDIGO_OK_STATE, hw_property_state(box, AUX_INFO_PROPERTY_NAME));
	ASSERT_EQ_INT(INDIGO_OK_STATE, hw_property_state(box, AUX_WEATHER_PROPERTY_NAME));
	if (advance) {
		indigo_property_state alert = INDIGO_IDLE_STATE;
		ASSERT_TRUE(hw_light_item(box, AUX_POWER_OUTLET_STATE_PROPERTY_NAME, AUX_POWER_OUTLET_STATE_1_ITEM_NAME, &alert));
		printf("    power warning %s\n", alert == INDIGO_ALERT_STATE ? "on" : "off");
		ASSERT_TRUE(alert == INDIGO_OK_STATE || alert == INDIGO_ALERT_STATE);
	}
}

// Every outlet switches on its own and the status poll reads the same state back.
static void ppb_switches_each_outlet(void) {
	for (int i = 0; i < outlet_count; i++) {
		for (int pass = 0; pass < 2; pass++) {
			bool on = pass == 0 ? !initial_outlets[i] : initial_outlets[i];
			ASSERT_TRUE(set_outlet(i, on));
			wait_for_polls();
			ASSERT_TRUE(outlet_is(i, on));
			for (int j = 0; j < outlet_count; j++) {
				if (j != i) {
					ASSERT_TRUE(outlet_is(j, initial_outlets[j]));
				}
			}
		}
	}
	// Repeating a request is answered the same way.
	ASSERT_TRUE(set_outlet(0, initial_outlets[0]));
	ASSERT_TRUE(set_outlet(0, initial_outlets[0]));
}

// The duty cycle is a percentage the driver scales to the box's 0 to 255 and the poll scales back.
static void ppb_sets_the_heater_duty_cycles(void) {
	ASSERT_TRUE(set_automatic_dew(false));
	static const double values[][2] = { { 0, 0 }, { 100, 0 }, { 0, 100 }, { 50, 25 }, { 37, 80 }, { 0, 0 } };
	for (int i = 0; i < ARRAY_SIZE(values); i++) {
		ASSERT_TRUE(set_heaters(values[i][0], values[i][1]));
		wait_for_polls();
		ASSERT_TRUE(heaters_are(values[i][0], values[i][1]));
	}
}

static void ppb_switches_the_dew_control(void) {
	for (int pass = 0; pass < 2; pass++) {
		bool automatic = pass == 0 ? !initial_automatic_dew : initial_automatic_dew;
		ASSERT_TRUE(set_automatic_dew(automatic));
		wait_for_polls();
		ASSERT_TRUE(automatic_dew_is(automatic));
	}
	ASSERT_TRUE(set_automatic_dew(false));
	ASSERT_TRUE(set_automatic_dew(false));
	ASSERT_TRUE(automatic_dew_is(false));
}

// A voltage only selects the setpoint of the adjustable output; the outlet switch stays where it is.
static void ppb_selects_the_dslr_voltage(void) {
	if (!advance) {
		ASSERT_TRUE(hw_property_hidden(box, AUX_DSLR_POWER_PROPERTY_NAME));
		printf("    no adjustable output on this model\n");
		return;
	}
	ASSERT_TRUE(set_outlet(1, false));
	for (int i = 0; i < ARRAY_SIZE(dslr_voltages); i++) {
		ASSERT_TRUE(set_dslr_voltage(dslr_voltages[i]));
		wait_for_polls();
		ASSERT_TRUE(dslr_voltage_is(dslr_voltages[i]));
		ASSERT_TRUE(outlet_is(1, false));
	}
	ASSERT_TRUE(set_outlet(1, true));
	wait_for_polls();
	ASSERT_TRUE(outlet_is(1, true));
	ASSERT_TRUE(dslr_voltage_is(dslr_voltages[ARRAY_SIZE(dslr_voltages) - 1]));
	ASSERT_TRUE(set_outlet(1, initial_outlets[1]));
	if (initial_dslr != NULL) {
		ASSERT_TRUE(set_dslr_voltage(initial_dslr));
	}
}

static void ppb_relabels_the_heaters(void) {
	ASSERT_TRUE(hw_set_text(box, AUX_OUTLET_NAMES_PROPERTY_NAME, AUX_HEATER_OUTLET_NAME_1_ITEM_NAME, "Primary", INDIGO_OK_STATE, SHORT_TIMEOUT));
	ASSERT_TRUE(hw_property_defined(box, AUX_HEATER_OUTLET_PROPERTY_NAME));
	ASSERT_TRUE(hw_set_text(box, AUX_OUTLET_NAMES_PROPERTY_NAME, AUX_HEATER_OUTLET_NAME_1_ITEM_NAME, "Heater #1", INDIGO_OK_STATE, SHORT_TIMEOUT));
	ASSERT_TRUE(set_heaters(10, 0));
	ASSERT_TRUE(heaters_are(10, 0));
	ASSERT_TRUE(set_heaters(0, 0));
}

// The power-on default is stored from the outlets as they are now, which is the state the session found.
static void ppb_stores_the_outlet_states_as_default(void) {
	for (int i = 0; i < outlet_count; i++) {
		ASSERT_TRUE(set_outlet(i, initial_outlets[i]));
	}
	ASSERT_TRUE(hw_set_switch(box, AUX_SAVE_OUTLET_STATES_AS_DEFAULT_PROPERTY_NAME, AUX_SAVE_OUTLET_STATES_AS_DEFAULT_ITEM_NAME, INDIGO_OK_STATE, SHORT_TIMEOUT));
	bool value = true;
	ASSERT_TRUE(hw_switch_item(box, AUX_SAVE_OUTLET_STATES_AS_DEFAULT_PROPERTY_NAME, AUX_SAVE_OUTLET_STATES_AS_DEFAULT_ITEM_NAME, &value) && !value);
	// Storing the default does not switch anything.
	wait_for_polls();
	for (int i = 0; i < outlet_count; i++) {
		ASSERT_TRUE(outlet_is(i, initial_outlets[i]));
	}
}

// The reboot is momentary and has no answer. The box comes back with the outlets in the power-on state
// stored by the previous case, which is the state the session found, so the outlets are switched the
// other way first.
static void ppb_reboots(void) {
	for (int i = 0; i < outlet_count; i++) {
		ASSERT_TRUE(set_outlet(i, !initial_outlets[i]));
	}
	ASSERT_TRUE(hw_set_switch(box, AUX_REBOOT_PROPERTY_NAME, "REBOOT", INDIGO_OK_STATE, SHORT_TIMEOUT));
	bool value = true;
	ASSERT_TRUE(hw_switch_item(box, AUX_REBOOT_PROPERTY_NAME, "REBOOT", &value) && !value);
	indigo_usleep(5000000);
	ASSERT_TRUE(hw_disconnect(box, SHORT_TIMEOUT));
	ASSERT_TRUE(hw_connect(box, SHORT_TIMEOUT));
	ASSERT_TRUE(wait_for_first_poll());
	ASSERT_TRUE(hw_wait_settled(box, AUX_POWER_OUTLET_PROPERTY_NAME, INDIGO_OK_STATE, SHORT_TIMEOUT));
	wait_for_polls();
	for (int i = 0; i < outlet_count; i++) {
		ASSERT_TRUE(outlet_is(i, initial_outlets[i]));
	}
}

static void ppb_reconnects(void) {
	ASSERT_TRUE(set_heaters(20, 30));
	ASSERT_TRUE(hw_disconnect(box, SHORT_TIMEOUT));
	ASSERT_TRUE(hw_property_hidden(box, AUX_POWER_OUTLET_PROPERTY_NAME));
	ASSERT_TRUE(hw_connect(box, SHORT_TIMEOUT));
	ASSERT_TRUE(wait_for_first_poll());
	// The box kept the duty cycles over the reconnect.
	ASSERT_TRUE(heaters_are(20, 30));
	ASSERT_TRUE(set_heaters(0, 0));
	ASSERT_TRUE(heaters_are(0, 0));
}

static void ppb_rejects_shutdown_while_connected(void) {
	ASSERT_EQ_INT(INDIGO_BUSY, indigo_aux_ppb(INDIGO_DRIVER_SHUTDOWN, NULL));
	ASSERT_TRUE(set_outlet(0, initial_outlets[0]));
}

static void ppb_reinitializes(void) {
	ASSERT_TRUE(hw_disconnect(box, SHORT_TIMEOUT));
	ASSERT_EQ_INT(INDIGO_OK, indigo_aux_ppb(INDIGO_DRIVER_SHUTDOWN, NULL));
	ASSERT_EQ_INT(-1, hw_device_index(DEVICE_NAME));
	ASSERT_EQ_INT(INDIGO_OK, indigo_aux_ppb(INDIGO_DRIVER_INIT, NULL));
	box = hw_wait_for_device(DEVICE_NAME, SHORT_TIMEOUT);
	ASSERT_TRUE(box >= 0);
	ASSERT_TRUE(select_port());
	ASSERT_TRUE(hw_connect(box, SHORT_TIMEOUT));
	ASSERT_TRUE(wait_for_first_poll());
	ASSERT_TRUE(set_outlet(0, initial_outlets[0]));
}

int main(int argc, char **argv) {
	if (argc < 2 || strcmp(argv[1], "--run")) {
		fprintf(stderr, "Physical Pocket Powerbox test: run explicitly with --run (or make test-aux-ppb-hw).\n");
		return 2;
	}
	setvbuf(stdout, NULL, _IONBF, 0);
	for (int i = 2; i < argc; i++) {
		if (!strcmp(argv[i], "--debug")) {
			indigo_set_log_level(INDIGO_LOG_DEBUG);
		}
	}
	// AUX_OUTLET_NAMES is persistent, so the session keeps its configuration out of the user's own folder.
	if (!indigo_test_use_private_home()) {
		return 1;
	}
	serial_port = hw_port("PPB_HW_PORT");
	const indigo_test_case tests[] = {
		{ "ppb_publishes_the_model_and_its_outlets", ppb_publishes_the_model_and_its_outlets },
		{ "ppb_reports_its_sensors", ppb_reports_its_sensors },
		{ "ppb_switches_each_outlet", ppb_switches_each_outlet },
		{ "ppb_sets_the_heater_duty_cycles", ppb_sets_the_heater_duty_cycles },
		{ "ppb_switches_the_dew_control", ppb_switches_the_dew_control },
		{ "ppb_selects_the_dslr_voltage", ppb_selects_the_dslr_voltage },
		{ "ppb_relabels_the_heaters", ppb_relabels_the_heaters },
		{ "ppb_stores_the_outlet_states_as_default", ppb_stores_the_outlet_states_as_default },
		{ "ppb_reboots", ppb_reboots },
		{ "ppb_reconnects", ppb_reconnects },
		{ "ppb_rejects_shutdown_while_connected", ppb_rejects_shutdown_while_connected },
		{ "ppb_reinitializes", ppb_reinitializes }
	};
	int result = 1;
	bool started = false, initialized = false;
	HW_CHECK(hw_start() == INDIGO_OK);
	started = true;
	HW_CHECK(hw_attach_client("Pocket Powerbox hardware test") == INDIGO_OK);
	HW_CHECK(indigo_aux_ppb(INDIGO_DRIVER_INIT, NULL) == INDIGO_OK);
	initialized = true;
	box = hw_wait_for_device(DEVICE_NAME, SHORT_TIMEOUT);
	HW_CHECK(box >= 0);
	HW_CHECK(select_port());
	HW_CHECK(hw_connect(box, SHORT_TIMEOUT));
	HW_CHECK(capture_state());
	state_captured = true;
	result = indigo_run_tests("Pocket Powerbox hardware", tests, ARRAY_SIZE(tests));
cleanup:
	restore_initial_state();
	if (!hw_disconnect(box, SHORT_TIMEOUT)) {
		indigo_test_failures++;
	}
	if (initialized && indigo_aux_ppb(INDIGO_DRIVER_SHUTDOWN, NULL) != INDIGO_OK) {
		indigo_test_failures++;
	}
	indigo_detach_client(&hw_client);
	if (started) {
		indigo_stop();
	}
	hw_release_properties();
	indigo_test_remove_private_home();
	return indigo_test_failures ? 1 : result;
}
