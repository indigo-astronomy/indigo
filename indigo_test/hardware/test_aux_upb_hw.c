// Copyright (c) 2026 INDIGO initiative
// All rights reserved.
//
// You may use this software under the terms of 'INDIGO Astronomy
// open-source license' (see LICENSE.md).
//
// THIS SOFTWARE IS PROVIDED BY THE AUTHORS 'AS IS' AND ANY EXPRESS
// OR IMPLIED WARRANTIES, INCLUDING, BUT NOT LIMITED TO, THE IMPLIED
// WARRANTIES OF MERCHANTABILITY AND FITNESS FOR A PARTICULAR PURPOSE
// ARE DISCLAIMED. IN NO EVENT SHALL THE AUTHOR BE LIABLE FOR ANY
// DIRECT, INDIRECT, INCIDENTAL, SPECIAL, EXEMPLARY, OR CONSEQUENTIAL
// DAMAGES (INCLUDING, BUT NOT LIMITED TO, PROCUREMENT OF SUBSTITUTE
// GOODS OR SERVICES; LOSS OF USE, DATA, OR PROFITS; OR BUSINESS
// INTERRUPTION) HOWEVER CAUSED AND ON ANY THEORY OF LIABILITY,
// WHETHER IN CONTRACT, STRICT LIABILITY, OR TORT (INCLUDING
// NEGLIGENCE OR OTHERWISE) ARISING IN ANY WAY OUT OF THE USE OF THIS
// SOFTWARE, EVEN IF ADVISED OF THE POSSIBILITY OF SUCH DAMAGE.

// Code is generated by AI

// Opt-in acceptance test for a physically connected Pegasus Ultimate Powerbox. It runs the AUX
// acceptance checklist of DRIVER_TESTING_RULES.md against the real box: connection, identity and
// model dependent inventory, the sensor readings and their polling, every power outlet, the heater
// outlets, dew control, the USB control the model provides, outlet naming, reconnect and driver
// reinitialization.
//
// THE POWER OUTLETS ARE PHYSICALLY SWITCHED. Every outlet this test touches is switched back to
// the state it had when the session started, and the session restores the heaters, the dew mode
// and the USB control as well, but anything powered through the box loses power for the duration
// of its scenario. Run it only on a box whose outlets are free.
//
// The serial port comes from UPB_HW_PORT. When it is not set the port the driver itself detected
// is used.

#include <limits.h>
#include <math.h>
#include <pthread.h>
#include <stdlib.h>
#include <string.h>
#include <unistd.h>
#include <indigo/indigo_bus.h>
#include <indigo/indigo_client.h>
#include <indigo/indigo_driver.h>
#include <indigo/indigo_names.h>
#include <indigo/indigo_timer.h>
#include <indigo_drivers/aux_upb/indigo_aux_upb.h>
#include "../test_runner.h"

#define ARRAY_SIZE(a) (sizeof(a) / sizeof((a)[0]))
#define MAX_DEVICES 4
#define MAX_PROPERTIES 64

#define AUX_DEVICE_NAME "Ultimate Powerbox"
#define FOCUSER_DEVICE_NAME "Ultimate Powerbox (focuser)"

// Driver-defined property names, declared in the generated source rather than in the header.
#define X_AUX_HUB_PROPERTY_NAME "X_AUX_HUB"
#define X_AUX_HUB_ENABLED_ITEM_NAME "ENABLED"
#define X_AUX_HUB_DISABLED_ITEM_NAME "DISABLED"
#define X_AUX_VARIABLE_PROPERTY_NAME "X_AUX_VARIABLE_POWER_OUTLET"
#define X_AUX_VARIABLE_ITEM_NAME "OUTLET_1"

// One serialized request over the link plus the box's own reply latency.
#define SHORT_TIMEOUT 15.0
// The status handler runs every few seconds, so this covers two periods.
#define POLL_TIMEOUT 25.0

#define CHECK(condition) do { if (!(condition)) { fprintf(stderr, "%s:%d: %s\n", __FILE__, __LINE__, #condition); indigo_test_failures++; goto cleanup; } } while (0)

typedef struct {
	char name[INDIGO_NAME_SIZE];
	indigo_device *device;
	unsigned interface;
	bool present;
	indigo_property *properties[MAX_PROPERTIES];
	unsigned revisions[MAX_PROPERTIES];
} observed_device;

static observed_device devices[MAX_DEVICES];
static pthread_mutex_t mutex = PTHREAD_MUTEX_INITIALIZER;
static int aux = -1, focuser = -1;
static indigo_client client;
static const char *serial_port = NULL;

// The box state captured once it is connected. Every scenario works relative to these values and
// the session restores them before it disconnects.
static bool outlets_initial[4];
static double heaters_initial[3];
static char dew_initial[INDIGO_NAME_SIZE], hub_initial[INDIGO_NAME_SIZE];
static double variable_initial;
static int outlet_count, heater_count;
static bool has_hub, has_variable, has_usb_ports;
static bool settings_captured;

static int slot(int d, const char *name) {
	for (int p = 0; p < MAX_PROPERTIES; p++) {
		if (devices[d].properties[p] && !strcmp(devices[d].properties[p]->name, name)) {
			return p;
		}
	}
	return -1;
}

static indigo_result observe(indigo_device *device, indigo_property *property, const char *message) {
	pthread_mutex_lock(&mutex);
	int d;
	for (d = 0; d < MAX_DEVICES; d++) {
		if (!*devices[d].name || !strcmp(devices[d].name, property->device)) {
			break;
		}
	}
	if (d < MAX_DEVICES) {
		snprintf(devices[d].name, INDIGO_NAME_SIZE, "%s", property->device);
		devices[d].device = device;
		devices[d].present = true;
		if (!strcmp(property->name, INFO_PROPERTY_NAME)) {
			for (int i = 0; i < property->count; i++) {
				if (!strcmp(property->items[i].name, INFO_DEVICE_INTERFACE_ITEM_NAME)) {
					devices[d].interface = (unsigned)strtoul(property->items[i].text.value, NULL, 10);
				}
			}
		}
		int p = slot(d, property->name);
		if (p < 0) {
			for (p = 0; p < MAX_PROPERTIES && devices[d].properties[p]; p++) { }
		}
		if (p < MAX_PROPERTIES) {
			indigo_release_property(devices[d].properties[p]);
			devices[d].properties[p] = indigo_copy_property(NULL, property);
			devices[d].revisions[p]++;
		}
	}
	pthread_mutex_unlock(&mutex);
	if (message && *message) {
		fprintf(stderr, "    %s %s: %s\n", property->device, property->name, message);
	}
	return INDIGO_OK;
}

static indigo_result define_property(indigo_client *client, indigo_device *device, indigo_property *property, const char *message) {
	return observe(device, property, message);
}

static indigo_result update_property(indigo_client *client, indigo_device *device, indigo_property *property, const char *message) {
	return observe(device, property, message);
}

static indigo_result report_message(indigo_client *client, indigo_device *device, indigo_property *property, const char *message) {
	if (message && *message) {
		fprintf(stderr, "    message: %s\n", message);
	}
	return INDIGO_OK;
}

static indigo_result delete_property(indigo_client *client, indigo_device *device, indigo_property *property, const char *message) {
	pthread_mutex_lock(&mutex);
	for (int d = 0; d < MAX_DEVICES; d++) {
		if (strcmp(devices[d].name, property->device)) {
			continue;
		}
		if (*property->name) {
			int p = slot(d, property->name);
			if (p >= 0) {
				indigo_release_property(devices[d].properties[p]);
				devices[d].properties[p] = NULL;
				devices[d].revisions[p] = 0;
			}
		} else {
			devices[d].present = false;
			for (int p = 0; p < MAX_PROPERTIES; p++) {
				indigo_release_property(devices[d].properties[p]);
				devices[d].properties[p] = NULL;
				devices[d].revisions[p] = 0;
			}
		}
	}
	pthread_mutex_unlock(&mutex);
	return INDIGO_OK;
}

static int device_index(const char *name) {
	pthread_mutex_lock(&mutex);
	int result = -1;
	for (int d = 0; d < MAX_DEVICES; d++) {
		if (!strcmp(devices[d].name, name)) {
			result = d;
		}
	}
	pthread_mutex_unlock(&mutex);
	return result;
}

static unsigned revision(int d, const char *name) {
	pthread_mutex_lock(&mutex);
	int p = slot(d, name);
	unsigned result = p < 0 ? 0 : devices[d].revisions[p];
	pthread_mutex_unlock(&mutex);
	return result;
}

static bool property_defined(int d, const char *name) {
	pthread_mutex_lock(&mutex);
	bool found = slot(d, name) >= 0;
	pthread_mutex_unlock(&mutex);
	return found;
}

static int property_count(int d, const char *name) {
	pthread_mutex_lock(&mutex);
	int p = slot(d, name);
	int result = p < 0 ? -1 : devices[d].properties[p]->count;
	pthread_mutex_unlock(&mutex);
	return result;
}

static bool number_item(int d, const char *name, const char *item, double *value) {
	pthread_mutex_lock(&mutex);
	bool found = false;
	int p = slot(d, name);
	if (p >= 0) {
		indigo_property *property = devices[d].properties[p];
		for (int i = 0; i < property->count; i++) {
			if (!strcmp(property->items[i].name, item)) {
				*value = property->items[i].number.value;
				found = true;
			}
		}
	}
	pthread_mutex_unlock(&mutex);
	if (!found) {
		fprintf(stderr, "    %s.%s is missing\n", name, item);
	}
	return found;
}

static bool switch_item(int d, const char *name, const char *item, bool *value) {
	pthread_mutex_lock(&mutex);
	bool found = false;
	int p = slot(d, name);
	if (p >= 0) {
		indigo_property *property = devices[d].properties[p];
		for (int i = 0; i < property->count; i++) {
			if (!strcmp(property->items[i].name, item)) {
				*value = property->items[i].sw.value;
				found = true;
			}
		}
	}
	pthread_mutex_unlock(&mutex);
	if (!found) {
		fprintf(stderr, "    %s.%s is missing\n", name, item);
	}
	return found;
}

static bool selected_switch(int d, const char *name, char *item, size_t size) {
	pthread_mutex_lock(&mutex);
	bool found = false;
	int p = slot(d, name);
	if (p >= 0) {
		indigo_property *property = devices[d].properties[p];
		for (int i = 0; i < property->count; i++) {
			if (property->items[i].sw.value) {
				snprintf(item, size, "%s", property->items[i].name);
				found = true;
			}
		}
	}
	pthread_mutex_unlock(&mutex);
	return found;
}

static bool item_name_at(int d, const char *name, int index, char *item, size_t size) {
	pthread_mutex_lock(&mutex);
	bool found = false;
	int p = slot(d, name);
	if (p >= 0 && index < devices[d].properties[p]->count) {
		snprintf(item, size, "%s", devices[d].properties[p]->items[index].name);
		found = true;
	}
	pthread_mutex_unlock(&mutex);
	return found;
}

static bool wait_settled(int d, const char *name, indigo_property_state state, double timeout) {
	double deadline = indigo_monotonic_time() + timeout;
	while (indigo_monotonic_time() < deadline) {
		pthread_mutex_lock(&mutex);
		int p = slot(d, name);
		bool done = p >= 0 && devices[d].properties[p]->state == state;
		pthread_mutex_unlock(&mutex);
		if (done) {
			return true;
		}
		indigo_usleep(100000);
	}
	fprintf(stderr, "    %s did not settle in state %d\n", name, state);
	return false;
}

static bool wait_revision(int d, const char *name, unsigned after, double timeout) {
	double deadline = indigo_monotonic_time() + timeout;
	while (indigo_monotonic_time() < deadline) {
		if (revision(d, name) > after) {
			return true;
		}
		indigo_usleep(100000);
	}
	fprintf(stderr, "    %s was not published again\n", name);
	return false;
}

static bool wait_switch_item(int d, const char *name, const char *item, bool expected, double timeout) {
	double deadline = indigo_monotonic_time() + timeout;
	while (indigo_monotonic_time() < deadline) {
		bool value = false;
		if (switch_item(d, name, item, &value) && value == expected) {
			return true;
		}
		indigo_usleep(100000);
	}
	fprintf(stderr, "    %s.%s did not become %s\n", name, item, expected ? "on" : "off");
	return false;
}

static bool wait_number_item(int d, const char *name, const char *item, double expected, double tolerance, double timeout) {
	double deadline = indigo_monotonic_time() + timeout;
	while (indigo_monotonic_time() < deadline) {
		double value = 0;
		if (number_item(d, name, item, &value) && fabs(value - expected) <= tolerance) {
			return true;
		}
		indigo_usleep(100000);
	}
	fprintf(stderr, "    %s.%s did not reach %g\n", name, item, expected);
	return false;
}

// Every request waits for the property to settle first, because the change dispatch drops a
// request that arrives while the property is still BUSY.
static bool set_switch(int d, const char *name, const char *item, bool value, double timeout) {
	if (!wait_settled(d, name, INDIGO_OK_STATE, timeout)) {
		return false;
	}
	if (indigo_change_switch_property_1(&client, devices[d].name, name, item, value) != INDIGO_OK) {
		return false;
	}
	return wait_settled(d, name, INDIGO_OK_STATE, timeout);
}

static bool set_number(int d, const char *name, const char *item, double value, double timeout) {
	if (!wait_settled(d, name, INDIGO_OK_STATE, timeout)) {
		return false;
	}
	if (indigo_change_number_property_1(&client, devices[d].name, name, item, value) != INDIGO_OK) {
		return false;
	}
	return wait_settled(d, name, INDIGO_OK_STATE, timeout);
}

static bool connect_device(int d, double timeout) {
	if (d < 0) {
		return false;
	}
	bool connected = false;
	if (switch_item(d, CONNECTION_PROPERTY_NAME, CONNECTION_CONNECTED_ITEM_NAME, &connected) && connected) {
		return true;
	}
	unsigned before = revision(d, CONNECTION_PROPERTY_NAME);
	indigo_change_switch_property_1(&client, devices[d].name, CONNECTION_PROPERTY_NAME, CONNECTION_CONNECTED_ITEM_NAME, true);
	if (!wait_revision(d, CONNECTION_PROPERTY_NAME, before, timeout) || !wait_settled(d, CONNECTION_PROPERTY_NAME, INDIGO_OK_STATE, timeout)) {
		return false;
	}
	return switch_item(d, CONNECTION_PROPERTY_NAME, CONNECTION_CONNECTED_ITEM_NAME, &connected) && connected;
}

static bool disconnect_device(int d) {
	if (d < 0 || !devices[d].present) {
		return true;
	}
	bool connected = false;
	if (switch_item(d, CONNECTION_PROPERTY_NAME, CONNECTION_CONNECTED_ITEM_NAME, &connected) && !connected) {
		return true;
	}
	indigo_change_switch_property_1(&client, devices[d].name, CONNECTION_PROPERTY_NAME, CONNECTION_DISCONNECTED_ITEM_NAME, true);
	return wait_settled(d, CONNECTION_PROPERTY_NAME, INDIGO_OK_STATE, SHORT_TIMEOUT);
}

static bool wait_presence(double timeout) {
	double deadline = indigo_monotonic_time() + timeout;
	while (indigo_monotonic_time() < deadline) {
		aux = device_index(AUX_DEVICE_NAME);
		focuser = device_index(FOCUSER_DEVICE_NAME);
		if (aux >= 0) {
			return true;
		}
		indigo_usleep(100000);
	}
	fprintf(stderr, "    %s never appeared\n", AUX_DEVICE_NAME);
	return false;
}

static bool select_port(void) {
	if (serial_port == NULL) {
		char detected[INDIGO_VALUE_SIZE] = "";
		pthread_mutex_lock(&mutex);
		int p = slot(aux, DEVICE_PORT_PROPERTY_NAME);
		if (p >= 0 && devices[aux].properties[p]->count > 0) {
			snprintf(detected, sizeof(detected), "%s", devices[aux].properties[p]->items[0].text.value);
		}
		pthread_mutex_unlock(&mutex);
		if (*detected) {
			printf("    using the detected port %s\n", detected);
			return true;
		}
		fprintf(stderr, "    no port was detected; set UPB_HW_PORT\n");
		return false;
	}
	unsigned before = revision(aux, DEVICE_PORT_PROPERTY_NAME);
	indigo_change_text_property_1(&client, AUX_DEVICE_NAME, DEVICE_PORT_PROPERTY_NAME, DEVICE_PORT_ITEM_NAME, serial_port);
	return wait_revision(aux, DEVICE_PORT_PROPERTY_NAME, before, SHORT_TIMEOUT);
}

// Capture what the box looked like when the session started, so every scenario can put it back.
static bool capture_initial_settings(void) {
	outlet_count = property_count(aux, AUX_POWER_OUTLET_PROPERTY_NAME);
	heater_count = property_count(aux, AUX_HEATER_OUTLET_PROPERTY_NAME);
	has_hub = property_defined(aux, X_AUX_HUB_PROPERTY_NAME);
	has_variable = property_defined(aux, X_AUX_VARIABLE_PROPERTY_NAME);
	has_usb_ports = property_defined(aux, AUX_USB_PORT_PROPERTY_NAME);
	if (outlet_count < 1 || heater_count < 1) {
		return false;
	}
	for (int i = 0; i < outlet_count && i < 4; i++) {
		char item[INDIGO_NAME_SIZE];
		if (!item_name_at(aux, AUX_POWER_OUTLET_PROPERTY_NAME, i, item, sizeof(item)) || !switch_item(aux, AUX_POWER_OUTLET_PROPERTY_NAME, item, outlets_initial + i)) {
			return false;
		}
	}
	for (int i = 0; i < heater_count && i < 3; i++) {
		char item[INDIGO_NAME_SIZE];
		if (!item_name_at(aux, AUX_HEATER_OUTLET_PROPERTY_NAME, i, item, sizeof(item)) || !number_item(aux, AUX_HEATER_OUTLET_PROPERTY_NAME, item, heaters_initial + i)) {
			return false;
		}
	}
	if (!selected_switch(aux, AUX_DEW_CONTROL_PROPERTY_NAME, dew_initial, sizeof(dew_initial))) {
		return false;
	}
	if (has_hub && !selected_switch(aux, X_AUX_HUB_PROPERTY_NAME, hub_initial, sizeof(hub_initial))) {
		return false;
	}
	if (has_variable && !number_item(aux, X_AUX_VARIABLE_PROPERTY_NAME, X_AUX_VARIABLE_ITEM_NAME, &variable_initial)) {
		return false;
	}
	settings_captured = true;
	return true;
}

static void restore_initial_settings(void) {
	if (!settings_captured) {
		return;
	}
	for (int i = 0; i < heater_count && i < 3; i++) {
		char item[INDIGO_NAME_SIZE];
		if (item_name_at(aux, AUX_HEATER_OUTLET_PROPERTY_NAME, i, item, sizeof(item))) {
			set_number(aux, AUX_HEATER_OUTLET_PROPERTY_NAME, item, heaters_initial[i], SHORT_TIMEOUT);
		}
	}
	for (int i = 0; i < outlet_count && i < 4; i++) {
		char item[INDIGO_NAME_SIZE];
		if (item_name_at(aux, AUX_POWER_OUTLET_PROPERTY_NAME, i, item, sizeof(item))) {
			set_switch(aux, AUX_POWER_OUTLET_PROPERTY_NAME, item, outlets_initial[i], SHORT_TIMEOUT);
		}
	}
	if (*dew_initial) {
		set_switch(aux, AUX_DEW_CONTROL_PROPERTY_NAME, dew_initial, true, SHORT_TIMEOUT);
	}
	if (has_hub && *hub_initial) {
		set_switch(aux, X_AUX_HUB_PROPERTY_NAME, hub_initial, true, SHORT_TIMEOUT);
	}
	if (has_variable) {
		set_number(aux, X_AUX_VARIABLE_PROPERTY_NAME, X_AUX_VARIABLE_ITEM_NAME, variable_initial, SHORT_TIMEOUT);
	}
}

// ------------------------------------------------------------------ scenarios

static void upb_reports_identity_and_capabilities(void) {
	char model[INDIGO_VALUE_SIZE] = "", revision_text[INDIGO_VALUE_SIZE] = "";
	pthread_mutex_lock(&mutex);
	int p = slot(aux, INFO_PROPERTY_NAME);
	if (p >= 0) {
		indigo_property *info = devices[aux].properties[p];
		for (int i = 0; i < info->count; i++) {
			if (!strcmp(info->items[i].name, INFO_DEVICE_MODEL_ITEM_NAME)) {
				snprintf(model, sizeof(model), "%s", info->items[i].text.value);
			} else if (!strcmp(info->items[i].name, INFO_DEVICE_FW_REVISION_ITEM_NAME)) {
				snprintf(revision_text, sizeof(revision_text), "%s", info->items[i].text.value);
			}
		}
	}
	pthread_mutex_unlock(&mutex);
	printf("    model '%s', firmware '%s', %d outlets, %d heaters, hub %s, usb ports %s, variable %s\n", model, revision_text, outlet_count, heater_count, has_hub ? "yes" : "no", has_usb_ports ? "yes" : "no", has_variable ? "yes" : "no");
	ASSERT_TRUE(devices[aux].interface & INDIGO_INTERFACE_AUX_POWERBOX);
	// The identified model has to replace the placeholder the attach handler seeds.
	ASSERT_TRUE(*model && strcmp(model, "Unknown"));
	ASSERT_TRUE(*revision_text && strcmp(revision_text, "Unknown"));
	ASSERT_EQ_INT(4, outlet_count);
	// The v1 box has two heaters and no variable voltage output, the v2 has three of each.
	ASSERT_TRUE(heater_count == 2 || heater_count == 3);
	ASSERT_EQ_INT(heater_count == 3, has_variable);
	// The hub switch belongs to the v1 box; the v2 switches its ports individually.
	ASSERT_TRUE(heater_count == 3 || has_hub);
}

static void upb_publishes_the_property_contract(void) {
	ASSERT_TRUE(property_defined(aux, AUX_POWER_OUTLET_PROPERTY_NAME));
	ASSERT_TRUE(property_defined(aux, AUX_POWER_OUTLET_STATE_PROPERTY_NAME));
	ASSERT_TRUE(property_defined(aux, AUX_POWER_OUTLET_CURRENT_PROPERTY_NAME));
	ASSERT_TRUE(property_defined(aux, AUX_HEATER_OUTLET_PROPERTY_NAME));
	ASSERT_TRUE(property_defined(aux, AUX_HEATER_OUTLET_STATE_PROPERTY_NAME));
	ASSERT_TRUE(property_defined(aux, AUX_HEATER_OUTLET_CURRENT_PROPERTY_NAME));
	ASSERT_TRUE(property_defined(aux, AUX_DEW_CONTROL_PROPERTY_NAME));
	ASSERT_TRUE(property_defined(aux, AUX_WEATHER_PROPERTY_NAME));
	ASSERT_TRUE(property_defined(aux, AUX_INFO_PROPERTY_NAME));
	ASSERT_TRUE(property_defined(aux, AUX_OUTLET_NAMES_PROPERTY_NAME));
	ASSERT_TRUE(property_defined(aux, AUX_SAVE_OUTLET_STATES_AS_DEFAULT_PROPERTY_NAME));
	ASSERT_EQ_INT(outlet_count, property_count(aux, AUX_POWER_OUTLET_STATE_PROPERTY_NAME));
	ASSERT_EQ_INT(outlet_count, property_count(aux, AUX_POWER_OUTLET_CURRENT_PROPERTY_NAME));
	ASSERT_EQ_INT(heater_count, property_count(aux, AUX_HEATER_OUTLET_STATE_PROPERTY_NAME));
	ASSERT_EQ_INT(heater_count, property_count(aux, AUX_HEATER_OUTLET_CURRENT_PROPERTY_NAME));
}

static void upb_reads_its_sensors(void) {
	double voltage = 0, current = 0, temperature = 0, humidity = 0, dewpoint = 0;
	ASSERT_TRUE(number_item(aux, AUX_INFO_PROPERTY_NAME, AUX_INFO_VOLTAGE_ITEM_NAME, &voltage));
	ASSERT_TRUE(number_item(aux, AUX_INFO_PROPERTY_NAME, AUX_INFO_CURRENT_ITEM_NAME, &current));
	ASSERT_TRUE(number_item(aux, AUX_WEATHER_PROPERTY_NAME, AUX_WEATHER_TEMPERATURE_ITEM_NAME, &temperature));
	ASSERT_TRUE(number_item(aux, AUX_WEATHER_PROPERTY_NAME, AUX_WEATHER_HUMIDITY_ITEM_NAME, &humidity));
	ASSERT_TRUE(number_item(aux, AUX_WEATHER_PROPERTY_NAME, AUX_WEATHER_DEWPOINT_ITEM_NAME, &dewpoint));
	printf("    %.1f V, %.2f A, %.1f C, %.0f %%RH, dewpoint %.1f C\n", voltage, current, temperature, humidity, dewpoint);
	// A powered box reads a plausible supply voltage; the sensors are on the same frame.
	ASSERT_TRUE(voltage > 5 && voltage < 30);
	ASSERT_TRUE(current >= 0 && current < 30);
	ASSERT_TRUE(humidity >= 0 && humidity <= 100);
}

static void upb_polls_its_sensors(void) {
	unsigned before = revision(aux, AUX_INFO_PROPERTY_NAME);
	ASSERT_TRUE(wait_revision(aux, AUX_INFO_PROPERTY_NAME, before, POLL_TIMEOUT));
}

// Each outlet is switched to the opposite of what it was, read back, and put back.
static void upb_switches_every_power_outlet(void) {
	for (int i = 0; i < outlet_count && i < 4; i++) {
		char item[INDIGO_NAME_SIZE];
		ASSERT_TRUE(item_name_at(aux, AUX_POWER_OUTLET_PROPERTY_NAME, i, item, sizeof(item)));
		bool target = !outlets_initial[i];
		ASSERT_TRUE(set_switch(aux, AUX_POWER_OUTLET_PROPERTY_NAME, item, target, SHORT_TIMEOUT));
		// The status poll reads the outlet mask back, so the new state has to survive it.
		ASSERT_TRUE(wait_switch_item(aux, AUX_POWER_OUTLET_PROPERTY_NAME, item, target, POLL_TIMEOUT));
		ASSERT_TRUE(set_switch(aux, AUX_POWER_OUTLET_PROPERTY_NAME, item, outlets_initial[i], SHORT_TIMEOUT));
		ASSERT_TRUE(wait_switch_item(aux, AUX_POWER_OUTLET_PROPERTY_NAME, item, outlets_initial[i], POLL_TIMEOUT));
	}
}

// A switched outlet draws through the box's own shunt, so its state light follows the switch.
static void upb_reports_outlet_state_and_current(void) {
	char item[INDIGO_NAME_SIZE], current_item[INDIGO_NAME_SIZE];
	ASSERT_TRUE(item_name_at(aux, AUX_POWER_OUTLET_PROPERTY_NAME, 0, item, sizeof(item)));
	ASSERT_TRUE(item_name_at(aux, AUX_POWER_OUTLET_CURRENT_PROPERTY_NAME, 0, current_item, sizeof(current_item)));
	double current = 0;
	ASSERT_TRUE(number_item(aux, AUX_POWER_OUTLET_CURRENT_PROPERTY_NAME, current_item, &current));
	ASSERT_TRUE(current >= 0);
	ASSERT_TRUE(set_switch(aux, AUX_POWER_OUTLET_PROPERTY_NAME, item, true, SHORT_TIMEOUT));
	// The state light is republished only when a flag actually changes, so the value is what
	// matters: a healthy switched-on outlet is OK rather than ALERT.
	double state_value = 0;
	ASSERT_TRUE(wait_settled(aux, AUX_POWER_OUTLET_STATE_PROPERTY_NAME, INDIGO_OK_STATE, POLL_TIMEOUT));
	pthread_mutex_lock(&mutex);
	int sp = slot(aux, AUX_POWER_OUTLET_STATE_PROPERTY_NAME);
	if (sp >= 0 && devices[aux].properties[sp]->count > 0) {
		state_value = devices[aux].properties[sp]->items[0].light.value;
	}
	pthread_mutex_unlock(&mutex);
	printf("    outlet 1 state light %g, current %.2f A\n", state_value, current);
	ASSERT_TRUE(state_value != INDIGO_ALERT_STATE);
	ASSERT_TRUE(set_switch(aux, AUX_POWER_OUTLET_PROPERTY_NAME, item, outlets_initial[0], SHORT_TIMEOUT));
}

static void upb_sets_heater_duty_cycles(void) {
	for (int i = 0; i < heater_count && i < 3; i++) {
		char item[INDIGO_NAME_SIZE];
		ASSERT_TRUE(item_name_at(aux, AUX_HEATER_OUTLET_PROPERTY_NAME, i, item, sizeof(item)));
		ASSERT_TRUE(set_number(aux, AUX_HEATER_OUTLET_PROPERTY_NAME, item, 20, SHORT_TIMEOUT));
		// The box stores the duty cycle as 0..255, so the readback is rounded.
		ASSERT_TRUE(wait_number_item(aux, AUX_HEATER_OUTLET_PROPERTY_NAME, item, 20, 1, POLL_TIMEOUT));
		ASSERT_TRUE(set_number(aux, AUX_HEATER_OUTLET_PROPERTY_NAME, item, heaters_initial[i], SHORT_TIMEOUT));
		ASSERT_TRUE(wait_number_item(aux, AUX_HEATER_OUTLET_PROPERTY_NAME, item, heaters_initial[i], 1, POLL_TIMEOUT));
	}
}

static void upb_switches_dew_control(void) {
	ASSERT_TRUE(set_switch(aux, AUX_DEW_CONTROL_PROPERTY_NAME, AUX_DEW_CONTROL_AUTOMATIC_ITEM_NAME, true, SHORT_TIMEOUT));
	ASSERT_TRUE(wait_switch_item(aux, AUX_DEW_CONTROL_PROPERTY_NAME, AUX_DEW_CONTROL_AUTOMATIC_ITEM_NAME, true, POLL_TIMEOUT));
	ASSERT_TRUE(set_switch(aux, AUX_DEW_CONTROL_PROPERTY_NAME, AUX_DEW_CONTROL_MANUAL_ITEM_NAME, true, SHORT_TIMEOUT));
	ASSERT_TRUE(wait_switch_item(aux, AUX_DEW_CONTROL_PROPERTY_NAME, AUX_DEW_CONTROL_MANUAL_ITEM_NAME, true, POLL_TIMEOUT));
	ASSERT_TRUE(set_switch(aux, AUX_DEW_CONTROL_PROPERTY_NAME, dew_initial, true, SHORT_TIMEOUT));
}

static void upb_switches_the_usb_control(void) {
	if (has_usb_ports) {
		// The v2 box switches its ports itself.
		char item[INDIGO_NAME_SIZE];
		ASSERT_TRUE(item_name_at(aux, AUX_USB_PORT_PROPERTY_NAME, 0, item, sizeof(item)));
		bool initial = false;
		ASSERT_TRUE(switch_item(aux, AUX_USB_PORT_PROPERTY_NAME, item, &initial));
		ASSERT_TRUE(set_switch(aux, AUX_USB_PORT_PROPERTY_NAME, item, !initial, SHORT_TIMEOUT));
		ASSERT_TRUE(wait_switch_item(aux, AUX_USB_PORT_PROPERTY_NAME, item, !initial, POLL_TIMEOUT));
		ASSERT_TRUE(set_switch(aux, AUX_USB_PORT_PROPERTY_NAME, item, initial, SHORT_TIMEOUT));
	} else if (has_hub) {
		ASSERT_TRUE(set_switch(aux, X_AUX_HUB_PROPERTY_NAME, X_AUX_HUB_DISABLED_ITEM_NAME, true, SHORT_TIMEOUT));
		ASSERT_TRUE(set_switch(aux, X_AUX_HUB_PROPERTY_NAME, X_AUX_HUB_ENABLED_ITEM_NAME, true, SHORT_TIMEOUT));
		ASSERT_TRUE(set_switch(aux, X_AUX_HUB_PROPERTY_NAME, hub_initial, true, SHORT_TIMEOUT));
	} else {
		printf("    no USB control on this model\n");
	}
}

static void upb_sets_the_variable_outlet(void) {
	if (!has_variable) {
		printf("    no variable voltage outlet on this model\n");
		return;
	}
	ASSERT_TRUE(set_number(aux, X_AUX_VARIABLE_PROPERTY_NAME, X_AUX_VARIABLE_ITEM_NAME, 5, SHORT_TIMEOUT));
	ASSERT_TRUE(set_number(aux, X_AUX_VARIABLE_PROPERTY_NAME, X_AUX_VARIABLE_ITEM_NAME, variable_initial, SHORT_TIMEOUT));
}

static void upb_renames_an_outlet(void) {
	char original[INDIGO_VALUE_SIZE] = "";
	pthread_mutex_lock(&mutex);
	int p = slot(aux, AUX_OUTLET_NAMES_PROPERTY_NAME);
	if (p >= 0 && devices[aux].properties[p]->count > 0) {
		snprintf(original, sizeof(original), "%s", devices[aux].properties[p]->items[0].text.value);
	}
	pthread_mutex_unlock(&mutex);
	ASSERT_TRUE(*original);
	char item[INDIGO_NAME_SIZE];
	ASSERT_TRUE(item_name_at(aux, AUX_OUTLET_NAMES_PROPERTY_NAME, 0, item, sizeof(item)));
	indigo_change_text_property_1(&client, AUX_DEVICE_NAME, AUX_OUTLET_NAMES_PROPERTY_NAME, item, "HW test");
	ASSERT_TRUE(wait_settled(aux, AUX_OUTLET_NAMES_PROPERTY_NAME, INDIGO_OK_STATE, SHORT_TIMEOUT));
	indigo_change_text_property_1(&client, AUX_DEVICE_NAME, AUX_OUTLET_NAMES_PROPERTY_NAME, item, original);
	ASSERT_TRUE(wait_settled(aux, AUX_OUTLET_NAMES_PROPERTY_NAME, INDIGO_OK_STATE, SHORT_TIMEOUT));
}

// The focuser shares the box's connection. It is exercised only as far as a box without a motor
// allows: it has to come up, publish its contract and read its position back.
static void upb_connects_the_focuser(void) {
	if (focuser < 0) {
		focuser = device_index(FOCUSER_DEVICE_NAME);
	}
	if (focuser < 0) {
		printf("    the focuser device is not published\n");
		return;
	}
	ASSERT_TRUE(connect_device(focuser, SHORT_TIMEOUT));
	ASSERT_TRUE(devices[focuser].interface & INDIGO_INTERFACE_FOCUSER);
	ASSERT_TRUE(property_defined(focuser, FOCUSER_POSITION_PROPERTY_NAME));
	ASSERT_TRUE(property_defined(focuser, FOCUSER_STEPS_PROPERTY_NAME));
	ASSERT_TRUE(property_defined(focuser, FOCUSER_ABORT_MOTION_PROPERTY_NAME));
	double position = 0, temperature = 0;
	ASSERT_TRUE(number_item(focuser, FOCUSER_POSITION_PROPERTY_NAME, FOCUSER_POSITION_ITEM_NAME, &position));
	ASSERT_TRUE(number_item(focuser, FOCUSER_TEMPERATURE_PROPERTY_NAME, FOCUSER_TEMPERATURE_ITEM_NAME, &temperature));
	printf("    focuser position %.0f, temperature %.1f C\n", position, temperature);
	// An abort while the motor is idle is harmless and must be accepted.
	ASSERT_TRUE(set_switch(focuser, FOCUSER_ABORT_MOTION_PROPERTY_NAME, FOCUSER_ABORT_MOTION_ITEM_NAME, true, SHORT_TIMEOUT));
	ASSERT_TRUE(disconnect_device(focuser));
	// Closing the focuser must not take the powerbox connection down with it.
	bool connected = false;
	ASSERT_TRUE(switch_item(aux, CONNECTION_PROPERTY_NAME, CONNECTION_CONNECTED_ITEM_NAME, &connected) && connected);
}

static void upb_reconnects(void) {
	ASSERT_TRUE(disconnect_device(aux));
	ASSERT_TRUE(connect_device(aux, SHORT_TIMEOUT));
	double voltage = 0;
	ASSERT_TRUE(wait_settled(aux, AUX_INFO_PROPERTY_NAME, INDIGO_OK_STATE, POLL_TIMEOUT));
	ASSERT_TRUE(number_item(aux, AUX_INFO_PROPERTY_NAME, AUX_INFO_VOLTAGE_ITEM_NAME, &voltage));
	ASSERT_TRUE(voltage > 5);
}

static void upb_reinitializes(void) {
	ASSERT_TRUE(disconnect_device(aux));
	ASSERT_TRUE(indigo_aux_upb(INDIGO_DRIVER_SHUTDOWN, NULL) == INDIGO_OK);
	ASSERT_TRUE(indigo_aux_upb(INDIGO_DRIVER_INIT, NULL) == INDIGO_OK);
	ASSERT_TRUE(wait_presence(SHORT_TIMEOUT));
	ASSERT_TRUE(select_port());
	ASSERT_TRUE(connect_device(aux, SHORT_TIMEOUT));
}

int main(int argc, char **argv) {
	if (argc < 2 || strcmp(argv[1], "--run")) {
		fprintf(stderr, "Physical Pegasus Ultimate Powerbox test: run explicitly with --run (or make test-aux-upb-hw).\n");
		fprintf(stderr, "IT SWITCHES THE POWER OUTLETS. Run it only on a box whose outlets are free.\n");
		return 2;
	}
	setvbuf(stdout, NULL, _IONBF, 0);
	if (getenv("UPB_HW_DEBUG")) {
		indigo_set_log_level(INDIGO_LOG_DEBUG);
	}
	serial_port = getenv("UPB_HW_PORT");
	client = (indigo_client){ .name = "Ultimate Powerbox hardware test", .version = INDIGO_VERSION_CURRENT, .define_property = define_property, .update_property = update_property, .delete_property = delete_property, .send_message = report_message };
	const indigo_test_case tests[] = {
		{ "upb_reports_identity_and_capabilities", upb_reports_identity_and_capabilities },
		{ "upb_publishes_the_property_contract", upb_publishes_the_property_contract },
		{ "upb_reads_its_sensors", upb_reads_its_sensors },
		{ "upb_polls_its_sensors", upb_polls_its_sensors },
		{ "upb_switches_every_power_outlet", upb_switches_every_power_outlet },
		{ "upb_reports_outlet_state_and_current", upb_reports_outlet_state_and_current },
		{ "upb_sets_heater_duty_cycles", upb_sets_heater_duty_cycles },
		{ "upb_switches_dew_control", upb_switches_dew_control },
		{ "upb_switches_the_usb_control", upb_switches_the_usb_control },
		{ "upb_sets_the_variable_outlet", upb_sets_the_variable_outlet },
		{ "upb_renames_an_outlet", upb_renames_an_outlet },
		{ "upb_connects_the_focuser", upb_connects_the_focuser },
		{ "upb_reconnects", upb_reconnects },
		{ "upb_reinitializes", upb_reinitializes }
	};
	int result = 1;
	bool started = false, initialized = false;
	if (!indigo_test_use_private_home()) {
		return 1;
	}
	CHECK(indigo_start() == INDIGO_OK);
	started = true;
	CHECK(indigo_attach_client(&client) == INDIGO_OK);
	CHECK(indigo_aux_upb(INDIGO_DRIVER_INIT, NULL) == INDIGO_OK);
	initialized = true;
	CHECK(wait_presence(SHORT_TIMEOUT));
	CHECK(select_port());
	CHECK(connect_device(aux, SHORT_TIMEOUT));
	CHECK(capture_initial_settings());
	result = indigo_run_tests("Ultimate Powerbox hardware", tests, ARRAY_SIZE(tests));
cleanup:
	if (aux >= 0 && devices[aux].present) {
		restore_initial_settings();
		printf("Restored the outlet, heater, dew and USB state the session started with\n");
	}
	if (!disconnect_device(focuser) || !disconnect_device(aux)) {
		indigo_test_failures++;
	}
	if (initialized && indigo_aux_upb(INDIGO_DRIVER_SHUTDOWN, NULL) != INDIGO_OK) {
		indigo_test_failures++;
	}
	indigo_detach_client(&client);
	if (started) {
		indigo_stop();
	}
	for (int d = 0; d < MAX_DEVICES; d++) {
		for (int p = 0; p < MAX_PROPERTIES; p++) {
			indigo_release_property(devices[d].properties[p]);
		}
	}
	indigo_test_remove_private_home();
	return indigo_test_failures ? 1 : result;
}
