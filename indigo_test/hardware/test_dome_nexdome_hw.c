// Copyright (c) 2026 INDIGO initiative
// All rights reserved.
//
// You may use this software under the terms of 'INDIGO Astronomy
// open-source license' (see LICENSE.md).
//
// THIS SOFTWARE IS PROVIDED BY THE AUTHORS 'AS IS' AND ANY EXPRESS
// OR IMPLIED WARRANTIES, INCLUDING, BUT NOT LIMITED TO, THE IMPLIED
// WARRANTIES OF MERCHANTABILITY AND FITNESS FOR A PARTICULAR PURPOSE
// ARE DISCLAIMED. IN NO EVENT SHALL THE AUTHOR BE LIABLE FOR ANY
// DIRECT, INDIRECT, INCIDENTAL, SPECIAL, EXEMPLARY, OR CONSEQUENTIAL
// DAMAGES (INCLUDING, BUT NOT LIMITED TO, PROCUREMENT OF SUBSTITUTE
// GOODS OR SERVICES; LOSS OF USE, DATA, OR PROFITS; OR BUSINESS
// INTERRUPTION) HOWEVER CAUSED AND ON ANY THEORY OF LIABILITY,
// WHETHER IN CONTRACT, STRICT LIABILITY, OR TORT (INCLUDING
// NEGLIGENCE OR OTHERWISE) ARISING IN ANY WAY OUT OF THE USE OF THIS
// SOFTWARE, EVEN IF ADVISED OF THE POSSIBILITY OF SUCH DAMAGE.

// Code is generated by AI

// Opt-in acceptance test for a physically connected NexDome rotation controller with firmware 1.x, or for
// the Arduino sketch dome_nexdome_simulator.ino running on a board. It reads the model, firmware and
// supply voltages, slews to an azimuth and back, moves by steps both ways, aborts a rotation, opens and
// closes the shutter, finds home and calibrates a full turn, parks and refuses a slew while parked,
// reconnects and runs driver INIT/SHUTDOWN.
//
// THE DOME ROTATES (A FULL TURN WHILE CALIBRATING) AND THE SHUTTER OPENS. The session returns the dome to the
// azimuth, shutter and park state it found. Calibration rewrites the steps per turn stored in the controller
// with a fresh measurement.
//
// The port comes from NEXDOME_HW_PORT (a serial port, or nexdome://host for a network bridge).

#include <math.h>
#include <stdlib.h>
#include <indigo_drivers/dome_nexdome/indigo_dome_nexdome.h>
#include "dome_hw_common.h"

#define DEVICE_NAME "NexDome"

#define SHORT_TIMEOUT 15.0
#define MOTION_TIMEOUT 240.0

static int dome = -1;
static const char *serial_port = NULL;
static bool state_captured = false, shutter_was_open = false, was_parked = false, has_shutter = false;
static double initial_azimuth = 0;

static bool select_port(void) {
	if (serial_port == NULL || !*serial_port) {
		fprintf(stderr, "    set NEXDOME_HW_PORT to the rotation controller's port\n");
		return false;
	}
	printf("Using port %s\n", serial_port);
	return hw_set_text(dome, DEVICE_PORT_PROPERTY_NAME, DEVICE_PORT_ITEM_NAME, serial_port, INDIGO_OK_STATE, SHORT_TIMEOUT);
}

// The first status poll runs 0.5 s after the connection; the supply voltages come with it.
static bool wait_for_first_poll(void) {
	double deadline = indigo_monotonic_time() + SHORT_TIMEOUT;
	double volts = 0;
	while (indigo_monotonic_time() < deadline) {
		if (hw_number_item(dome, "X_POWER", "ROTATOR_VOLTAGE", &volts) && volts > 0) {
			indigo_usleep(1500000);
			return true;
		}
		indigo_usleep(10000);
	}
	fprintf(stderr, "    the supply voltage was never read\n");
	return false;
}

static bool run_operation(const char *property, const char *item, indigo_property_state expected, double timeout) {
	if (!dome_hw_idle(dome, property, SHORT_TIMEOUT)) {
		return false;
	}
	unsigned before = hw_revision(dome, property);
	indigo_change_switch_property_1(&hw_client, DEVICE_NAME, property, item, true);
	return dome_hw_settles(dome, property, before, expected, timeout);
}

static bool capture_state(void) {
	if (!wait_for_first_poll() || !hw_wait_settled(dome, DOME_HORIZONTAL_COORDINATES_PROPERTY_NAME, INDIGO_OK_STATE, MOTION_TIMEOUT)) {
		return false;
	}
	initial_azimuth = dome_hw_azimuth(dome);
	shutter_was_open = dome_hw_switch_is(dome, DOME_SHUTTER_PROPERTY_NAME, DOME_SHUTTER_OPENED_ITEM_NAME);
	has_shutter = shutter_was_open || dome_hw_switch_is(dome, DOME_SHUTTER_PROPERTY_NAME, DOME_SHUTTER_CLOSED_ITEM_NAME);
	was_parked = dome_hw_switch_is(dome, DOME_PARK_PROPERTY_NAME, DOME_PARK_PARKED_ITEM_NAME);
	printf("    azimuth %.1f, shutter %s, %s\n", initial_azimuth, !has_shutter ? "not reported" : shutter_was_open ? "open" : "closed", was_parked ? "parked" : "unparked");
	return !isnan(initial_azimuth);
}

static void restore_initial_state(void) {
	if (dome < 0 || !state_captured || !hw_connected(dome)) {
		return;
	}
	if (dome_hw_switch_is(dome, DOME_PARK_PROPERTY_NAME, DOME_PARK_PARKED_ITEM_NAME)) {
		dome_hw_park(dome, false, SHORT_TIMEOUT);
	}
	if (has_shutter && dome_hw_switch_is(dome, DOME_SHUTTER_PROPERTY_NAME, DOME_SHUTTER_OPENED_ITEM_NAME) != shutter_was_open) {
		dome_hw_open_close(dome, DOME_SHUTTER_PROPERTY_NAME, shutter_was_open, INDIGO_OK_STATE, MOTION_TIMEOUT);
	}
	if (was_parked) {
		dome_hw_park(dome, true, MOTION_TIMEOUT);
	} else {
		dome_hw_goto(dome, initial_azimuth, INDIGO_OK_STATE, MOTION_TIMEOUT);
	}
}

static void nexdome_publishes_the_property_contract(void) {
	char model[INDIGO_VALUE_SIZE] = "", firmware[INDIGO_VALUE_SIZE] = "";
	double rotator = 0, shutter = 0;
	ASSERT_TRUE((hw_device_interface(dome) & INDIGO_INTERFACE_DOME) != 0);
	ASSERT_TRUE(hw_text_item(dome, INFO_PROPERTY_NAME, INFO_DEVICE_MODEL_ITEM_NAME, model, sizeof(model)));
	ASSERT_TRUE(hw_text_item(dome, INFO_PROPERTY_NAME, INFO_DEVICE_FW_REVISION_ITEM_NAME, firmware, sizeof(firmware)));
	ASSERT_TRUE(hw_number_item(dome, "X_POWER", "ROTATOR_VOLTAGE", &rotator));
	ASSERT_TRUE(hw_number_item(dome, "X_POWER", "SHUTTER_VOLTAGE", &shutter));
	printf("    model %s, firmware %s, rotator %.2f V, shutter %.2f V\n", model, firmware, rotator, shutter);
	ASSERT_STREQ("NexDome", model);
	ASSERT_TRUE(firmware[0] == '1' && firmware[1] == '.');
	ASSERT_TRUE(rotator > 5 && rotator < 20);
	ASSERT_TRUE(hw_property_defined(dome, "X_REVERSED"));
	ASSERT_TRUE(hw_property_defined(dome, "X_FIND_HOME"));
	ASSERT_TRUE(hw_property_defined(dome, "X_CALIBRATE"));
	ASSERT_TRUE(hw_property_defined(dome, "X_RESET_SHUTTER_COMM"));
	ASSERT_TRUE(hw_property_hidden(dome, DOME_SPEED_PROPERTY_NAME));
	ASSERT_TRUE(initial_azimuth >= 0 && initial_azimuth <= 360);
}

static void nexdome_slews_to_an_azimuth(void) {
	if (was_parked) {
		ASSERT_TRUE(dome_hw_park(dome, false, SHORT_TIMEOUT));
	}
	double target = dome_hw_normalize(floor(initial_azimuth) + 40.3);
	ASSERT_TRUE(dome_hw_goto(dome, target, INDIGO_OK_STATE, MOTION_TIMEOUT));
	ASSERT_TRUE(dome_hw_at(dome, target, 0.2));
	ASSERT_TRUE(dome_hw_goto(dome, dome_hw_normalize(target - 25), INDIGO_OK_STATE, MOTION_TIMEOUT));
	ASSERT_TRUE(dome_hw_at(dome, dome_hw_normalize(target - 25), 0.2));
}

static void nexdome_moves_by_steps(void) {
	double start = dome_hw_azimuth(dome);
	ASSERT_TRUE(dome_hw_steps(dome, true, 15, MOTION_TIMEOUT));
	ASSERT_TRUE(dome_hw_at(dome, dome_hw_normalize(start + 15), 0.2));
	ASSERT_TRUE(dome_hw_steps(dome, false, 15, MOTION_TIMEOUT));
	ASSERT_TRUE(dome_hw_at(dome, start, 0.2));
}

static void nexdome_aborts_a_rotation(void) {
	double start = dome_hw_azimuth(dome);
	double target = dome_hw_normalize(start + 120);
	ASSERT_TRUE(dome_hw_idle(dome, DOME_HORIZONTAL_COORDINATES_PROPERTY_NAME, SHORT_TIMEOUT));
	unsigned before = hw_revision(dome, DOME_HORIZONTAL_COORDINATES_PROPERTY_NAME);
	indigo_change_number_property_1(&hw_client, DEVICE_NAME, DOME_HORIZONTAL_COORDINATES_PROPERTY_NAME, DOME_HORIZONTAL_COORDINATES_AZ_ITEM_NAME, target);
	ASSERT_TRUE(hw_wait_state(dome, DOME_HORIZONTAL_COORDINATES_PROPERTY_NAME, before, INDIGO_BUSY_STATE, SHORT_TIMEOUT));
	indigo_usleep(3000000);
	ASSERT_TRUE(dome_hw_abort(dome, SHORT_TIMEOUT));
	ASSERT_TRUE(dome_hw_idle(dome, DOME_HORIZONTAL_COORDINATES_PROPERTY_NAME, MOTION_TIMEOUT));
	indigo_usleep(2500000);
	double stopped = dome_hw_azimuth(dome);
	printf("    stopped at %.1f on the way from %.1f to %.1f, state %d\n", stopped, start, target, hw_property_state(dome, DOME_HORIZONTAL_COORDINATES_PROPERTY_NAME));
	ASSERT_TRUE(dome_hw_azimuth_distance(stopped, target) > 1);
	indigo_usleep(2500000);
	ASSERT_TRUE(dome_hw_at(dome, stopped, 0.2));
	ASSERT_TRUE(hw_property_state(dome, DOME_HORIZONTAL_COORDINATES_PROPERTY_NAME) != INDIGO_BUSY_STATE);
}

static void nexdome_moves_the_shutter(void) {
	if (!has_shutter) {
		printf("    the controller reports no shutter\n");
		return;
	}
	bool open = dome_hw_switch_is(dome, DOME_SHUTTER_PROPERTY_NAME, DOME_SHUTTER_OPENED_ITEM_NAME);
	ASSERT_TRUE(dome_hw_open_close(dome, DOME_SHUTTER_PROPERTY_NAME, !open, INDIGO_OK_STATE, MOTION_TIMEOUT));
	ASSERT_TRUE(dome_hw_open_close(dome, DOME_SHUTTER_PROPERTY_NAME, open, INDIGO_OK_STATE, MOTION_TIMEOUT));
	ASSERT_TRUE(dome_hw_open_close(dome, DOME_SHUTTER_PROPERTY_NAME, !open, INDIGO_OK_STATE, MOTION_TIMEOUT));
	ASSERT_TRUE(dome_hw_open_close(dome, DOME_SHUTTER_PROPERTY_NAME, open, INDIGO_OK_STATE, MOTION_TIMEOUT));
	indigo_usleep(2500000);
	ASSERT_TRUE(dome_hw_switch_is(dome, DOME_SHUTTER_PROPERTY_NAME, open ? DOME_SHUTTER_OPENED_ITEM_NAME : DOME_SHUTTER_CLOSED_ITEM_NAME));
}

// Calibration needs the dome at its home position, so it follows a home search.
static void nexdome_finds_home_and_calibrates(void) {
	ASSERT_TRUE(run_operation("X_FIND_HOME", "FIND_HOME", INDIGO_OK_STATE, MOTION_TIMEOUT));
	ASSERT_TRUE(dome_hw_idle(dome, DOME_HORIZONTAL_COORDINATES_PROPERTY_NAME, MOTION_TIMEOUT));
	double home = dome_hw_azimuth(dome);
	printf("    home at %.1f\n", home);
	ASSERT_TRUE(run_operation("X_CALIBRATE", "CALIBRATE", INDIGO_OK_STATE, MOTION_TIMEOUT));
	ASSERT_TRUE(dome_hw_idle(dome, DOME_HORIZONTAL_COORDINATES_PROPERTY_NAME, MOTION_TIMEOUT));
	ASSERT_TRUE(dome_hw_at(dome, home, 1));
	// Away from home the controller refuses to calibrate.
	ASSERT_TRUE(dome_hw_goto(dome, dome_hw_normalize(home + 30), INDIGO_OK_STATE, MOTION_TIMEOUT));
	ASSERT_TRUE(run_operation("X_CALIBRATE", "CALIBRATE", INDIGO_ALERT_STATE, SHORT_TIMEOUT));
}

static void nexdome_parks(void) {
	ASSERT_TRUE(dome_hw_park(dome, true, MOTION_TIMEOUT));
	double parked = dome_hw_azimuth(dome);
	printf("    parked at %.1f\n", parked);
	ASSERT_TRUE(dome_hw_goto(dome, dome_hw_normalize(parked + 90), INDIGO_ALERT_STATE, SHORT_TIMEOUT));
	ASSERT_TRUE(dome_hw_at(dome, parked, 0.2));
	ASSERT_TRUE(dome_hw_park(dome, false, SHORT_TIMEOUT));
	ASSERT_TRUE(dome_hw_goto(dome, dome_hw_normalize(parked + 10), INDIGO_OK_STATE, MOTION_TIMEOUT));
}

static void nexdome_reconnects(void) {
	double azimuth = dome_hw_azimuth(dome);
	ASSERT_TRUE(hw_disconnect(dome, SHORT_TIMEOUT));
	ASSERT_TRUE(hw_property_hidden(dome, DOME_SHUTTER_PROPERTY_NAME));
	ASSERT_TRUE(hw_connect(dome, SHORT_TIMEOUT));
	ASSERT_TRUE(wait_for_first_poll());
	ASSERT_TRUE(dome_hw_at(dome, azimuth, 0.2));
}

static void nexdome_rejects_shutdown_while_connected(void) {
	ASSERT_EQ_INT(INDIGO_BUSY, indigo_dome_nexdome(INDIGO_DRIVER_SHUTDOWN, NULL));
	ASSERT_TRUE(hw_connected(dome));
}

static void nexdome_reinitializes(void) {
	ASSERT_TRUE(hw_disconnect(dome, SHORT_TIMEOUT));
	ASSERT_EQ_INT(INDIGO_OK, indigo_dome_nexdome(INDIGO_DRIVER_SHUTDOWN, NULL));
	ASSERT_EQ_INT(-1, hw_device_index(DEVICE_NAME));
	ASSERT_EQ_INT(INDIGO_OK, indigo_dome_nexdome(INDIGO_DRIVER_INIT, NULL));
	dome = hw_wait_for_device(DEVICE_NAME, SHORT_TIMEOUT);
	ASSERT_TRUE(dome >= 0);
	ASSERT_TRUE(select_port());
	ASSERT_TRUE(hw_connect(dome, SHORT_TIMEOUT));
	ASSERT_TRUE(wait_for_first_poll());
}

int main(int argc, char **argv) {
	if (argc < 2 || strcmp(argv[1], "--run")) {
		fprintf(stderr, "Physical NexDome test: run explicitly with --run (or make test-dome-nexdome-hw).\n");
		return 2;
	}
	setvbuf(stdout, NULL, _IONBF, 0);
	for (int i = 2; i < argc; i++) {
		if (!strcmp(argv[i], "--debug")) {
			indigo_set_log_level(INDIGO_LOG_DEBUG);
		}
	}
	if (!indigo_test_use_private_home()) {
		return 1;
	}
	serial_port = hw_port("NEXDOME_HW_PORT");
	const indigo_test_case tests[] = {
		{ "nexdome_publishes_the_property_contract", nexdome_publishes_the_property_contract },
		{ "nexdome_slews_to_an_azimuth", nexdome_slews_to_an_azimuth },
		{ "nexdome_moves_by_steps", nexdome_moves_by_steps },
		{ "nexdome_aborts_a_rotation", nexdome_aborts_a_rotation },
		{ "nexdome_moves_the_shutter", nexdome_moves_the_shutter },
		{ "nexdome_finds_home_and_calibrates", nexdome_finds_home_and_calibrates },
		{ "nexdome_parks", nexdome_parks },
		{ "nexdome_reconnects", nexdome_reconnects },
		{ "nexdome_rejects_shutdown_while_connected", nexdome_rejects_shutdown_while_connected },
		{ "nexdome_reinitializes", nexdome_reinitializes }
	};
	int result = 1;
	bool started = false, initialized = false;
	HW_CHECK(hw_start() == INDIGO_OK);
	started = true;
	HW_CHECK(hw_attach_client("NexDome hardware test") == INDIGO_OK);
	HW_CHECK(indigo_dome_nexdome(INDIGO_DRIVER_INIT, NULL) == INDIGO_OK);
	initialized = true;
	dome = hw_wait_for_device(DEVICE_NAME, SHORT_TIMEOUT);
	HW_CHECK(dome >= 0);
	HW_CHECK(select_port());
	HW_CHECK(hw_connect(dome, SHORT_TIMEOUT));
	HW_CHECK(capture_state());
	state_captured = true;
	result = indigo_run_tests("NexDome hardware", tests, ARRAY_SIZE(tests));
cleanup:
	restore_initial_state();
	if (!hw_disconnect(dome, SHORT_TIMEOUT)) {
		indigo_test_failures++;
	}
	if (initialized && indigo_dome_nexdome(INDIGO_DRIVER_SHUTDOWN, NULL) != INDIGO_OK) {
		indigo_test_failures++;
	}
	indigo_detach_client(&hw_client);
	if (started) {
		indigo_stop();
	}
	hw_release_properties();
	indigo_test_remove_private_home();
	return indigo_test_failures ? 1 : result;
}
