// Copyright (c) 2026 INDIGO initiative
// All rights reserved.
//
// You may use this software under the terms of 'INDIGO Astronomy
// open-source license' (see LICENSE.md).
//
// THIS SOFTWARE IS PROVIDED BY THE AUTHORS 'AS IS' AND ANY EXPRESS
// OR IMPLIED WARRANTIES, INCLUDING, BUT NOT LIMITED TO, THE IMPLIED
// WARRANTIES OF MERCHANTABILITY AND FITNESS FOR A PARTICULAR PURPOSE
// ARE DISCLAIMED. IN NO EVENT SHALL THE AUTHOR BE LIABLE FOR ANY
// DIRECT, INDIRECT, INCIDENTAL, SPECIAL, EXEMPLARY, OR CONSEQUENTIAL
// DAMAGES (INCLUDING, BUT NOT LIMITED TO, PROCUREMENT OF SUBSTITUTE
// GOODS OR SERVICES; LOSS OF USE, DATA, OR PROFITS; OR BUSINESS
// INTERRUPTION) HOWEVER CAUSED AND ON ANY THEORY OF LIABILITY,
// WHETHER IN CONTRACT, STRICT LIABILITY, OR TORT (INCLUDING
// NEGLIGENCE OR OTHERWISE) ARISING IN ANY WAY OUT OF THE USE OF THIS
// SOFTWARE, EVEN IF ADVISED OF THE POSSIBILITY OF SUCH DAMAGE.

// Code is generated by AI

// Switches one port of the USB hub built into a Pegasus Ultimate Powerbox, so a hardware suite can
// unplug and replug a camera on a host that has no per port control of its own. It is the macOS
// counterpart of the Linux `disable` attribute that `usb_hotplug_test_common.h` writes, and the
// reason it exists: macOS has no equivalent of that attribute, and `uhubctl` reports a port as off
// while the device stays enumerated.
//
// The hub is a Microchip 0424:2517 and answers the standard PORT_POWER feature through libusb,
// which is exactly how the `aux_upb` driver drives `AUX_USB_PORT`. Clearing the feature really does
// cut the port: `GET_STATUS` answers 0x00000000, powered off and disconnected, for the whole off
// period, and a camera that loads its firmware from the host comes back under its loader product
// id, so the power really was gone.
//
// What the host learns from it decides what a scenario built on this may assert. Measured on macOS
// 15 with a QHY5L-II on 2026-09-22: while the port is off the device stays in the IOKit registry
// and in `libusb_get_device_list()`, so nothing at all reaches a libusb hot-plug callback and a
// scenario that waits for the camera to be absent waits out its timeout with the camera still
// there. Both events are delivered when the power comes back - DEVICE_LEFT about 0.27 s after
// SET_FEATURE and DEVICE_ARRIVED some 10 ms after it. A scenario therefore switches the port off,
// leaves it off for as long as it wants the camera unpowered, switches it back on and waits for the
// withdrawal and the re-arrival from that moment, rather than waiting for absence in between. On
// Linux the same writes produce the same disconnect immediately, so a suite that follows this order
// works on both; prefer the per port `disable` attribute there, which also tears the device down in
// the USB core while the port is off.
//
// The port is a hub port number, counted from 1, and belongs to the box rather than to the host, so
// it is stable across reboots and independent of which host port the box hangs on. Nothing here
// looks for the camera: the caller names the port its camera sits on, because a port that carries
// something else is switched just as willingly.

#ifndef indigo_powerbox_hotplug_test_common_h
#define indigo_powerbox_hotplug_test_common_h

#include <stdbool.h>
#include <stdio.h>
#include <stdlib.h>
#include <string.h>
#include <libusb-1.0/libusb.h>
#include <indigo/indigo_bus.h>

#define POWERBOX_HUB_VENDOR 0x0424
#define POWERBOX_HUB_PRODUCT 0x2517
// USB 2.0 specification, table 11-17: PORT_POWER.
#define POWERBOX_PORT_POWER 8
// USB 2.0 specification, table 11-21: wPortStatus bit 8 is PORT_POWER.
#define POWERBOX_PORT_POWERED 0x00000100

typedef struct {
	libusb_device_handle *hub;
	int port;
	bool off;
} powerbox_hub_port;

// Opens the Powerbox hub and remembers the port to switch. Returns false when no such hub is
// attached, which is how a suite tells that this backend is not available on the machine it runs
// on.
static bool powerbox_hub_open(powerbox_hub_port *hub_port, int port) {
	memset(hub_port, 0, sizeof(*hub_port));
	hub_port->port = port;
	if (port < 1) {
		fprintf(stderr, "    %d is not a hub port number, they count from 1\n", port);
		return false;
	}
	if (libusb_init(NULL) != LIBUSB_SUCCESS) {
		fprintf(stderr, "    libusb could not be initialized\n");
		return false;
	}
	libusb_device **list = NULL;
	ssize_t count = libusb_get_device_list(NULL, &list);
	for (ssize_t i = 0; i < count && !hub_port->hub; i++) {
		struct libusb_device_descriptor descriptor;
		if (libusb_get_device_descriptor(list[i], &descriptor) != LIBUSB_SUCCESS) {
			continue;
		}
		if (descriptor.idVendor == POWERBOX_HUB_VENDOR && descriptor.idProduct == POWERBOX_HUB_PRODUCT) {
			libusb_open(list[i], &hub_port->hub);
		}
	}
	if (list) {
		libusb_free_device_list(list, 1);
	}
	if (!hub_port->hub) {
		fprintf(stderr, "    no Pegasus Powerbox hub (%04x:%04x) could be opened\n", POWERBOX_HUB_VENDOR, POWERBOX_HUB_PRODUCT);
		return false;
	}
	return true;
}

// Reads the hub's status of the port, so a caller can confirm that the port really lost its power
// rather than trusting the request it just made.
static bool powerbox_hub_status(powerbox_hub_port *hub_port, uint32_t *status) {
	int rc = libusb_control_transfer(hub_port->hub, LIBUSB_ENDPOINT_IN | LIBUSB_REQUEST_TYPE_CLASS | LIBUSB_RECIPIENT_OTHER, LIBUSB_REQUEST_GET_STATUS, 0, hub_port->port, (unsigned char *)status, sizeof(*status), 3000);
	if (rc != (int)sizeof(*status)) {
		fprintf(stderr, "    port %d status: %s\n", hub_port->port, libusb_strerror((enum libusb_error)rc));
		return false;
	}
	return true;
}

static bool powerbox_hub_switch(powerbox_hub_port *hub_port, bool on) {
	int rc = libusb_control_transfer(hub_port->hub, LIBUSB_ENDPOINT_OUT | LIBUSB_REQUEST_TYPE_CLASS | LIBUSB_RECIPIENT_OTHER, on ? LIBUSB_REQUEST_SET_FEATURE : LIBUSB_REQUEST_CLEAR_FEATURE, POWERBOX_PORT_POWER, hub_port->port, NULL, 0, 3000);
	if (rc != LIBUSB_SUCCESS) {
		fprintf(stderr, "    switching port %d %s: %s\n", hub_port->port, on ? "on" : "off", libusb_strerror((enum libusb_error)rc));
		return false;
	}
	hub_port->off = !on;
	uint32_t status = 0;
	if (!powerbox_hub_status(hub_port, &status)) {
		return false;
	}
	bool powered = (status & POWERBOX_PORT_POWERED) != 0;
	if (powered != on) {
		fprintf(stderr, "    port %d reports status 0x%08x after it was switched %s\n", hub_port->port, status, on ? "on" : "off");
		return false;
	}
	printf("    Powerbox hub port %d switched %s, status 0x%08x\n", hub_port->port, on ? "on" : "off", status);
	return true;
}

// Leaves the port unpowered for `off_time` seconds and switches it back on. The caller waits for
// the driver's reaction after this returns, because on macOS neither event is delivered until the
// power is back.
static bool powerbox_hub_cycle(powerbox_hub_port *hub_port, double off_time) {
	if (!powerbox_hub_switch(hub_port, false)) {
		return false;
	}
	indigo_usleep((unsigned long)(off_time * 1000000));
	return powerbox_hub_switch(hub_port, true);
}

static void powerbox_hub_close(powerbox_hub_port *hub_port) {
	if (hub_port->hub) {
		if (hub_port->off) {
			powerbox_hub_switch(hub_port, true);
		}
		libusb_close(hub_port->hub);
		hub_port->hub = NULL;
	}
}

#endif /* indigo_powerbox_hotplug_test_common_h */
