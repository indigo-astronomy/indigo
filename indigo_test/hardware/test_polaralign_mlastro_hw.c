// Copyright (c) 2026 INDIGO initiative
// All rights reserved.
//
// You may use this software under the terms of 'INDIGO Astronomy
// open-source license' (see LICENSE.md).
//
// THIS SOFTWARE IS PROVIDED BY THE AUTHORS 'AS IS' AND ANY EXPRESS
// OR IMPLIED WARRANTIES, INCLUDING, BUT NOT LIMITED TO, THE IMPLIED
// WARRANTIES OF MERCHANTABILITY AND FITNESS FOR A PARTICULAR PURPOSE
// ARE DISCLAIMED. IN NO EVENT SHALL THE AUTHOR BE LIABLE FOR ANY
// DIRECT, INDIRECT, INCIDENTAL, SPECIAL, EXEMPLARY, OR CONSEQUENTIAL
// DAMAGES (INCLUDING, BUT NOT LIMITED TO, PROCUREMENT OF SUBSTITUTE
// GOODS OR SERVICES; LOSS OF USE, DATA, OR PROFITS; OR BUSINESS
// INTERRUPTION) HOWEVER CAUSED AND ON ANY THEORY OF LIABILITY,
// WHETHER IN CONTRACT, STRICT LIABILITY, OR TORT (INCLUDING
// NEGLIGENCE OR OTHERWISE) ARISING IN ANY WAY OUT OF THE USE OF THIS
// SOFTWARE, EVEN IF ADVISED OF THE POSSIBILITY OF SUCH DAMAGE.

// Code is generated by AI

// Opt-in acceptance test for the MLAstro RPA firmware running on a bare ESP32 board, without the
// TMC2209 motor drivers of a real RPA controller. It covers what such a bench board can prove: the
// serial handshake through the boot log and the firmware's unsolicited log lines, identity, the
// published property contract, telemetry polling, every setting with its readback from the
// controller's own telemetry, the home reference, the controller ERROR state and its reset,
// motion requests rejected by the locked controller without losing reply synchronization, abort,
// reconnect and driver INIT/SHUTDOWN.
//
// NOTHING MOVES. Without motor drivers the firmware reports ERROR (AzNC/AlNC, driver not
// connected) and rejects every motion command with "error: System Locked"; the suite asserts that
// state and fails on a controller that is not locked, so it is never run against a real RPA with
// motors attached. Settings are changed only in controller memory (Save&Reboot is never sent) and
// are restored at the end.
//
// The port comes from MLASTRO_HW_PORT.

#include <ctype.h>
#include <math.h>
#include <stdlib.h>
#include <indigo_drivers/polaralign_mlastro/indigo_polaralign_mlastro.h>
#include "hardware_test_common.h"

#define DEVICE_NAME "MLAstro RPA"

// Opening the port resets the ESP32, which boots for a few seconds before it answers the
// handshake, so a connection needs more than one serialized transaction.
#define CONNECT_TIMEOUT 20.0
#define SHORT_TIMEOUT 10.0
// The telemetry poll runs every second; three periods prove a value survives the readback.
#define POLL_TIMEOUT 5.0
#define READBACK_WAIT 3.5

#define X_MLASTRO_SPEED_PROPERTY_NAME "X_MLASTRO_SPEED"
#define X_MLASTRO_SPEED_ITEM_NAME "SPEED"
#define X_MLASTRO_BACKLASH_ENABLE_PROPERTY_NAME "X_MLASTRO_BACKLASH_ENABLE"
#define X_MLASTRO_BACKLASH_ENABLE_ENABLED_ITEM_NAME "ENABLED"
#define X_MLASTRO_BACKLASH_ENABLE_DISABLED_ITEM_NAME "DISABLED"
#define X_MLASTRO_BACKLASH_STEPS_PROPERTY_NAME "X_MLASTRO_BACKLASH_STEPS"
#define X_MLASTRO_BACKLASH_STEPS_ALT_ITEM_NAME "ALT"
#define X_MLASTRO_BACKLASH_STEPS_AZ_ITEM_NAME "AZ"
#define X_MLASTRO_STATUS_PROPERTY_NAME "X_MLASTRO_STATUS"
#define X_MLASTRO_STATUS_ITEM_NAME "STATUS"
#define X_MLASTRO_HOMED_PROPERTY_NAME "X_MLASTRO_HOMED"
#define X_MLASTRO_HOMED_ITEM_NAME "HOMED"
#define X_MLASTRO_GOTO_HOME_PROPERTY_NAME "X_MLASTRO_GOTO_HOME"
#define X_MLASTRO_GOTO_HOME_ITEM_NAME "GOTO_HOME"
#define X_MLASTRO_CLEAR_HOME_PROPERTY_NAME "X_MLASTRO_CLEAR_HOME"
#define X_MLASTRO_CLEAR_HOME_ITEM_NAME "CLEAR_HOME"
#define X_MLASTRO_RESET_ERROR_PROPERTY_NAME "X_MLASTRO_RESET_ERROR"
#define X_MLASTRO_RESET_ERROR_ITEM_NAME "RESET_ERROR"

static int rpa = -1;
static const char *serial_port = NULL;
static double initial_speed, initial_steps_alt, initial_steps_az, initial_backlash_alt, initial_backlash_az;
static double initial_limits[4];
static bool initial_alt_reversed, initial_az_reversed, initial_backlash_enabled;
static bool state_captured = false;
static const char *limit_items[4] = { POLARALIGN_LIMITS_MIN_POSITION_ALT_ITEM_NAME, POLARALIGN_LIMITS_MAX_POSITION_ALT_ITEM_NAME, POLARALIGN_LIMITS_MIN_POSITION_AZ_ITEM_NAME, POLARALIGN_LIMITS_MAX_POSITION_AZ_ITEM_NAME };

static bool select_port(void) {
	if (serial_port == NULL || !*serial_port) {
		fprintf(stderr, "    set MLASTRO_HW_PORT to the controller's serial port\n");
		return false;
	}
	printf("Using port %s\n", serial_port);
	return hw_set_text(rpa, DEVICE_PORT_PROPERTY_NAME, DEVICE_PORT_ITEM_NAME, serial_port, INDIGO_OK_STATE, SHORT_TIMEOUT);
}

static double number(const char *property, const char *item) {
	double value = NAN;
	hw_number_item(rpa, property, item, &value);
	return value;
}

static bool switch_on(const char *property, const char *item) {
	bool value = false;
	return hw_switch_item(rpa, property, item, &value) && value;
}

static void status(char *value, size_t size) {
	*value = '\0';
	hw_text_item(rpa, X_MLASTRO_STATUS_PROPERTY_NAME, X_MLASTRO_STATUS_ITEM_NAME, value, size);
}

static bool wait_status(const char *expected, double timeout) {
	char value[INDIGO_VALUE_SIZE];
	double deadline = indigo_monotonic_time() + timeout;
	while (indigo_monotonic_time() < deadline) {
		status(value, sizeof(value));
		if (!strcmp(value, expected)) {
			return true;
		}
		indigo_usleep(20000);
	}
	fprintf(stderr, "    timeout: status is '%s', expected '%s'\n", value, expected);
	return false;
}

static bool wait_homed(indigo_property_state expected, double timeout) {
	indigo_property_state value = INDIGO_IDLE_STATE;
	double deadline = indigo_monotonic_time() + timeout;
	while (indigo_monotonic_time() < deadline) {
		if (hw_light_item(rpa, X_MLASTRO_HOMED_PROPERTY_NAME, X_MLASTRO_HOMED_ITEM_NAME, &value) && value == expected) {
			return true;
		}
		indigo_usleep(20000);
	}
	fprintf(stderr, "    timeout: HOMED is %d, expected %d\n", value, expected);
	return false;
}

// A multi-item change carries every item, so the driver sends the values the test means rather
// than whatever the untouched items' targets happen to be.
static bool set_numbers(const char *property, int count, const char **items, const double *values) {
	unsigned before = hw_revision(rpa, property);
	indigo_change_number_property(&hw_client, hw_device_name(rpa), property, count, items, values);
	return hw_wait_state(rpa, property, before, INDIGO_OK_STATE, SHORT_TIMEOUT);
}

static bool set_steps_per_degree(double alt, double az) {
	const char *items[] = { POLARALIGN_STEPS_PER_DEGREE_ALT_ITEM_NAME, POLARALIGN_STEPS_PER_DEGREE_AZ_ITEM_NAME };
	const double values[] = { alt, az };
	return set_numbers(POLARALIGN_STEPS_PER_DEGREE_PROPERTY_NAME, 2, items, values);
}

static bool set_backlash_steps(double alt, double az) {
	const char *items[] = { X_MLASTRO_BACKLASH_STEPS_ALT_ITEM_NAME, X_MLASTRO_BACKLASH_STEPS_AZ_ITEM_NAME };
	const double values[] = { alt, az };
	return set_numbers(X_MLASTRO_BACKLASH_STEPS_PROPERTY_NAME, 2, items, values);
}

static bool set_limits(const double *values) {
	return set_numbers(POLARALIGN_LIMITS_PROPERTY_NAME, 4, limit_items, values);
}

static bool set_direction(const char *property, bool reversed) {
	return hw_set_switch(rpa, property, reversed ? POLARALIGN_DIRECTION_REVERSED_ITEM_NAME : POLARALIGN_DIRECTION_NORMAL_ITEM_NAME, INDIGO_OK_STATE, SHORT_TIMEOUT);
}

static bool set_backlash_enabled(bool enabled) {
	return hw_set_switch(rpa, X_MLASTRO_BACKLASH_ENABLE_PROPERTY_NAME, enabled ? X_MLASTRO_BACKLASH_ENABLE_ENABLED_ITEM_NAME : X_MLASTRO_BACKLASH_ENABLE_DISABLED_ITEM_NAME, INDIGO_OK_STATE, SHORT_TIMEOUT);
}

// The telemetry poll overwrites every idle setting with what the controller reports, so a value
// that is still there after several polls is one the firmware accepted and echoes back.
static void let_the_telemetry_read_back(void) {
	indigo_usleep((unsigned)(READBACK_WAIT * 1000000));
}

static bool capture_initial_state(void) {
	initial_speed = number(X_MLASTRO_SPEED_PROPERTY_NAME, X_MLASTRO_SPEED_ITEM_NAME);
	initial_steps_alt = number(POLARALIGN_STEPS_PER_DEGREE_PROPERTY_NAME, POLARALIGN_STEPS_PER_DEGREE_ALT_ITEM_NAME);
	initial_steps_az = number(POLARALIGN_STEPS_PER_DEGREE_PROPERTY_NAME, POLARALIGN_STEPS_PER_DEGREE_AZ_ITEM_NAME);
	initial_backlash_alt = number(X_MLASTRO_BACKLASH_STEPS_PROPERTY_NAME, X_MLASTRO_BACKLASH_STEPS_ALT_ITEM_NAME);
	initial_backlash_az = number(X_MLASTRO_BACKLASH_STEPS_PROPERTY_NAME, X_MLASTRO_BACKLASH_STEPS_AZ_ITEM_NAME);
	for (int i = 0; i < 4; i++) {
		initial_limits[i] = number(POLARALIGN_LIMITS_PROPERTY_NAME, limit_items[i]);
		if (isnan(initial_limits[i])) {
			return false;
		}
	}
	initial_alt_reversed = switch_on(POLARALIGN_DIRECTION_ALT_PROPERTY_NAME, POLARALIGN_DIRECTION_REVERSED_ITEM_NAME);
	initial_az_reversed = switch_on(POLARALIGN_DIRECTION_AZ_PROPERTY_NAME, POLARALIGN_DIRECTION_REVERSED_ITEM_NAME);
	initial_backlash_enabled = switch_on(X_MLASTRO_BACKLASH_ENABLE_PROPERTY_NAME, X_MLASTRO_BACKLASH_ENABLE_ENABLED_ITEM_NAME);
	if (isnan(initial_speed) || isnan(initial_steps_alt) || isnan(initial_steps_az) || isnan(initial_backlash_alt) || isnan(initial_backlash_az)) {
		return false;
	}
	state_captured = true;
	return true;
}

// Put every setting back the way the session found it, whatever happened above.
static void restore_initial_state(void) {
	if (rpa < 0 || !state_captured || !hw_connected(rpa)) {
		return;
	}
	hw_set_number(rpa, X_MLASTRO_SPEED_PROPERTY_NAME, X_MLASTRO_SPEED_ITEM_NAME, initial_speed, INDIGO_OK_STATE, SHORT_TIMEOUT);
	set_steps_per_degree(initial_steps_alt, initial_steps_az);
	set_backlash_steps(initial_backlash_alt, initial_backlash_az);
	set_limits(initial_limits);
	set_direction(POLARALIGN_DIRECTION_ALT_PROPERTY_NAME, initial_alt_reversed);
	set_direction(POLARALIGN_DIRECTION_AZ_PROPERTY_NAME, initial_az_reversed);
	set_backlash_enabled(initial_backlash_enabled);
}

static void mlastro_reports_identity(void) {
	char model[INDIGO_VALUE_SIZE] = "", firmware[INDIGO_VALUE_SIZE] = "", serial[INDIGO_VALUE_SIZE] = "";
	ASSERT_TRUE((hw_device_interface(rpa) & INDIGO_INTERFACE_POLARALIGN) != 0);
	ASSERT_STREQ(DEVICE_NAME, hw_device_name(rpa));
	ASSERT_TRUE(hw_text_item(rpa, INFO_PROPERTY_NAME, INFO_DEVICE_MODEL_ITEM_NAME, model, sizeof(model)));
	ASSERT_TRUE(hw_text_item(rpa, INFO_PROPERTY_NAME, INFO_DEVICE_FW_REVISION_ITEM_NAME, firmware, sizeof(firmware)));
	ASSERT_TRUE(hw_text_item(rpa, INFO_PROPERTY_NAME, INFO_DEVICE_SERIAL_NUM_ITEM_NAME, serial, sizeof(serial)));
	printf("    %s, '%s', serial '%s'\n", model, firmware, serial);
	ASSERT_STREQ("MLAstro RPA", model);
	// "ok,firmware 1.8.1,SN:24:6F:28:25:54:BC": the version field and the base MAC, with no
	// separator or line terminator left over from the handshake reply.
	ASSERT_TRUE(!strncmp(firmware, "firmware ", 9));
	ASSERT_EQ_INT(17, (int)strlen(serial));
	for (int i = 0; i < 17; i++) {
		ASSERT_TRUE(i % 3 == 2 ? serial[i] == ':' : isxdigit((unsigned char)serial[i]) != 0);
	}
}

static void mlastro_publishes_the_property_contract(void) {
	double min = 0, max = 0;
	const char *properties[] = { POLARALIGN_OFFSET_PROPERTY_NAME, POLARALIGN_ABORT_MOTION_PROPERTY_NAME, POLARALIGN_STEPS_PER_DEGREE_PROPERTY_NAME, POLARALIGN_DIRECTION_ALT_PROPERTY_NAME, POLARALIGN_DIRECTION_AZ_PROPERTY_NAME, POLARALIGN_RESET_POSITION_ALT_PROPERTY_NAME, POLARALIGN_RESET_POSITION_AZ_PROPERTY_NAME, POLARALIGN_LIMITS_PROPERTY_NAME, X_MLASTRO_SPEED_PROPERTY_NAME, X_MLASTRO_BACKLASH_ENABLE_PROPERTY_NAME, X_MLASTRO_BACKLASH_STEPS_PROPERTY_NAME, X_MLASTRO_STATUS_PROPERTY_NAME, X_MLASTRO_HOMED_PROPERTY_NAME, X_MLASTRO_GOTO_HOME_PROPERTY_NAME, X_MLASTRO_CLEAR_HOME_PROPERTY_NAME, X_MLASTRO_RESET_ERROR_PROPERTY_NAME };
	for (size_t i = 0; i < ARRAY_SIZE(properties); i++) {
		if (!hw_property_defined(rpa, properties[i])) {
			fprintf(stderr, "    %s is not defined\n", properties[i]);
		}
		ASSERT_TRUE(hw_property_defined(rpa, properties[i]));
	}
	ASSERT_TRUE(hw_number_item_range(rpa, X_MLASTRO_SPEED_PROPERTY_NAME, X_MLASTRO_SPEED_ITEM_NAME, &min, &max));
	ASSERT_EQ_INT(1, (int)min);
	ASSERT_EQ_INT(5, (int)max);
	ASSERT_TRUE(hw_number_item_range(rpa, POLARALIGN_OFFSET_PROPERTY_NAME, POLARALIGN_OFFSET_AZ_ITEM_NAME, &min, &max));
	ASSERT_EQ_INT(-5400, (int)min);
	ASSERT_EQ_INT(5400, (int)max);
	ASSERT_EQ_INT(INDIGO_OK_STATE, hw_property_state(rpa, POLARALIGN_OFFSET_PROPERTY_NAME));
}

// The connect-time telemetry has to have reached every setting: the firmware reports positive
// steps per degree, a speed level inside 1-5 and a soft limit window around zero, none of which the
// attach-time defaults all match.
static void mlastro_reads_the_configuration(void) {
	printf("    speed %g, steps/deg alt %g az %g, limits alt [%g, %g] az [%g, %g] arcmin, backlash %s %g/%g\n", initial_speed, initial_steps_alt, initial_steps_az, initial_limits[0], initial_limits[1], initial_limits[2], initial_limits[3], initial_backlash_enabled ? "on" : "off", initial_backlash_alt, initial_backlash_az);
	ASSERT_TRUE(initial_speed >= 1 && initial_speed <= 5);
	ASSERT_TRUE(initial_steps_alt > 0 && initial_steps_az > 0);
	ASSERT_TRUE(initial_limits[0] < 0 && initial_limits[1] > 0);
	ASSERT_TRUE(initial_limits[2] < 0 && initial_limits[3] > 0);
	ASSERT_NEAR(0, number(POLARALIGN_OFFSET_PROPERTY_NAME, POLARALIGN_OFFSET_ALT_ITEM_NAME), 1e-6);
	ASSERT_NEAR(0, number(POLARALIGN_OFFSET_PROPERTY_NAME, POLARALIGN_OFFSET_AZ_ITEM_NAME), 1e-6);
}

// A board without TMC2209 drivers reports ERROR (driver not connected) as soon as control is
// taken; the driver has to publish that as an alert rather than as a usable controller.
static void mlastro_reports_the_locked_controller(void) {
	char value[INDIGO_VALUE_SIZE];
	status(value, sizeof(value));
	printf("    controller status '%s'\n", value);
	ASSERT_STREQ("ERROR", value);
	ASSERT_EQ_INT(INDIGO_ALERT_STATE, hw_property_state(rpa, X_MLASTRO_STATUS_PROPERTY_NAME));
	// The poll keeps running: the status is republished, not just set once at connect.
	indigo_usleep(1500000);
	ASSERT_TRUE(hw_connected(rpa));
	ASSERT_TRUE(wait_status("ERROR", POLL_TIMEOUT));
}

static void mlastro_changes_the_speed_level(void) {
	for (int level = 1; level <= 5; level++) {
		ASSERT_TRUE(hw_set_number(rpa, X_MLASTRO_SPEED_PROPERTY_NAME, X_MLASTRO_SPEED_ITEM_NAME, level, INDIGO_OK_STATE, SHORT_TIMEOUT));
	}
	double changed = initial_speed == 2 ? 4 : 2;
	ASSERT_TRUE(hw_set_number(rpa, X_MLASTRO_SPEED_PROPERTY_NAME, X_MLASTRO_SPEED_ITEM_NAME, changed, INDIGO_OK_STATE, SHORT_TIMEOUT));
	let_the_telemetry_read_back();
	ASSERT_NEAR(changed, number(X_MLASTRO_SPEED_PROPERTY_NAME, X_MLASTRO_SPEED_ITEM_NAME), 0);
	ASSERT_TRUE(hw_set_number(rpa, X_MLASTRO_SPEED_PROPERTY_NAME, X_MLASTRO_SPEED_ITEM_NAME, initial_speed, INDIGO_OK_STATE, SHORT_TIMEOUT));
	let_the_telemetry_read_back();
	ASSERT_NEAR(initial_speed, number(X_MLASTRO_SPEED_PROPERTY_NAME, X_MLASTRO_SPEED_ITEM_NAME), 0);
}

static void mlastro_changes_the_steps_per_degree(void) {
	double alt = initial_steps_alt + 250, az = initial_steps_az + 125;
	ASSERT_TRUE(set_steps_per_degree(alt, az));
	let_the_telemetry_read_back();
	ASSERT_NEAR(alt, number(POLARALIGN_STEPS_PER_DEGREE_PROPERTY_NAME, POLARALIGN_STEPS_PER_DEGREE_ALT_ITEM_NAME), 0);
	ASSERT_NEAR(az, number(POLARALIGN_STEPS_PER_DEGREE_PROPERTY_NAME, POLARALIGN_STEPS_PER_DEGREE_AZ_ITEM_NAME), 0);
	ASSERT_TRUE(set_steps_per_degree(initial_steps_alt, initial_steps_az));
	let_the_telemetry_read_back();
	ASSERT_NEAR(initial_steps_alt, number(POLARALIGN_STEPS_PER_DEGREE_PROPERTY_NAME, POLARALIGN_STEPS_PER_DEGREE_ALT_ITEM_NAME), 0);
	ASSERT_NEAR(initial_steps_az, number(POLARALIGN_STEPS_PER_DEGREE_PROPERTY_NAME, POLARALIGN_STEPS_PER_DEGREE_AZ_ITEM_NAME), 0);
}

// The two axes are separate commands (AlRD/AzRD), so each has to change alone.
static void mlastro_reverses_each_axis(void) {
	ASSERT_TRUE(set_direction(POLARALIGN_DIRECTION_ALT_PROPERTY_NAME, !initial_alt_reversed));
	let_the_telemetry_read_back();
	ASSERT_TRUE(switch_on(POLARALIGN_DIRECTION_ALT_PROPERTY_NAME, POLARALIGN_DIRECTION_REVERSED_ITEM_NAME) == !initial_alt_reversed);
	ASSERT_TRUE(switch_on(POLARALIGN_DIRECTION_AZ_PROPERTY_NAME, POLARALIGN_DIRECTION_REVERSED_ITEM_NAME) == initial_az_reversed);
	ASSERT_TRUE(set_direction(POLARALIGN_DIRECTION_AZ_PROPERTY_NAME, !initial_az_reversed));
	let_the_telemetry_read_back();
	ASSERT_TRUE(switch_on(POLARALIGN_DIRECTION_AZ_PROPERTY_NAME, POLARALIGN_DIRECTION_REVERSED_ITEM_NAME) == !initial_az_reversed);
	ASSERT_TRUE(set_direction(POLARALIGN_DIRECTION_ALT_PROPERTY_NAME, initial_alt_reversed));
	ASSERT_TRUE(set_direction(POLARALIGN_DIRECTION_AZ_PROPERTY_NAME, initial_az_reversed));
	let_the_telemetry_read_back();
	ASSERT_TRUE(switch_on(POLARALIGN_DIRECTION_ALT_PROPERTY_NAME, POLARALIGN_DIRECTION_REVERSED_ITEM_NAME) == initial_alt_reversed);
	ASSERT_TRUE(switch_on(POLARALIGN_DIRECTION_AZ_PROPERTY_NAME, POLARALIGN_DIRECTION_REVERSED_ITEM_NAME) == initial_az_reversed);
}

// The limits travel in degrees with two decimals (AzL1:%.2f), so a value of whole arcminutes that
// is a multiple of 0.6 comes back exactly.
static void mlastro_changes_the_soft_limits(void) {
	const double changed[4] = { -300, 420, -240, 360 };
	ASSERT_TRUE(set_limits(changed));
	let_the_telemetry_read_back();
	for (int i = 0; i < 4; i++) {
		ASSERT_NEAR(changed[i], number(POLARALIGN_LIMITS_PROPERTY_NAME, limit_items[i]), 1e-6);
	}
	ASSERT_TRUE(set_limits(initial_limits));
	let_the_telemetry_read_back();
	for (int i = 0; i < 4; i++) {
		ASSERT_NEAR(initial_limits[i], number(POLARALIGN_LIMITS_PROPERTY_NAME, limit_items[i]), 1e-6);
	}
}

static void mlastro_changes_the_backlash(void) {
	ASSERT_TRUE(set_backlash_enabled(!initial_backlash_enabled));
	ASSERT_TRUE(set_backlash_steps(initial_backlash_alt + 17, initial_backlash_az + 23));
	let_the_telemetry_read_back();
	ASSERT_TRUE(switch_on(X_MLASTRO_BACKLASH_ENABLE_PROPERTY_NAME, X_MLASTRO_BACKLASH_ENABLE_ENABLED_ITEM_NAME) == !initial_backlash_enabled);
	ASSERT_NEAR(initial_backlash_alt + 17, number(X_MLASTRO_BACKLASH_STEPS_PROPERTY_NAME, X_MLASTRO_BACKLASH_STEPS_ALT_ITEM_NAME), 0);
	ASSERT_NEAR(initial_backlash_az + 23, number(X_MLASTRO_BACKLASH_STEPS_PROPERTY_NAME, X_MLASTRO_BACKLASH_STEPS_AZ_ITEM_NAME), 0);
	ASSERT_TRUE(set_backlash_enabled(initial_backlash_enabled));
	ASSERT_TRUE(set_backlash_steps(initial_backlash_alt, initial_backlash_az));
	let_the_telemetry_read_back();
	ASSERT_TRUE(switch_on(X_MLASTRO_BACKLASH_ENABLE_PROPERTY_NAME, X_MLASTRO_BACKLASH_ENABLE_ENABLED_ITEM_NAME) == initial_backlash_enabled);
	ASSERT_NEAR(initial_backlash_alt, number(X_MLASTRO_BACKLASH_STEPS_PROPERTY_NAME, X_MLASTRO_BACKLASH_STEPS_ALT_ITEM_NAME), 0);
	ASSERT_NEAR(initial_backlash_az, number(X_MLASTRO_BACKLASH_STEPS_PROPERTY_NAME, X_MLASTRO_BACKLASH_STEPS_AZ_ITEM_NAME), 0);
}

// SetH:1 is accepted even while the controller is locked; RstH:1 forgets it again. The telemetry
// Home key has to agree with the driver's own bookkeeping after several polls.
static void mlastro_sets_and_clears_the_home_reference(void) {
	ASSERT_TRUE(hw_set_switch(rpa, POLARALIGN_RESET_POSITION_AZ_PROPERTY_NAME, POLARALIGN_RESET_POSITION_ITEM_NAME, INDIGO_OK_STATE, SHORT_TIMEOUT));
	ASSERT_TRUE(wait_homed(INDIGO_OK_STATE, POLL_TIMEOUT));
	let_the_telemetry_read_back();
	ASSERT_TRUE(wait_homed(INDIGO_OK_STATE, 0.1));
	ASSERT_NEAR(0, number(POLARALIGN_OFFSET_PROPERTY_NAME, POLARALIGN_OFFSET_AZ_ITEM_NAME), 1e-6);
	ASSERT_TRUE(hw_set_switch(rpa, X_MLASTRO_CLEAR_HOME_PROPERTY_NAME, X_MLASTRO_CLEAR_HOME_ITEM_NAME, INDIGO_OK_STATE, SHORT_TIMEOUT));
	ASSERT_TRUE(wait_homed(INDIGO_IDLE_STATE, POLL_TIMEOUT));
	let_the_telemetry_read_back();
	ASSERT_TRUE(wait_homed(INDIGO_IDLE_STATE, 0.1));
	// The altitude reset zeroes the same shared reference.
	ASSERT_TRUE(hw_set_switch(rpa, POLARALIGN_RESET_POSITION_ALT_PROPERTY_NAME, POLARALIGN_RESET_POSITION_ITEM_NAME, INDIGO_OK_STATE, SHORT_TIMEOUT));
	ASSERT_TRUE(wait_homed(INDIGO_OK_STATE, POLL_TIMEOUT));
	let_the_telemetry_read_back();
	ASSERT_TRUE(wait_homed(INDIGO_OK_STATE, 0.1));
}

// A locked controller rejects the move. The request must end in ALERT with the target put back on
// the position, and the next command must still get its own reply: the firmware answers a
// rejected chained command with "error: System Locked" followed by an extra "ok".
static void rejected_move(const char *label, double alt, double az) {
	unsigned before = hw_revision(rpa, POLARALIGN_OFFSET_PROPERTY_NAME);
	const char *items[] = { POLARALIGN_OFFSET_ALT_ITEM_NAME, POLARALIGN_OFFSET_AZ_ITEM_NAME };
	const double values[] = { alt, az };
	indigo_change_number_property(&hw_client, hw_device_name(rpa), POLARALIGN_OFFSET_PROPERTY_NAME, 2, items, values);
	ASSERT_TRUE(hw_wait_state(rpa, POLARALIGN_OFFSET_PROPERTY_NAME, before, INDIGO_ALERT_STATE, SHORT_TIMEOUT));
	double target = NAN;
	ASSERT_TRUE(hw_number_item_target(rpa, POLARALIGN_OFFSET_PROPERTY_NAME, POLARALIGN_OFFSET_AZ_ITEM_NAME, &target));
	ASSERT_NEAR(0, target, 1e-6);
	ASSERT_TRUE(hw_number_item_target(rpa, POLARALIGN_OFFSET_PROPERTY_NAME, POLARALIGN_OFFSET_ALT_ITEM_NAME, &target));
	ASSERT_NEAR(0, target, 1e-6);
	ASSERT_NEAR(0, number(POLARALIGN_OFFSET_PROPERTY_NAME, POLARALIGN_OFFSET_AZ_ITEM_NAME), 1e-6);
	ASSERT_NEAR(0, number(POLARALIGN_OFFSET_PROPERTY_NAME, POLARALIGN_OFFSET_ALT_ITEM_NAME), 1e-6);
	double changed = initial_speed == 1 ? 5 : 1;
	ASSERT_TRUE(hw_set_number(rpa, X_MLASTRO_SPEED_PROPERTY_NAME, X_MLASTRO_SPEED_ITEM_NAME, changed, INDIGO_OK_STATE, SHORT_TIMEOUT));
	let_the_telemetry_read_back();
	ASSERT_NEAR(changed, number(X_MLASTRO_SPEED_PROPERTY_NAME, X_MLASTRO_SPEED_ITEM_NAME), 0);
	ASSERT_TRUE(hw_set_number(rpa, X_MLASTRO_SPEED_PROPERTY_NAME, X_MLASTRO_SPEED_ITEM_NAME, initial_speed, INDIGO_OK_STATE, SHORT_TIMEOUT));
	ASSERT_TRUE(hw_connected(rpa));
	printf("    %s rejected, replies stay in step\n", label);
}

static void mlastro_rejects_a_single_axis_move_while_locked(void) {
	rejected_move("azimuth move", 0, 10);
	rejected_move("altitude move", -7.5, 0);
}

static void mlastro_rejects_a_two_axis_move_while_locked(void) {
	rejected_move("two-axis alignment", 5, -12);
}

static void mlastro_rejects_return_to_home_while_locked(void) {
	ASSERT_TRUE(wait_homed(INDIGO_OK_STATE, 0.1));
	ASSERT_TRUE(hw_set_switch(rpa, X_MLASTRO_GOTO_HOME_PROPERTY_NAME, X_MLASTRO_GOTO_HOME_ITEM_NAME, INDIGO_ALERT_STATE, SHORT_TIMEOUT));
	ASSERT_TRUE(hw_property_state(rpa, POLARALIGN_OFFSET_PROPERTY_NAME) != INDIGO_BUSY_STATE);
	ASSERT_TRUE(hw_set_number(rpa, X_MLASTRO_SPEED_PROPERTY_NAME, X_MLASTRO_SPEED_ITEM_NAME, initial_speed, INDIGO_OK_STATE, SHORT_TIMEOUT));
}

static void mlastro_accepts_an_abort_while_idle(void) {
	ASSERT_TRUE(hw_set_switch(rpa, POLARALIGN_ABORT_MOTION_PROPERTY_NAME, POLARALIGN_ABORT_MOTION_ITEM_NAME, INDIGO_OK_STATE, SHORT_TIMEOUT));
	ASSERT_TRUE(hw_property_state(rpa, POLARALIGN_OFFSET_PROPERTY_NAME) != INDIGO_BUSY_STATE);
	ASSERT_NEAR(0, number(POLARALIGN_OFFSET_PROPERTY_NAME, POLARALIGN_OFFSET_AZ_ITEM_NAME), 1e-6);
	ASSERT_TRUE(hw_connected(rpa));
}

// ReER:1 is acknowledged and the controller re-detects the missing drivers at once, so the reset
// succeeds and the status goes back to ERROR on the next polls.
static void mlastro_resets_the_controller_error(void) {
	ASSERT_TRUE(hw_set_switch(rpa, X_MLASTRO_RESET_ERROR_PROPERTY_NAME, X_MLASTRO_RESET_ERROR_ITEM_NAME, INDIGO_OK_STATE, SHORT_TIMEOUT));
	let_the_telemetry_read_back();
	ASSERT_TRUE(wait_status("ERROR", POLL_TIMEOUT));
	ASSERT_EQ_INT(INDIGO_ALERT_STATE, hw_property_state(rpa, X_MLASTRO_STATUS_PROPERTY_NAME));
	ASSERT_TRUE(hw_connected(rpa));
}

// Opening the port resets the ESP32, so a reconnect has to handshake through the boot log again
// and read the identity back.
static void mlastro_reconnects(void) {
	ASSERT_TRUE(hw_disconnect(rpa, SHORT_TIMEOUT));
	ASSERT_TRUE(hw_property_hidden(rpa, X_MLASTRO_STATUS_PROPERTY_NAME));
	double started = indigo_monotonic_time();
	ASSERT_TRUE(hw_connect(rpa, CONNECT_TIMEOUT));
	printf("    reconnected in %.1f s\n", indigo_monotonic_time() - started);
	ASSERT_TRUE(hw_property_defined(rpa, X_MLASTRO_STATUS_PROPERTY_NAME));
	char firmware[INDIGO_VALUE_SIZE] = "";
	ASSERT_TRUE(hw_text_item(rpa, INFO_PROPERTY_NAME, INFO_DEVICE_FW_REVISION_ITEM_NAME, firmware, sizeof(firmware)));
	ASSERT_TRUE(!strncmp(firmware, "firmware ", 9));
	ASSERT_TRUE(wait_status("ERROR", POLL_TIMEOUT));
	ASSERT_TRUE(hw_set_number(rpa, X_MLASTRO_SPEED_PROPERTY_NAME, X_MLASTRO_SPEED_ITEM_NAME, initial_speed, INDIGO_OK_STATE, SHORT_TIMEOUT));
}

// Repeated connect/disconnect cycles, each of which resets the board, must all come up.
static void mlastro_survives_repeated_reconnects(void) {
	for (int cycle = 0; cycle < 3; cycle++) {
		ASSERT_TRUE(hw_disconnect(rpa, SHORT_TIMEOUT));
		ASSERT_TRUE(hw_connect(rpa, CONNECT_TIMEOUT));
		ASSERT_TRUE(wait_status("ERROR", POLL_TIMEOUT));
	}
}

// A full driver teardown and bring-up, which is what a server does when the driver is unloaded and
// loaded again. It has to leave no device behind and find the controller a second time.
static void mlastro_reinitializes(void) {
	ASSERT_TRUE(hw_disconnect(rpa, SHORT_TIMEOUT));
	ASSERT_EQ_INT(INDIGO_OK, indigo_polaralign_mlastro(INDIGO_DRIVER_SHUTDOWN, NULL));
	ASSERT_EQ_INT(-1, hw_device_index(DEVICE_NAME));
	ASSERT_EQ_INT(INDIGO_OK, indigo_polaralign_mlastro(INDIGO_DRIVER_INIT, NULL));
	rpa = hw_wait_for_device(DEVICE_NAME, SHORT_TIMEOUT);
	ASSERT_TRUE(rpa >= 0);
	ASSERT_TRUE(select_port());
	ASSERT_TRUE(hw_connect(rpa, CONNECT_TIMEOUT));
	ASSERT_TRUE(wait_status("ERROR", POLL_TIMEOUT));
}

int main(int argc, char **argv) {
	if (argc < 2 || strcmp(argv[1], "--run")) {
		fprintf(stderr, "Physical MLAstro RPA firmware test: run explicitly with --run (or make test-polaralign-mlastro-hw).\n");
		return 2;
	}
	setvbuf(stdout, NULL, _IONBF, 0);
	for (int i = 2; i < argc; i++) {
		if (!strcmp(argv[i], "--debug")) {
			indigo_set_log_level(INDIGO_LOG_DEBUG);
		}
	}
	// POLARALIGN_LIMITS is persistent, so the session keeps its configuration out of the user's own
	// folder.
	if (!indigo_test_use_private_home()) {
		return 1;
	}
	serial_port = getenv("MLASTRO_HW_PORT");
	const indigo_test_case tests[] = {
		{ "mlastro_reports_identity", mlastro_reports_identity },
		{ "mlastro_publishes_the_property_contract", mlastro_publishes_the_property_contract },
		{ "mlastro_reads_the_configuration", mlastro_reads_the_configuration },
		{ "mlastro_reports_the_locked_controller", mlastro_reports_the_locked_controller },
		{ "mlastro_changes_the_speed_level", mlastro_changes_the_speed_level },
		{ "mlastro_changes_the_steps_per_degree", mlastro_changes_the_steps_per_degree },
		{ "mlastro_reverses_each_axis", mlastro_reverses_each_axis },
		{ "mlastro_changes_the_soft_limits", mlastro_changes_the_soft_limits },
		{ "mlastro_changes_the_backlash", mlastro_changes_the_backlash },
		{ "mlastro_sets_and_clears_the_home_reference", mlastro_sets_and_clears_the_home_reference },
		{ "mlastro_rejects_a_single_axis_move_while_locked", mlastro_rejects_a_single_axis_move_while_locked },
		{ "mlastro_rejects_a_two_axis_move_while_locked", mlastro_rejects_a_two_axis_move_while_locked },
		{ "mlastro_rejects_return_to_home_while_locked", mlastro_rejects_return_to_home_while_locked },
		{ "mlastro_accepts_an_abort_while_idle", mlastro_accepts_an_abort_while_idle },
		{ "mlastro_resets_the_controller_error", mlastro_resets_the_controller_error },
		{ "mlastro_reconnects", mlastro_reconnects },
		{ "mlastro_survives_repeated_reconnects", mlastro_survives_repeated_reconnects },
		{ "mlastro_reinitializes", mlastro_reinitializes }
	};
	int result = 1;
	bool started = false, initialized = false;
	HW_CHECK(indigo_start() == INDIGO_OK);
	started = true;
	HW_CHECK(hw_attach_client("MLAstro RPA hardware test") == INDIGO_OK);
	HW_CHECK(indigo_polaralign_mlastro(INDIGO_DRIVER_INIT, NULL) == INDIGO_OK);
	initialized = true;
	rpa = hw_wait_for_device(DEVICE_NAME, SHORT_TIMEOUT);
	HW_CHECK(rpa >= 0);
	HW_CHECK(select_port());
	HW_CHECK(hw_connect(rpa, CONNECT_TIMEOUT));
	HW_CHECK(capture_initial_state());
	result = indigo_run_tests("MLAstro RPA hardware", tests, ARRAY_SIZE(tests));
cleanup:
	// Leave the controller's settings exactly as the session found them, whatever happened above.
	restore_initial_state();
	if (!hw_disconnect(rpa, SHORT_TIMEOUT)) {
		indigo_test_failures++;
	}
	if (initialized && indigo_polaralign_mlastro(INDIGO_DRIVER_SHUTDOWN, NULL) != INDIGO_OK) {
		indigo_test_failures++;
	}
	indigo_detach_client(&hw_client);
	if (started) {
		indigo_stop();
	}
	hw_release_properties();
	indigo_test_remove_private_home();
	return indigo_test_failures ? 1 : result;
}
