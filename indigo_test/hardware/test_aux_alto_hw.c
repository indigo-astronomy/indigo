// Copyright (c) 2026 INDIGO initiative
// All rights reserved.
//
// You may use this software under the terms of 'INDIGO Astronomy
// open-source license' (see LICENSE.md).
//
// THIS SOFTWARE IS PROVIDED BY THE AUTHORS 'AS IS' AND ANY EXPRESS
// OR IMPLIED WARRANTIES, INCLUDING, BUT NOT LIMITED TO, THE IMPLIED
// WARRANTIES OF MERCHANTABILITY AND FITNESS FOR A PARTICULAR PURPOSE
// ARE DISCLAIMED. IN NO EVENT SHALL THE AUTHOR BE LIABLE FOR ANY
// DIRECT, INDIRECT, INCIDENTAL, SPECIAL, EXEMPLARY, OR CONSEQUENTIAL
// DAMAGES (INCLUDING, BUT NOT LIMITED TO, PROCUREMENT OF SUBSTITUTE
// GOODS OR SERVICES; LOSS OF USE, DATA, OR PROFITS; OR BUSINESS
// INTERRUPTION) HOWEVER CAUSED AND ON ANY THEORY OF LIABILITY,
// WHETHER IN CONTRACT, STRICT LIABILITY, OR TORT (INCLUDING
// NEGLIGENCE OR OTHERWISE) ARISING IN ANY WAY OUT OF THE USE OF THIS
// SOFTWARE, EVEN IF ADVISED OF THE POSSIBILITY OF SUCH DAMAGE.

// Code is generated by AI

// Physical PrimaLuce Lab ALTO test for indigo_aux_alto. THE COVER MOVES over its whole travel; keep its path clear.
// The run restores the position it found, the LEDs and the preset it uses. Calibration is not run.

#include <math.h>
#include <stdlib.h>
#include <indigo_drivers/aux_alto/indigo_aux_alto.h>
#include "hardware_test_common.h"

#define DEVICE_NAME "PrimaluceLab ALTO"
#define SHORT_TIMEOUT 15.0
// A full stroke takes about 34 s on an ALTO1.
#define MOVE_TIMEOUT 60.0
#define USED_PRESET "PRESET_3"
#define UNNAMED_PRESET "PRESET_2"

static int cover = -1;
static const char *serial_port = NULL;
static bool state_captured = false;
static double initial_position = 100;
static char initial_leds[INDIGO_NAME_SIZE] = "ON";
static char initial_used_name[INDIGO_VALUE_SIZE] = "";

static bool select_port(void) {
	if (serial_port == NULL || !*serial_port) {
		fprintf(stderr, "    set ALTO_HW_PORT to the cover's serial port\n");
		return false;
	}
	printf("Using port %s\n", serial_port);
	return hw_set_text(cover, DEVICE_PORT_PROPERTY_NAME, DEVICE_PORT_ITEM_NAME, serial_port, INDIGO_OK_STATE, SHORT_TIMEOUT);
}

static bool position_is(double expected) {
	double value = -1;
	return hw_number_item(cover, "X_COVER_POSITION", "POSITION", &value) && value == expected;
}

static bool move_to(double position) {
	return hw_set_number(cover, "X_COVER_POSITION", "POSITION", position, INDIGO_OK_STATE, MOVE_TIMEOUT) && position_is(position);
}

static bool switch_on(const char *property, const char *item) {
	bool value = false;
	return hw_switch_item(cover, property, item, &value) && value;
}

static void restore_initial_state(void) {
	if (cover < 0 || !state_captured || !hw_connected(cover)) {
		return;
	}
	move_to(initial_position);
	hw_set_switch(cover, "X_LEDS", initial_leds, INDIGO_OK_STATE, SHORT_TIMEOUT);
	// A preset takes a position only while it has a name, so the position goes first.
	hw_set_number(cover, "X_PRESETS", USED_PRESET, 0, INDIGO_OK_STATE, SHORT_TIMEOUT);
	hw_set_text(cover, "X_PRESET_NAMES", USED_PRESET, initial_used_name, INDIGO_OK_STATE, SHORT_TIMEOUT);
}

static void alto_publishes_the_property_contract(void) {
	double min = -1, max = -1, temperature = -100;
	char model[INDIGO_VALUE_SIZE] = "";
	ASSERT_TRUE((hw_device_interface(cover) & INDIGO_INTERFACE_AUX_DUSTCAP) != 0);
	ASSERT_STREQ(DEVICE_NAME, hw_device_name(cover));
	ASSERT_TRUE(hw_text_item(cover, INFO_PROPERTY_NAME, INFO_DEVICE_MODEL_ITEM_NAME, model, sizeof(model)));
	ASSERT_TRUE(!strncmp(model, "ALTO", 4));
	ASSERT_TRUE(hw_property_defined(cover, AUX_COVER_PROPERTY_NAME));
	ASSERT_TRUE(hw_property_defined(cover, "X_COVER_ABORT"));
	ASSERT_TRUE(hw_property_defined(cover, "X_CALIBRATION"));
	ASSERT_TRUE(hw_number_item_range(cover, "X_COVER_POSITION", "POSITION", &min, &max));
	ASSERT_EQ_INT(0, (int)min);
	ASSERT_EQ_INT(100, (int)max);
	ASSERT_TRUE(hw_number_item(cover, "X_STATE", "TEMPERATURE", &temperature));
	ASSERT_TRUE(temperature > -20 && temperature < 80);
	// The cases start fully open, and AUX_COVER shows that end.
	ASSERT_TRUE(position_is(100));
	ASSERT_TRUE(switch_on(AUX_COVER_PROPERTY_NAME, AUX_COVER_OPEN_ITEM_NAME));
	ASSERT_TRUE(!switch_on(AUX_COVER_PROPERTY_NAME, AUX_COVER_CLOSE_ITEM_NAME));
	printf("    %s at %g %%, %g °C\n", model, initial_position, temperature);
}

static void alto_moves_to_partial_positions(void) {
	ASSERT_TRUE(move_to(80));
	ASSERT_TRUE(!switch_on(AUX_COVER_PROPERTY_NAME, AUX_COVER_OPEN_ITEM_NAME) && !switch_on(AUX_COVER_PROPERTY_NAME, AUX_COVER_CLOSE_ITEM_NAME));
	ASSERT_TRUE(move_to(60));
	// Idle polls (2 s apart) agree with the position reached.
	indigo_usleep(4500000);
	ASSERT_TRUE(position_is(60));
	ASSERT_TRUE(hw_property_state(cover, "X_COVER_POSITION") == INDIGO_OK_STATE);
}

static void alto_closes_and_opens(void) {
	ASSERT_TRUE(hw_set_switch(cover, AUX_COVER_PROPERTY_NAME, AUX_COVER_CLOSE_ITEM_NAME, INDIGO_OK_STATE, MOVE_TIMEOUT));
	ASSERT_TRUE(position_is(0));
	ASSERT_TRUE(switch_on(AUX_COVER_PROPERTY_NAME, AUX_COVER_CLOSE_ITEM_NAME));
	ASSERT_TRUE(hw_set_switch(cover, AUX_COVER_PROPERTY_NAME, AUX_COVER_OPEN_ITEM_NAME, INDIGO_OK_STATE, MOVE_TIMEOUT));
	ASSERT_TRUE(position_is(100));
	ASSERT_TRUE(switch_on(AUX_COVER_PROPERTY_NAME, AUX_COVER_OPEN_ITEM_NAME));
}

// An abort mid-move stops the cover (decelerated) short of the target; the move ends ALERT and a fresh move works.
static void alto_aborts_a_move(void) {
	double position = -1;
	ASSERT_TRUE(position_is(100));
	unsigned before = hw_revision(cover, "X_COVER_POSITION");
	hw_request_number(cover, "X_COVER_POSITION", "POSITION", 20);
	indigo_usleep(4000000);
	ASSERT_TRUE(hw_set_switch(cover, "X_COVER_ABORT", "ABORT", INDIGO_OK_STATE, SHORT_TIMEOUT));
	ASSERT_TRUE(hw_wait_state(cover, "X_COVER_POSITION", before, INDIGO_ALERT_STATE, SHORT_TIMEOUT));
	ASSERT_TRUE(hw_number_item(cover, "X_COVER_POSITION", "POSITION", &position));
	printf("    stopped at %g %%\n", position);
	ASSERT_TRUE(position > 20 && position < 100);
	indigo_usleep(2000000);
	ASSERT_TRUE(position_is(position));
	ASSERT_TRUE(move_to(100));
}

static void alto_uses_presets(void) {
	char text[INDIGO_VALUE_SIZE] = "";
	ASSERT_TRUE(hw_set_text(cover, "X_PRESET_NAMES", USED_PRESET, "INDIGO test", INDIGO_OK_STATE, SHORT_TIMEOUT));
	ASSERT_TRUE(hw_set_number(cover, "X_PRESETS", USED_PRESET, 70, INDIGO_OK_STATE, SHORT_TIMEOUT));
	// A recall moves the cover to the preset.
	ASSERT_TRUE(hw_set_switch(cover, "X_PRESET_RECALL", USED_PRESET, INDIGO_OK_STATE, SHORT_TIMEOUT));
	ASSERT_TRUE(hw_wait_settled(cover, "X_COVER_POSITION", INDIGO_OK_STATE, MOVE_TIMEOUT));
	ASSERT_TRUE(position_is(70));
	// A preset without a name refuses a position.
	ASSERT_TRUE(hw_text_item(cover, "X_PRESET_NAMES", UNNAMED_PRESET, text, sizeof(text)));
	if (*text == 0) {
		double value = -1;
		ASSERT_TRUE(hw_set_number(cover, "X_PRESETS", UNNAMED_PRESET, 30, INDIGO_ALERT_STATE, SHORT_TIMEOUT));
		ASSERT_TRUE(hw_number_item(cover, "X_PRESETS", UNNAMED_PRESET, &value) && value == 0);
	} else {
		printf("    %s is named \"%s\", the unnamed-preset check is skipped\n", UNNAMED_PRESET, text);
	}
	ASSERT_TRUE(hw_set_number(cover, "X_PRESETS", USED_PRESET, 0, INDIGO_OK_STATE, SHORT_TIMEOUT));
	ASSERT_TRUE(hw_set_text(cover, "X_PRESET_NAMES", USED_PRESET, initial_used_name, INDIGO_OK_STATE, SHORT_TIMEOUT));
	ASSERT_TRUE(move_to(100));
}

static void alto_changes_the_leds(void) {
	ASSERT_TRUE(hw_set_switch(cover, "X_LEDS", "DIM", INDIGO_OK_STATE, SHORT_TIMEOUT));
	ASSERT_TRUE(hw_set_switch(cover, "X_LEDS", "MIDDLE", INDIGO_OK_STATE, SHORT_TIMEOUT));
	ASSERT_TRUE(hw_set_switch(cover, "X_LEDS", initial_leds, INDIGO_OK_STATE, SHORT_TIMEOUT));
}

// The controller keeps the position; a reconnect reads it back.
static void alto_reconnects(void) {
	ASSERT_TRUE(move_to(90));
	ASSERT_TRUE(hw_disconnect(cover, SHORT_TIMEOUT));
	ASSERT_TRUE(hw_property_hidden(cover, AUX_COVER_PROPERTY_NAME));
	ASSERT_TRUE(hw_connect(cover, SHORT_TIMEOUT));
	ASSERT_TRUE(position_is(90));
	ASSERT_TRUE(move_to(100));
}

static void alto_rejects_shutdown_while_connected(void) {
	ASSERT_EQ_INT(INDIGO_BUSY, indigo_aux_alto(INDIGO_DRIVER_SHUTDOWN, NULL));
	ASSERT_TRUE(hw_set_switch(cover, "X_LEDS", initial_leds, INDIGO_OK_STATE, SHORT_TIMEOUT));
}

static void alto_reinitializes(void) {
	ASSERT_TRUE(hw_disconnect(cover, SHORT_TIMEOUT));
	ASSERT_EQ_INT(INDIGO_OK, indigo_aux_alto(INDIGO_DRIVER_SHUTDOWN, NULL));
	ASSERT_EQ_INT(-1, hw_device_index(DEVICE_NAME));
	ASSERT_EQ_INT(INDIGO_OK, indigo_aux_alto(INDIGO_DRIVER_INIT, NULL));
	cover = hw_wait_for_device(DEVICE_NAME, SHORT_TIMEOUT);
	ASSERT_TRUE(cover >= 0);
	ASSERT_TRUE(select_port());
	ASSERT_TRUE(hw_connect(cover, SHORT_TIMEOUT));
	ASSERT_TRUE(move_to(95));
	ASSERT_TRUE(move_to(100));
}

int main(int argc, char **argv) {
	if (argc < 2 || strcmp(argv[1], "--run")) {
		fprintf(stderr, "Physical ALTO test: run explicitly with --run (or make test-aux-alto-hw).\n");
		return 2;
	}
	setvbuf(stdout, NULL, _IONBF, 0);
	for (int i = 2; i < argc; i++) {
		if (!strcmp(argv[i], "--debug")) {
			indigo_set_log_level(INDIGO_LOG_DEBUG);
		}
	}
	if (!indigo_test_use_private_home()) {
		return 1;
	}
	serial_port = hw_port("ALTO_HW_PORT");
	const indigo_test_case tests[] = {
		{ "alto_publishes_the_property_contract", alto_publishes_the_property_contract },
		{ "alto_moves_to_partial_positions", alto_moves_to_partial_positions },
		{ "alto_closes_and_opens", alto_closes_and_opens },
		{ "alto_aborts_a_move", alto_aborts_a_move },
		{ "alto_uses_presets", alto_uses_presets },
		{ "alto_changes_the_leds", alto_changes_the_leds },
		{ "alto_reconnects", alto_reconnects },
		{ "alto_rejects_shutdown_while_connected", alto_rejects_shutdown_while_connected },
		{ "alto_reinitializes", alto_reinitializes }
	};
	int result = 1;
	bool started = false, initialized = false;
	HW_CHECK(hw_start() == INDIGO_OK);
	started = true;
	HW_CHECK(hw_attach_client("ALTO hardware test") == INDIGO_OK);
	HW_CHECK(indigo_aux_alto(INDIGO_DRIVER_INIT, NULL) == INDIGO_OK);
	initialized = true;
	cover = hw_wait_for_device(DEVICE_NAME, SHORT_TIMEOUT);
	HW_CHECK(cover >= 0);
	HW_CHECK(select_port());
	HW_CHECK(hw_connect(cover, SHORT_TIMEOUT));
	HW_CHECK(hw_number_item(cover, "X_COVER_POSITION", "POSITION", &initial_position));
	const char *leds[] = { "OFF", "DIM", "MIDDLE", "ON" };
	for (int i = 0; i < ARRAY_SIZE(leds); i++) {
		if (switch_on("X_LEDS", leds[i])) {
			snprintf(initial_leds, sizeof(initial_leds), "%s", leds[i]);
		}
	}
	HW_CHECK(hw_text_item(cover, "X_PRESET_NAMES", USED_PRESET, initial_used_name, sizeof(initial_used_name)));
	if (*initial_used_name) {
		fprintf(stderr, "    preset 3 is in use (\"%s\"); clear it or change USED_PRESET\n", initial_used_name);
		HW_CHECK(false);
	}
	state_captured = true;
	// The cases start from fully open.
	HW_CHECK(move_to(100));
	result = indigo_run_tests("ALTO hardware", tests, ARRAY_SIZE(tests));
cleanup:
	restore_initial_state();
	if (!hw_disconnect(cover, SHORT_TIMEOUT)) {
		indigo_test_failures++;
	}
	if (initialized && indigo_aux_alto(INDIGO_DRIVER_SHUTDOWN, NULL) != INDIGO_OK) {
		indigo_test_failures++;
	}
	indigo_detach_client(&hw_client);
	if (started) {
		indigo_stop();
	}
	hw_release_properties();
	indigo_test_remove_private_home();
	return indigo_test_failures ? 1 : result;
}
