// Copyright (c) 2026 INDIGO initiative
// All rights reserved.
//
// You may use this software under the terms of 'INDIGO Astronomy
// open-source license' (see LICENSE.md).
//
// THIS SOFTWARE IS PROVIDED BY THE AUTHORS 'AS IS' AND ANY EXPRESS
// OR IMPLIED WARRANTIES, INCLUDING, BUT NOT LIMITED TO, THE IMPLIED
// WARRANTIES OF MERCHANTABILITY AND FITNESS FOR A PARTICULAR PURPOSE
// ARE DISCLAIMED. IN NO EVENT SHALL THE AUTHOR BE LIABLE FOR ANY
// DIRECT, INDIRECT, INCIDENTAL, SPECIAL, EXEMPLARY, OR CONSEQUENTIAL
// DAMAGES (INCLUDING, BUT NOT LIMITED TO, PROCUREMENT OF SUBSTITUTE
// GOODS OR SERVICES; LOSS OF USE, DATA, OR PROFITS; OR BUSINESS
// INTERRUPTION) HOWEVER CAUSED AND ON ANY THEORY OF LIABILITY,
// WHETHER IN CONTRACT, STRICT LIABILITY, OR TORT (INCLUDING
// NEGLIGENCE OR OTHERWISE) ARISING IN ANY WAY OUT OF THE USE OF THIS
// SOFTWARE, EVEN IF ADVISED OF THE POSSIBILITY OF SUCH DAMAGE.

// Code is generated by AI

// Physical IIDC camera acceptance test implemented by Claude.

#include <pthread.h>
#include <math.h>
#include <stdlib.h>

#include <indigo/indigo_driver.h>
#include <indigo_drivers/ccd_iidc/indigo_ccd_iidc.h>

#include "../test_runner.h"

#define MAX_DEVICES 16
#define MAX_PROPERTIES 128
#define CHECK(condition) do { if (!(condition)) { fprintf(stderr, "%s:%d: %s\n", __FILE__, __LINE__, #condition); indigo_test_failures++; goto cleanup; } } while (0)

typedef struct {
	char name[INDIGO_NAME_SIZE];
	unsigned interface;
	bool present;
	indigo_property *properties[MAX_PROPERTIES];
	unsigned revisions[MAX_PROPERTIES];
	unsigned frames;
	unsigned invalid_frames;
} observed_device;

static observed_device devices[MAX_DEVICES];
static pthread_mutex_t mutex = PTHREAD_MUTEX_INITIALIZER;
static indigo_client client;
static int camera = -1;
static bool hotplug;
static double short_exposure = 0.1;
static const char *skipped_modes;

// Camera modes that cannot transmit a frame at all are excluded by name through INDIGO_TEST_SKIP_MODES, never silently.
static bool mode_skipped(const char *name) {
	size_t length = strlen(name);
	for (const char *entry = skipped_modes; entry && *entry; ) {
		const char *separator = strchr(entry, ',');
		size_t entry_length = separator ? (size_t)(separator - entry) : strlen(entry);
		if (entry_length == length && !strncmp(entry, name, length)) {
			return true;
		}
		entry = separator ? separator + 1 : NULL;
	}
	return false;
}

static int property_slot(int device_index, const char *name) {
	for (int property_index = 0; property_index < MAX_PROPERTIES; property_index++) {
		if (devices[device_index].properties[property_index] && !strcmp(devices[device_index].properties[property_index]->name, name)) {
			return property_index;
		}
	}
	return -1;
}

static indigo_result observe(indigo_device *device, indigo_property *property, const char *message, bool image_update) {
	pthread_mutex_lock(&mutex);
	int device_index;
	for (device_index = 0; device_index < MAX_DEVICES; device_index++) {
		if (!*devices[device_index].name || !strcmp(devices[device_index].name, property->device)) {
			break;
		}
	}
	if (device_index < MAX_DEVICES) {
		snprintf(devices[device_index].name, INDIGO_NAME_SIZE, "%s", property->device);
		if (!image_update && !strcmp(property->name, INFO_PROPERTY_NAME)) {
			devices[device_index].present = true;
			for (int item_index = 0; item_index < property->count; item_index++) {
				if (!strcmp(property->items[item_index].name, INFO_DEVICE_INTERFACE_ITEM_NAME)) {
					devices[device_index].interface = strtoul(property->items[item_index].text.value, NULL, 10);
				}
			}
		}
		int property_index = property_slot(device_index, property->name);
		if (property_index < 0) {
			for (property_index = 0; property_index < MAX_PROPERTIES && devices[device_index].properties[property_index]; property_index++) { }
		}
		if (property_index < MAX_PROPERTIES) {
			indigo_release_property(devices[device_index].properties[property_index]);
			devices[device_index].properties[property_index] = indigo_copy_property(NULL, property);
			devices[device_index].revisions[property_index]++;
		}
		if (image_update && !strcmp(property->name, CCD_IMAGE_PROPERTY_NAME) && property->state == INDIGO_OK_STATE && property->count && property->items[0].blob.value) {
			indigo_item *item = property->items;
			indigo_raw_header header = { 0 };
			if (item->blob.size >= sizeof(header)) {
				memcpy(&header, item->blob.value, sizeof(header));
			}
			unsigned bytes_per_pixel = header.signature == INDIGO_RAW_MONO8 ? 1 : (header.signature == INDIGO_RAW_MONO16 ? 2 : (header.signature == INDIGO_RAW_RGB24 ? 3 : (header.signature == INDIGO_RAW_RGB48 ? 6 : 0)));
			if (strcmp(item->blob.format, ".raw") || !bytes_per_pixel || !header.width || !header.height || (uint64_t)header.width * header.height * bytes_per_pixel + sizeof(header) > item->blob.size) {
				devices[device_index].invalid_frames++;
			}
			devices[device_index].frames++;
			if (devices[device_index].frames <= 12 || devices[device_index].frames % 100 == 0) {
				printf("    frame %u: %u x %u, %ld bytes\n", devices[device_index].frames, header.width, header.height, item->blob.size);
			}
		}
	}
	pthread_mutex_unlock(&mutex);
	if (message && *message) {
		fprintf(stderr, "    %s %s: %s\n", property->device, property->name, message);
	}
	return INDIGO_OK;
}

static indigo_result define_property(indigo_client *client, indigo_device *device, indigo_property *property, const char *message) {
	return observe(device, property, message, false);
}

static indigo_result update_property(indigo_client *client, indigo_device *device, indigo_property *property, const char *message) {
	return observe(device, property, message, true);
}

static indigo_result report_message(indigo_client *client, indigo_device *device, indigo_property *property, const char *message) {
	fprintf(stderr, "    message: %s\n", message ? message : "");
	return INDIGO_OK;
}

static indigo_result delete_property(indigo_client *client, indigo_device *device, indigo_property *property, const char *message) {
	if (!*property->name) {
		pthread_mutex_lock(&mutex);
		for (int device_index = 0; device_index < MAX_DEVICES; device_index++) {
			if (!strcmp(devices[device_index].name, property->device)) {
				devices[device_index].present = false;
				for (int property_index = 0; property_index < MAX_PROPERTIES; property_index++) {
					indigo_release_property(devices[device_index].properties[property_index]);
					devices[device_index].properties[property_index] = NULL;
				}
			}
		}
		pthread_mutex_unlock(&mutex);
	}
	return INDIGO_OK;
}

static bool select_camera(void) {
	const char *requested = getenv("INDIGO_TEST_DEVICE");
	int matches = 0;
	pthread_mutex_lock(&mutex);
	for (int device_index = 0; device_index < MAX_DEVICES; device_index++) {
		if (devices[device_index].present && (devices[device_index].interface & INDIGO_INTERFACE_CCD)) {
			printf("    discovered camera: %s\n", devices[device_index].name);
			if (!requested || !strcmp(requested, devices[device_index].name)) {
				camera = device_index;
				matches++;
			}
		}
	}
	pthread_mutex_unlock(&mutex);
	if (matches != 1) {
		fprintf(stderr, "Expected one matching IIDC camera, found %d. Set INDIGO_TEST_DEVICE to an exact discovered name when needed.\n", matches);
		camera = -1;
		return false;
	}
	printf("    selected: %s\n", devices[camera].name);
	return true;
}

static bool wait_presence(bool present) {
	for (int iteration = 0; iteration < 18000; iteration++) {
		pthread_mutex_lock(&mutex);
		bool ready = camera >= 0 && devices[camera].present == present;
		if (ready && present) {
			ready = property_slot(camera, CONNECTION_PROPERTY_NAME) >= 0;
		}
		pthread_mutex_unlock(&mutex);
		if (ready) {
			return true;
		}
		indigo_usleep(10000);
	}
	fprintf(stderr, "Timed out waiting for physical %s\n", present ? "replug" : "unplug");
	return false;
}

static unsigned property_revision(const char *name) {
	pthread_mutex_lock(&mutex);
	int property_index = property_slot(camera, name);
	unsigned result = property_index < 0 ? 0 : devices[camera].revisions[property_index];
	pthread_mutex_unlock(&mutex);
	return result;
}

static indigo_property *snapshot(const char *name) {
	pthread_mutex_lock(&mutex);
	int property_index = property_slot(camera, name);
	indigo_property *result = property_index < 0 ? NULL : indigo_copy_property(NULL, devices[camera].properties[property_index]);
	pthread_mutex_unlock(&mutex);
	return result;
}

static bool same_values(indigo_property *before, indigo_property *after) {
	if (!before || !after || before->type != after->type || before->count != after->count) {
		return false;
	}
	for (int item_index = 0; item_index < before->count; item_index++) {
		indigo_item *before_item = before->items + item_index, *after_item = after->items + item_index;
		if (strcmp(before_item->name, after_item->name)) {
			return false;
		}
		if (before->type == INDIGO_NUMBER_VECTOR && (before_item->number.value != after_item->number.value || before_item->number.target != after_item->number.target)) {
			return false;
		}
		if (before->type == INDIGO_SWITCH_VECTOR && before_item->sw.value != after_item->sw.value) {
			return false;
		}
	}
	return true;
}

static bool wait_state(const char *name, unsigned after, indigo_property_state state) {
	for (int iteration = 0; iteration < 6000; iteration++) {
		pthread_mutex_lock(&mutex);
		int property_index = property_slot(camera, name);
		bool ready = property_index >= 0 && devices[camera].revisions[property_index] > after && devices[camera].properties[property_index]->state == state;
		bool failed = property_index >= 0 && devices[camera].revisions[property_index] > after && devices[camera].properties[property_index]->state == INDIGO_ALERT_STATE && state != INDIGO_ALERT_STATE;
		indigo_property_state actual = property_index < 0 ? INDIGO_IDLE_STATE : devices[camera].properties[property_index]->state;
		pthread_mutex_unlock(&mutex);
		if (ready) {
			return true;
		}
		if (failed) {
			fprintf(stderr, "Failed: %s %s entered state %d while waiting for %d\n", devices[camera].name, name, actual, state);
			return false;
		}
		indigo_usleep(10000);
	}
	fprintf(stderr, "Timeout: %s %s expected state %d\n", devices[camera].name, name, state);
	return false;
}

static bool change_switch(const char *name, const char *item, indigo_property_state state) {
	unsigned before = property_revision(name);
	indigo_change_switch_property_1(&client, devices[camera].name, name, item, true);
	return wait_state(name, before, state);
}

static bool change_number(const char *name, const char *item, double value, indigo_property_state state) {
	unsigned before = property_revision(name);
	indigo_change_number_property_1(&client, devices[camera].name, name, item, value);
	return wait_state(name, before, state);
}

// A refused change must publish ALERT and leave every value and target of the property untouched.
static bool reject_number_change(const char *name, const char *item, double value) {
	indigo_property *before = snapshot(name);
	unsigned revision = property_revision(name);
	indigo_change_number_property_1(&client, devices[camera].name, name, item, value);
	bool result = wait_state(name, revision, INDIGO_ALERT_STATE);
	indigo_property *after = snapshot(name);
	result = result && same_values(before, after);
	indigo_release_property(before);
	indigo_release_property(after);
	return result;
}

static bool reject_switch_change(const char *name, const char *item) {
	indigo_property *before = snapshot(name);
	unsigned revision = property_revision(name);
	indigo_change_switch_property_1(&client, devices[camera].name, name, item, true);
	bool result = wait_state(name, revision, INDIGO_ALERT_STATE);
	indigo_property *after = snapshot(name);
	result = result && same_values(before, after);
	indigo_release_property(before);
	indigo_release_property(after);
	return result;
}

static unsigned frame_count(void) {
	pthread_mutex_lock(&mutex);
	unsigned result = devices[camera].frames;
	pthread_mutex_unlock(&mutex);
	return result;
}

static bool disconnect_camera(void) {
	pthread_mutex_lock(&mutex);
	bool present = camera >= 0 && devices[camera].present;
	int property_index = camera < 0 ? -1 : property_slot(camera, CONNECTION_PROPERTY_NAME);
	bool disconnected = property_index >= 0 && indigo_get_switch(devices[camera].properties[property_index], CONNECTION_DISCONNECTED_ITEM_NAME);
	pthread_mutex_unlock(&mutex);
	if (!present || disconnected) {
		return true;
	}
	return change_switch(CONNECTION_PROPERTY_NAME, CONNECTION_DISCONNECTED_ITEM_NAME, INDIGO_OK_STATE);
}

static bool acquire(double duration) {
	unsigned before = frame_count();
	if (!change_number(CCD_EXPOSURE_PROPERTY_NAME, CCD_EXPOSURE_ITEM_NAME, duration, INDIGO_OK_STATE)) {
		return false;
	}
	return frame_count() == before + 1;
}

static bool setup_exposure_duration(void) {
	pthread_mutex_lock(&mutex);
	int property_index = property_slot(camera, CCD_EXPOSURE_PROPERTY_NAME);
	if (property_index < 0) {
		pthread_mutex_unlock(&mutex);
		return false;
	}
	double minimum = devices[camera].properties[property_index]->items[0].number.min;
	double maximum = devices[camera].properties[property_index]->items[0].number.max;
	pthread_mutex_unlock(&mutex);
	if (minimum <= 0 || maximum < minimum) {
		return false;
	}
	// IIDC shutter ranges are camera defined and can be far below one second, so clamp the nominal duration into the advertised range.
	short_exposure = fmin(maximum, fmax(minimum, 0.1));
	const char *override = getenv("INDIGO_TEST_SHORT_EXPOSURE");
	if (override) {
		char *end = NULL;
		double value = strtod(override, &end);
		if (!*override || *end || !isfinite(value) || value < minimum || value > maximum) {
			fprintf(stderr, "INDIGO_TEST_SHORT_EXPOSURE must be within %g .. %g s\n", minimum, maximum);
			return false;
		}
		short_exposure = value;
	}
	printf("    exposure range: %g .. %g s; testing %g s\n", minimum, maximum, short_exposure);
	return true;
}

static bool exercise_modes(void) {
	char names[64][INDIGO_NAME_SIZE], labels[64][INDIGO_VALUE_SIZE];
	char original[INDIGO_NAME_SIZE] = "";
	int count = 0;
	int tested = 0;
	const char *filter = getenv("INDIGO_TEST_MODE");
	pthread_mutex_lock(&mutex);
	int property_index = property_slot(camera, CCD_MODE_PROPERTY_NAME);
	if (property_index >= 0) {
		indigo_property *property = devices[camera].properties[property_index];
		count = property->count < 64 ? property->count : 64;
		for (int item_index = 0; item_index < count; item_index++) {
			snprintf(names[item_index], INDIGO_NAME_SIZE, "%s", property->items[item_index].name);
			snprintf(labels[item_index], INDIGO_VALUE_SIZE, "%s", property->items[item_index].label);
			if (property->items[item_index].sw.value) {
				snprintf(original, sizeof(original), "%s", property->items[item_index].name);
			}
		}
	}
	pthread_mutex_unlock(&mutex);
	for (int item_index = 0; item_index < count; item_index++) {
		printf("    advertised mode: %s (%s)%s\n", names[item_index], labels[item_index], strcmp(names[item_index], original) ? "" : ", selected");
	}
	for (int item_index = 0; item_index < count; item_index++) {
		if (filter && strcmp(filter, names[item_index])) {
			continue;
		}
		if (mode_skipped(names[item_index])) {
			printf("    mode skipped by request: %s (%s)\n", names[item_index], labels[item_index]);
			continue;
		}
		tested++;
		printf("    mode: %s (%s)\n", names[item_index], labels[item_index]);
		if (!change_switch(CCD_MODE_PROPERTY_NAME, names[item_index], INDIGO_OK_STATE) || !acquire(short_exposure)) {
			return false;
		}
	}
	if (filter && tested == 0) {
		fprintf(stderr, "Requested mode is not advertised: %s\n", filter);
	}
	if (!filter && tested > 0 && original[0] && !change_switch(CCD_MODE_PROPERTY_NAME, original, INDIGO_OK_STATE)) {
		return false;
	}
	return tested > 0;
}

// An accepted control change must commit value and target together; the refused write needs an injected SDK failure and stays with the fake SDK suite.
static bool exercise_control(const char *property_name, const char *item_name) {
	double original = 0, requested = 0, minimum = 0, maximum = 0;
	bool writable = false;
	pthread_mutex_lock(&mutex);
	int property_index = property_slot(camera, property_name);
	if (property_index >= 0) {
		indigo_property *property = devices[camera].properties[property_index];
		if (!property->hidden && property->perm == INDIGO_RW_PERM && property->count) {
			original = property->items[0].number.value;
			minimum = property->items[0].number.min;
			maximum = property->items[0].number.max;
			requested = minimum;
			writable = true;
		}
	}
	pthread_mutex_unlock(&mutex);
	if (!writable) {
		printf("    optional control unavailable/read-only: %s\n", property_name);
		return true;
	}
	// Both limits stay inside the advertised range; a midpoint could coincide with the value the camera already holds and would test nothing.
	if (requested == original) {
		requested = maximum;
	}
	if (requested == original) {
		printf("    control is not adjustable: %s\n", property_name);
		return true;
	}
	if (!change_number(property_name, item_name, requested, INDIGO_OK_STATE)) {
		return false;
	}
	indigo_property *accepted = snapshot(property_name);
	bool committed = accepted && accepted->items[0].number.value == requested && accepted->items[0].number.target == requested;
	indigo_release_property(accepted);
	if (!committed) {
		fprintf(stderr, "Accepted %s did not commit value and target to %g\n", property_name, requested);
		return false;
	}
	if (!acquire(short_exposure) || !change_number(property_name, item_name, original, INDIGO_OK_STATE)) {
		return false;
	}
	indigo_property *restored = snapshot(property_name);
	committed = restored && restored->items[0].number.value == original && restored->items[0].number.target == original;
	indigo_release_property(restored);
	printf("    %s accepted: %g -> %g -> %g\n", property_name, original, requested, original);
	return committed;
}

static void hardware_workflows(void) {
	bool initialized = false;
	CHECK(indigo_start() == INDIGO_OK);
	CHECK(indigo_attach_client(&client) == INDIGO_OK);
	CHECK(indigo_ccd_iidc(INDIGO_DRIVER_INIT, NULL) == INDIGO_OK);
	initialized = true;
	// Let initial USB enumeration settle before selecting a unique camera.
	for (int iteration = 0; iteration < 500; iteration++) {
		indigo_usleep(10000);
	}
	CHECK(select_camera());
	CHECK(change_switch(CONNECTION_PROPERTY_NAME, CONNECTION_CONNECTED_ITEM_NAME, INDIGO_OK_STATE));
	CHECK(change_switch(CCD_UPLOAD_MODE_PROPERTY_NAME, CCD_UPLOAD_MODE_CLIENT_ITEM_NAME, INDIGO_OK_STATE));
	CHECK(change_switch(CCD_IMAGE_FORMAT_PROPERTY_NAME, CCD_IMAGE_FORMAT_RAW_ITEM_NAME, INDIGO_OK_STATE));
	CHECK(setup_exposure_duration());
	CHECK(exercise_modes());
	CHECK(exercise_control(CCD_GAIN_PROPERTY_NAME, CCD_GAIN_ITEM_NAME));
	CHECK(exercise_control(CCD_GAMMA_PROPERTY_NAME, CCD_GAMMA_ITEM_NAME));
	unsigned before = frame_count();
	unsigned streaming_revision = property_revision(CCD_STREAMING_PROPERTY_NAME);
	indigo_change_number_property(&client, devices[camera].name, CCD_STREAMING_PROPERTY_NAME, 2, (const char *[]){ CCD_STREAMING_EXPOSURE_ITEM_NAME, CCD_STREAMING_COUNT_ITEM_NAME }, (double []){ short_exposure, 5 });
	CHECK(wait_state(CCD_STREAMING_PROPERTY_NAME, streaming_revision, INDIGO_OK_STATE));
	CHECK(frame_count() == before + 5);
	before = frame_count();
	streaming_revision = property_revision(CCD_STREAMING_PROPERTY_NAME);
	indigo_change_number_property(&client, devices[camera].name, CCD_STREAMING_PROPERTY_NAME, 2, (const char *[]){ CCD_STREAMING_EXPOSURE_ITEM_NAME, CCD_STREAMING_COUNT_ITEM_NAME }, (double []){ short_exposure, -1 });
	CHECK(wait_state(CCD_STREAMING_PROPERTY_NAME, streaming_revision, INDIGO_BUSY_STATE));
	for (int iteration = 0; iteration < 3000 && frame_count() < before + 3; iteration++) {
		indigo_usleep(10000);
	}
	CHECK(frame_count() >= before + 3);
	// Geometry changes are refused while an acquisition runs; the client must see ALERT and the unchanged geometry.
	indigo_property *frame = snapshot(CCD_FRAME_PROPERTY_NAME);
	CHECK(frame && frame->count > 2);
	double width = frame->items[2].number.value;
	indigo_release_property(frame);
	CHECK(reject_number_change(CCD_FRAME_PROPERTY_NAME, CCD_FRAME_WIDTH_ITEM_NAME, width / 2));
	char other_mode[INDIGO_NAME_SIZE] = "";
	indigo_property *mode = snapshot(CCD_MODE_PROPERTY_NAME);
	if (mode) {
		for (int item_index = 0; item_index < mode->count; item_index++) {
			if (!mode->items[item_index].sw.value && !*other_mode && !mode_skipped(mode->items[item_index].name)) {
				snprintf(other_mode, sizeof(other_mode), "%s", mode->items[item_index].name);
			}
		}
	}
	indigo_release_property(mode);
	CHECK(*other_mode);
	CHECK(reject_switch_change(CCD_MODE_PROPERTY_NAME, other_mode));
	printf("    geometry changes refused while streaming: %s and %s kept their values\n", CCD_FRAME_PROPERTY_NAME, CCD_MODE_PROPERTY_NAME);
	CHECK(change_switch(CCD_ABORT_EXPOSURE_PROPERTY_NAME, CCD_ABORT_EXPOSURE_ITEM_NAME, INDIGO_OK_STATE));
	CHECK(wait_state(CCD_STREAMING_PROPERTY_NAME, streaming_revision, INDIGO_OK_STATE));
	// The same changes are accepted once the acquisition has finished.
	CHECK(change_switch(CCD_MODE_PROPERTY_NAME, other_mode, INDIGO_OK_STATE));
	CHECK(acquire(short_exposure));
	CHECK(disconnect_camera());
	CHECK(change_switch(CONNECTION_PROPERTY_NAME, CONNECTION_CONNECTED_ITEM_NAME, INDIGO_OK_STATE));
	CHECK(change_switch(CCD_UPLOAD_MODE_PROPERTY_NAME, CCD_UPLOAD_MODE_CLIENT_ITEM_NAME, INDIGO_OK_STATE));
	CHECK(change_switch(CCD_IMAGE_FORMAT_PROPERTY_NAME, CCD_IMAGE_FORMAT_RAW_ITEM_NAME, INDIGO_OK_STATE));
	CHECK(setup_exposure_duration());
	CHECK(acquire(short_exposure));
	if (hotplug) {
		printf("HOTPLUG_READY: unplug USB camera now: %s\n", devices[camera].name);
		CHECK(wait_presence(false));
		printf("HOTPLUG_REMOVED: reconnect the same USB camera now\n");
		CHECK(wait_presence(true));
		CHECK(change_switch(CONNECTION_PROPERTY_NAME, CONNECTION_CONNECTED_ITEM_NAME, INDIGO_OK_STATE));
		CHECK(change_switch(CCD_UPLOAD_MODE_PROPERTY_NAME, CCD_UPLOAD_MODE_CLIENT_ITEM_NAME, INDIGO_OK_STATE));
		CHECK(change_switch(CCD_IMAGE_FORMAT_PROPERTY_NAME, CCD_IMAGE_FORMAT_RAW_ITEM_NAME, INDIGO_OK_STATE));
		CHECK(setup_exposure_duration());
		CHECK(acquire(short_exposure));
		printf("HOTPLUG_RECOVERED: exposure succeeded after replug\n");
	}
	CHECK(disconnect_camera());
	CHECK(indigo_ccd_iidc(INDIGO_DRIVER_SHUTDOWN, NULL) == INDIGO_OK);
	initialized = false;
	CHECK(indigo_ccd_iidc(INDIGO_DRIVER_INIT, NULL) == INDIGO_OK);
	initialized = true;
	CHECK(wait_presence(true));
	CHECK(change_switch(CONNECTION_PROPERTY_NAME, CONNECTION_CONNECTED_ITEM_NAME, INDIGO_OK_STATE));
	CHECK(change_switch(CCD_UPLOAD_MODE_PROPERTY_NAME, CCD_UPLOAD_MODE_CLIENT_ITEM_NAME, INDIGO_OK_STATE));
	CHECK(change_switch(CCD_IMAGE_FORMAT_PROPERTY_NAME, CCD_IMAGE_FORMAT_RAW_ITEM_NAME, INDIGO_OK_STATE));
	CHECK(setup_exposure_duration());
	CHECK(acquire(short_exposure));
	pthread_mutex_lock(&mutex);
	unsigned invalid_frames = devices[camera].invalid_frames;
	pthread_mutex_unlock(&mutex);
	CHECK(invalid_frames == 0);
	printf("    driver shutdown/reinit and fresh exposure succeeded\n");
cleanup:
	if (camera >= 0) {
		indigo_change_switch_property_1(&client, devices[camera].name, CCD_ABORT_EXPOSURE_PROPERTY_NAME, CCD_ABORT_EXPOSURE_ITEM_NAME, true);
		if (!disconnect_camera()) {
			indigo_test_failures++;
		}
	}
	if (initialized && indigo_ccd_iidc(INDIGO_DRIVER_SHUTDOWN, NULL) != INDIGO_OK) {
		indigo_test_failures++;
	}
	indigo_detach_client(&client);
	indigo_stop();
}

int main(int argc, char **argv) {
	if ((argc != 2 && argc != 3) || strcmp(argv[1], "--run") || (argc == 3 && strcmp(argv[2], "--hotplug"))) {
		fprintf(stderr, "Physical IIDC camera test: run explicitly with --run (or make test-ccd-iidc-hw).\n");
		return 2;
	}
	hotplug = argc == 3;
	skipped_modes = getenv("INDIGO_TEST_SKIP_MODES");
	setvbuf(stdout, NULL, _IONBF, 0);
	if (getenv("INDIGO_TEST_DEBUG")) {
		indigo_set_log_level(INDIGO_LOG_DEBUG);
	}
	client = (indigo_client){ .name = "IIDC hardware test", .version = INDIGO_VERSION_CURRENT, .define_property = define_property, .update_property = update_property, .delete_property = delete_property, .send_message = report_message };
	const indigo_test_case tests[] = { { "Physical IIDC camera modes, controls, exposure, streaming, refused geometry and reconnect", hardware_workflows } };
	int result = indigo_run_tests("IIDC hardware", tests, 1);
	for (int device_index = 0; device_index < MAX_DEVICES; device_index++) {
		for (int property_index = 0; property_index < MAX_PROPERTIES; property_index++) {
			indigo_release_property(devices[device_index].properties[property_index]);
		}
	}
	return result;
}
