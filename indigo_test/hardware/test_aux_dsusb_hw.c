// Copyright (c) 2026 INDIGO initiative
// All rights reserved.
//
// You may use this software under the terms of 'INDIGO Astronomy
// open-source license' (see LICENSE.md).
//
// THIS SOFTWARE IS PROVIDED BY THE AUTHORS 'AS IS' AND ANY EXPRESS
// OR IMPLIED WARRANTIES, INCLUDING, BUT NOT LIMITED TO, THE IMPLIED
// WARRANTIES OF MERCHANTABILITY AND FITNESS FOR A PARTICULAR PURPOSE
// ARE DISCLAIMED. IN NO EVENT SHALL THE AUTHOR BE LIABLE FOR ANY
// DIRECT, INDIRECT, INCIDENTAL, SPECIAL, EXEMPLARY, OR CONSEQUENTIAL
// DAMAGES (INCLUDING, BUT NOT LIMITED TO, PROCUREMENT OF SUBSTITUTE
// GOODS OR SERVICES; LOSS OF USE, DATA, OR PROFITS; OR BUSINESS
// INTERRUPTION) HOWEVER CAUSED AND ON ANY THEORY OF LIABILITY,
// WHETHER IN CONTRACT, STRICT LIABILITY, OR TORT (INCLUDING
// NEGLIGENCE OR OTHERWISE) ARISING IN ANY WAY OUT OF THE USE OF THIS
// SOFTWARE, EVEN IF ADVISED OF THE POSSIBILITY OF SUCH DAMAGE.

// Code is generated by AI

// Opt-in acceptance test for a physically connected Shoestring DSUSB shutter release. It runs the
// AUX acceptance checklist of DRIVER_TESTING_RULES.md against the real adapter: discovery through
// the libusb hot-plug enumeration, the published property contract, a whole-second and a
// subsecond exposure with its countdown, the request that arrives while the shutter is already
// open, abort, the focus-before-capture sequence, the persistence of the driver setting, a
// disconnect with the shutter open, reconnect and driver INIT/SHUTDOWN.
//
// The adapter closes the focus and shutter contacts of whatever camera is wired to it, so a
// camera on the other end takes the exposures this test starts. Every exposure is short and every
// scenario leaves the contacts released.
//
// Physical hot-plug is not part of this test; it is driven by the faked libusb boundary of
// indigo_test/integration/test_aux_dsusb_sdk.c.

#include <indigo_drivers/aux_dsusb/indigo_aux_dsusb.h>
#include "hardware_test_common.h"

// One USB HID transaction plus the driver's own connection work.
#define SHORT_TIMEOUT 15.0
// The longest exposure a scenario starts, plus the focus delay and the completion latency.
#define EXPOSURE_TIMEOUT 20.0

// Driver-defined property names, declared in the generated source rather than in the header.
#define X_CONFIG_PROPERTY_NAME "X_CONFIG"
#define X_CONFIG_FOCUS_ITEM_NAME "FOCUS"

// The driver holds the focus contact for one second before it opens the shutter.
#define FOCUS_DELAY 1.0

static int shutter = -1;

static bool expose(double seconds, double *elapsed) {
	unsigned before = hw_revision(shutter, CCD_EXPOSURE_PROPERTY_NAME);
	double started = indigo_monotonic_time();
	hw_request_number(shutter, CCD_EXPOSURE_PROPERTY_NAME, CCD_EXPOSURE_ITEM_NAME, seconds);
	if (!hw_wait_state(shutter, CCD_EXPOSURE_PROPERTY_NAME, before, INDIGO_OK_STATE, EXPOSURE_TIMEOUT)) {
		return false;
	}
	if (elapsed != NULL) {
		*elapsed = indigo_monotonic_time() - started;
	}
	return true;
}

static bool exposure_is_cleared(void) {
	double value = -1;
	if (!hw_number_item(shutter, CCD_EXPOSURE_PROPERTY_NAME, CCD_EXPOSURE_ITEM_NAME, &value)) {
		return false;
	}
	if (value != 0) {
		fprintf(stderr, "    CCD_EXPOSURE.EXPOSURE is %g after the exposure, expected 0\n", value);
		return false;
	}
	return true;
}

static bool focus_before_capture(bool enabled) {
	return hw_set_switch_value(shutter, X_CONFIG_PROPERTY_NAME, X_CONFIG_FOCUS_ITEM_NAME, enabled, INDIGO_OK_STATE, SHORT_TIMEOUT);
}

static void dsusb_reports_identity_and_capabilities(void) {
	char name[INDIGO_VALUE_SIZE] = "";
	ASSERT_TRUE((hw_device_interface(shutter) & INDIGO_INTERFACE_AUX_SHUTTER) != 0);
	// The adapter has no identity of its own beyond the name libdsusb derives from the USB
	// descriptor, which the driver uses as the device name and publishes through INFO.
	printf("    device %s\n", hw_device_name(shutter));
	ASSERT_TRUE(strstr(hw_device_name(shutter), "DSUSB") != NULL);
	ASSERT_TRUE(hw_text_item(shutter, INFO_PROPERTY_NAME, INFO_DEVICE_NAME_ITEM_NAME, name, sizeof(name)));
	ASSERT_STREQ(hw_device_name(shutter), name);
	ASSERT_EQ_INT(1, hw_device_count());
}

static void dsusb_publishes_the_property_contract(void) {
	double value = -1, min = -1, max = -1;
	bool focus = true;
	ASSERT_TRUE(hw_property_defined(shutter, CCD_EXPOSURE_PROPERTY_NAME));
	ASSERT_TRUE(hw_property_defined(shutter, CCD_ABORT_EXPOSURE_PROPERTY_NAME));
	ASSERT_TRUE(hw_property_defined(shutter, X_CONFIG_PROPERTY_NAME));
	ASSERT_TRUE(hw_number_item(shutter, CCD_EXPOSURE_PROPERTY_NAME, CCD_EXPOSURE_ITEM_NAME, &value));
	ASSERT_TRUE(value == 0);
	ASSERT_TRUE(hw_number_item_range(shutter, CCD_EXPOSURE_PROPERTY_NAME, CCD_EXPOSURE_ITEM_NAME, &min, &max));
	ASSERT_TRUE(min == 0 && max == 1000);
	ASSERT_TRUE(hw_switch_item(shutter, X_CONFIG_PROPERTY_NAME, X_CONFIG_FOCUS_ITEM_NAME, &focus));
	// The adapter is a pure output, so it has no sensor properties, no port and no simulation.
	ASSERT_TRUE(hw_property_hidden(shutter, DEVICE_PORT_PROPERTY_NAME));
	ASSERT_TRUE(hw_property_hidden(shutter, DEVICE_PORTS_PROPERTY_NAME));
	ASSERT_TRUE(hw_property_hidden(shutter, SIMULATION_PROPERTY_NAME));
	ASSERT_TRUE(hw_property_hidden(shutter, AUTHENTICATION_PROPERTY_NAME));
	ASSERT_TRUE(hw_property_defined(shutter, CONFIG_PROPERTY_NAME));
}

static void dsusb_runs_an_exposure(void) {
	double elapsed = 0, remaining = -1;
	hw_forget_states();
	unsigned before = hw_revision(shutter, CCD_EXPOSURE_PROPERTY_NAME);
	double started = indigo_monotonic_time();
	hw_request_number(shutter, CCD_EXPOSURE_PROPERTY_NAME, CCD_EXPOSURE_ITEM_NAME, 3);
	ASSERT_TRUE(hw_wait_settled(shutter, CCD_EXPOSURE_PROPERTY_NAME, INDIGO_BUSY_STATE, SHORT_TIMEOUT));
	// The countdown is published once a second and rounded up, so a poll 1.4 s into a three second
	// exposure has to see two seconds left.
	indigo_usleep(1400000);
	ASSERT_TRUE(hw_number_item(shutter, CCD_EXPOSURE_PROPERTY_NAME, CCD_EXPOSURE_ITEM_NAME, &remaining));
	printf("    %.0f s left after 1.4 s of a 3 s exposure\n", remaining);
	ASSERT_TRUE(remaining == 2);
	ASSERT_TRUE(hw_wait_state(shutter, CCD_EXPOSURE_PROPERTY_NAME, before, INDIGO_OK_STATE, EXPOSURE_TIMEOUT));
	elapsed = indigo_monotonic_time() - started;
	printf("    3 s exposure completed in %.3f s\n", elapsed);
	ASSERT_TRUE(elapsed > 2.9 && elapsed < 4.0);
	ASSERT_TRUE(exposure_is_cleared());
}

static void dsusb_runs_a_subsecond_exposure(void) {
	double elapsed = 0;
	hw_forget_states();
	// A subsecond request must not be stretched to the one second the countdown otherwise uses as
	// its period, and it still has to be advertised BUSY before it completes.
	ASSERT_TRUE(expose(0.4, &elapsed));
	printf("    0.4 s exposure completed in %.3f s\n", elapsed);
	ASSERT_TRUE((hw_states_seen(shutter, CCD_EXPOSURE_PROPERTY_NAME) & (1u << INDIGO_BUSY_STATE)) != 0);
	ASSERT_TRUE(elapsed > 0.35 && elapsed < 1.5);
	ASSERT_TRUE(exposure_is_cleared());
}

static void dsusb_ignores_a_request_while_exposing(void) {
	double target = -1, elapsed = 0;
	unsigned before = hw_revision(shutter, CCD_EXPOSURE_PROPERTY_NAME);
	double started = indigo_monotonic_time();
	hw_request_number(shutter, CCD_EXPOSURE_PROPERTY_NAME, CCD_EXPOSURE_ITEM_NAME, 3);
	ASSERT_TRUE(hw_wait_settled(shutter, CCD_EXPOSURE_PROPERTY_NAME, INDIGO_BUSY_STATE, SHORT_TIMEOUT));
	indigo_usleep(500000);
	// The shutter is open, so the second request is dropped instead of restarting or extending the
	// exposure that is already running.
	hw_request_number(shutter, CCD_EXPOSURE_PROPERTY_NAME, CCD_EXPOSURE_ITEM_NAME, 30);
	indigo_usleep(500000);
	ASSERT_TRUE(hw_number_item_target(shutter, CCD_EXPOSURE_PROPERTY_NAME, CCD_EXPOSURE_ITEM_NAME, &target));
	ASSERT_TRUE(target == 3);
	ASSERT_TRUE(hw_wait_state(shutter, CCD_EXPOSURE_PROPERTY_NAME, before, INDIGO_OK_STATE, EXPOSURE_TIMEOUT));
	elapsed = indigo_monotonic_time() - started;
	printf("    the exposure kept its own 3 s and completed in %.3f s\n", elapsed);
	ASSERT_TRUE(elapsed < 5);
}

static void dsusb_aborts_an_exposure(void) {
	bool aborting = true;
	unsigned before = hw_revision(shutter, CCD_EXPOSURE_PROPERTY_NAME);
	hw_request_number(shutter, CCD_EXPOSURE_PROPERTY_NAME, CCD_EXPOSURE_ITEM_NAME, 30);
	ASSERT_TRUE(hw_wait_settled(shutter, CCD_EXPOSURE_PROPERTY_NAME, INDIGO_BUSY_STATE, SHORT_TIMEOUT));
	indigo_usleep(500000);
	double started = indigo_monotonic_time();
	ASSERT_TRUE(hw_set_switch(shutter, CCD_ABORT_EXPOSURE_PROPERTY_NAME, CCD_ABORT_EXPOSURE_ITEM_NAME, INDIGO_OK_STATE, SHORT_TIMEOUT));
	// The abort closes the shutter at once and reports the exposure as failed, not as completed.
	ASSERT_TRUE(hw_wait_state(shutter, CCD_EXPOSURE_PROPERTY_NAME, before, INDIGO_ALERT_STATE, SHORT_TIMEOUT));
	printf("    abort answered in %.3f s\n", indigo_monotonic_time() - started);
	ASSERT_TRUE(hw_switch_item(shutter, CCD_ABORT_EXPOSURE_PROPERTY_NAME, CCD_ABORT_EXPOSURE_ITEM_NAME, &aborting));
	ASSERT_TRUE(!aborting);
	// An abort with no exposure running is accepted as well, and a fresh exposure still works.
	ASSERT_TRUE(hw_set_switch(shutter, CCD_ABORT_EXPOSURE_PROPERTY_NAME, CCD_ABORT_EXPOSURE_ITEM_NAME, INDIGO_OK_STATE, SHORT_TIMEOUT));
	ASSERT_TRUE(expose(1, NULL));
	ASSERT_TRUE(exposure_is_cleared());
}

static void dsusb_focuses_before_the_exposure(void) {
	double elapsed = 0;
	bool focus = false;
	ASSERT_TRUE(focus_before_capture(true));
	ASSERT_TRUE(hw_switch_item(shutter, X_CONFIG_PROPERTY_NAME, X_CONFIG_FOCUS_ITEM_NAME, &focus));
	ASSERT_TRUE(focus);
	// The focus contact is held for a second before the shutter opens, so the same request takes
	// that second longer than it does without the setting.
	ASSERT_TRUE(expose(1, &elapsed));
	printf("    1 s exposure with focus before capture completed in %.3f s\n", elapsed);
	ASSERT_TRUE(elapsed > FOCUS_DELAY + 0.9 && elapsed < FOCUS_DELAY + 2.5);
	ASSERT_TRUE(exposure_is_cleared());
	// An abort during the focus delay has to stop the sequence before the shutter is opened.
	hw_request_number(shutter, CCD_EXPOSURE_PROPERTY_NAME, CCD_EXPOSURE_ITEM_NAME, 30);
	ASSERT_TRUE(hw_wait_settled(shutter, CCD_EXPOSURE_PROPERTY_NAME, INDIGO_BUSY_STATE, SHORT_TIMEOUT));
	unsigned before = hw_revision(shutter, CCD_EXPOSURE_PROPERTY_NAME);
	ASSERT_TRUE(hw_set_switch(shutter, CCD_ABORT_EXPOSURE_PROPERTY_NAME, CCD_ABORT_EXPOSURE_ITEM_NAME, INDIGO_OK_STATE, SHORT_TIMEOUT));
	ASSERT_TRUE(hw_wait_state(shutter, CCD_EXPOSURE_PROPERTY_NAME, before, INDIGO_ALERT_STATE, SHORT_TIMEOUT));
	// The focus finalizer of the aborted request must not open the shutter afterwards.
	indigo_usleep(1500000);
	ASSERT_TRUE(hw_property_state(shutter, CCD_EXPOSURE_PROPERTY_NAME) != INDIGO_BUSY_STATE);
	ASSERT_TRUE(focus_before_capture(false));
	ASSERT_TRUE(expose(0.5, NULL));
}

static void dsusb_restores_the_setting_after_a_reconnect(void) {
	bool focus = false;
	// X_CONFIG is persistent, so the value a client saves has to come back with the device. The
	// session runs against a private HOME, so this writes no configuration of the user's own.
	ASSERT_TRUE(focus_before_capture(true));
	ASSERT_TRUE(hw_save_configuration(shutter, SHORT_TIMEOUT));
	ASSERT_TRUE(hw_disconnect(shutter, SHORT_TIMEOUT));
	ASSERT_TRUE(hw_connect(shutter, SHORT_TIMEOUT));
	ASSERT_TRUE(hw_switch_item(shutter, X_CONFIG_PROPERTY_NAME, X_CONFIG_FOCUS_ITEM_NAME, &focus));
	ASSERT_TRUE(focus);
	ASSERT_TRUE(focus_before_capture(false));
	ASSERT_TRUE(hw_save_configuration(shutter, SHORT_TIMEOUT));
	ASSERT_TRUE(hw_disconnect(shutter, SHORT_TIMEOUT));
	ASSERT_TRUE(hw_connect(shutter, SHORT_TIMEOUT));
	ASSERT_TRUE(hw_switch_item(shutter, X_CONFIG_PROPERTY_NAME, X_CONFIG_FOCUS_ITEM_NAME, &focus));
	ASSERT_TRUE(!focus);
}

static void dsusb_survives_a_disconnect_during_an_exposure(void) {
	hw_request_number(shutter, CCD_EXPOSURE_PROPERTY_NAME, CCD_EXPOSURE_ITEM_NAME, 30);
	ASSERT_TRUE(hw_wait_settled(shutter, CCD_EXPOSURE_PROPERTY_NAME, INDIGO_BUSY_STATE, SHORT_TIMEOUT));
	indigo_usleep(500000);
	// Closing the adapter releases the shutter, so the disconnect must not wait for the exposure
	// and must not leave the contact closed.
	ASSERT_TRUE(hw_disconnect(shutter, SHORT_TIMEOUT));
	ASSERT_TRUE(hw_connect(shutter, SHORT_TIMEOUT));
	ASSERT_TRUE(hw_property_state(shutter, CCD_EXPOSURE_PROPERTY_NAME) != INDIGO_BUSY_STATE);
	ASSERT_TRUE(expose(1, NULL));
	ASSERT_TRUE(exposure_is_cleared());
}

static void dsusb_reconnects(void) {
	ASSERT_TRUE(hw_disconnect(shutter, SHORT_TIMEOUT));
	// Disconnecting an already disconnected device is tolerated: the request is a no-op the driver
	// answers without an ALERT, so there is no new revision to wait for.
	hw_request_switch(shutter, CONNECTION_PROPERTY_NAME, CONNECTION_DISCONNECTED_ITEM_NAME, true);
	indigo_usleep(500000);
	ASSERT_EQ_INT(INDIGO_OK_STATE, hw_property_state(shutter, CONNECTION_PROPERTY_NAME));
	ASSERT_TRUE(!hw_connected(shutter));
	ASSERT_TRUE(hw_connect(shutter, SHORT_TIMEOUT));
	ASSERT_TRUE((hw_device_interface(shutter) & INDIGO_INTERFACE_AUX_SHUTTER) != 0);
	ASSERT_TRUE(expose(0.5, NULL));
}

static void dsusb_reinitializes(void) {
	ASSERT_TRUE(hw_connect(shutter, SHORT_TIMEOUT));
	// A driver with a connected device must refuse to shut down instead of pulling the adapter out
	// from under its client.
	ASSERT_EQ_INT(INDIGO_BUSY, indigo_aux_dsusb(INDIGO_DRIVER_SHUTDOWN, NULL));
	ASSERT_TRUE(hw_disconnect(shutter, SHORT_TIMEOUT));
	ASSERT_EQ_INT(INDIGO_OK, indigo_aux_dsusb(INDIGO_DRIVER_SHUTDOWN, NULL));
	ASSERT_EQ_INT(INDIGO_OK, indigo_aux_dsusb(INDIGO_DRIVER_INIT, NULL));
	shutter = hw_wait_for_device(NULL, SHORT_TIMEOUT);
	ASSERT_TRUE(shutter >= 0);
	ASSERT_TRUE(hw_connect(shutter, SHORT_TIMEOUT));
	ASSERT_TRUE(expose(0.5, NULL));
}

int main(int argc, char **argv) {
	if (argc < 2 || strcmp(argv[1], "--run")) {
		fprintf(stderr, "Physical Shoestring DSUSB test: run explicitly with --run (or make test-aux-dsusb-hw).\n");
		return 2;
	}
	setvbuf(stdout, NULL, _IONBF, 0);
	for (int i = 2; i < argc; i++) {
		if (!strcmp(argv[i], "--debug")) {
			indigo_set_log_level(INDIGO_LOG_DEBUG);
		}
	}
	// X_CONFIG is persistent and one scenario saves it, so the session keeps its configuration out
	// of the user's own folder.
	if (!indigo_test_use_private_home()) {
		return 1;
	}
	const indigo_test_case tests[] = {
		{ "dsusb_reports_identity_and_capabilities", dsusb_reports_identity_and_capabilities },
		{ "dsusb_publishes_the_property_contract", dsusb_publishes_the_property_contract },
		{ "dsusb_runs_an_exposure", dsusb_runs_an_exposure },
		{ "dsusb_runs_a_subsecond_exposure", dsusb_runs_a_subsecond_exposure },
		{ "dsusb_ignores_a_request_while_exposing", dsusb_ignores_a_request_while_exposing },
		{ "dsusb_aborts_an_exposure", dsusb_aborts_an_exposure },
		{ "dsusb_focuses_before_the_exposure", dsusb_focuses_before_the_exposure },
		{ "dsusb_restores_the_setting_after_a_reconnect", dsusb_restores_the_setting_after_a_reconnect },
		{ "dsusb_survives_a_disconnect_during_an_exposure", dsusb_survives_a_disconnect_during_an_exposure },
		{ "dsusb_reconnects", dsusb_reconnects },
		{ "dsusb_reinitializes", dsusb_reinitializes }
	};
	int result = 1;
	bool started = false, initialized = false;
	HW_CHECK(indigo_start() == INDIGO_OK);
	started = true;
	HW_CHECK(hw_attach_client("Shoestring DSUSB hardware test") == INDIGO_OK);
	HW_CHECK(indigo_aux_dsusb(INDIGO_DRIVER_INIT, NULL) == INDIGO_OK);
	initialized = true;
	shutter = hw_wait_for_device(NULL, SHORT_TIMEOUT);
	HW_CHECK(shutter >= 0);
	printf("Found %s\n", hw_device_name(shutter));
	HW_CHECK(hw_connect(shutter, SHORT_TIMEOUT));
	result = indigo_run_tests("Shoestring DSUSB hardware", tests, ARRAY_SIZE(tests));
cleanup:
	if (!hw_disconnect(shutter, SHORT_TIMEOUT)) {
		indigo_test_failures++;
	}
	if (initialized && indigo_aux_dsusb(INDIGO_DRIVER_SHUTDOWN, NULL) != INDIGO_OK) {
		indigo_test_failures++;
	}
	indigo_detach_client(&hw_client);
	if (started) {
		indigo_stop();
	}
	hw_release_properties();
	indigo_test_remove_private_home();
	return indigo_test_failures ? 1 : result;
}
