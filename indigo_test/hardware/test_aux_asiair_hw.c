// Copyright (c) 2026 INDIGO initiative
// All rights reserved.
//
// You may use this software under the terms of 'INDIGO Astronomy
// open-source license' (see LICENSE.md).
//
// THIS SOFTWARE IS PROVIDED BY THE AUTHORS 'AS IS' AND ANY EXPRESS
// OR IMPLIED WARRANTIES, INCLUDING, BUT NOT LIMITED TO, THE IMPLIED
// WARRANTIES OF MERCHANTABILITY AND FITNESS FOR A PARTICULAR PURPOSE
// ARE DISCLAIMED. IN NO EVENT SHALL THE AUTHOR BE LIABLE FOR ANY
// DIRECT, INDIRECT, INCIDENTAL, SPECIAL, EXEMPLARY, OR CONSEQUENTIAL
// DAMAGES (INCLUDING, BUT NOT LIMITED TO, PROCUREMENT OF SUBSTITUTE
// GOODS OR SERVICES; LOSS OF USE, DATA, OR PROFITS; OR BUSINESS
// INTERRUPTION) HOWEVER CAUSED AND ON ANY THEORY OF LIABILITY,
// WHETHER IN CONTRACT, STRICT LIABILITY, OR TORT (INCLUDING
// NEGLIGENCE OR OTHERWISE) ARISING IN ANY WAY OUT OF THE USE OF THIS
// SOFTWARE, EVEN IF ADVISED OF THE POSSIBILITY OF SUCH DAMAGE.

// Code is generated by AI

/** Physical Raspberry Pi GPIO test for the Raspberry Pi GPIO AUX driver.
 \file test_aux_rpio_hw.c

 This test drives the real 40-pin header, so it is opt-in and must be run
 explicitly. NOTHING MAY BE CONNECTED TO THE HEADER: the test switches all
 four power ports on and off.

 It runs on a bare Raspberry Pi as well as on an ASIAIR, because the ports are
 ordinary header pins. On a bare Pi it exercises everything the driver does;
 only the power circuitry of a real ASIAIR is left unverified.

 Every assertion is verified through the pinctrl tool rather than through the
 sysfs files the driver itself writes, so the evidence is independent of the
 interface under test. pinctrl reads the pin controller registers and reports
 the function and the electrical level of a pin.
 */

#include <stdbool.h>
#include <stdio.h>
#include <stdlib.h>
#include <string.h>
#include <unistd.h>

#include <indigo/indigo_bus.h>
#include <indigo/indigo_client.h>
#include <indigo/indigo_names.h>
#include <indigo_linux_drivers/aux_asiair/indigo_aux_asiair.h>

#include "../test_runner.h"

#define ARRAY_SIZE(array) ((int)(sizeof(array) / sizeof((array)[0])))
#define ASIAIR_DEVICE_NAME "ZWO Power Ports ASIAIR"
#define OUTPUT_COUNT 4

static const int output_pins[OUTPUT_COUNT] = { 12, 13, 26, 18 };
static const char *outlet_items[OUTPUT_COUNT] = {
	AUX_GPIO_OUTLETS_OUTLET_1_ITEM_NAME, AUX_GPIO_OUTLETS_OUTLET_2_ITEM_NAME,
	AUX_GPIO_OUTLETS_OUTLET_3_ITEM_NAME, AUX_GPIO_OUTLETS_OUTLET_4_ITEM_NAME
};

static bool connected;
static indigo_property_state connection_state = INDIGO_IDLE_STATE;

// One line of pinctrl output, for example "18: op dh pd | hi // GPIO18 = output".
static bool pin_state(int pin, char *buffer, int size) {
	char command[64];
	snprintf(command, sizeof(command), "pinctrl get %d 2>/dev/null", pin);
	FILE *pipe = popen(command, "r");
	if (pipe == NULL) {
		return false;
	}
	bool ok = fgets(buffer, size, pipe) != NULL;
	pclose(pipe);
	if (ok) {
		buffer[strcspn(buffer, "\n")] = 0;
	}
	return ok;
}

// The driver and pinctrl reach the pin controller through different
// interfaces, so a change can take a moment to become visible on the
// verification path. Every check is therefore polled with a bounded wait
// rather than read once.
static bool pin_matches(int pin, const char *first, const char *second, const char *expected) {
	char line[160] = { 0 };
	for (int i = 0; i < 20; i++) {
		if (pin_state(pin, line, sizeof(line)) && strstr(line, first) != NULL && (second == NULL || strstr(line, second) != NULL)) {
			return true;
		}
		indigo_usleep(50000);
	}
	printf("    pin %d reports '%s', expected %s\n", pin, line, expected);
	return false;
}

static bool pin_is_output_level(int pin, const char *level) {
	return pin_matches(pin, " op ", level, level[1] == 'h' ? "an output driven high" : "an output driven low");
}

static bool pin_is_input(int pin) {
	return pin_matches(pin, " ip ", NULL, "an input");
}

// Unexporting a line does not restore its function on the RP1: a pin the driver
// released stays configured as it was left. What matters is that the sysfs node
// is gone and that no output is left driving the header, so a released output is
// required to be low rather than unclaimed.
static bool pin_node_is_gone(int pin, int base) {
	char path[64];
	snprintf(path, sizeof(path), "/sys/class/gpio/gpio%d", base + pin);
	return access(path, F_OK) != 0;
}

static bool pin_is_not_driven_high(int pin) {
	char line[160];
	indigo_usleep(100000);
	if (!pin_state(pin, line, sizeof(line))) {
		return false;
	}
	bool ok = strstr(line, "| hi") == NULL;
	if (!ok) {
		printf("    pin %d reports '%s', it is still driving the header\n", pin, line);
	}
	return ok;
}

// The sysfs number of a BCM pin is the base of the header controller plus the
// BCM number, which is what the driver is expected to resolve.
static int header_base(void) {
	FILE *pipe = popen("for c in /sys/class/gpio/gpiochip*; do grep -q '^pinctrl-' $c/label && cat $c/base; done", "r");
	char line[32] = { 0 };
	int base = 0;
	if (pipe != NULL) {
		if (fgets(line, sizeof(line), pipe) != NULL) {
			base = atoi(line);
		}
		pclose(pipe);
	}
	return base;
}

static indigo_result client_update(indigo_client *client, indigo_device *device, indigo_property *property, const char *message) {
	if (strcmp(property->device, ASIAIR_DEVICE_NAME) || strcmp(property->name, CONNECTION_PROPERTY_NAME)) {
		return INDIGO_OK;
	}
	connection_state = property->state;
	for (int i = 0; i < property->count; i++) {
		if (!strcmp(property->items[i].name, CONNECTION_CONNECTED_ITEM_NAME)) {
			connected = property->items[i].sw.value;
		}
	}
	return INDIGO_OK;
}

static indigo_client test_client = { "ASIAIR hardware test client", false, NULL, INDIGO_OK, INDIGO_VERSION_CURRENT, NULL, NULL, NULL, client_update, NULL, NULL, NULL };

static bool wait_for_connection(bool expected) {
	for (int i = 0; i < 100; i++) {
		if (connected == expected && connection_state == INDIGO_OK_STATE) {
			return true;
		}
		indigo_usleep(100000);
	}
	return false;
}

static bool set_outlet(int line, bool value) {
	indigo_change_switch_property_1(&test_client, ASIAIR_DEVICE_NAME, AUX_GPIO_OUTLETS_PROPERTY_NAME, outlet_items[line], value);
	indigo_usleep(200000);
	return true;
}

static void connect_and_export(void) {
	ASSERT_EQ_INT(INDIGO_OK, indigo_start());
	ASSERT_EQ_INT(INDIGO_OK, indigo_attach_client(&test_client));
	ASSERT_EQ_INT(INDIGO_OK, indigo_aux_asiair(INDIGO_DRIVER_INIT, NULL));
	indigo_change_switch_property_1(&test_client, ASIAIR_DEVICE_NAME, CONNECTION_PROPERTY_NAME, CONNECTION_CONNECTED_ITEM_NAME, true);
	ASSERT_TRUE(wait_for_connection(true));
	// Every pin the driver claims must now be a real GPIO, which is what the
	// bare BCM numbering could not achieve on this machine.
	int base = header_base();
	printf("  header controller base = %d\n", base);
	ASSERT_TRUE(base > 0);
}

static void outputs_drive_the_physical_pins(void) {
	int working = 0;
	// Every output is measured before anything is asserted, so one dead output
	// does not hide the state of the others.
	for (int i = 0; i < OUTPUT_COUNT; i++) {
		set_outlet(i, true);
		bool high = pin_is_output_level(output_pins[i], "hi");
		set_outlet(i, false);
		bool low = pin_is_output_level(output_pins[i], "lo");
		printf("  output #%d (GPIO %2d): %s\n", i + 1, output_pins[i], high && low ? "switches" : "DEAD");
		working += high && low ? 1 : 0;
	}
	printf("  %d of %d outputs reach the header\n", working, OUTPUT_COUNT);
	ASSERT_EQ_INT(OUTPUT_COUNT, working);
}

static void disconnect_releases_every_pin(void) {
	indigo_change_switch_property_1(&test_client, ASIAIR_DEVICE_NAME, CONNECTION_PROPERTY_NAME, CONNECTION_DISCONNECTED_ITEM_NAME, true);
	ASSERT_TRUE(wait_for_connection(false));
	indigo_usleep(300000);
	int base = header_base();
	for (int i = 0; i < OUTPUT_COUNT; i++) {
		ASSERT_TRUE(pin_node_is_gone(output_pins[i], base));
		ASSERT_TRUE(pin_is_not_driven_high(output_pins[i]));
	}
	ASSERT_EQ_INT(INDIGO_OK, indigo_aux_asiair(INDIGO_DRIVER_SHUTDOWN, NULL));
	indigo_detach_client(&test_client);
	indigo_stop();
}

int main(int argc, char **argv) {
	setvbuf(stdout, NULL, _IONBF, 0);
	if (argc < 2 || strcmp(argv[1], "--run")) {
		fprintf(stderr, "Physical ASIAIR power port test: it switches all four ports, so nothing may be\n");
		fprintf(stderr, "connected to the 40-pin header. Run explicitly with --run (or make test-aux-asiair-hw).\n");
		return 0;
	}
	alarm(300);
	const indigo_test_case tests[] = {
		{ "connect claims the header pins", connect_and_export },
		{ "outputs drive the physical pins", outputs_drive_the_physical_pins },
		{ "disconnect releases every pin", disconnect_releases_every_pin }
	};
	return indigo_run_tests("aux_asiair hardware tests", tests, ARRAY_SIZE(tests));
}
