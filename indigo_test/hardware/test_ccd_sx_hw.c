// Copyright (c) 2026 INDIGO initiative
// All rights reserved.
//
// You may use this software under the terms of 'INDIGO Astronomy
// open-source license' (see LICENSE.md).
//
// THIS SOFTWARE IS PROVIDED BY THE AUTHORS 'AS IS' AND ANY EXPRESS
// OR IMPLIED WARRANTIES, INCLUDING, BUT NOT LIMITED TO, THE IMPLIED
// WARRANTIES OF MERCHANTABILITY AND FITNESS FOR A PARTICULAR PURPOSE
// ARE DISCLAIMED. IN NO EVENT SHALL THE AUTHOR BE LIABLE FOR ANY
// DIRECT, INDIRECT, INCIDENTAL, SPECIAL, EXEMPLARY, OR CONSEQUENTIAL
// DAMAGES (INCLUDING, BUT NOT LIMITED TO, PROCUREMENT OF SUBSTITUTE
// GOODS OR SERVICES; LOSS OF USE, DATA, OR PROFITS; OR BUSINESS
// INTERRUPTION) HOWEVER CAUSED AND ON ANY THEORY OF LIABILITY,
// WHETHER IN CONTRACT, STRICT LIABILITY, OR TORT (INCLUDING
// NEGLIGENCE OR OTHERWISE) ARISING IN ANY WAY OUT OF THE USE OF THIS
// SOFTWARE, EVEN IF ADVISED OF THE POSSIBILITY OF SUCH DAMAGE.

// Code is generated by AI

// Physical Starlight Xpress camera acceptance test. It mirrors the hardware
// applicable scenarios of indigo_test/integration/test_ccd_sx_usb.c with real
// USB transport, real cameras and the production indigo_ccd_sx driver.

#include <pthread.h>
#include <stdatomic.h>
#include <unistd.h>
#include <stdlib.h>
#include <math.h>

#include <indigo/indigo_driver.h>
#include <indigo_drivers/ccd_sx/indigo_ccd_sx.h>

#include "../test_runner.h"

#define MAX_DEVICES 16
#define MAX_PROPERTIES 64
#define MAX_CAMERAS 4
#define ARRAY_SIZE(a) (sizeof(a) / sizeof((a)[0]))
#define CHECK(condition) do { if (!(condition)) { fprintf(stderr, "%s:%d: %s\n", __FILE__, __LINE__, #condition); indigo_test_failures++; goto cleanup; } } while (0)

typedef struct {
	char name[INDIGO_NAME_SIZE];
	unsigned interface;
	bool present;
	indigo_property *properties[MAX_PROPERTIES];
	unsigned revisions[MAX_PROPERTIES];
	unsigned frames, invalid_frames, uniform_frames;
	unsigned expected_width, expected_height;
	unsigned frame_width, frame_height;
	unsigned long frame_size;
} observed_device;

typedef struct {
	char name[INDIGO_NAME_SIZE];
	bool probed, cooler, star2k, flood_led;
	int width, height;
	double pixel_width, pixel_height;
} sx_capabilities;

typedef struct {
	int ccd, guider;
	sx_capabilities *caps;
} sx_camera;

static const char *camera_filter;
static _Atomic double test_deadline;
static char running_test[128];

static observed_device devices[MAX_DEVICES];
static sx_capabilities capabilities[MAX_CAMERAS];
static sx_camera cameras[MAX_CAMERAS];
static int camera_count;
static pthread_mutex_t mutex = PTHREAD_MUTEX_INITIALIZER;
static bool driver_initialized;
static char timed_guider[INDIGO_NAME_SIZE];
static double guide_started[2], guide_finished[2];
static unsigned guide_completions[2];
static unsigned guide_nonzero_completions;

static void *watchdog(void *data) {
	while (true) {
		indigo_usleep(1000000);
		double deadline = atomic_load(&test_deadline);
		if (deadline > 0 && indigo_monotonic_time() > deadline) {
			fprintf(stderr, "DEADLINE: '%s' did not finish in time, the driver is most probably deadlocked\n", running_test);
			fflush(stderr);
			_exit(3);
		}
	}
	return NULL;
}

static int find_device(const char *name) {
	for (int d = 0; d < MAX_DEVICES; d++) {
		if (!*devices[d].name) {
			INDIGO_COPY_NAME(devices[d].name, name);
			return d;
		}
		if (!strcmp(devices[d].name, name)) {
			return d;
		}
	}
	return -1;
}

static int property_slot(int d, const char *name) {
	for (int p = 0; p < MAX_PROPERTIES; p++) {
		if (devices[d].properties[p] != NULL && !strcmp(devices[d].properties[p]->name, name)) {
			return p;
		}
	}
	return -1;
}

static void note_image(int d, indigo_property *property) {
	indigo_item *item = property->items;
	indigo_raw_header header = { 0 };
	bool valid = item->blob.value != NULL && !strcmp(item->blob.format, ".raw") && item->blob.size >= sizeof(header);
	if (valid) {
		memcpy(&header, item->blob.value, sizeof(header));
		valid = header.signature == INDIGO_RAW_MONO16 && item->blob.size >= sizeof(header) + (unsigned long)header.width * header.height * 2;
	}
	if (valid && devices[d].expected_width != 0) {
		valid = header.width == devices[d].expected_width && header.height == devices[d].expected_height;
	}
	if (valid) {
		uint16_t min = 0xFFFF, max = 0;
		unsigned long count = (unsigned long)header.width * header.height;
		for (unsigned long i = 0; i < count; i += 7) {
			uint16_t value;
			memcpy(&value, (char *)item->blob.value + sizeof(header) + 2 * i, 2);
			if (value < min) {
				min = value;
			}
			if (value > max) {
				max = value;
			}
		}
		if (max == min) {
			devices[d].uniform_frames++;
		}
		printf("    frame %u: %u x %u, %lu bytes, pixel range %u..%u\n", devices[d].frames + 1, header.width, header.height, (unsigned long)item->blob.size, min, max);
	} else {
		devices[d].invalid_frames++;
		printf("    frame %u: INVALID (%u x %u, %lu bytes, signature %u, expected %u x %u)\n", devices[d].frames + 1, header.width, header.height, (unsigned long)item->blob.size, header.signature, devices[d].expected_width, devices[d].expected_height);
	}
	devices[d].frame_width = header.width;
	devices[d].frame_height = header.height;
	devices[d].frame_size = (unsigned long)item->blob.size;
	devices[d].frames++;
}

static void note_guide(indigo_property *property) {
	if (strcmp(property->device, timed_guider)) {
		return;
	}
	int axis = !strcmp(property->name, GUIDER_GUIDE_DEC_PROPERTY_NAME);
	if (property->state == INDIGO_BUSY_STATE) {
		guide_started[axis] = indigo_monotonic_time();
	} else if (property->state == INDIGO_OK_STATE && guide_started[axis] > 0) {
		guide_finished[axis] = indigo_monotonic_time();
		guide_completions[axis]++;
		for (int i = 0; i < property->count; i++) {
			if (property->items[i].number.value != 0) {
				guide_nonzero_completions++;
			}
		}
	}
}

static indigo_result observe(indigo_property *property, bool update) {
	pthread_mutex_lock(&mutex);
	int d = find_device(property->device);
	if (d < 0) {
		pthread_mutex_unlock(&mutex);
		return INDIGO_OK;
	}
	int slot = property_slot(d, property->name);
	if (slot < 0) {
		for (slot = 0; slot < MAX_PROPERTIES && devices[d].properties[slot] != NULL; slot++) {
		}
	}
	if (slot < MAX_PROPERTIES) {
		indigo_release_property(devices[d].properties[slot]);
		devices[d].properties[slot] = indigo_copy_property(NULL, property);
		devices[d].revisions[slot]++;
	}
	if (!strcmp(property->name, INFO_PROPERTY_NAME)) {
		devices[d].present = true;
		for (int i = 0; i < property->count; i++) {
			if (!strcmp(property->items[i].name, INFO_DEVICE_INTERFACE_ITEM_NAME)) {
				devices[d].interface = (unsigned)atoi(property->items[i].text.value);
			}
		}
	}
	if (update && !strcmp(property->name, CCD_IMAGE_PROPERTY_NAME) && property->state == INDIGO_OK_STATE && property->count > 0 && property->items[0].blob.size > 0 && property->items[0].blob.value != NULL) {
		note_image(d, property);
	}
	if (!strcmp(property->name, GUIDER_GUIDE_RA_PROPERTY_NAME) || !strcmp(property->name, GUIDER_GUIDE_DEC_PROPERTY_NAME)) {
		note_guide(property);
	}
	pthread_mutex_unlock(&mutex);
	return INDIGO_OK;
}

static indigo_result define_property(indigo_client *client, indigo_device *device, indigo_property *property, const char *message) {
	return observe(property, false);
}

static indigo_result update_property(indigo_client *client, indigo_device *device, indigo_property *property, const char *message) {
	return observe(property, true);
}

static indigo_result delete_property(indigo_client *client, indigo_device *device, indigo_property *property, const char *message) {
	pthread_mutex_lock(&mutex);
	int d = find_device(property->device);
	if (d >= 0) {
		for (int p = 0; p < MAX_PROPERTIES; p++) {
			if (devices[d].properties[p] != NULL && (!*property->name || !strcmp(devices[d].properties[p]->name, property->name))) {
				indigo_release_property(devices[d].properties[p]);
				devices[d].properties[p] = NULL;
				devices[d].revisions[p]++;
			}
		}
		if (!*property->name) {
			devices[d].present = false;
		}
	}
	pthread_mutex_unlock(&mutex);
	return INDIGO_OK;
}

static indigo_client client = {
	.name = "SX physical acceptance",
	.version = INDIGO_VERSION_CURRENT,
	.define_property = define_property,
	.update_property = update_property,
	.delete_property = delete_property
};

static unsigned revision(int d, const char *name) {
	pthread_mutex_lock(&mutex);
	int slot = property_slot(d, name);
	unsigned result = slot < 0 ? 0 : devices[d].revisions[slot];
	pthread_mutex_unlock(&mutex);
	return result;
}

static bool exists(int d, const char *name) {
	pthread_mutex_lock(&mutex);
	bool result = property_slot(d, name) >= 0;
	pthread_mutex_unlock(&mutex);
	return result;
}

static indigo_property_state state_of(int d, const char *name) {
	pthread_mutex_lock(&mutex);
	int slot = property_slot(d, name);
	indigo_property_state result = slot < 0 ? INDIGO_IDLE_STATE : devices[d].properties[slot]->state;
	pthread_mutex_unlock(&mutex);
	return result;
}

static double number_of(int d, const char *name, const char *item) {
	pthread_mutex_lock(&mutex);
	int slot = property_slot(d, name);
	double result = NAN;
	if (slot >= 0) {
		for (int i = 0; i < devices[d].properties[slot]->count; i++) {
			if (!strcmp(devices[d].properties[slot]->items[i].name, item)) {
				result = devices[d].properties[slot]->items[i].number.value;
			}
		}
	}
	pthread_mutex_unlock(&mutex);
	return result;
}

static double target_of(int d, const char *name, const char *item) {
	pthread_mutex_lock(&mutex);
	int slot = property_slot(d, name);
	double result = NAN;
	if (slot >= 0) {
		for (int i = 0; i < devices[d].properties[slot]->count; i++) {
			if (!strcmp(devices[d].properties[slot]->items[i].name, item)) {
				result = devices[d].properties[slot]->items[i].number.target;
			}
		}
	}
	pthread_mutex_unlock(&mutex);
	return result;
}

static double number_max_of(int d, const char *name, const char *item) {
	pthread_mutex_lock(&mutex);
	int slot = property_slot(d, name);
	double result = NAN;
	if (slot >= 0) {
		for (int i = 0; i < devices[d].properties[slot]->count; i++) {
			if (!strcmp(devices[d].properties[slot]->items[i].name, item)) {
				result = devices[d].properties[slot]->items[i].number.max;
			}
		}
	}
	pthread_mutex_unlock(&mutex);
	return result;
}

static bool switch_of(int d, const char *name, const char *item) {
	pthread_mutex_lock(&mutex);
	int slot = property_slot(d, name);
	bool result = false;
	if (slot >= 0) {
		for (int i = 0; i < devices[d].properties[slot]->count; i++) {
			if (!strcmp(devices[d].properties[slot]->items[i].name, item)) {
				result = devices[d].properties[slot]->items[i].sw.value;
			}
		}
	}
	pthread_mutex_unlock(&mutex);
	return result;
}

static int count_of(int d, const char *name) {
	pthread_mutex_lock(&mutex);
	int slot = property_slot(d, name);
	int result = slot < 0 ? -1 : devices[d].properties[slot]->count;
	pthread_mutex_unlock(&mutex);
	return result;
}

static bool item_named(int d, const char *name, int index, const char *expected) {
	pthread_mutex_lock(&mutex);
	int slot = property_slot(d, name);
	bool result = slot >= 0 && index < devices[d].properties[slot]->count && !strcmp(devices[d].properties[slot]->items[index].name, expected);
	pthread_mutex_unlock(&mutex);
	return result;
}

static indigo_property_perm perm_of(int d, const char *name) {
	pthread_mutex_lock(&mutex);
	int slot = property_slot(d, name);
	indigo_property_perm result = slot < 0 ? INDIGO_RO_PERM : devices[d].properties[slot]->perm;
	pthread_mutex_unlock(&mutex);
	return result;
}

static bool wait_state(int d, const char *name, unsigned after, indigo_property_state state, double timeout) {
	for (double waited = 0; waited < timeout; waited += 0.01) {
		pthread_mutex_lock(&mutex);
		int slot = property_slot(d, name);
		bool ready = slot >= 0 && devices[d].revisions[slot] > after && devices[d].properties[slot]->state == state;
		pthread_mutex_unlock(&mutex);
		if (ready) {
			return true;
		}
		indigo_usleep(10000);
	}
	fprintf(stderr, "    timeout waiting for %s.%s state %d (got %d)\n", devices[d].name, name, state, state_of(d, name));
	return false;
}

static bool wait_revision(int d, const char *name, unsigned after, double timeout) {
	for (double waited = 0; waited < timeout; waited += 0.01) {
		pthread_mutex_lock(&mutex);
		int slot = property_slot(d, name);
		bool ready = slot >= 0 && devices[d].revisions[slot] > after;
		pthread_mutex_unlock(&mutex);
		if (ready) {
			return true;
		}
		indigo_usleep(10000);
	}
	return false;
}

static bool wait_switch(int d, const char *name, const char *item, bool value, double timeout) {
	for (double waited = 0; waited < timeout; waited += 0.01) {
		if (switch_of(d, name, item) == value) {
			return true;
		}
		indigo_usleep(10000);
	}
	return false;
}

static bool wait_frames(int d, unsigned expected, double timeout) {
	for (double waited = 0; waited < timeout; waited += 0.01) {
		pthread_mutex_lock(&mutex);
		bool ready = devices[d].frames >= expected;
		pthread_mutex_unlock(&mutex);
		if (ready) {
			return true;
		}
		indigo_usleep(10000);
	}
	return false;
}

static unsigned frames_of(int d) {
	pthread_mutex_lock(&mutex);
	unsigned result = devices[d].frames;
	pthread_mutex_unlock(&mutex);
	return result;
}

static unsigned invalid_frames_of(int d) {
	pthread_mutex_lock(&mutex);
	unsigned result = devices[d].invalid_frames;
	pthread_mutex_unlock(&mutex);
	return result;
}

static void expect_geometry(int d, unsigned width, unsigned height) {
	pthread_mutex_lock(&mutex);
	devices[d].expected_width = width;
	devices[d].expected_height = height;
	pthread_mutex_unlock(&mutex);
}

static bool set_switch(int d, const char *name, const char *item, indigo_property_state state, double timeout) {
	unsigned before = revision(d, name);
	return indigo_change_switch_property_1(&client, devices[d].name, name, item, true) == INDIGO_OK && wait_state(d, name, before, state, timeout);
}

static bool set_number(int d, const char *name, const char *item, double value, indigo_property_state state, double timeout) {
	unsigned before = revision(d, name);
	return indigo_change_number_property_1(&client, devices[d].name, name, item, value) == INDIGO_OK && wait_state(d, name, before, state, timeout);
}

static bool set_numbers(int d, const char *name, int count, const char **items, const double *values, indigo_property_state state, double timeout) {
	unsigned before = revision(d, name);
	return indigo_change_number_property(&client, devices[d].name, name, count, items, values) == INDIGO_OK && wait_state(d, name, before, state, timeout);
}

static bool connect_device(int d) {
	if (switch_of(d, CONNECTION_PROPERTY_NAME, CONNECTION_CONNECTED_ITEM_NAME)) {
		return true;
	}
	return set_switch(d, CONNECTION_PROPERTY_NAME, CONNECTION_CONNECTED_ITEM_NAME, INDIGO_OK_STATE, 20);
}

static bool disconnect_device(int d) {
	if (!switch_of(d, CONNECTION_PROPERTY_NAME, CONNECTION_CONNECTED_ITEM_NAME)) {
		return true;
	}
	return set_switch(d, CONNECTION_PROPERTY_NAME, CONNECTION_DISCONNECTED_ITEM_NAME, INDIGO_OK_STATE, 20);
}

static bool prepare_client_raw(int d) {
	return set_switch(d, CCD_UPLOAD_MODE_PROPERTY_NAME, CCD_UPLOAD_MODE_CLIENT_ITEM_NAME, INDIGO_OK_STATE, 5) && set_switch(d, CCD_IMAGE_FORMAT_PROPERTY_NAME, CCD_IMAGE_FORMAT_RAW_ITEM_NAME, INDIGO_OK_STATE, 5);
}

static bool acquire(int d, double seconds) {
	unsigned width = (unsigned)(number_of(d, CCD_FRAME_PROPERTY_NAME, CCD_FRAME_WIDTH_ITEM_NAME) / number_of(d, CCD_BIN_PROPERTY_NAME, CCD_BIN_HORIZONTAL_ITEM_NAME));
	unsigned height = (unsigned)(number_of(d, CCD_FRAME_PROPERTY_NAME, CCD_FRAME_HEIGHT_ITEM_NAME) / number_of(d, CCD_BIN_PROPERTY_NAME, CCD_BIN_VERTICAL_ITEM_NAME));
	expect_geometry(d, width, height);
	unsigned before = frames_of(d);
	unsigned invalid = invalid_frames_of(d);
	if (!set_number(d, CCD_EXPOSURE_PROPERTY_NAME, CCD_EXPOSURE_ITEM_NAME, seconds, INDIGO_OK_STATE, seconds + 60)) {
		return false;
	}
	return wait_frames(d, before + 1, 10) && frames_of(d) == before + 1 && invalid_frames_of(d) == invalid;
}

static bool camera_label(int c, char *buffer, int size) {
	snprintf(buffer, size, "%s", devices[cameras[c].ccd].name);
	return true;
}

static sx_capabilities *capabilities_of(const char *name) {
	for (int i = 0; i < MAX_CAMERAS; i++) {
		if (!*capabilities[i].name) {
			INDIGO_COPY_NAME(capabilities[i].name, name);
			return capabilities + i;
		}
		if (!strcmp(capabilities[i].name, name)) {
			return capabilities + i;
		}
	}
	return NULL;
}

static bool probe_camera(int c) {
	sx_capabilities *caps = cameras[c].caps;
	if (caps->probed) {
		return true;
	}
	int ccd = cameras[c].ccd, guider = cameras[c].guider;
	if (!connect_device(ccd)) {
		return false;
	}
	caps->width = (int)number_of(ccd, CCD_INFO_PROPERTY_NAME, CCD_INFO_WIDTH_ITEM_NAME);
	caps->height = (int)number_of(ccd, CCD_INFO_PROPERTY_NAME, CCD_INFO_HEIGHT_ITEM_NAME);
	caps->pixel_width = number_of(ccd, CCD_INFO_PROPERTY_NAME, CCD_INFO_PIXEL_WIDTH_ITEM_NAME);
	caps->pixel_height = number_of(ccd, CCD_INFO_PROPERTY_NAME, CCD_INFO_PIXEL_HEIGHT_ITEM_NAME);
	caps->cooler = exists(ccd, CCD_COOLER_PROPERTY_NAME);
	caps->flood_led = exists(ccd, "X_CCD_FLOOD_LED");
	caps->star2k = guider >= 0 && set_switch(guider, CONNECTION_PROPERTY_NAME, CONNECTION_CONNECTED_ITEM_NAME, INDIGO_OK_STATE, 20) && switch_of(guider, CONNECTION_PROPERTY_NAME, CONNECTION_CONNECTED_ITEM_NAME);
	if (guider >= 0) {
		disconnect_device(guider);
	}
	disconnect_device(ccd);
	caps->probed = true;
	printf("    %s: %d x %d, pixel %.2f x %.2f um, cooler %s, Star2K %s, flood LED %s\n", caps->name, caps->width, caps->height, caps->pixel_width, caps->pixel_height, caps->cooler ? "yes" : "no", caps->star2k ? "yes" : "no", caps->flood_led ? "yes" : "no");
	return true;
}

static bool discover(void) {
	for (int i = 0; i < 1500; i++) {
		int found = 0;
		pthread_mutex_lock(&mutex);
		for (int d = 0; d < MAX_DEVICES; d++) {
			if (devices[d].present && property_slot(d, CONNECTION_PROPERTY_NAME) >= 0) {
				found++;
			}
		}
		pthread_mutex_unlock(&mutex);
		if (found >= 2) {
			indigo_usleep(1500000);
			break;
		}
		indigo_usleep(10000);
	}
	camera_count = 0;
	pthread_mutex_lock(&mutex);
	for (int d = 0; d < MAX_DEVICES && camera_count < MAX_CAMERAS; d++) {
		if (!devices[d].present || !(devices[d].interface & INDIGO_INTERFACE_CCD)) {
			continue;
		}
		char guider_name[INDIGO_NAME_SIZE];
		snprintf(guider_name, sizeof(guider_name), "%s (guider)", devices[d].name);
		int guider = -1;
		for (int g = 0; g < MAX_DEVICES; g++) {
			if (devices[g].present && !strcmp(devices[g].name, guider_name)) {
				guider = g;
			}
		}
		cameras[camera_count].ccd = d;
		cameras[camera_count].guider = guider;
		camera_count++;
	}
	pthread_mutex_unlock(&mutex);
	for (int c = 0; c < camera_count; c++) {
		cameras[c].caps = capabilities_of(devices[cameras[c].ccd].name);
		if (cameras[c].caps == NULL) {
			return false;
		}
	}
	return camera_count > 0;
}

static bool start_driver(void) {
	pthread_mutex_lock(&mutex);
	for (int d = 0; d < MAX_DEVICES; d++) {
		for (int p = 0; p < MAX_PROPERTIES; p++) {
			indigo_release_property(devices[d].properties[p]);
			devices[d].properties[p] = NULL;
			devices[d].revisions[p] = 0;
		}
		memset(devices + d, 0, sizeof(observed_device));
	}
	pthread_mutex_unlock(&mutex);
	if (indigo_start() != INDIGO_OK || indigo_attach_client(&client) != INDIGO_OK) {
		return false;
	}
	if (indigo_ccd_sx(INDIGO_DRIVER_INIT, NULL) != INDIGO_OK) {
		return false;
	}
	driver_initialized = true;
	if (!discover()) {
		return false;
	}
	for (int c = 0; c < camera_count; c++) {
		if (!probe_camera(c)) {
			return false;
		}
	}
	return true;
}

static void stop_driver(void) {
	for (int d = 0; d < MAX_DEVICES; d++) {
		if (*devices[d].name && switch_of(d, CONNECTION_PROPERTY_NAME, CONNECTION_CONNECTED_ITEM_NAME)) {
			disconnect_device(d);
		}
	}
	if (driver_initialized) {
		indigo_ccd_sx(INDIGO_DRIVER_SHUTDOWN, NULL);
		driver_initialized = false;
	}
	indigo_detach_client(&client);
	indigo_stop();
}

// ---------------------------------------------------------------- test cases

static void identity_and_property_contract(void) {
	indigo_driver_info info;
	CHECK(indigo_ccd_sx(INDIGO_DRIVER_INFO, &info) == INDIGO_OK);
	CHECK(!strcmp(info.name, "indigo_ccd_sx") && !strcmp(info.description, "Starlight Xpress Camera") && INDIGO_DRIVER_API_GENERATION(info.version) == INDIGO_DRIVER_API_3);
	CHECK(start_driver());
	printf("    discovered %d camera(s)\n", camera_count);
	for (int c = 0; c < camera_count; c++) {
		int ccd = cameras[c].ccd, guider = cameras[c].guider;
		printf("    %s / %s\n", devices[ccd].name, guider >= 0 ? devices[guider].name : "(no guider device)");
		CHECK(strchr(devices[ccd].name, '#') != NULL);
		CHECK(devices[ccd].interface == INDIGO_INTERFACE_CCD);
		CHECK(guider >= 0 && devices[guider].interface == INDIGO_INTERFACE_GUIDER);
		CHECK(!exists(ccd, CCD_INFO_PROPERTY_NAME) && !exists(ccd, CCD_EXPOSURE_PROPERTY_NAME));
		CHECK(exists(ccd, INFO_PROPERTY_NAME) && exists(ccd, CONFIG_PROPERTY_NAME) && exists(ccd, PROFILE_PROPERTY_NAME));
		CHECK(!exists(ccd, SIMULATION_PROPERTY_NAME) && !exists(ccd, DEVICE_PORT_PROPERTY_NAME));
		CHECK(connect_device(ccd));
		CHECK(number_of(ccd, CCD_INFO_PROPERTY_NAME, CCD_INFO_BITS_PER_PIXEL_ITEM_NAME) == 16);
		CHECK(number_of(ccd, CCD_INFO_PROPERTY_NAME, CCD_INFO_MAX_HORIZONTAL_BIN_ITEM_NAME) == 4);
		CHECK(number_of(ccd, CCD_INFO_PROPERTY_NAME, CCD_INFO_MAX_VERTICAL_BIN_ITEM_NAME) == 4);
		CHECK(number_of(ccd, CCD_INFO_PROPERTY_NAME, CCD_INFO_WIDTH_ITEM_NAME) == cameras[c].caps->width);
		CHECK(number_of(ccd, CCD_INFO_PROPERTY_NAME, CCD_INFO_HEIGHT_ITEM_NAME) == cameras[c].caps->height);
		CHECK(number_max_of(ccd, CCD_FRAME_PROPERTY_NAME, CCD_FRAME_WIDTH_ITEM_NAME) == cameras[c].caps->width);
		CHECK(number_max_of(ccd, CCD_FRAME_PROPERTY_NAME, CCD_FRAME_HEIGHT_ITEM_NAME) == cameras[c].caps->height);
		CHECK(count_of(ccd, CCD_MODE_PROPERTY_NAME) == 3);
		CHECK(item_named(ccd, CCD_MODE_PROPERTY_NAME, 0, "BIN_1x1") && item_named(ccd, CCD_MODE_PROPERTY_NAME, 1, "BIN_2x2") && item_named(ccd, CCD_MODE_PROPERTY_NAME, 2, "BIN_4x4"));
		CHECK(perm_of(ccd, CCD_MODE_PROPERTY_NAME) == INDIGO_RW_PERM && perm_of(ccd, CCD_BIN_PROPERTY_NAME) == INDIGO_RW_PERM);
		CHECK(number_max_of(ccd, CCD_BIN_PROPERTY_NAME, CCD_BIN_HORIZONTAL_ITEM_NAME) == 4);
		CHECK(exists(ccd, CCD_EXPOSURE_PROPERTY_NAME) && exists(ccd, CCD_ABORT_EXPOSURE_PROPERTY_NAME) && exists(ccd, CCD_FRAME_PROPERTY_NAME) && exists(ccd, CCD_IMAGE_PROPERTY_NAME) && exists(ccd, CCD_IMAGE_FORMAT_PROPERTY_NAME) && exists(ccd, CCD_UPLOAD_MODE_PROPERTY_NAME) && exists(ccd, CCD_FRAME_TYPE_PROPERTY_NAME));
		CHECK(!exists(ccd, CCD_STREAMING_PROPERTY_NAME) && !exists(ccd, CCD_GAIN_PROPERTY_NAME) && !exists(ccd, CCD_OFFSET_PROPERTY_NAME) && !exists(ccd, CCD_GAMMA_PROPERTY_NAME) && !exists(ccd, CCD_COOLER_POWER_PROPERTY_NAME) && !exists(ccd, CCD_READ_MODE_PROPERTY_NAME));
		CHECK(exists(ccd, CCD_COOLER_PROPERTY_NAME) == cameras[c].caps->cooler);
		CHECK(exists(ccd, CCD_TEMPERATURE_PROPERTY_NAME) == cameras[c].caps->cooler);
		CHECK(exists(ccd, "X_CCD_FLOOD_LED") == cameras[c].caps->flood_led);
		if (cameras[c].caps->flood_led) {
			CHECK(count_of(ccd, "X_CCD_FLOOD_LED") == 2 && item_named(ccd, "X_CCD_FLOOD_LED", 0, "ON") && item_named(ccd, "X_CCD_FLOOD_LED", 1, "OFF"));
		}
		CHECK(disconnect_device(ccd));
		CHECK(!exists(ccd, CCD_INFO_PROPERTY_NAME));
		CHECK(exists(ccd, INFO_PROPERTY_NAME) && exists(ccd, CONNECTION_PROPERTY_NAME));
	}
cleanup:
	stop_driver();
}

static void shared_lifecycle_and_rejected_shutdown(void) {
	CHECK(start_driver());
	for (int c = 0; c < camera_count; c++) {
		int ccd = cameras[c].ccd, guider = cameras[c].guider;
		bool star2k = cameras[c].caps->star2k;
		for (int first = 0; first < 2; first++) {
			int order[] = { first ? guider : ccd, first ? ccd : guider };
			if (first && !star2k) {
				continue;
			}
			CHECK(connect_device(order[0]));
			CHECK(star2k ? connect_device(order[1]) : true);
			CHECK(indigo_ccd_sx(INDIGO_DRIVER_SHUTDOWN, NULL) == INDIGO_BUSY);
			CHECK(prepare_client_raw(ccd));
			CHECK(acquire(ccd, 0.05));
			CHECK(disconnect_device(order[0]));
			if (star2k) {
				if (order[0] == ccd) {
					CHECK(set_number(guider, GUIDER_GUIDE_RA_PROPERTY_NAME, GUIDER_GUIDE_EAST_ITEM_NAME, 100, INDIGO_BUSY_STATE, 5));
					CHECK(wait_state(guider, GUIDER_GUIDE_RA_PROPERTY_NAME, revision(guider, GUIDER_GUIDE_RA_PROPERTY_NAME) - 1, INDIGO_OK_STATE, 5));
				} else {
					CHECK(acquire(ccd, 0.05));
				}
				CHECK(disconnect_device(order[1]));
			}
		}
		if (!star2k) {
			CHECK(connect_device(guider) == false);
			CHECK(state_of(guider, CONNECTION_PROPERTY_NAME) == INDIGO_ALERT_STATE);
			CHECK(!switch_of(guider, CONNECTION_PROPERTY_NAME, CONNECTION_CONNECTED_ITEM_NAME));
			CHECK(disconnect_device(guider));
		}
		for (int cycle = 0; cycle < 3; cycle++) {
			CHECK(connect_device(ccd));
			CHECK(prepare_client_raw(ccd));
			CHECK(acquire(ccd, 0.05));
			CHECK(disconnect_device(ccd));
		}
	}
	CHECK(indigo_ccd_sx(INDIGO_DRIVER_SHUTDOWN, NULL) == INDIGO_OK);
	driver_initialized = false;
cleanup:
	stop_driver();
}

static void acquisition_units_types_bins_and_roi(void) {
	CHECK(start_driver());
	for (int c = 0; c < camera_count; c++) {
		int ccd = cameras[c].ccd;
		int width = cameras[c].caps->width, height = cameras[c].caps->height;
		CHECK(connect_device(ccd));
		CHECK(prepare_client_raw(ccd));
		CHECK(acquire(ccd, 0.05));
		CHECK(devices[ccd].frame_width == (unsigned)width && devices[ccd].frame_height == (unsigned)height);
		const char *types[] = { CCD_FRAME_TYPE_LIGHT_ITEM_NAME, CCD_FRAME_TYPE_FLAT_ITEM_NAME, CCD_FRAME_TYPE_DARK_ITEM_NAME, CCD_FRAME_TYPE_DARKFLAT_ITEM_NAME, CCD_FRAME_TYPE_BIAS_ITEM_NAME };
		for (int i = 0; i < ARRAY_SIZE(types); i++) {
			CHECK(set_switch(ccd, CCD_FRAME_TYPE_PROPERTY_NAME, types[i], INDIGO_OK_STATE, 5));
			CHECK(acquire(ccd, 0.05));
			if (!strcmp(types[i], CCD_FRAME_TYPE_BIAS_ITEM_NAME)) {
				CHECK(number_of(ccd, CCD_EXPOSURE_PROPERTY_NAME, CCD_EXPOSURE_ITEM_NAME) == 0 || number_of(ccd, CCD_EXPOSURE_PROPERTY_NAME, CCD_EXPOSURE_ITEM_NAME) < 0.05);
			}
		}
		CHECK(set_switch(ccd, CCD_FRAME_TYPE_PROPERTY_NAME, CCD_FRAME_TYPE_LIGHT_ITEM_NAME, INDIGO_OK_STATE, 5));
		for (int bin = 1; bin <= 4; bin *= 2) {
			char mode[16];
			snprintf(mode, sizeof(mode), "BIN_%dx%d", bin, bin);
			CHECK(set_switch(ccd, CCD_MODE_PROPERTY_NAME, mode, INDIGO_OK_STATE, 5));
			CHECK(number_of(ccd, CCD_BIN_PROPERTY_NAME, CCD_BIN_HORIZONTAL_ITEM_NAME) == bin && number_of(ccd, CCD_BIN_PROPERTY_NAME, CCD_BIN_VERTICAL_ITEM_NAME) == bin);
			CHECK(acquire(ccd, 0.05));
			CHECK(devices[ccd].frame_width == (unsigned)(width / bin) && devices[ccd].frame_height == (unsigned)(height / bin));
		}
		const double invalid[][2] = { { 3, 3 }, { 1, 2 }, { 5, 5 } };
		const char *bin_items[] = { CCD_BIN_HORIZONTAL_ITEM_NAME, CCD_BIN_VERTICAL_ITEM_NAME };
		const double accepted[] = { 2, 2 }, restored[] = { 1, 1 };
		CHECK(set_switch(ccd, CCD_MODE_PROPERTY_NAME, "BIN_1x1", INDIGO_OK_STATE, 5));
		// An accepted binning commits value and target together; that committed pair is what a refused one has to keep.
		CHECK(set_numbers(ccd, CCD_BIN_PROPERTY_NAME, 2, bin_items, accepted, INDIGO_OK_STATE, 5));
		CHECK(number_of(ccd, CCD_BIN_PROPERTY_NAME, CCD_BIN_HORIZONTAL_ITEM_NAME) == 2 && target_of(ccd, CCD_BIN_PROPERTY_NAME, CCD_BIN_HORIZONTAL_ITEM_NAME) == 2);
		CHECK(number_of(ccd, CCD_BIN_PROPERTY_NAME, CCD_BIN_VERTICAL_ITEM_NAME) == 2 && target_of(ccd, CCD_BIN_PROPERTY_NAME, CCD_BIN_VERTICAL_ITEM_NAME) == 2);
		CHECK(set_numbers(ccd, CCD_BIN_PROPERTY_NAME, 2, bin_items, restored, INDIGO_OK_STATE, 5));
		for (int i = 0; i < ARRAY_SIZE(invalid); i++) {
			CHECK(set_numbers(ccd, CCD_BIN_PROPERTY_NAME, 2, bin_items, invalid[i], INDIGO_ALERT_STATE, 5));
			// The refusal precedes every copy, so both the published values and the targets stay on the last accepted pair.
			CHECK(number_of(ccd, CCD_BIN_PROPERTY_NAME, CCD_BIN_HORIZONTAL_ITEM_NAME) == 1 && number_of(ccd, CCD_BIN_PROPERTY_NAME, CCD_BIN_VERTICAL_ITEM_NAME) == 1);
			CHECK(target_of(ccd, CCD_BIN_PROPERTY_NAME, CCD_BIN_HORIZONTAL_ITEM_NAME) == 1 && target_of(ccd, CCD_BIN_PROPERTY_NAME, CCD_BIN_VERTICAL_ITEM_NAME) == 1);
		}
		// The property has to work again after the refusals.
		CHECK(set_numbers(ccd, CCD_BIN_PROPERTY_NAME, 2, bin_items, accepted, INDIGO_OK_STATE, 5));
		CHECK(acquire(ccd, 0.05));
		CHECK(devices[ccd].frame_width == (unsigned)(width / 2) && devices[ccd].frame_height == (unsigned)(height / 2));
		CHECK(set_numbers(ccd, CCD_BIN_PROPERTY_NAME, 2, bin_items, restored, INDIGO_OK_STATE, 5));
		const char *frame_items[] = { CCD_FRAME_LEFT_ITEM_NAME, CCD_FRAME_TOP_ITEM_NAME, CCD_FRAME_WIDTH_ITEM_NAME, CCD_FRAME_HEIGHT_ITEM_NAME };
		const double roi[] = { 64, 60, 256, 192 };
		CHECK(set_numbers(ccd, CCD_FRAME_PROPERTY_NAME, 4, frame_items, roi, INDIGO_OK_STATE, 5));
		CHECK(acquire(ccd, 0.05));
		CHECK(devices[ccd].frame_width == 256 && devices[ccd].frame_height == 192);
		const double overflow[] = { (double)(width - 16), (double)(height - 16), 256, 192 };
		CHECK(set_numbers(ccd, CCD_FRAME_PROPERTY_NAME, 4, frame_items, overflow, INDIGO_ALERT_STATE, 5));
		CHECK(number_of(ccd, CCD_FRAME_PROPERTY_NAME, CCD_FRAME_WIDTH_ITEM_NAME) == 16 && number_of(ccd, CCD_FRAME_PROPERTY_NAME, CCD_FRAME_HEIGHT_ITEM_NAME) == 16);
		CHECK(acquire(ccd, 0.05));
		const double full[] = { 0, 0, (double)width, (double)height };
		CHECK(set_numbers(ccd, CCD_FRAME_PROPERTY_NAME, 4, frame_items, full, INDIGO_OK_STATE, 5));
		CHECK(acquire(ccd, 1.5));
		CHECK(acquire(ccd, 4));
		CHECK(acquire(ccd, 0.05));
		CHECK(invalid_frames_of(ccd) == 0);
		CHECK(devices[ccd].uniform_frames < devices[ccd].frames);
		printf("    %s: %u frames, %u invalid, %u uniform\n", devices[ccd].name, devices[ccd].frames, devices[ccd].invalid_frames, devices[ccd].uniform_frames);
		CHECK(disconnect_device(ccd));
	}
cleanup:
	stop_driver();
}

static void abort_and_reacquisition(void) {
	CHECK(start_driver());
	for (int c = 0; c < camera_count; c++) {
		int ccd = cameras[c].ccd;
		CHECK(connect_device(ccd));
		CHECK(prepare_client_raw(ccd));
		unsigned before = frames_of(ccd);
		CHECK(set_number(ccd, CCD_EXPOSURE_PROPERTY_NAME, CCD_EXPOSURE_ITEM_NAME, 20, INDIGO_BUSY_STATE, 5));
		indigo_usleep(1500000);
		CHECK(state_of(ccd, CCD_EXPOSURE_PROPERTY_NAME) == INDIGO_BUSY_STATE);
		CHECK(set_switch(ccd, CCD_ABORT_EXPOSURE_PROPERTY_NAME, CCD_ABORT_EXPOSURE_ITEM_NAME, INDIGO_OK_STATE, 10));
		CHECK(wait_state(ccd, CCD_EXPOSURE_PROPERTY_NAME, 0, INDIGO_ALERT_STATE, 5));
		indigo_usleep(500000);
		CHECK(frames_of(ccd) == before);
		CHECK(acquire(ccd, 0.05));
		before = frames_of(ccd);
		CHECK(set_number(ccd, CCD_EXPOSURE_PROPERTY_NAME, CCD_EXPOSURE_ITEM_NAME, 0.05, INDIGO_BUSY_STATE, 5));
		indigo_usleep(150000);
		double issued = indigo_monotonic_time();
		indigo_change_switch_property_1(&client, devices[ccd].name, CCD_ABORT_EXPOSURE_PROPERTY_NAME, CCD_ABORT_EXPOSURE_ITEM_NAME, true);
		bool settled = false;
		for (double waited = 0; waited < 60 && !settled; waited += 0.01) {
			settled = state_of(ccd, CCD_EXPOSURE_PROPERTY_NAME) != INDIGO_BUSY_STATE && state_of(ccd, CCD_ABORT_EXPOSURE_PROPERTY_NAME) != INDIGO_BUSY_STATE;
			if (!settled) {
				indigo_usleep(10000);
			}
		}
		indigo_usleep(500000);
		printf("    %s: abort during readout -> exposure %d, abort %d, frames %+d, latency %.3f s\n", devices[ccd].name, state_of(ccd, CCD_EXPOSURE_PROPERTY_NAME), state_of(ccd, CCD_ABORT_EXPOSURE_PROPERTY_NAME), (int)(frames_of(ccd) - before), indigo_monotonic_time() - issued);
		CHECK(settled);
		CHECK(frames_of(ccd) - before <= 1);
		CHECK(acquire(ccd, 0.05));
		CHECK(set_switch(ccd, CCD_ABORT_EXPOSURE_PROPERTY_NAME, CCD_ABORT_EXPOSURE_ITEM_NAME, INDIGO_ALERT_STATE, 5));
		CHECK(acquire(ccd, 0.05));
		CHECK(disconnect_device(ccd));
	}
cleanup:
	stop_driver();
}

static void cooling_profile(void) {
	CHECK(start_driver());
	for (int c = 0; c < camera_count; c++) {
		int ccd = cameras[c].ccd;
		CHECK(connect_device(ccd));
		if (!cameras[c].caps->cooler) {
			printf("    %s: uncooled, CCD_COOLER and CCD_TEMPERATURE hidden\n", devices[ccd].name);
			CHECK(!exists(ccd, CCD_COOLER_PROPERTY_NAME) && !exists(ccd, CCD_TEMPERATURE_PROPERTY_NAME) && !exists(ccd, CCD_COOLER_POWER_PROPERTY_NAME));
			CHECK(prepare_client_raw(ccd));
			CHECK(acquire(ccd, 0.05));
			CHECK(disconnect_device(ccd));
			continue;
		}
		bool cooler_was_on = switch_of(ccd, CCD_COOLER_PROPERTY_NAME, CCD_COOLER_ON_ITEM_NAME);
		double initial_temperature = number_of(ccd, CCD_TEMPERATURE_PROPERTY_NAME, CCD_TEMPERATURE_ITEM_NAME);
		double initial_target = number_of(ccd, CCD_TEMPERATURE_PROPERTY_NAME, CCD_TEMPERATURE_ITEM_NAME);
		printf("    %s: initial temperature %.1f C, cooler %s\n", devices[ccd].name, initial_temperature, cooler_was_on ? "on" : "off");
		CHECK(initial_temperature > -60 && initial_temperature < 60);
		double target = floor(initial_temperature) - 5;
		CHECK(set_number(ccd, CCD_TEMPERATURE_PROPERTY_NAME, CCD_TEMPERATURE_ITEM_NAME, target, INDIGO_BUSY_STATE, 10));
		CHECK(wait_switch(ccd, CCD_COOLER_PROPERTY_NAME, CCD_COOLER_ON_ITEM_NAME, true, 5));
		CHECK(number_of(ccd, CCD_TEMPERATURE_PROPERTY_NAME, CCD_TEMPERATURE_ITEM_NAME) != target);
		double started = indigo_monotonic_time(), last = initial_temperature;
		unsigned updates = 0;
		while (indigo_monotonic_time() - started < 30) {
			unsigned mark = revision(ccd, CCD_TEMPERATURE_PROPERTY_NAME);
			if (!wait_revision(ccd, CCD_TEMPERATURE_PROPERTY_NAME, mark, 12)) {
				break;
			}
			CHECK(state_of(ccd, CCD_TEMPERATURE_PROPERTY_NAME) != INDIGO_ALERT_STATE && state_of(ccd, CCD_COOLER_PROPERTY_NAME) != INDIGO_ALERT_STATE);
			last = number_of(ccd, CCD_TEMPERATURE_PROPERTY_NAME, CCD_TEMPERATURE_ITEM_NAME);
			updates++;
		}
		printf("    %s: target %.1f C, %u temperature updates, last %.1f C, cooler state %d\n", devices[ccd].name, target, updates, last, state_of(ccd, CCD_COOLER_PROPERTY_NAME));
		CHECK(updates >= 2);
		CHECK(last > -60 && last < 60);
		CHECK(last <= initial_temperature - 0.5);
		CHECK(prepare_client_raw(ccd));
		CHECK(acquire(ccd, 0.05));
		CHECK(set_switch(ccd, CCD_COOLER_PROPERTY_NAME, CCD_COOLER_OFF_ITEM_NAME, INDIGO_OK_STATE, 10));
		CHECK(wait_switch(ccd, CCD_COOLER_PROPERTY_NAME, CCD_COOLER_ON_ITEM_NAME, false, 10));
		CHECK(acquire(ccd, 0.05));
		CHECK(disconnect_device(ccd));
		CHECK(connect_device(ccd));
		printf("    %s: temperature after reconnect %.1f C\n", devices[ccd].name, number_of(ccd, CCD_TEMPERATURE_PROPERTY_NAME, CCD_TEMPERATURE_ITEM_NAME));
		if (cooler_was_on) {
			CHECK(set_number(ccd, CCD_TEMPERATURE_PROPERTY_NAME, CCD_TEMPERATURE_ITEM_NAME, initial_target, INDIGO_BUSY_STATE, 10));
		}
		CHECK(disconnect_device(ccd));
	}
cleanup:
	stop_driver();
}

static bool pulse(int guider, const char *property, const char *direction, double milliseconds, indigo_property_state state) {
	return set_number(guider, property, direction, milliseconds, state, 10);
}

static void guider_pulses_and_shared_acquisition(void) {
	CHECK(start_driver());
	for (int c = 0; c < camera_count; c++) {
		int ccd = cameras[c].ccd, guider = cameras[c].guider;
		if (!cameras[c].caps->star2k) {
			printf("    %s: no Star2K, guider connection refused\n", devices[ccd].name);
			continue;
		}
		CHECK(connect_device(ccd));
		CHECK(connect_device(guider));
		CHECK(prepare_client_raw(ccd));
		const char *properties[] = { GUIDER_GUIDE_RA_PROPERTY_NAME, GUIDER_GUIDE_RA_PROPERTY_NAME, GUIDER_GUIDE_DEC_PROPERTY_NAME, GUIDER_GUIDE_DEC_PROPERTY_NAME };
		const char *items[] = { GUIDER_GUIDE_EAST_ITEM_NAME, GUIDER_GUIDE_WEST_ITEM_NAME, GUIDER_GUIDE_NORTH_ITEM_NAME, GUIDER_GUIDE_SOUTH_ITEM_NAME };
		for (int i = 0; i < 4; i++) {
			unsigned before = revision(guider, properties[i]);
			CHECK(pulse(guider, properties[i], items[i], 200, INDIGO_BUSY_STATE));
			CHECK(wait_state(guider, properties[i], before + 1, INDIGO_OK_STATE, 5));
			CHECK(number_of(guider, properties[i], items[i]) == 0);
		}
		double started = indigo_monotonic_time();
		CHECK(pulse(guider, GUIDER_GUIDE_RA_PROPERTY_NAME, GUIDER_GUIDE_EAST_ITEM_NAME, 800, INDIGO_BUSY_STATE));
		indigo_usleep(200000);
		CHECK(pulse(guider, GUIDER_GUIDE_RA_PROPERTY_NAME, GUIDER_GUIDE_WEST_ITEM_NAME, 200, INDIGO_BUSY_STATE));
		CHECK(wait_state(guider, GUIDER_GUIDE_RA_PROPERTY_NAME, revision(guider, GUIDER_GUIDE_RA_PROPERTY_NAME) - 1, INDIGO_OK_STATE, 10));
		double replaced = indigo_monotonic_time() - started;
		printf("    %s: 800 ms pulse replaced after 200 ms by a 200 ms pulse, the axis finished in %.3f s\n", devices[guider].name, replaced);
		CHECK(replaced > 0.3 && replaced < 0.7);
		CHECK(number_of(guider, GUIDER_GUIDE_RA_PROPERTY_NAME, GUIDER_GUIDE_EAST_ITEM_NAME) == 0 && number_of(guider, GUIDER_GUIDE_RA_PROPERTY_NAME, GUIDER_GUIDE_WEST_ITEM_NAME) == 0);
		started = indigo_monotonic_time();
		CHECK(pulse(guider, GUIDER_GUIDE_RA_PROPERTY_NAME, GUIDER_GUIDE_EAST_ITEM_NAME, 3000, INDIGO_BUSY_STATE));
		indigo_usleep(300000);
		CHECK(pulse(guider, GUIDER_GUIDE_RA_PROPERTY_NAME, GUIDER_GUIDE_EAST_ITEM_NAME, 0, INDIGO_OK_STATE));
		double cancelled = indigo_monotonic_time() - started;
		printf("    %s: zero request cancelled the running 3000 ms pulse after %.3f s\n", devices[guider].name, cancelled);
		CHECK(cancelled < 1.5);
		CHECK(pulse(guider, GUIDER_GUIDE_RA_PROPERTY_NAME, GUIDER_GUIDE_EAST_ITEM_NAME, 300, INDIGO_BUSY_STATE));
		CHECK(pulse(guider, GUIDER_GUIDE_DEC_PROPERTY_NAME, GUIDER_GUIDE_NORTH_ITEM_NAME, 600, INDIGO_BUSY_STATE));
		CHECK(wait_state(guider, GUIDER_GUIDE_RA_PROPERTY_NAME, revision(guider, GUIDER_GUIDE_RA_PROPERTY_NAME) - 1, INDIGO_OK_STATE, 5));
		CHECK(state_of(guider, GUIDER_GUIDE_DEC_PROPERTY_NAME) == INDIGO_BUSY_STATE || state_of(guider, GUIDER_GUIDE_DEC_PROPERTY_NAME) == INDIGO_OK_STATE);
		CHECK(wait_state(guider, GUIDER_GUIDE_DEC_PROPERTY_NAME, 0, INDIGO_OK_STATE, 5));
		unsigned before_frames = frames_of(ccd);
		expect_geometry(ccd, (unsigned)number_of(ccd, CCD_FRAME_PROPERTY_NAME, CCD_FRAME_WIDTH_ITEM_NAME), (unsigned)number_of(ccd, CCD_FRAME_PROPERTY_NAME, CCD_FRAME_HEIGHT_ITEM_NAME));
		CHECK(set_number(ccd, CCD_EXPOSURE_PROPERTY_NAME, CCD_EXPOSURE_ITEM_NAME, 6, INDIGO_BUSY_STATE, 5));
		for (int i = 0; i < 4; i++) {
			unsigned before = revision(guider, properties[i]);
			CHECK(pulse(guider, properties[i], items[i], 250, INDIGO_BUSY_STATE));
			CHECK(wait_state(guider, properties[i], before + 1, INDIGO_OK_STATE, 10));
		}
		CHECK(state_of(ccd, CCD_EXPOSURE_PROPERTY_NAME) == INDIGO_BUSY_STATE);
		CHECK(wait_state(ccd, CCD_EXPOSURE_PROPERTY_NAME, 0, INDIGO_OK_STATE, 60));
		CHECK(wait_frames(ccd, before_frames + 1, 10));
		CHECK(invalid_frames_of(ccd) == 0);
		CHECK(pulse(guider, GUIDER_GUIDE_DEC_PROPERTY_NAME, GUIDER_GUIDE_SOUTH_ITEM_NAME, 700, INDIGO_BUSY_STATE));
		CHECK(disconnect_device(guider));
		CHECK(acquire(ccd, 0.05));
		CHECK(connect_device(guider));
		CHECK(pulse(guider, GUIDER_GUIDE_RA_PROPERTY_NAME, GUIDER_GUIDE_WEST_ITEM_NAME, 100, INDIGO_BUSY_STATE));
		CHECK(wait_state(guider, GUIDER_GUIDE_RA_PROPERTY_NAME, 0, INDIGO_OK_STATE, 5));
		CHECK(disconnect_device(guider));
		CHECK(disconnect_device(ccd));
	}
cleanup:
	stop_driver();
}

static int compare_samples(const void *left, const void *right) {
	double a = *(const double *)left, b = *(const double *)right;
	return (a > b) - (a < b);
}

static void guider_pulse_timing(void) {
	CHECK(start_driver());
	for (int c = 0; c < camera_count; c++) {
		int ccd = cameras[c].ccd, guider = cameras[c].guider;
		if (!cameras[c].caps->star2k) {
			continue;
		}
		CHECK(connect_device(ccd));
		CHECK(connect_device(guider));
		CHECK(prepare_client_raw(ccd));
		INDIGO_COPY_NAME(timed_guider, devices[guider].name);
		const char *properties[] = { GUIDER_GUIDE_RA_PROPERTY_NAME, GUIDER_GUIDE_DEC_PROPERTY_NAME, GUIDER_GUIDE_DEC_PROPERTY_NAME, GUIDER_GUIDE_RA_PROPERTY_NAME };
		const char *directions[] = { GUIDER_GUIDE_WEST_ITEM_NAME, GUIDER_GUIDE_SOUTH_ITEM_NAME, GUIDER_GUIDE_NORTH_ITEM_NAME, GUIDER_GUIDE_EAST_ITEM_NAME };
		const int durations[] = { 20, 50, 100, 250, 500 };
		double errors[80], absolute[80], total = 0, squares = 0;
		int count = 0;
		for (int workload = 0; workload < 2; workload++) {
			if (workload) {
				expect_geometry(ccd, (unsigned)number_of(ccd, CCD_FRAME_PROPERTY_NAME, CCD_FRAME_WIDTH_ITEM_NAME), (unsigned)number_of(ccd, CCD_FRAME_PROPERTY_NAME, CCD_FRAME_HEIGHT_ITEM_NAME));
				CHECK(set_number(ccd, CCD_EXPOSURE_PROPERTY_NAME, CCD_EXPOSURE_ITEM_NAME, 60, INDIGO_BUSY_STATE, 5));
			}
			for (int direction = 0; direction < 4; direction++) {
				int axis = !strcmp(properties[direction], GUIDER_GUIDE_DEC_PROPERTY_NAME);
				for (int sample = -1; sample < 5; sample++) {
					int requested = sample < 0 ? 20 : durations[sample];
					unsigned before = guide_completions[axis];
					guide_started[axis] = 0;
					CHECK(pulse(guider, properties[direction], directions[direction], requested, INDIGO_BUSY_STATE));
					CHECK(wait_state(guider, properties[direction], revision(guider, properties[direction]) - 1, INDIGO_OK_STATE, 10));
					CHECK(guide_completions[axis] == before + 1);
					if (sample < 0) {
						continue;
					}
					double actual = (guide_finished[axis] - guide_started[axis]) * 1000;
					double error = actual - requested;
					CHECK(isfinite(actual) && actual > 0);
					printf("    %s %s %s requested=%d ms observed=%.3f ms error=%+.3f ms (%+.2f%%)\n", devices[guider].name, workload ? "exposing" : "idle", directions[direction], requested, actual, error, error / requested * 100);
					errors[count] = error;
					absolute[count++] = fabs(error);
					total += error;
					squares += error * error;
				}
			}
			if (workload) {
				CHECK(set_switch(ccd, CCD_ABORT_EXPOSURE_PROPERTY_NAME, CCD_ABORT_EXPOSURE_ITEM_NAME, INDIGO_OK_STATE, 10));
			}
		}
		CHECK(guide_nonzero_completions == 0);
		qsort(errors, count, sizeof(double), compare_samples);
		qsort(absolute, count, sizeof(double), compare_samples);
		double mean = total / count;
		printf("    %s BUSY-to-OK pulse error n=%d min=%+.3f mean=%+.3f median=%+.3f p95=%+.3f p99=%+.3f max=%+.3f stddev=%.3f max_abs=%.3f ms\n", devices[guider].name, count, errors[0], mean, (errors[count / 2 - 1] + errors[count / 2]) / 2, errors[(int)ceil(count * 0.95) - 1], errors[(int)ceil(count * 0.99) - 1], errors[count - 1], sqrt(fmax(0, squares / count - mean * mean)), absolute[count - 1]);
		*timed_guider = 0;
		CHECK(disconnect_device(guider));
		CHECK(disconnect_device(ccd));
	}
cleanup:
	*timed_guider = 0;
	stop_driver();
}

static void flood_led_contract(void) {
	CHECK(start_driver());
	for (int c = 0; c < camera_count; c++) {
		int ccd = cameras[c].ccd;
		CHECK(connect_device(ccd));
		if (!cameras[c].caps->flood_led) {
			printf("    %s: no flood LED, X_CCD_FLOOD_LED hidden\n", devices[ccd].name);
			CHECK(!exists(ccd, "X_CCD_FLOOD_LED"));
			CHECK(disconnect_device(ccd));
			continue;
		}
		CHECK(switch_of(ccd, "X_CCD_FLOOD_LED", "OFF"));
		CHECK(set_switch(ccd, "X_CCD_FLOOD_LED", "ON", INDIGO_OK_STATE, 5));
		CHECK(prepare_client_raw(ccd));
		CHECK(acquire(ccd, 0.05));
		CHECK(set_switch(ccd, "X_CCD_FLOOD_LED", "OFF", INDIGO_OK_STATE, 5));
		CHECK(set_switch(ccd, "X_CCD_FLOOD_LED", "ON", INDIGO_OK_STATE, 5));
		CHECK(disconnect_device(ccd));
		CHECK(connect_device(ccd));
		CHECK(switch_of(ccd, "X_CCD_FLOOD_LED", "OFF"));
		CHECK(disconnect_device(ccd));
	}
cleanup:
	stop_driver();
}

static void teardown_and_reload(void) {
	for (int cycle = 0; cycle < 2; cycle++) {
		CHECK(start_driver());
		for (int c = 0; c < camera_count; c++) {
			int ccd = cameras[c].ccd;
			CHECK(connect_device(ccd));
			CHECK(prepare_client_raw(ccd));
			CHECK(acquire(ccd, 0.05));
			CHECK(disconnect_device(ccd));
		}
		CHECK(indigo_ccd_sx(INDIGO_DRIVER_SHUTDOWN, NULL) == INDIGO_OK);
		driver_initialized = false;
		stop_driver();
	}
	return;
cleanup:
	stop_driver();
}

static void prompt(const char *action, const char *name, const char *context) {
	printf("\n\a================================================================\n");
	printf(">>> %s the USB cable of '%s' NOW (%s)\n", action, name, context);
	printf("================================================================\n");
}

static bool wait_presence(int d, bool present, double timeout) {
	double reported = 0;
	for (double waited = 0; waited < timeout; waited += 0.1) {
		pthread_mutex_lock(&mutex);
		bool current = devices[d].present;
		pthread_mutex_unlock(&mutex);
		if (current == present) {
			printf("    '%s' %s\n", devices[d].name, present ? "is back" : "is gone");
			return true;
		}
		if (waited - reported >= 10) {
			reported = waited;
			printf("    still waiting for '%s' to %s ... %.0f s\n", devices[d].name, present ? "come back" : "disappear", waited);
		}
		indigo_usleep(100000);
	}
	printf("    TIMEOUT waiting for '%s' to %s\n", devices[d].name, present ? "come back" : "disappear");
	return false;
}

static void physical_hotplug(void) {
	CHECK(start_driver());
	for (int c = 0; c < camera_count; c++) {
		int ccd = cameras[c].ccd, guider = cameras[c].guider;
		if (camera_filter != NULL && strstr(devices[ccd].name, camera_filter) == NULL) {
			continue;
		}
		CHECK(connect_device(ccd));
		CHECK(prepare_client_raw(ccd));
		printf("\n    camera '%s' is connected and idle\n", devices[ccd].name);
		prompt("UNPLUG", devices[ccd].name, "camera is connected and idle");
		CHECK(wait_presence(ccd, false, 420));
		prompt("PLUG BACK IN", devices[ccd].name, "idle removal was detected");
		CHECK(wait_presence(ccd, true, 420));
		indigo_usleep(1500000);
		CHECK(connect_device(ccd));
		CHECK(prepare_client_raw(ccd));
		CHECK(acquire(ccd, 0.05));
		CHECK(set_number(ccd, CCD_EXPOSURE_PROPERTY_NAME, CCD_EXPOSURE_ITEM_NAME, 60, INDIGO_BUSY_STATE, 5));
		prompt("UNPLUG", devices[ccd].name, "a 60 second exposure is running now");
		CHECK(wait_presence(ccd, false, 420));
		prompt("PLUG BACK IN", devices[ccd].name, "removal during exposure was detected");
		CHECK(wait_presence(ccd, true, 420));
		indigo_usleep(1500000);
		CHECK(connect_device(ccd));
		CHECK(prepare_client_raw(ccd));
		CHECK(acquire(ccd, 0.05));
		if (cameras[c].caps->star2k) {
			CHECK(connect_device(guider));
			CHECK(pulse(guider, GUIDER_GUIDE_RA_PROPERTY_NAME, GUIDER_GUIDE_EAST_ITEM_NAME, 200, INDIGO_BUSY_STATE));
			CHECK(wait_state(guider, GUIDER_GUIDE_RA_PROPERTY_NAME, 0, INDIGO_OK_STATE, 5));
			CHECK(disconnect_device(guider));
		}
		CHECK(disconnect_device(ccd));
		for (int other = 0; other < camera_count; other++) {
			if (other == c) {
				continue;
			}
			printf("\n    DO NOT TOUCH ANY CABLE - checking that '%s' still works\n", devices[cameras[other].ccd].name);
			CHECK(connect_device(cameras[other].ccd));
			CHECK(prepare_client_raw(cameras[other].ccd));
			CHECK(acquire(cameras[other].ccd, 0.05));
			CHECK(disconnect_device(cameras[other].ccd));
		}
	}
cleanup:
	stop_driver();
}

int main(int argc, char **argv) {
	bool run = false, hotplug = false, debug = false;
	const char *filter = NULL;
	for (int i = 1; i < argc; i++) {
		if (!strcmp(argv[i], "--run")) {
			run = true;
		} else if (!strcmp(argv[i], "--hotplug")) {
			hotplug = true;
		} else if (!strcmp(argv[i], "--debug")) {
			debug = true;
		} else if (!strcmp(argv[i], "--camera") && i + 1 < argc) {
			camera_filter = argv[++i];
		} else {
			filter = argv[i];
		}
	}
	if (!run) {
		fprintf(stderr, "This test operates physical Starlight Xpress cameras. Run with --run [--hotplug] [--debug] [--camera <substring>] [name filter].\n");
		return 2;
	}
	setvbuf(stdout, NULL, _IONBF, 0);
	indigo_set_log_level(debug ? INDIGO_LOG_DEBUG : INDIGO_LOG_ERROR);
	const indigo_test_case tests[] = {
		{ "Identity, discovery and property contract", identity_and_property_contract },
		{ "Shared lifecycle and rejected shutdown", shared_lifecycle_and_rejected_shutdown },
		{ "Acquisition units, frame types, bins and ROI", acquisition_units_types_bins_and_roi },
		{ "Abort orders and reacquisition", abort_and_reacquisition },
		{ "Cooling profile", cooling_profile },
		{ "Guider pulses and shared acquisition", guider_pulses_and_shared_acquisition },
		{ "Guider pulse timing", guider_pulse_timing },
		{ "Flood LED contract", flood_led_contract },
		{ "Teardown and reload", teardown_and_reload }
	};
	const indigo_test_case hotplug_test[] = { { "Physical idle and active hot-plug", physical_hotplug } };
	pthread_t watchdog_thread;
	pthread_create(&watchdog_thread, NULL, watchdog, NULL);
	pthread_detach(watchdog_thread);
	int result = 0, matched = 0;
	for (int i = 0; i < ARRAY_SIZE(tests); i++) {
		if (filter == NULL || strstr(tests[i].name, filter)) {
			matched++;
			snprintf(running_test, sizeof(running_test), "%s", tests[i].name);
			atomic_store(&test_deadline, indigo_monotonic_time() + 600);
			result |= indigo_run_tests("SX hardware", tests + i, 1);
			atomic_store(&test_deadline, 0);
		}
	}
	if (hotplug) {
		matched++;
		snprintf(running_test, sizeof(running_test), "%s", hotplug_test[0].name);
		atomic_store(&test_deadline, indigo_monotonic_time() + 5400);
		result |= indigo_run_tests("SX hardware", hotplug_test, 1);
		atomic_store(&test_deadline, 0);
	}
	for (int d = 0; d < MAX_DEVICES; d++) {
		for (int p = 0; p < MAX_PROPERTIES; p++) {
			indigo_release_property(devices[d].properties[p]);
			devices[d].properties[p] = NULL;
		}
	}
	return matched ? result : 1;
}
