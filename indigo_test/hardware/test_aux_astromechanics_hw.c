// Copyright (c) 2026 INDIGO initiative
// All rights reserved.
//
// You may use this software under the terms of 'INDIGO Astronomy
// open-source license' (see LICENSE.md).
//
// THIS SOFTWARE IS PROVIDED BY THE AUTHORS 'AS IS' AND ANY EXPRESS
// OR IMPLIED WARRANTIES, INCLUDING, BUT NOT LIMITED TO, THE IMPLIED
// WARRANTIES OF MERCHANTABILITY AND FITNESS FOR A PARTICULAR PURPOSE
// ARE DISCLAIMED. IN NO EVENT SHALL THE AUTHOR BE LIABLE FOR ANY
// DIRECT, INDIRECT, INCIDENTAL, SPECIAL, EXEMPLARY, OR CONSEQUENTIAL
// DAMAGES (INCLUDING, BUT NOT LIMITED TO, PROCUREMENT OF SUBSTITUTE
// GOODS OR SERVICES; LOSS OF USE, DATA, OR PROFITS; OR BUSINESS
// INTERRUPTION) HOWEVER CAUSED AND ON ANY THEORY OF LIABILITY,
// WHETHER IN CONTRACT, STRICT LIABILITY, OR TORT (INCLUDING
// NEGLIGENCE OR OTHERWISE) ARISING IN ANY WAY OUT OF THE USE OF THIS
// SOFTWARE, EVEN IF ADVISED OF THE POSSIBILITY OF SUCH DAMAGE.

// Code is generated by AI

// Opt-in acceptance test for a physically connected ASTROMECHANICS Light Pollution Meter PRO, or for
// the Arduino sketch aux_astromechanics_simulator.ino running on a board. It checks the published
// property contract, waits for a reading (a measurement takes up to 120 s under a dark sky), checks
// that the Bortle class follows it, reconnects and runs driver INIT/SHUTDOWN. Nothing is written to
// the meter. A steady meter repeats the same reading, which INDIGO does not republish, so the suite
// does not count readings over time.
//
// The port comes from ASTROMECHANICS_HW_PORT. The driver has no match pattern, so the port must be given.

#include <math.h>
#include <stdlib.h>
#include <indigo_drivers/aux_astromechanics/indigo_aux_astromechanics.h>
#include "hardware_test_common.h"

#define DEVICE_NAME "ASTROMECHANICS LPM"

#define SHORT_TIMEOUT 15.0
// The meter answers when the measurement is over, up to 120 s under a dark sky.
#define READING_TIMEOUT 140.0

static int meter = -1;
static const char *serial_port = NULL;

static bool select_port(void) {
	if (serial_port == NULL || !*serial_port) {
		fprintf(stderr, "    set ASTROMECHANICS_HW_PORT to the meter's serial port\n");
		return false;
	}
	printf("Using port %s\n", serial_port);
	return hw_set_text(meter, DEVICE_PORT_PROPERTY_NAME, DEVICE_PORT_ITEM_NAME, serial_port, INDIGO_OK_STATE, SHORT_TIMEOUT);
}

// Waits for a fresh OK publication of a reading in the range the meter can report.
static bool wait_for_reading(double *brightness, double *bortle) {
	unsigned before = hw_revision(meter, AUX_WEATHER_PROPERTY_NAME);
	double deadline = indigo_monotonic_time() + READING_TIMEOUT;
	while (indigo_monotonic_time() < deadline) {
		if (hw_wait_state(meter, AUX_WEATHER_PROPERTY_NAME, before, INDIGO_OK_STATE, deadline - indigo_monotonic_time()) && hw_number_item(meter, AUX_WEATHER_PROPERTY_NAME, AUX_WEATHER_SKY_BRIGHTNESS_ITEM_NAME, brightness) && *brightness > 0) {
			return hw_number_item(meter, AUX_WEATHER_PROPERTY_NAME, AUX_WEATHER_SKY_BORTLE_CLASS_ITEM_NAME, bortle);
		}
		before = hw_revision(meter, AUX_WEATHER_PROPERTY_NAME);
	}
	return false;
}

static void astromechanics_publishes_the_property_contract(void) {
	ASSERT_TRUE((hw_device_interface(meter) & INDIGO_INTERFACE_AUX_SQM) != 0);
	ASSERT_STREQ(DEVICE_NAME, hw_device_name(meter));
	ASSERT_TRUE(hw_property_defined(meter, AUX_WEATHER_PROPERTY_NAME));
	ASSERT_TRUE(hw_item_defined(meter, AUX_WEATHER_PROPERTY_NAME, AUX_WEATHER_SKY_BRIGHTNESS_ITEM_NAME));
	ASSERT_TRUE(hw_item_defined(meter, AUX_WEATHER_PROPERTY_NAME, AUX_WEATHER_SKY_BORTLE_CLASS_ITEM_NAME));
	ASSERT_TRUE(hw_property_hidden(meter, AUX_LIGHT_SWITCH_PROPERTY_NAME));
}

static void astromechanics_reports_the_sky_brightness(void) {
	double brightness = 0, bortle = 0;
	double started = indigo_monotonic_time();
	ASSERT_TRUE(wait_for_reading(&brightness, &bortle));
	printf("    %.2f mag/arcsec2, Bortle %g, after %.1f s\n", brightness, bortle, indigo_monotonic_time() - started);
	// The meter's range, and a Bortle class on the 1 to 9 scale.
	ASSERT_TRUE(brightness > 10 && brightness < 25);
	ASSERT_TRUE(bortle >= 1 && bortle <= 9);
}

// The reading is defined again with the connection; a reading equal to the last one is not
// republished, so the defined value is accepted once it is in range and OK.
static void astromechanics_reconnects(void) {
	double brightness = 0;
	ASSERT_TRUE(hw_disconnect(meter, SHORT_TIMEOUT));
	ASSERT_TRUE(hw_property_hidden(meter, AUX_WEATHER_PROPERTY_NAME));
	ASSERT_TRUE(hw_connect(meter, SHORT_TIMEOUT));
	ASSERT_TRUE(hw_wait_settled(meter, AUX_WEATHER_PROPERTY_NAME, INDIGO_OK_STATE, READING_TIMEOUT));
	double deadline = indigo_monotonic_time() + READING_TIMEOUT;
	while (indigo_monotonic_time() < deadline && (!hw_number_item(meter, AUX_WEATHER_PROPERTY_NAME, AUX_WEATHER_SKY_BRIGHTNESS_ITEM_NAME, &brightness) || brightness <= 0)) {
		indigo_usleep(100000);
	}
	ASSERT_TRUE(brightness > 10 && brightness < 25);
}

static void astromechanics_reinitializes(void) {
	double brightness = 0, bortle = 0;
	ASSERT_TRUE(hw_disconnect(meter, SHORT_TIMEOUT));
	ASSERT_EQ_INT(INDIGO_OK, indigo_aux_astromechanics(INDIGO_DRIVER_SHUTDOWN, NULL));
	ASSERT_EQ_INT(-1, hw_device_index(DEVICE_NAME));
	ASSERT_EQ_INT(INDIGO_OK, indigo_aux_astromechanics(INDIGO_DRIVER_INIT, NULL));
	meter = hw_wait_for_device(DEVICE_NAME, SHORT_TIMEOUT);
	ASSERT_TRUE(meter >= 0);
	ASSERT_TRUE(select_port());
	ASSERT_TRUE(hw_connect(meter, SHORT_TIMEOUT));
	ASSERT_TRUE(wait_for_reading(&brightness, &bortle));
}

int main(int argc, char **argv) {
	if (argc < 2 || strcmp(argv[1], "--run")) {
		fprintf(stderr, "Physical ASTROMECHANICS LPM test: run explicitly with --run (or make test-aux-astromechanics-hw).\n");
		return 2;
	}
	setvbuf(stdout, NULL, _IONBF, 0);
	for (int i = 2; i < argc; i++) {
		if (!strcmp(argv[i], "--debug")) {
			indigo_set_log_level(INDIGO_LOG_DEBUG);
		}
	}
	if (!indigo_test_use_private_home()) {
		return 1;
	}
	serial_port = hw_port("ASTROMECHANICS_HW_PORT");
	const indigo_test_case tests[] = {
		{ "astromechanics_publishes_the_property_contract", astromechanics_publishes_the_property_contract },
		{ "astromechanics_reports_the_sky_brightness", astromechanics_reports_the_sky_brightness },
		{ "astromechanics_reconnects", astromechanics_reconnects },
		{ "astromechanics_reinitializes", astromechanics_reinitializes }
	};
	int result = 1;
	bool started = false, initialized = false;
	HW_CHECK(hw_start() == INDIGO_OK);
	started = true;
	HW_CHECK(hw_attach_client("ASTROMECHANICS LPM hardware test") == INDIGO_OK);
	HW_CHECK(indigo_aux_astromechanics(INDIGO_DRIVER_INIT, NULL) == INDIGO_OK);
	initialized = true;
	meter = hw_wait_for_device(DEVICE_NAME, SHORT_TIMEOUT);
	HW_CHECK(meter >= 0);
	HW_CHECK(select_port());
	HW_CHECK(hw_connect(meter, SHORT_TIMEOUT));
	result = indigo_run_tests("ASTROMECHANICS LPM hardware", tests, ARRAY_SIZE(tests));
cleanup:
	if (!hw_disconnect(meter, SHORT_TIMEOUT)) {
		indigo_test_failures++;
	}
	if (initialized && indigo_aux_astromechanics(INDIGO_DRIVER_SHUTDOWN, NULL) != INDIGO_OK) {
		indigo_test_failures++;
	}
	indigo_detach_client(&hw_client);
	if (started) {
		indigo_stop();
	}
	hw_release_properties();
	indigo_test_remove_private_home();
	return indigo_test_failures ? 1 : result;
}
