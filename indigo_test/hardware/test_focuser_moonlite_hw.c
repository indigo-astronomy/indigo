// Copyright (c) 2026 INDIGO initiative
// All rights reserved.
//
// You may use this software under the terms of 'INDIGO Astronomy
// open-source license' (see LICENSE.md).
//
// THIS SOFTWARE IS PROVIDED BY THE AUTHORS 'AS IS' AND ANY EXPRESS
// OR IMPLIED WARRANTIES, INCLUDING, BUT NOT LIMITED TO, THE IMPLIED
// WARRANTIES OF MERCHANTABILITY AND FITNESS FOR A PARTICULAR PURPOSE
// ARE DISCLAIMED. IN NO EVENT SHALL THE AUTHOR BE LIABLE FOR ANY
// DIRECT, INDIRECT, INCIDENTAL, SPECIAL, EXEMPLARY, OR CONSEQUENTIAL
// DAMAGES (INCLUDING, BUT NOT LIMITED TO, PROCUREMENT OF SUBSTITUTE
// GOODS OR SERVICES; LOSS OF USE, DATA, OR PROFITS; OR BUSINESS
// INTERRUPTION) HOWEVER CAUSED AND ON ANY THEORY OF LIABILITY,
// WHETHER IN CONTRACT, STRICT LIABILITY, OR TORT (INCLUDING
// NEGLIGENCE OR OTHERWISE) ARISING IN ANY WAY OUT OF THE USE OF THIS
// SOFTWARE, EVEN IF ADVISED OF THE POSSIBILITY OF SUCH DAMAGE.

// Code is generated by AI

// Opt-in acceptance test for a physically connected MoonLite focuser (or a compatible controller), or for the
// Arduino sketch focuser_moonlite_simulator.ino running on a board. It checks the values read at the connection,
// moves to absolute positions and by steps both ways, aborts a move, sets and reads back the speed, the
// compensation coefficient and the stepping mode, switches the compensation mode and the reversed direction,
// reconnects and runs driver INIT/SHUTDOWN.
//
// THE FOCUSER MOVES. The session writes back the settings it found and returns to the position it found.
//
// The port comes from MOONLITE_HW_PORT.

#include <math.h>
#include <stdlib.h>
#include <indigo_drivers/focuser_moonlite/indigo_focuser_moonlite.h>
#include "focuser_hw_common.h"

#define DEVICE_NAME "MoonLite"

#define SHORT_TIMEOUT 15.0
#define MOVE_TIMEOUT 120.0
#define TRAVEL 1500

static int focuser = -1;
static const char *serial_port = NULL;
static bool state_captured = false, half_step = false;
static double initial_position = 0, initial_speed = 0, initial_coefficient = 0, base = 0;

static bool select_port(void) {
	if (serial_port == NULL || !*serial_port) {
		fprintf(stderr, "    set MOONLITE_HW_PORT to the focuser's port\n");
		return false;
	}
	printf("Using port %s\n", serial_port);
	return hw_set_text(focuser, DEVICE_PORT_PROPERTY_NAME, DEVICE_PORT_ITEM_NAME, serial_port, INDIGO_OK_STATE, SHORT_TIMEOUT);
}

static bool set_number(const char *property, const char *item, double value) {
	return focuser_hw_set_number(focuser, property, item, value, INDIGO_OK_STATE, SHORT_TIMEOUT) && focuser_hw_value(focuser, property, item) == value;
}

static void restore_initial_state(void) {
	if (focuser < 0 || !state_captured || !hw_connected(focuser)) {
		return;
	}
	focuser_hw_idle(focuser, FOCUSER_POSITION_PROPERTY_NAME, MOVE_TIMEOUT);
	focuser_hw_set_switch(focuser, FOCUSER_MODE_PROPERTY_NAME, FOCUSER_MODE_MANUAL_ITEM_NAME, SHORT_TIMEOUT);
	focuser_hw_set_switch(focuser, FOCUSER_REVERSE_MOTION_PROPERTY_NAME, FOCUSER_REVERSE_MOTION_DISABLED_ITEM_NAME, SHORT_TIMEOUT);
	focuser_hw_set_switch(focuser, "X_FOCUSER_STEPPING_MODE", half_step ? "HALF" : "FULL", SHORT_TIMEOUT);
	set_number(FOCUSER_COMPENSATION_PROPERTY_NAME, FOCUSER_COMPENSATION_ITEM_NAME, initial_coefficient);
	set_number(FOCUSER_SPEED_PROPERTY_NAME, FOCUSER_SPEED_ITEM_NAME, 1);
	focuser_hw_goto(focuser, initial_position, INDIGO_OK_STATE, MOVE_TIMEOUT);
	set_number(FOCUSER_SPEED_PROPERTY_NAME, FOCUSER_SPEED_ITEM_NAME, initial_speed);
}

static void moonlite_publishes_the_values(void) {
	char firmware[INDIGO_VALUE_SIZE] = "";
	double temperature = focuser_hw_value(focuser, FOCUSER_TEMPERATURE_PROPERTY_NAME, FOCUSER_TEMPERATURE_ITEM_NAME);
	ASSERT_TRUE((hw_device_interface(focuser) & INDIGO_INTERFACE_FOCUSER) != 0);
	ASSERT_TRUE(hw_text_item(focuser, INFO_PROPERTY_NAME, INFO_DEVICE_FW_REVISION_ITEM_NAME, firmware, sizeof(firmware)));
	printf("    firmware %s, position %g, speed %g, coefficient %g, %s step, %.1f C\n", firmware, initial_position, initial_speed, initial_coefficient, half_step ? "half" : "full", temperature);
	ASSERT_TRUE(strlen(firmware) == 3 && firmware[1] == '.');
	ASSERT_TRUE(initial_speed >= 1 && initial_speed <= 5);
	ASSERT_TRUE(temperature > -50 && temperature < 60);
	ASSERT_TRUE(hw_property_defined(focuser, "X_FOCUSER_STEPPING_MODE"));
	ASSERT_TRUE(hw_property_defined(focuser, FOCUSER_COMPENSATION_PROPERTY_NAME));
	ASSERT_TRUE(hw_property_defined(focuser, FOCUSER_LIMITS_PROPERTY_NAME));
}

static void moonlite_moves_to_absolute_positions(void) {
	ASSERT_TRUE(set_number(FOCUSER_SPEED_PROPERTY_NAME, FOCUSER_SPEED_ITEM_NAME, 1));
	ASSERT_TRUE(focuser_hw_goto(focuser, base + TRAVEL, INDIGO_OK_STATE, MOVE_TIMEOUT));
	ASSERT_TRUE(focuser_hw_goto(focuser, base + 11, INDIGO_OK_STATE, MOVE_TIMEOUT));
	ASSERT_TRUE(focuser_hw_goto(focuser, base, INDIGO_OK_STATE, MOVE_TIMEOUT));
	ASSERT_TRUE(focuser_hw_goto(focuser, base, INDIGO_OK_STATE, SHORT_TIMEOUT));
}

// INDIGO counts an inward move as increasing the position (the 2.0 driver did as well); the steps are checked by
// distance and by the way back.
static void moonlite_moves_by_steps(void) {
	ASSERT_TRUE(focuser_hw_steps(focuser, true, 250, INDIGO_OK_STATE, MOVE_TIMEOUT));
	double outward = focuser_hw_position(focuser);
	ASSERT_EQ_INT(250, abs((int)(outward - base)));
	ASSERT_TRUE(focuser_hw_steps(focuser, false, 250, INDIGO_OK_STATE, MOVE_TIMEOUT));
	ASSERT_EQ_INT((int)base, (int)focuser_hw_position(focuser));
}

// The reversed direction is applied by the driver: an outward step goes the other way.
static void moonlite_reverses_the_direction(void) {
	ASSERT_TRUE(focuser_hw_steps(focuser, true, 100, INDIGO_OK_STATE, MOVE_TIMEOUT));
	double normal = focuser_hw_position(focuser) - base;
	ASSERT_TRUE(focuser_hw_goto(focuser, base, INDIGO_OK_STATE, MOVE_TIMEOUT));
	ASSERT_TRUE(focuser_hw_set_switch(focuser, FOCUSER_REVERSE_MOTION_PROPERTY_NAME, FOCUSER_REVERSE_MOTION_ENABLED_ITEM_NAME, SHORT_TIMEOUT));
	ASSERT_TRUE(focuser_hw_steps(focuser, true, 100, INDIGO_OK_STATE, MOVE_TIMEOUT));
	double reversed = focuser_hw_position(focuser) - base;
	ASSERT_TRUE(focuser_hw_set_switch(focuser, FOCUSER_REVERSE_MOTION_PROPERTY_NAME, FOCUSER_REVERSE_MOTION_DISABLED_ITEM_NAME, SHORT_TIMEOUT));
	printf("    outward 100 steps: %+g normal, %+g reversed\n", normal, reversed);
	ASSERT_EQ_INT(100, abs((int)normal));
	ASSERT_EQ_INT((int)-normal, (int)reversed);
	ASSERT_TRUE(focuser_hw_goto(focuser, base, INDIGO_OK_STATE, MOVE_TIMEOUT));
}

static void moonlite_aborts_a_move(void) {
	ASSERT_TRUE(set_number(FOCUSER_SPEED_PROPERTY_NAME, FOCUSER_SPEED_ITEM_NAME, 5));
	ASSERT_TRUE(focuser_hw_start_goto(focuser, base + TRAVEL, SHORT_TIMEOUT));
	indigo_usleep(2500000);
	ASSERT_TRUE(focuser_hw_abort(focuser, SHORT_TIMEOUT));
	ASSERT_TRUE(focuser_hw_idle(focuser, FOCUSER_POSITION_PROPERTY_NAME, SHORT_TIMEOUT));
	indigo_usleep(1000000);
	double stopped = focuser_hw_position(focuser);
	printf("    stopped at %g on the way from %g to %g, state %d\n", stopped, base, base + TRAVEL, hw_property_state(focuser, FOCUSER_POSITION_PROPERTY_NAME));
	ASSERT_TRUE(stopped > base && stopped < base + TRAVEL);
	indigo_usleep(1500000);
	ASSERT_EQ_INT((int)stopped, (int)focuser_hw_position(focuser));
	ASSERT_TRUE(set_number(FOCUSER_SPEED_PROPERTY_NAME, FOCUSER_SPEED_ITEM_NAME, 1));
	ASSERT_TRUE(focuser_hw_goto(focuser, base, INDIGO_OK_STATE, MOVE_TIMEOUT));
}

static void moonlite_changes_the_settings(void) {
	for (int speed = 1; speed <= 5; speed++) {
		ASSERT_TRUE(set_number(FOCUSER_SPEED_PROPERTY_NAME, FOCUSER_SPEED_ITEM_NAME, speed));
	}
	ASSERT_TRUE(set_number(FOCUSER_COMPENSATION_PROPERTY_NAME, FOCUSER_COMPENSATION_ITEM_NAME, -12));
	ASSERT_TRUE(set_number(FOCUSER_COMPENSATION_PROPERTY_NAME, FOCUSER_COMPENSATION_ITEM_NAME, 33));
	ASSERT_TRUE(focuser_hw_set_switch(focuser, "X_FOCUSER_STEPPING_MODE", half_step ? "FULL" : "HALF", SHORT_TIMEOUT));
	ASSERT_TRUE(focuser_hw_set_switch(focuser, FOCUSER_MODE_PROPERTY_NAME, FOCUSER_MODE_AUTOMATIC_ITEM_NAME, SHORT_TIMEOUT));
	ASSERT_TRUE(focuser_hw_set_switch(focuser, FOCUSER_MODE_PROPERTY_NAME, FOCUSER_MODE_MANUAL_ITEM_NAME, SHORT_TIMEOUT));
	// The controller keeps them over a reconnect.
	ASSERT_TRUE(hw_disconnect(focuser, SHORT_TIMEOUT));
	ASSERT_TRUE(hw_connect(focuser, SHORT_TIMEOUT));
	ASSERT_EQ_INT(5, (int)focuser_hw_value(focuser, FOCUSER_SPEED_PROPERTY_NAME, FOCUSER_SPEED_ITEM_NAME));
	ASSERT_EQ_INT(33, (int)focuser_hw_value(focuser, FOCUSER_COMPENSATION_PROPERTY_NAME, FOCUSER_COMPENSATION_ITEM_NAME));
	ASSERT_TRUE(focuser_hw_switch_is(focuser, "X_FOCUSER_STEPPING_MODE", half_step ? "FULL" : "HALF"));
	ASSERT_TRUE(focuser_hw_set_switch(focuser, "X_FOCUSER_STEPPING_MODE", half_step ? "HALF" : "FULL", SHORT_TIMEOUT));
	ASSERT_TRUE(set_number(FOCUSER_COMPENSATION_PROPERTY_NAME, FOCUSER_COMPENSATION_ITEM_NAME, initial_coefficient));
	ASSERT_TRUE(set_number(FOCUSER_SPEED_PROPERTY_NAME, FOCUSER_SPEED_ITEM_NAME, 1));
}

static void moonlite_reconnects(void) {
	ASSERT_TRUE(hw_disconnect(focuser, SHORT_TIMEOUT));
	ASSERT_TRUE(hw_property_hidden(focuser, FOCUSER_POSITION_PROPERTY_NAME));
	ASSERT_TRUE(hw_connect(focuser, SHORT_TIMEOUT));
	ASSERT_EQ_INT((int)base, (int)focuser_hw_position(focuser));
	ASSERT_EQ_INT(INDIGO_OK_STATE, hw_property_state(focuser, FOCUSER_POSITION_PROPERTY_NAME));
}

static void moonlite_rejects_shutdown_while_connected(void) {
	ASSERT_EQ_INT(INDIGO_BUSY, indigo_focuser_moonlite(INDIGO_DRIVER_SHUTDOWN, NULL));
	ASSERT_TRUE(hw_connected(focuser));
}

static void moonlite_reinitializes(void) {
	ASSERT_TRUE(hw_disconnect(focuser, SHORT_TIMEOUT));
	ASSERT_EQ_INT(INDIGO_OK, indigo_focuser_moonlite(INDIGO_DRIVER_SHUTDOWN, NULL));
	ASSERT_EQ_INT(-1, hw_device_index(DEVICE_NAME));
	ASSERT_EQ_INT(INDIGO_OK, indigo_focuser_moonlite(INDIGO_DRIVER_INIT, NULL));
	focuser = hw_wait_for_device(DEVICE_NAME, SHORT_TIMEOUT);
	ASSERT_TRUE(focuser >= 0);
	ASSERT_TRUE(select_port());
	ASSERT_TRUE(hw_connect(focuser, SHORT_TIMEOUT));
	ASSERT_EQ_INT((int)base, (int)focuser_hw_position(focuser));
}

int main(int argc, char **argv) {
	if (argc < 2 || strcmp(argv[1], "--run")) {
		fprintf(stderr, "Physical MoonLite test: run explicitly with --run (or make test-focuser-moonlite-hw).\n");
		return 2;
	}
	setvbuf(stdout, NULL, _IONBF, 0);
	for (int i = 2; i < argc; i++) {
		if (!strcmp(argv[i], "--debug")) {
			indigo_set_log_level(INDIGO_LOG_DEBUG);
		}
	}
	if (!indigo_test_use_private_home()) {
		return 1;
	}
	serial_port = hw_port("MOONLITE_HW_PORT");
	const indigo_test_case tests[] = {
		{ "moonlite_publishes_the_values", moonlite_publishes_the_values },
		{ "moonlite_moves_to_absolute_positions", moonlite_moves_to_absolute_positions },
		{ "moonlite_moves_by_steps", moonlite_moves_by_steps },
		{ "moonlite_reverses_the_direction", moonlite_reverses_the_direction },
		{ "moonlite_aborts_a_move", moonlite_aborts_a_move },
		{ "moonlite_changes_the_settings", moonlite_changes_the_settings },
		{ "moonlite_reconnects", moonlite_reconnects },
		{ "moonlite_rejects_shutdown_while_connected", moonlite_rejects_shutdown_while_connected },
		{ "moonlite_reinitializes", moonlite_reinitializes }
	};
	int result = 1;
	bool started = false, initialized = false;
	HW_CHECK(hw_start() == INDIGO_OK);
	started = true;
	HW_CHECK(hw_attach_client("MoonLite hardware test") == INDIGO_OK);
	HW_CHECK(indigo_focuser_moonlite(INDIGO_DRIVER_INIT, NULL) == INDIGO_OK);
	initialized = true;
	focuser = hw_wait_for_device(DEVICE_NAME, SHORT_TIMEOUT);
	HW_CHECK(focuser >= 0);
	HW_CHECK(select_port());
	HW_CHECK(hw_connect(focuser, SHORT_TIMEOUT));
	HW_CHECK(focuser_hw_idle(focuser, FOCUSER_POSITION_PROPERTY_NAME, MOVE_TIMEOUT));
	initial_position = focuser_hw_position(focuser);
	initial_speed = focuser_hw_value(focuser, FOCUSER_SPEED_PROPERTY_NAME, FOCUSER_SPEED_ITEM_NAME);
	initial_coefficient = focuser_hw_value(focuser, FOCUSER_COMPENSATION_PROPERTY_NAME, FOCUSER_COMPENSATION_ITEM_NAME);
	half_step = focuser_hw_switch_is(focuser, "X_FOCUSER_STEPPING_MODE", "HALF");
	double max = focuser_hw_value(focuser, FOCUSER_LIMITS_PROPERTY_NAME, FOCUSER_LIMITS_MAX_POSITION_ITEM_NAME);
	double min = focuser_hw_value(focuser, FOCUSER_LIMITS_PROPERTY_NAME, FOCUSER_LIMITS_MIN_POSITION_ITEM_NAME);
	base = initial_position < min + 500 ? min + 500 : initial_position + TRAVEL + 500 > max ? max - TRAVEL - 500 : initial_position;
	state_captured = true;
	result = indigo_run_tests("MoonLite hardware", tests, ARRAY_SIZE(tests));
cleanup:
	restore_initial_state();
	if (!hw_disconnect(focuser, SHORT_TIMEOUT)) {
		indigo_test_failures++;
	}
	if (initialized && indigo_focuser_moonlite(INDIGO_DRIVER_SHUTDOWN, NULL) != INDIGO_OK) {
		indigo_test_failures++;
	}
	indigo_detach_client(&hw_client);
	if (started) {
		indigo_stop();
	}
	hw_release_properties();
	indigo_test_remove_private_home();
	return indigo_test_failures ? 1 : result;
}
