// Copyright (c) 2026 INDIGO initiative
// All rights reserved.
//
// You may use this software under the terms of 'INDIGO Astronomy
// open-source license' (see LICENSE.md).
//
// THIS SOFTWARE IS PROVIDED BY THE AUTHORS 'AS IS' AND ANY EXPRESS
// OR IMPLIED WARRANTIES, INCLUDING, BUT NOT LIMITED TO, THE IMPLIED
// WARRANTIES OF MERCHANTABILITY AND FITNESS FOR A PARTICULAR PURPOSE
// ARE DISCLAIMED. IN NO EVENT SHALL THE AUTHOR BE LIABLE FOR ANY
// DIRECT, INDIRECT, INCIDENTAL, SPECIAL, EXEMPLARY, OR CONSEQUENTIAL
// DAMAGES (INCLUDING, BUT NOT LIMITED TO, PROCUREMENT OF SUBSTITUTE
// GOODS OR SERVICES; LOSS OF USE, DATA, OR PROFITS; OR BUSINESS
// INTERRUPTION) HOWEVER CAUSED AND ON ANY THEORY OF LIABILITY,
// WHETHER IN CONTRACT, STRICT LIABILITY, OR TORT (INCLUDING
// NEGLIGENCE OR OTHERWISE) ARISING IN ANY WAY OUT OF THE USE OF THIS
// SOFTWARE, EVEN IF ADVISED OF THE POSSIBILITY OF SUCH DAMAGE.

// Code is generated by AI

// Hardware test implemented by OpenAI Codex.

#include <pthread.h>
#include <stdlib.h>
#include <dirent.h>
#include <unistd.h>
#include <time.h>
#ifdef ASI_DYNAMIC_DRIVER
#include <dlfcn.h>
#endif
#include <indigo/indigo_driver.h>
#include <indigo_drivers/ccd_asi/indigo_ccd_asi.h>
#include <indigo_drivers/agent_imager/indigo_agent_imager.h>
#include "../test_runner.h"

#define ARRAY_SIZE(a) (sizeof(a) / sizeof((a)[0]))
#define TEST_SUFFIX "INDIGOT1"
_Static_assert(sizeof(TEST_SUFFIX) - 1 == 8, "Hardware suffix fixture must contain exactly eight bytes");
#define MAX_DEVICES 16
#define MAX_PROPERTIES 128
#define CHECK(condition)                                              \
	do {                                                                \
		if (!(condition)) {                                               \
			fprintf(stderr, "%s:%d: %s\n", __FILE__, __LINE__, #condition); \
			indigo_test_failures++;                                         \
			goto cleanup;                                                   \
		}                                                                 \
	} while (0)

typedef struct {
	char name[INDIGO_NAME_SIZE];
	indigo_device *device, *master;
	unsigned interface;
	bool present;
	indigo_property *properties[MAX_PROPERTIES];
	unsigned revisions[MAX_PROPERTIES];
	unsigned frames, invalid_frames, width, height, bytes;
} observed_device;

static observed_device devices[MAX_DEVICES];
static pthread_mutex_t mutex = PTHREAD_MUTEX_INITIALIZER;
static int camera = -1, guider = -1, imager = -1;
static bool hotplug, acceptance, suffix_only, abort_latency_only, abort_agent_only, abort_previews_only;

typedef struct {
	bool enabled;
	double sent, busy, done, agent_done;
	unsigned frames_sent, frames_busy, frames_done, frames_agent_done;
	indigo_property_state state;
} abort_measurement;

static abort_measurement abort_probe;
static char config_folder[] = "/tmp/indigo_asi_hw_XXXXXX";

#ifdef ASI_DYNAMIC_DRIVER
static indigo_result (*driver_entry)(indigo_driver_action, indigo_driver_info *);
static void *driver_library;

static bool load_driver_library(void) {
	driver_library = dlopen(ASI_DRIVER_PATH, RTLD_NOW | RTLD_LOCAL);
	if (!driver_library) {
		fprintf(stderr, "dlopen: %s\n", dlerror());
		return false;
	}
	driver_entry = dlsym(driver_library, "indigo_ccd_asi");
	return driver_entry != NULL;
}
#else
static indigo_result (*driver_entry)(indigo_driver_action, indigo_driver_info *) = indigo_ccd_asi;
#endif
static indigo_client client;

static int slot(int d, const char *name) {
	for (int p = 0; p < MAX_PROPERTIES; p++) {
		if (devices[d].properties[p] && !strcmp(devices[d].properties[p]->name, name)) {
			return p;
		}
	}
	return -1;
}

static indigo_result observe(indigo_device *device, indigo_property *property, const char *message, bool image_update) {
	pthread_mutex_lock(&mutex);
	int d;
	for (d = 0; d < MAX_DEVICES; d++) {
		if (!*devices[d].name || !strcmp(devices[d].name, property->device)) {
			break;
		}
	}
	if (d < MAX_DEVICES) {
		snprintf(devices[d].name, INDIGO_NAME_SIZE, "%s", property->device);
		devices[d].device = device;
		devices[d].master = device->master_device;
		if (!image_update && !strcmp(property->name, "INFO")) {
			devices[d].present = true;
			for (int i = 0; i < property->count; i++) {
				if (!strcmp(property->items[i].name, "DEVICE_INTERFACE")) {
					devices[d].interface = strtoul(property->items[i].text.value, NULL, 10);
				}
			}
		}
		int p = slot(d, property->name);
		if (p < 0) {
			for (p = 0; p < MAX_PROPERTIES && devices[d].properties[p]; p++) {
			}
		}
		if (p < MAX_PROPERTIES) {
			indigo_release_property(devices[d].properties[p]);
			devices[d].properties[p] = indigo_copy_property(NULL, property);
			devices[d].revisions[p]++;
		}
		if (abort_probe.enabled && d == imager && image_update && !strcmp(property->name, "AGENT_ABORT_PROCESS") && property->state != INDIGO_BUSY_STATE && abort_probe.agent_done == 0) {
			abort_probe.agent_done = indigo_monotonic_time();
			abort_probe.frames_agent_done = devices[camera].frames;
		}
		if (abort_probe.enabled && d == camera && image_update && !strcmp(property->name, "CCD_ABORT_EXPOSURE")) {
			if (property->state == INDIGO_BUSY_STATE && abort_probe.busy == 0) {
				abort_probe.busy = indigo_monotonic_time();
				abort_probe.frames_busy = devices[d].frames;
			} else if (property->state != INDIGO_BUSY_STATE && abort_probe.done == 0) {
				abort_probe.done = indigo_monotonic_time();
				abort_probe.frames_done = devices[d].frames;
				abort_probe.state = property->state;
			}
		}
		if (image_update && !strcmp(property->name, "CCD_IMAGE") && property->state == INDIGO_OK_STATE && property->count && property->items[0].blob.value) {
			indigo_item *item = property->items;
			indigo_raw_header header = { 0 };
			if (item->blob.size >= sizeof(header)) {
				memcpy(&header, item->blob.value, sizeof(header));
			}
			unsigned bytes = header.signature == INDIGO_RAW_MONO8 ? 1 : (header.signature == INDIGO_RAW_MONO16 ? 2 : (header.signature == INDIGO_RAW_RGB24 ? 3 : (header.signature == INDIGO_RAW_RGB48 ? 6 : 0)));
			if (strcmp(item->blob.format, ".raw") || !bytes || !header.width || !header.height || (uint64_t)header.width * header.height * bytes + sizeof(header) > item->blob.size) {
				devices[d].invalid_frames++;
			}
			devices[d].width = header.width;
			devices[d].height = header.height;
			devices[d].bytes = bytes;
			devices[d].frames++;
			if (devices[d].frames <= 12 || devices[d].frames % 100 == 0) {
				printf("    frame %u: %u x %u, %ld bytes\n", devices[d].frames, header.width, header.height, item->blob.size);
			}
		}
	}
	pthread_mutex_unlock(&mutex);
	if (message && *message) {
		fprintf(stderr, "    %s %s: %s\n", property->device, property->name, message);
	}
	return INDIGO_OK;
}

static indigo_result define_property(indigo_client *client, indigo_device *device, indigo_property *property, const char *message) {
	return observe(device, property, message, false);
}

static indigo_result update_property(indigo_client *client, indigo_device *device, indigo_property *property, const char *message) {
	return observe(device, property, message, true);
}

static indigo_result report_message(indigo_client *client, indigo_device *device, indigo_property *property, const char *message) {
	fprintf(stderr, "    message: %s\n", message ? message : "");
	return INDIGO_OK;
}

static indigo_result delete_property(indigo_client *client, indigo_device *device, indigo_property *property, const char *message) {
	if (!*property->name) {
		pthread_mutex_lock(&mutex);
		for (int d = 0; d < MAX_DEVICES; d++) {
			if (!strcmp(devices[d].name, property->device)) {
				devices[d].present = false;
				for (int p = 0; p < MAX_PROPERTIES; p++) {
					indigo_release_property(devices[d].properties[p]);
					devices[d].properties[p] = NULL;
				}
			}
		}
		pthread_mutex_unlock(&mutex);
	}
	return INDIGO_OK;
}

static bool same_camera_model(const char *name, const char *selected) {
	const char *suffix = strstr(selected, " #");
	size_t length = suffix ? (size_t)(suffix - selected) : strlen(selected);
	return !strncmp(name, selected, length) && (name[length] == 0 || !strncmp(name + length, " #", 2));
}

static bool wait_presence(bool present) {
	double deadline = indigo_monotonic_time() + 600;
	while (indigo_monotonic_time() < deadline) {
		pthread_mutex_lock(&mutex);
		if (present && !devices[camera].present) {
			for (int d = 0; d < MAX_DEVICES; d++) {
				if (devices[d].present && (devices[d].interface & INDIGO_INTERFACE_CCD) && same_camera_model(devices[d].name, getenv("INDIGO_TEST_DEVICE") ? getenv("INDIGO_TEST_DEVICE") : devices[camera].name)) {
					camera = d;
					guider = -1;
					for (int g = 0; g < MAX_DEVICES; g++) {
						if (devices[g].present && devices[g].master == devices[d].device && (devices[g].interface & INDIGO_INTERFACE_GUIDER)) {
							guider = g;
						}
					}
					break;
				}
			}
		}
		bool ready = devices[camera].present == present && (guider < 0 || devices[guider].present == present);
		if (present) {
			ready = ready && slot(camera, "CONNECTION") >= 0 && (guider < 0 || slot(guider, "CONNECTION") >= 0);
		}
		pthread_mutex_unlock(&mutex);
		if (ready) {
			return true;
		}
		indigo_usleep(10000);
	}
	fprintf(stderr, "Timed out waiting for physical %s\n", present ? "replug" : "unplug");
	return false;
}

static bool disconnect_device(int d) {
	if (d < 0) {
		return true;
	}
	pthread_mutex_lock(&mutex);
	bool present = devices[d].present;
	pthread_mutex_unlock(&mutex);
	if (!present) {
		return true;
	}
	indigo_change_switch_property_1(&client, devices[d].name, "CONNECTION", "DISCONNECTED", true);
	for (int i = 0; i < 3000; i++) {
		pthread_mutex_lock(&mutex);
		int p = slot(d, "CONNECTION");
		bool disconnected = false;
		if (p >= 0 && devices[d].properties[p]->state == INDIGO_OK_STATE) {
			indigo_property *property = devices[d].properties[p];
			for (int j = 0; j < property->count; j++) {
				if (!strcmp(property->items[j].name, "DISCONNECTED")) {
					disconnected = property->items[j].sw.value;
				}
			}
		}
		pthread_mutex_unlock(&mutex);
		if (disconnected) {
			return true;
		}
		indigo_usleep(10000);
	}
	fprintf(stderr, "Disconnect timeout: %s\n", devices[d].name);
	return false;
}

static unsigned revision(int d, const char *name) {
	pthread_mutex_lock(&mutex);
	int p = slot(d, name);
	unsigned result = p < 0 ? 0 : devices[d].revisions[p];
	pthread_mutex_unlock(&mutex);
	return result;
}

static bool wait_state(int d, const char *name, unsigned after, indigo_property_state state) {
	for (int i = 0; i < 3000; i++) {
		pthread_mutex_lock(&mutex);
		int p = slot(d, name);
		bool ready = p >= 0 && devices[d].revisions[p] > after && devices[d].properties[p]->state == state;
		bool failed = p >= 0 && devices[d].revisions[p] > after && devices[d].properties[p]->state == INDIGO_ALERT_STATE && state != INDIGO_ALERT_STATE;
		pthread_mutex_unlock(&mutex);
		if (failed) {
			fprintf(stderr, "Failed: %s %s expected state %d\n", devices[d].name, name, state);
			return false;
		}
		if (ready) {
			return true;
		}
		indigo_usleep(10000);
	}
	fprintf(stderr, "Timeout: %s %s expected state %d\n", devices[d].name, name, state);
	return false;
}

static bool switch_value(int d, const char *name, const char *item, indigo_property_state state) {
	if (d < 0) {
		return true;
	}
	unsigned before = revision(d, name);
	indigo_change_switch_property_1(&client, devices[d].name, name, item, true);
	return wait_state(d, name, before, state);
}

static bool number_value(int d, const char *name, const char *item, double value, indigo_property_state state) {
	if (d < 0) {
		return true;
	}
	unsigned before = revision(d, name);
	double sent = indigo_monotonic_time();
	if (getenv("INDIGO_ASI_DIAGNOSE_RETRY")) {
		printf("    request %s %s.%s = %.6f, expected %d\n", devices[d].name, name, item, value, state);
	}
	indigo_change_number_property_1(&client, devices[d].name, name, item, value);
	bool ok = wait_state(d, name, before, state);
	if (getenv("INDIGO_ASI_DIAGNOSE_RETRY")) {
		printf("    result %s %s: %s after %.3f s\n", devices[d].name, name, ok ? "PASS" : "FAIL", indigo_monotonic_time() - sent);
	}
	return ok;
}

static unsigned frames(void) {
	pthread_mutex_lock(&mutex);
	unsigned result = devices[camera].frames;
	pthread_mutex_unlock(&mutex);
	return result;
}

static indigo_property *snapshot(int d, const char *name) {
	pthread_mutex_lock(&mutex);
	int p = slot(d, name);
	indigo_property *copy = p < 0 ? NULL : indigo_copy_property(NULL, devices[d].properties[p]);
	pthread_mutex_unlock(&mutex);
	return copy;
}

static bool restore_property(indigo_property *p) {
	if (!p) {
		return true;
	}
	int target = -1;
	pthread_mutex_lock(&mutex);
	for (int d = 0; d < MAX_DEVICES; d++) {
		if (devices[d].present && !strcmp(devices[d].name, p->device)) {
			target = d;
			break;
		}
	}
	pthread_mutex_unlock(&mutex);
	if (target < 0) {
		return false;
	}
	unsigned before = revision(target, p->name);
	return indigo_change_property(&client, p) == INDIGO_OK && wait_state(target, p->name, before, INDIGO_OK_STATE);
}

static bool set_local_directory(void) {
	unsigned before = revision(camera, "CCD_LOCAL_MODE");
	indigo_change_text_property_1(&client, devices[camera].name, "CCD_LOCAL_MODE", "DIR", config_folder);
	return wait_state(camera, "CCD_LOCAL_MODE", before, INDIGO_OK_STATE);
}

static bool all_frame_types(void) {
	indigo_property *type = snapshot(camera, "CCD_FRAME_TYPE");
	bool ok = type != NULL;
	for (int i = 0; ok && i < type->count; i++) {
		unsigned before = frames();
		ok = switch_value(camera, "CCD_FRAME_TYPE", type->items[i].name, INDIGO_OK_STATE) && number_value(camera, "CCD_EXPOSURE", "EXPOSURE", 0.1, INDIGO_OK_STATE) && frames() == before + 1;
		printf("    frame type %s: %s\n", type->items[i].name, ok ? "PASS" : "FAIL");
	}
	ok = restore_property(type) && ok;
	indigo_release_property(type);
	return ok;
}

static indigo_property_state property_state(int d, const char *name) {
	pthread_mutex_lock(&mutex);
	int p = slot(d, name);
	indigo_property_state state = p < 0 ? INDIGO_IDLE_STATE : devices[d].properties[p]->state;
	pthread_mutex_unlock(&mutex);
	return state;
}

// Connects a device unless it is already connected. The framework answers a request for a device
// that is already connected without publishing anything, so a revision gated wait would time out.
static bool connect_device(int d) {
	if (d < 0) {
		return true;
	}
	indigo_property *connection = snapshot(d, "CONNECTION");
	bool connected = false;
	for (int i = 0; connection && i < connection->count; i++) {
		if (!strcmp(connection->items[i].name, "CONNECTED")) {
			connected = connection->items[i].sw.value;
		}
	}
	indigo_release_property(connection);
	return connected || switch_value(d, "CONNECTION", "CONNECTED", INDIGO_OK_STATE);
}

// Puts the camera back into the state every acquisition scenario expects: images delivered to this
// client as raw blobs and local files written into the temporary configuration directory.
static bool prepare_client_raw(void) {
	return set_local_directory() && switch_value(camera, "CCD_UPLOAD_MODE", "CLIENT", INDIGO_OK_STATE) && switch_value(camera, "CCD_IMAGE_FORMAT", "RAW", INDIGO_OK_STATE);
}

// Every pixel format the camera advertises has to deliver exactly one frame.
static bool exercise_pixel_formats(void) {
	indigo_property *pixel = snapshot(camera, "X_PIXEL_FORMAT");
	bool ok = pixel != NULL;
	for (int i = 0; ok && i < pixel->count; i++) {
		printf("    hardware pixel format: %s\n", pixel->items[i].name);
		unsigned before = frames();
		ok = switch_value(camera, "X_PIXEL_FORMAT", pixel->items[i].name, INDIGO_OK_STATE) && number_value(camera, "CCD_EXPOSURE", "EXPOSURE", 0.1, INDIGO_OK_STATE) && frames() == before + 1;
	}
	ok = restore_property(pixel) && ok;
	indigo_release_property(pixel);
	return ok;
}

// A nonzero ROI at every supported bin, checking the geometry of the delivered frame rather than
// only the accepted property value.
static bool exercise_bins_and_roi(void) {
	indigo_property *frame = snapshot(camera, "CCD_FRAME");
	indigo_property *bin = snapshot(camera, "CCD_BIN");
	bool ok = frame && bin;
	for (int factor = 1; ok && factor <= 2 && factor <= bin->items[0].number.max; factor++) {
		unsigned before = revision(camera, "CCD_BIN");
		indigo_change_number_property(&client, devices[camera].name, "CCD_BIN", 2, (const char *[]){ "HORIZONTAL", "VERTICAL" }, (double[]){ factor, factor });
		ok = wait_state(camera, "CCD_BIN", before, INDIGO_OK_STATE);
		before = revision(camera, "CCD_FRAME");
		indigo_change_number_property(&client, devices[camera].name, "CCD_FRAME", 4, (const char *[]){ "LEFT", "TOP", "WIDTH", "HEIGHT" }, (double[]){ 16, 24, 256, 256 });
		ok = ok && wait_state(camera, "CCD_FRAME", before, INDIGO_OK_STATE) && number_value(camera, "CCD_EXPOSURE", "EXPOSURE", 0.1, INDIGO_OK_STATE);
		pthread_mutex_lock(&mutex);
		ok = ok && devices[camera].width == 256 / factor && devices[camera].height == 256 / factor;
		pthread_mutex_unlock(&mutex);
		printf("    hardware ROI 256x256 at 16,24, bin %d: %s\n", factor, ok ? "PASS" : "FAIL");
	}
	// Binning bounds the frame, so it has to be restored first.
	ok = restore_property(bin) && ok;
	ok = restore_property(frame) && ok;
	indigo_release_property(bin);
	indigo_release_property(frame);
	return ok;
}

// A driver owned SDK setting survives CONFIG SAVE and comes back on CONFIG LOAD.
static bool exercise_configuration_roundtrip(void) {
#ifdef ASI_DYNAMIC_DRIVER
	printf("    configuration roundtrip: not applicable to the dynamic loader build\n");
	return true;
#else
	indigo_property *gain = snapshot(camera, "CCD_GAIN");
	bool ok = gain != NULL;
	if (ok && gain->perm != INDIGO_RW_PERM) {
		printf("    CCD_GAIN is read only on this camera, nothing to save\n");
	} else if (ok) {
		double value = gain->items[0].number.value;
		double changed = value < gain->items[0].number.max ? value + 1 : value - 1;
		ok = number_value(camera, "CCD_GAIN", "GAIN", changed, INDIGO_OK_STATE) && switch_value(camera, "CONFIG", "SAVE", INDIGO_OK_STATE) && restore_property(gain) && switch_value(camera, "CONFIG", "LOAD", INDIGO_OK_STATE);
		indigo_property *loaded = snapshot(camera, "CCD_GAIN");
		ok = ok && loaded && loaded->items[0].number.value == changed;
		indigo_release_property(loaded);
		printf("    hardware gain/config roundtrip in temporary directory: %s\n", ok ? "PASS" : "FAIL");
	}
	ok = restore_property(gain) && ok;
	indigo_release_property(gain);
	return ok;
#endif
}

// A long exposure completes while the guider of the same camera is pulsed, which is the shared
// session the two logical devices have to survive.
static bool exercise_guided_long_exposure(void) {
	unsigned before = revision(camera, "CCD_EXPOSURE");
	indigo_change_number_property_1(&client, devices[camera].name, "CCD_EXPOSURE", "EXPOSURE", 5);
	bool ok = wait_state(camera, "CCD_EXPOSURE", before, INDIGO_BUSY_STATE);
	if (guider < 0) {
		printf("    no ST4 port, only the long exposure is exercised\n");
	} else {
		ok = ok && number_value(guider, "GUIDER_GUIDE_RA", "EAST", 100, INDIGO_OK_STATE) && number_value(guider, "GUIDER_GUIDE_DEC", "NORTH", 100, INDIGO_OK_STATE);
	}
	return ok && wait_state(camera, "CCD_EXPOSURE", before, INDIGO_OK_STATE);
}

// Every writable advanced SDK control, plus gamma and offset. A control the SDK refuses has to end
// in ALERT with the original value still published, not silently report success.
static bool exercise_advanced_controls(void) {
	indigo_property *advanced = snapshot(camera, "X_ADVANCED");
	indigo_property *gamma = snapshot(camera, "CCD_GAMMA");
	indigo_property *offset = snapshot(camera, "CCD_OFFSET");
	bool ok = true;
	if (advanced && advanced->perm == INDIGO_RW_PERM) {
		for (int i = 0; ok && i < advanced->count; i++) {
			indigo_item *item = advanced->items + i;
			double changed = item->number.value < item->number.max ? item->number.value + item->number.step : item->number.value - item->number.step;
			if (changed >= item->number.min && changed <= item->number.max) {
				unsigned before = revision(camera, "X_ADVANCED");
				indigo_change_number_property_1(&client, devices[camera].name, "X_ADVANCED", item->name, changed);
				bool ready = false;
				for (int attempt = 0; attempt < 1000; attempt++) {
					indigo_property *p = snapshot(camera, "X_ADVANCED");
					ready = p && revision(camera, "X_ADVANCED") > before && p->state != INDIGO_BUSY_STATE;
					if (ready) {
						if (p->state == INDIGO_ALERT_STATE) {
							ok = p->items[i].number.value == item->number.value;
							printf("    SDK limitation: %s write rejected, original value %.0f retained: %s\n", item->name, item->number.value, ok ? "PASS error handling" : "FAIL");
						} else {
							ok = p->state == INDIGO_OK_STATE && p->items[i].number.value == changed;
							printf("    advanced %s write/readback: %s\n", item->name, ok ? "PASS" : "FAIL");
						}
					}
					indigo_release_property(p);
					if (ready) {
						break;
					}
					indigo_usleep(10000);
				}
				ok = ok && ready;
			}
		}
	} else {
		printf("    X_ADVANCED is not writable on this camera\n");
	}
	if (ok && gamma && gamma->perm == INDIGO_RW_PERM) {
		ok = number_value(camera, "CCD_GAMMA", "GAMMA", gamma->items->number.value < gamma->items->number.max ? gamma->items->number.value + 1 : gamma->items->number.value - 1, INDIGO_OK_STATE);
	}
	if (ok && offset && offset->perm == INDIGO_RW_PERM) {
		ok = number_value(camera, "CCD_OFFSET", "OFFSET", offset->items[0].number.value < offset->items[0].number.max ? offset->items[0].number.value + 1 : offset->items[0].number.value - 1, INDIGO_OK_STATE);
	}
	indigo_property *saved[] = { advanced, gamma, offset };
	for (int i = 0; i < ARRAY_SIZE(saved); i++) {
		ok = restore_property(saved[i]) && ok;
		indigo_release_property(saved[i]);
	}
	return ok;
}

// Each gain/offset preset the driver publishes is applied on the camera.
static bool exercise_presets(void) {
	indigo_property *presets = snapshot(camera, "X_PRESETS");
	indigo_property *gain = snapshot(camera, "CCD_GAIN");
	indigo_property *offset = snapshot(camera, "CCD_OFFSET");
	bool ok = presets != NULL;
	for (int i = 0; ok && i < presets->count; i++) {
		ok = switch_value(camera, "X_PRESETS", presets->items[i].name, INDIGO_OK_STATE);
		printf("    preset %s: %s\n", presets->items[i].name, ok ? "PASS" : "FAIL");
	}
	indigo_release_property(presets);
	indigo_property *saved[] = { gain, offset };
	for (int i = 0; i < ARRAY_SIZE(saved); i++) {
		ok = restore_property(saved[i]) && ok;
		indigo_release_property(saved[i]);
	}
	return ok;
}

// A cooled camera settles on a new target and reports power; an uncooled one only publishes the
// sensor temperature, which makes this row not applicable.
static bool exercise_cooling(void) {
	indigo_property *temperature = snapshot(camera, "CCD_TEMPERATURE");
	indigo_property *cooler = snapshot(camera, "CCD_COOLER");
	bool ok = true;
	if (temperature && cooler && temperature->perm == INDIGO_RW_PERM && cooler->perm == INDIGO_RW_PERM) {
		ok = switch_value(camera, "CCD_COOLER", "OFF", INDIGO_OK_STATE);
		// OFF lets the normal poll settle the measured-temperature property before a new target.
		ok = ok && wait_state(camera, "CCD_TEMPERATURE", 0, INDIGO_OK_STATE);
		// The measured temperature comes from the cooler poll. Do not wait for a fresh publication
		// here: the framework suppresses an update whose state and values are unchanged, so a
		// camera sitting at a stable temperature legitimately publishes nothing for minutes. Read
		// the last published value instead, and only wait while the driver still has no reading at
		// all, which is what the vendor SDK leaves behind for the first moments after init.
		double measured_value = 0;
		double reading_deadline = indigo_monotonic_time() + 20;
		while (ok) {
			indigo_property *measured = snapshot(camera, "CCD_TEMPERATURE");
			measured_value = measured && measured->count ? measured->items->number.value : 0;
			indigo_release_property(measured);
			if (measured_value != 0 || indigo_monotonic_time() >= reading_deadline) {
				break;
			}
			indigo_usleep(100000);
		}
		printf("    measured %.1f, original target %.1f, range %.1f .. %.1f\n", measured_value, temperature->items->number.target, temperature->items->number.min, temperature->items->number.max);
		// A camera that never publishes a reading cannot have a target derived from one.
		if (ok && measured_value == 0) {
			fprintf(stderr, "    no sensor temperature was published within 20 s\n");
			ok = false;
		}
		double target = fmax(temperature->items->number.min, fmin(temperature->items->number.max, floor(measured_value) - 1));
		ok = ok && number_value(camera, "CCD_TEMPERATURE", "TEMPERATURE", target, INDIGO_BUSY_STATE) && switch_value(camera, "CCD_COOLER", "ON", INDIGO_OK_STATE);
		double deadline = indigo_monotonic_time() + 60;
		bool cooled = false;
		while (ok && indigo_monotonic_time() < deadline) {
			indigo_property *t = snapshot(camera, "CCD_TEMPERATURE");
			indigo_property *power = snapshot(camera, "CCD_COOLER_POWER");
			if (t && power) {
				printf("    cooling target %.1f measured %.1f power %.1f%% state %d\n", t->items->number.target, t->items->number.value, power->items->number.value, t->state);
				cooled = t->state == INDIGO_OK_STATE && fabs(t->items->number.value - target) <= 0.5;
				ok = t->state != INDIGO_ALERT_STATE && power->state != INDIGO_ALERT_STATE;
			}
			indigo_release_property(t);
			indigo_release_property(power);
			if (cooled || !ok) {
				break;
			}
			indigo_usleep(1000000);
		}
		ok = ok && cooled;
		// Restore target with cooler off; then restore the original cooler selection.
		bool restored = switch_value(camera, "CCD_COOLER", "OFF", INDIGO_OK_STATE) && wait_state(camera, "CCD_TEMPERATURE", 0, INDIGO_OK_STATE);
		if (restored) {
			restored = number_value(camera, "CCD_TEMPERATURE", "TEMPERATURE", temperature->items->number.target, INDIGO_BUSY_STATE);
		}
		if (restored) {
			restored = switch_value(camera, "CCD_COOLER", "ON", INDIGO_OK_STATE);
			// Target is applied on the next normal poll after ON.
			double settle = indigo_monotonic_time() + 6;
			while (indigo_monotonic_time() < settle) {
				indigo_usleep(10000);
			}
		}
		restored = restore_property(cooler) && restored;
		printf("    cooler/target restoration: %s\n", restored ? "PASS" : "FAIL");
		ok = ok && restored;
	} else {
		printf("    cooling: sensor-only or unavailable\n");
		ok = temperature == NULL || wait_state(camera, "CCD_TEMPERATURE", 0, INDIGO_OK_STATE);
	}
	indigo_release_property(temperature);
	indigo_release_property(cooler);
	return ok;
}

// Fractional durations longer than a second are their own timing branch in the driver.
static bool exercise_fractional_exposures(void) {
	unsigned before = frames();
	bool ok = number_value(camera, "CCD_EXPOSURE", "EXPOSURE", 1.5, INDIGO_OK_STATE) && number_value(camera, "CCD_EXPOSURE", "EXPOSURE", 2.5, INDIGO_OK_STATE);
	return ok && frames() == before + 2;
}

// Streaming at a frame duration above the two-second video branch, aborted from BUSY, followed by a
// fresh snapshot to prove the stream released the camera.
static bool exercise_long_frame_stream(void) {
	unsigned before = frames(), changed = revision(camera, "CCD_STREAMING");
	indigo_change_number_property(&client, devices[camera].name, "CCD_STREAMING", 2, (const char *[]){ "EXPOSURE", "COUNT" }, (double[]){ 2.5, -1 });
	bool ok = wait_state(camera, "CCD_STREAMING", changed, INDIGO_BUSY_STATE);
	double deadline = indigo_monotonic_time() + 30;
	while (ok && frames() < before + 3 && indigo_monotonic_time() < deadline) {
		indigo_usleep(10000);
	}
	ok = ok && frames() >= before + 3;
	double sent = indigo_monotonic_time();
	ok = switch_value(camera, "CCD_ABORT_EXPOSURE", "ABORT_EXPOSURE", INDIGO_OK_STATE) && ok;
	printf("    long indefinite video: frames %u, terminal abort %.3f s, %s\n", frames() - before, indigo_monotonic_time() - sent, ok ? "PASS" : "FAIL");
	before = frames();
	return ok && number_value(camera, "CCD_EXPOSURE", "EXPOSURE", 0.1, INDIGO_OK_STATE) && frames() == before + 1;
}

// Repeated short exposures, each publishing exactly one frame.
static bool exercise_repeated_exposures(void) {
	for (int i = 0; i < 3; i++) {
		unsigned before = frames();
		if (!number_value(camera, "CCD_EXPOSURE", "EXPOSURE", 0.1, INDIGO_OK_STATE) || frames() != before + 1) {
			return false;
		}
	}
	return true;
}

// A long exposure is aborted from BUSY and the camera acquires again immediately afterwards.
static bool exercise_abort_and_reacquire(void) {
	bool ok = number_value(camera, "CCD_EXPOSURE", "EXPOSURE", 5, INDIGO_BUSY_STATE);
	// Allow delayed SDK setup to start the physical exposure before aborting it.
	indigo_usleep(500000);
	unsigned before = frames();
	ok = ok && switch_value(camera, "CCD_ABORT_EXPOSURE", "ABORT_EXPOSURE", INDIGO_OK_STATE) && wait_state(camera, "CCD_EXPOSURE", 0, INDIGO_ALERT_STATE);
	// An aborted exposure must not publish a frame.
	ok = ok && frames() == before;
	before = frames();
	return ok && number_value(camera, "CCD_EXPOSURE", "EXPOSURE", 0.1, INDIGO_OK_STATE) && frames() == before + 1;
}

// A finite stream delivers exactly the requested number of frames and finishes on its own.
static bool exercise_exact_stream(void) {
	unsigned before = frames(), stream_revision = revision(camera, "CCD_STREAMING");
	indigo_change_number_property(&client, devices[camera].name, "CCD_STREAMING", 2, (const char *[]){ "EXPOSURE", "COUNT" }, (double[]){ 0.1, 5 });
	bool ok = wait_state(camera, "CCD_STREAMING", stream_revision, INDIGO_OK_STATE);
	return ok && frames() == before + 5;
}

// A sustained indefinite stream keeps delivering frames and stops on abort.
static bool exercise_sustained_stream(void) {
	unsigned stream_revision = revision(camera, "CCD_STREAMING"), before = frames();
	indigo_change_number_property(&client, devices[camera].name, "CCD_STREAMING", 2, (const char *[]){ "EXPOSURE", "COUNT" }, (double[]){ 0.1, -1 });
	bool ok = wait_state(camera, "CCD_STREAMING", stream_revision, INDIGO_BUSY_STATE);
	for (int i = 0; i < 1000; i++) {
		indigo_usleep(10000);
	}
	ok = ok && frames() >= before + 3;
	printf("    sustained stream: %u frames in approximately 10 seconds\n", frames() - before);
	stream_revision = revision(camera, "CCD_STREAMING");
	ok = ok && switch_value(camera, "CCD_ABORT_EXPOSURE", "ABORT_EXPOSURE", INDIGO_OK_STATE) && wait_state(camera, "CCD_STREAMING", stream_revision, INDIGO_OK_STATE);
	// The stopped stream must not publish anything else.
	unsigned settled = frames();
	indigo_usleep(1500000);
	return ok && frames() == settled;
}

// All four relay directions, each completing and resetting its own item.
static bool exercise_guide_directions(void) {
	if (guider < 0) {
		printf("    no ST4 port, guide pulses are not applicable\n");
		return true;
	}
	const char *axes[] = { "GUIDER_GUIDE_RA", "GUIDER_GUIDE_RA", "GUIDER_GUIDE_DEC", "GUIDER_GUIDE_DEC" };
	const char *directions[] = { "EAST", "WEST", "NORTH", "SOUTH" };
	for (int i = 0; i < 4; i++) {
		if (!number_value(guider, axes[i], directions[i], 100, INDIGO_OK_STATE)) {
			return false;
		}
		indigo_property *axis = snapshot(guider, axes[i]);
		bool cleared = axis != NULL;
		for (int j = 0; axis && j < axis->count; j++) {
			cleared = cleared && axis->items[j].number.value == 0;
		}
		indigo_release_property(axis);
		if (!cleared) {
			fprintf(stderr, "    %s.%s did not reset to 0 after the pulse\n", axes[i], directions[i]);
			return false;
		}
	}
	return true;
}

// Both axes pulse at the same time and complete independently of each other.
static bool exercise_simultaneous_guide_axes(void) {
	if (guider < 0) {
		printf("    no ST4 port, simultaneous axes are not applicable\n");
		return true;
	}
	unsigned ra_before = revision(guider, "GUIDER_GUIDE_RA"), dec_before = revision(guider, "GUIDER_GUIDE_DEC");
	indigo_change_number_property_1(&client, devices[guider].name, "GUIDER_GUIDE_RA", "EAST", 1000);
	bool ok = wait_state(guider, "GUIDER_GUIDE_RA", ra_before, INDIGO_BUSY_STATE);
	indigo_change_number_property_1(&client, devices[guider].name, "GUIDER_GUIDE_DEC", "NORTH", 1500);
	ok = ok && wait_state(guider, "GUIDER_GUIDE_DEC", dec_before, INDIGO_BUSY_STATE);
	unsigned ra_busy = revision(guider, "GUIDER_GUIDE_RA"), dec_busy = revision(guider, "GUIDER_GUIDE_DEC");
	// Completing the shorter RA pulse must not end the DEC pulse that is still running.
	ok = ok && wait_state(guider, "GUIDER_GUIDE_RA", ra_busy, INDIGO_OK_STATE);
	ok = ok && property_state(guider, "GUIDER_GUIDE_DEC") == INDIGO_BUSY_STATE;
	ok = ok && wait_state(guider, "GUIDER_GUIDE_DEC", dec_busy, INDIGO_OK_STATE);
	// A zero request is a no-op that settles immediately.
	return ok && number_value(guider, "GUIDER_GUIDE_RA", "EAST", 0, INDIGO_OK_STATE) && number_value(guider, "GUIDER_GUIDE_DEC", "NORTH", 0, INDIGO_OK_STATE);
}

// A pulse requested while another pulse on the same axis is still running replaces it: the driver
// accepts the request, zeroes both items of the axis, releases both relays and runs the new
// duration instead of the remainder of the superseded one.
static bool exercise_guide_replacement(void) {
	if (guider < 0) {
		printf("    no ST4 port, guide pulse replacement is not applicable\n");
		return true;
	}
	bool ok = number_value(guider, "GUIDER_GUIDE_RA", "EAST", 2000, INDIGO_BUSY_STATE);
	indigo_usleep(500000);
	unsigned before = revision(guider, "GUIDER_GUIDE_RA");
	double sent = indigo_monotonic_time();
	indigo_change_number_property_1(&client, devices[guider].name, "GUIDER_GUIDE_RA", "WEST", 300);
	ok = ok && wait_state(guider, "GUIDER_GUIDE_RA", before, INDIGO_BUSY_STATE);
	indigo_property *ra = snapshot(guider, "GUIDER_GUIDE_RA");
	bool east = false, west = false;
	for (int i = 0; ra && i < ra->count; i++) {
		if (!strcmp(ra->items[i].name, "EAST")) {
			east = ra->items[i].number.value == 0;
		}
		if (!strcmp(ra->items[i].name, "WEST")) {
			west = ra->items[i].number.value == 300;
		}
	}
	indigo_release_property(ra);
	ok = ok && east && west;
	unsigned busy = revision(guider, "GUIDER_GUIDE_RA");
	ok = ok && wait_state(guider, "GUIDER_GUIDE_RA", busy, INDIGO_OK_STATE);
	double elapsed = indigo_monotonic_time() - sent;
	printf("    replacement pulse completed %.3f s after the request\n", elapsed);
	// The replacement runs its own 300 ms; the stale finaliser of the 2000 ms pulse must neither
	// end it early nor keep the axis busy for the rest of the superseded duration.
	ok = ok && elapsed > 0.2 && elapsed < 1.2;
	ra = snapshot(guider, "GUIDER_GUIDE_RA");
	bool cleared = ra != NULL;
	for (int i = 0; ra && i < ra->count; i++) {
		cleared = cleared && ra->items[i].number.value == 0;
	}
	indigo_release_property(ra);
	ok = ok && cleared;
	// A reversal on the same axis is the other replacement direction.
	ok = ok && number_value(guider, "GUIDER_GUIDE_RA", "WEST", 2000, INDIGO_BUSY_STATE);
	indigo_usleep(500000);
	before = revision(guider, "GUIDER_GUIDE_RA");
	sent = indigo_monotonic_time();
	indigo_change_number_property_1(&client, devices[guider].name, "GUIDER_GUIDE_RA", "EAST", 300);
	ok = ok && wait_state(guider, "GUIDER_GUIDE_RA", before, INDIGO_BUSY_STATE);
	busy = revision(guider, "GUIDER_GUIDE_RA");
	ok = ok && wait_state(guider, "GUIDER_GUIDE_RA", busy, INDIGO_OK_STATE);
	elapsed = indigo_monotonic_time() - sent;
	printf("    reversal pulse completed %.3f s after the request\n", elapsed);
	return ok && elapsed > 0.2 && elapsed < 1.2;
}

// Disconnecting the guider with a pulse pending cancels the driver work and releases the relays
// without closing the camera session its sibling still uses.
static bool exercise_guider_disconnect_during_pulse(void) {
	if (guider < 0) {
		printf("    no ST4 port, guider disconnect is not applicable\n");
		return true;
	}
	bool ok = number_value(guider, "GUIDER_GUIDE_RA", "WEST", 1000, INDIGO_BUSY_STATE) && disconnect_device(guider);
	unsigned before = frames();
	ok = ok && number_value(camera, "CCD_EXPOSURE", "EXPOSURE", 0.1, INDIGO_OK_STATE) && frames() == before + 1;
	return ok && connect_device(guider) && number_value(guider, "GUIDER_GUIDE_RA", "WEST", 100, INDIGO_OK_STATE);
}

// Disconnecting the camera leaves the guider operational on the same shared session.
static bool exercise_ccd_disconnect_with_live_guider(void) {
	bool ok = disconnect_device(camera);
	if (guider < 0) {
		printf("    no ST4 port, only the camera disconnect is exercised\n");
	} else {
		ok = ok && number_value(guider, "GUIDER_GUIDE_RA", "EAST", 100, INDIGO_OK_STATE);
	}
	ok = ok && connect_device(camera) && prepare_client_raw();
	unsigned before = frames();
	return ok && number_value(camera, "CCD_EXPOSURE", "EXPOSURE", 0.1, INDIGO_OK_STATE) && frames() == before + 1;
}

// The camera may be connected before the guider as well as after it.
static bool exercise_ccd_first_connection_order(void) {
	bool ok = disconnect_device(camera) && disconnect_device(guider);
	ok = ok && connect_device(camera) && connect_device(guider) && prepare_client_raw();
	unsigned before = frames();
	ok = ok && number_value(camera, "CCD_EXPOSURE", "EXPOSURE", 0.1, INDIGO_OK_STATE) && frames() == before + 1;
	if (guider >= 0) {
		ok = ok && number_value(guider, "GUIDER_GUIDE_RA", "EAST", 100, INDIGO_OK_STATE);
	}
	return ok;
}

// A full reconnect rebuilds the properties and the camera acquires again.
static bool exercise_reconnect(void) {
	bool ok = disconnect_device(guider) && disconnect_device(camera);
	ok = ok && connect_device(guider) && connect_device(camera) && prepare_client_raw();
	indigo_property *info = snapshot(camera, "CCD_INFO");
	ok = ok && info && info->count >= 2;
	indigo_release_property(info);
	unsigned before = frames();
	return ok && number_value(camera, "CCD_EXPOSURE", "EXPOSURE", 0.1, INDIGO_OK_STATE) && frames() == before + 1;
}

// A change request refused because the camera is acquiring has to come back as ALERT carrying the
// values the driver kept, and the same request has to be accepted once acquisition finished.
static bool exercise_rejected_changes_during_acquisition(void) {
	indigo_property *gain = snapshot(camera, "CCD_GAIN");
	if (!gain || gain->perm != INDIGO_RW_PERM) {
		printf("    CCD_GAIN is read only on this camera, no refusable control\n");
		indigo_release_property(gain);
		return true;
	}
	double original = gain->items[0].number.value;
	double rejected = original < gain->items[0].number.max ? original + 1 : original - 1;
	unsigned before = revision(camera, "CCD_EXPOSURE");
	indigo_change_number_property_1(&client, devices[camera].name, "CCD_EXPOSURE", "EXPOSURE", 5);
	bool ok = wait_state(camera, "CCD_EXPOSURE", before, INDIGO_BUSY_STATE);
	unsigned gain_before = revision(camera, "CCD_GAIN");
	indigo_change_number_property_1(&client, devices[camera].name, "CCD_GAIN", "GAIN", rejected);
	ok = ok && wait_state(camera, "CCD_GAIN", gain_before, INDIGO_ALERT_STATE);
	indigo_property *refused = snapshot(camera, "CCD_GAIN");
	ok = ok && refused && refused->count && refused->items[0].number.value == original && refused->items[0].number.target == original;
	printf("    refused gain during acquisition: value %.0f target %.0f, expected %.0f: %s\n", refused && refused->count ? refused->items[0].number.value : -1, refused && refused->count ? refused->items[0].number.target : -1, original, ok ? "PASS" : "FAIL");
	indigo_release_property(refused);
	ok = ok && wait_state(camera, "CCD_EXPOSURE", before, INDIGO_OK_STATE);
	ok = ok && number_value(camera, "CCD_GAIN", "GAIN", rejected, INDIGO_OK_STATE);
	ok = restore_property(gain) && ok;
	indigo_release_property(gain);
	return ok;
}

static bool physical_cycle(const char *phase) {
	int other = -1;
	pthread_mutex_lock(&mutex);
	for (int d = 0; d < MAX_DEVICES; d++) {
		if (d != camera && devices[d].present && (devices[d].interface & INDIGO_INTERFACE_CCD)) {
			other = d;
			break;
		}
	}
	pthread_mutex_unlock(&mutex);
	indigo_property *other_format = NULL, *other_upload = NULL;
	bool ok = true;
	if (other >= 0) {
		ok = switch_value(other, "CONNECTION", "CONNECTED", INDIGO_OK_STATE);
		other_format = snapshot(other, "CCD_IMAGE_FORMAT");
		other_upload = snapshot(other, "CCD_UPLOAD_MODE");
		ok = ok && switch_value(other, "CCD_UPLOAD_MODE", "CLIENT", INDIGO_OK_STATE) && switch_value(other, "CCD_IMAGE_FORMAT", "RAW", INDIGO_OK_STATE) && number_value(other, "CCD_EXPOSURE", "EXPOSURE", 0.1, INDIGO_OK_STATE);
	}
	if (ok) {
		printf("HOTPLUG_READY [%s]: unplug USB camera now: %s\n", phase, devices[camera].name);
		ok = wait_presence(false);
	}
	if (ok && other >= 0) {
		ok = number_value(other, "CCD_EXPOSURE", "EXPOSURE", 0.1, INDIGO_OK_STATE);
		printf("    second camera survives removal: %s, %s\n", devices[other].name, ok ? "PASS" : "FAIL");
	}
	if (ok) {
		printf("HOTPLUG_REMOVED [%s]: reconnect the same USB camera now\n", phase);
		ok = wait_presence(true) && connect_device(camera) && connect_device(guider) && switch_value(camera, "CCD_UPLOAD_MODE", "CLIENT", INDIGO_OK_STATE) && switch_value(camera, "CCD_IMAGE_FORMAT", "RAW", INDIGO_OK_STATE);
	}
	unsigned before = frames();
	ok = ok && number_value(camera, "CCD_EXPOSURE", "EXPOSURE", 0.1, INDIGO_OK_STATE) && frames() == before + 1 && number_value(guider, "GUIDER_GUIDE_RA", "EAST", 100, INDIGO_OK_STATE);
	if (other >= 0) {
		ok = restore_property(other_format) && ok;
		ok = restore_property(other_upload) && ok;
		ok = disconnect_device(other) && ok;
	}
	indigo_release_property(other_format);
	indigo_release_property(other_upload);
	printf("HOTPLUG_RECOVERED [%s]: %s, camera name: %s\n", phase, ok ? "PASS" : "FAIL", devices[camera].name);
	return ok;
}

static bool set_suffix(const char *value) {
	unsigned before = revision(camera, "X_CUSTOM_SUFFIX");
	printf("    Request suffix %s, revision %u\n", value, before);
	indigo_change_text_property_1(&client, devices[camera].name, "X_CUSTOM_SUFFIX", "SUFFIX", value);
	bool ok = wait_state(camera, "X_CUSTOM_SUFFIX", before, INDIGO_OK_STATE);
	indigo_property *p = snapshot(camera, "X_CUSTOM_SUFFIX");
	printf("    Suffix result: state %d, revision %u, value %s\n", p ? p->state : -1, revision(camera, "X_CUSTOM_SUFFIX"), p ? p->items[0].text.value : "missing");
	indigo_release_property(p);
	return ok;
}

static bool suffix_acceptance(void) {
	indigo_property *suffix = snapshot(camera, "X_CUSTOM_SUFFIX");
	if (!suffix || !suffix->count) {
		indigo_release_property(suffix);
		return false;
	}
	char original[17];
	snprintf(original, sizeof(original), "%s", suffix->items[0].text.value);
	indigo_release_property(suffix);
	printf("    original suffix: '%s'\n", original);
	bool ok = set_suffix(TEST_SUFFIX) && physical_cycle("8-byte suffix") && strstr(devices[camera].name, "#INDIGOT1") != NULL;
	if (ok) {
		ok = set_suffix("") && physical_cycle("cleared suffix") && strstr(devices[camera].name, "#INDIGOT1") == NULL;
	}
	// Always restore after the first flash write, including failed assertions.
	bool restored = set_suffix(original);
	if (restored && *original) {
		restored = physical_cycle("restored suffix") && strstr(devices[camera].name, original) != NULL;
	}
	printf("    original suffix restoration: %s\n", restored ? "PASS" : "FAIL");
	return ok && restored;
}

static indigo_property_state cached_state(const char *name) {
	pthread_mutex_lock(&mutex);
	int p = slot(camera, name);
	indigo_property_state state = p < 0 ? INDIGO_ALERT_STATE : devices[camera].properties[p]->state;
	pthread_mutex_unlock(&mutex);
	return state;
}

static bool abort_latency_trials(void) {
	indigo_property *saved_format = snapshot(camera, "CCD_IMAGE_FORMAT");
	indigo_property *saved_upload = snapshot(camera, "CCD_UPLOAD_MODE");
	bool ok = switch_value(camera, "CCD_UPLOAD_MODE", "CLIENT", INDIGO_OK_STATE) && switch_value(camera, "CCD_IMAGE_FORMAT", "RAW", INDIGO_OK_STATE);
	ok = ok && switch_value(camera, "CCD_ABORT_EXPOSURE", "ABORT_EXPOSURE", INDIGO_ALERT_STATE);
	unsigned max_sent = 0, max_busy = 0, max_done = 0;
	double max_latency = 0;
	for (int mode = abort_previews_only ? 3 : (abort_agent_only ? 2 : 0); ok && mode < (abort_previews_only ? 5 : (abort_agent_only ? 3 : 2)); mode++) {
		for (int trial = 0; ok && trial < 20; trial++) {
			unsigned before = frames();
			int phase_ms = (trial % 10) * (mode >= 2 ? 30 : 10);
			if (mode >= 2) {
				indigo_change_number_property(&client, devices[imager].name, "AGENT_IMAGER_BATCH", 3, (const char *[]){ "EXPOSURE", "COUNT", "DELAY" }, (double[]){ 0.1, mode == 4 ? -1 : 100, 0 });
				indigo_change_switch_property_1(&client, devices[imager].name, "AGENT_START_PROCESS", mode == 3 ? "PREVIEW" : (mode == 4 ? "STREAMING" : "EXPOSURE"), true);
			} else if (mode == 0) {
				indigo_change_number_property(&client, devices[camera].name, "CCD_STREAMING", 2, (const char *[]){ "EXPOSURE", "COUNT" }, (double[]){ 0.1, -1 });
			} else {
				indigo_change_number_property_1(&client, devices[camera].name, "CCD_EXPOSURE", "EXPOSURE", 0.1);
			}
			double deadline = indigo_monotonic_time() + 10, abort_at = 0;
			while (indigo_monotonic_time() < deadline) {
				double now = indigo_monotonic_time();
				if (abort_at == 0 && frames() >= before + 3 && (mode != 1 || cached_state("CCD_EXPOSURE") == INDIGO_OK_STATE)) {
					if (mode == 1) {
						indigo_change_number_property_1(&client, devices[camera].name, "CCD_EXPOSURE", "EXPOSURE", 0.1);
					}
					abort_at = now + phase_ms / 1000.0;
				}
				if (abort_at != 0 && now >= abort_at) {
					break;
				}
				if (mode == 1 && cached_state("CCD_EXPOSURE") == INDIGO_OK_STATE) {
					indigo_change_number_property_1(&client, devices[camera].name, "CCD_EXPOSURE", "EXPOSURE", 0.1);
				}
				indigo_usleep(500);
			}
			if (abort_at == 0) {
				fprintf(stderr, "No three-frame warmup in mode %d trial %d\n", mode, trial);
				ok = false;
				break;
			}
			pthread_mutex_lock(&mutex);
			abort_probe = (abort_measurement){ .enabled = true, .sent = indigo_monotonic_time(), .frames_sent = devices[camera].frames };
			pthread_mutex_unlock(&mutex);
			indigo_change_switch_property_1(&client, devices[mode >= 2 ? imager : camera].name, mode >= 2 ? "AGENT_ABORT_PROCESS" : "CCD_ABORT_EXPOSURE", mode >= 2 ? "ABORT" : "ABORT_EXPOSURE", true);
			deadline = indigo_monotonic_time() + 5;
			for (;;) {
				pthread_mutex_lock(&mutex);
				double done = mode >= 2 ? abort_probe.agent_done : abort_probe.done;
				pthread_mutex_unlock(&mutex);
				if (done != 0 || indigo_monotonic_time() >= deadline) {
					break;
				}
				indigo_usleep(500);
			}
			indigo_usleep(600000);
			pthread_mutex_lock(&mutex);
			abort_measurement result = abort_probe;
			unsigned end = devices[camera].frames;
			abort_probe.enabled = false;
			pthread_mutex_unlock(&mutex);
			unsigned after_sent = end - result.frames_sent, after_busy = result.busy ? end - result.frames_busy : 0, after_done = result.done ? end - result.frames_done : 0;
			double latency = result.done ? (result.done - result.sent) * 1000 : -1;
			printf("ABORT_LATENCY mode=%s trial=%d phase_ms=%d frames_before=%u after_send=%u after_busy=%u after_done=%u busy_ms=%.3f done_ms=%.3f state=%d\n", mode == 0 ? "stream" : (mode == 1 ? "client_series" : (mode == 2 ? "imager_batch" : (mode == 3 ? "imager_preview" : "imager_streaming"))), trial + 1, phase_ms, result.frames_sent - before, after_sent, after_busy, after_done, result.busy ? (result.busy - result.sent) * 1000 : -1, latency, result.state);
			if (mode >= 2) {
				printf("AGENT_LATENCY trial=%d done_ms=%.3f after_done=%u\n", trial + 1, result.agent_done ? (result.agent_done - result.sent) * 1000 : -1, result.agent_done ? end - result.frames_agent_done : 0);
			}
			if (after_sent > max_sent) {
				max_sent = after_sent;
			}
			if (after_busy > max_busy) {
				max_busy = after_busy;
			}
			if (after_done > max_done) {
				max_done = after_done;
			}
			if (latency > max_latency) {
				max_latency = latency;
			}
			ok = (mode >= 2 ? result.agent_done != 0 && end == result.frames_agent_done : result.busy != 0 && result.done != 0) && after_done == 0 && cached_state(mode == 0 || mode == 4 ? "CCD_STREAMING" : "CCD_EXPOSURE") != INDIGO_BUSY_STATE;
		}
	}
	pthread_mutex_lock(&mutex);
	abort_probe.enabled = false;
	pthread_mutex_unlock(&mutex);
	if (ok) {
		ok = number_value(camera, "CCD_EXPOSURE", "EXPOSURE", 0.1, INDIGO_OK_STATE);
	}
	if (ok) {
		ok = switch_value(camera, "CCD_ABORT_EXPOSURE", "ABORT_EXPOSURE", INDIGO_ALERT_STATE);
	}
	printf("ABORT_SUMMARY max_after_send=%u max_after_busy=%u max_after_done=%u max_done_ms=%.3f success=%d\n", max_sent, max_busy, max_done, max_latency, ok);
	bool format_restored = restore_property(saved_format);
	bool upload_restored = restore_property(saved_upload);
	indigo_release_property(saved_format);
	indigo_release_property(saved_upload);
	return ok && format_restored && upload_restored;
}

// The eight-byte flash suffix is written and restored inside one session. The camera only renames
// itself on replug, so the name check across a cable cycle stays in the opt-in --suffix case.
static bool exercise_custom_suffix(void) {
	indigo_property *suffix = snapshot(camera, "X_CUSTOM_SUFFIX");
	if (!suffix || !suffix->count) {
		printf("    X_CUSTOM_SUFFIX is not published, the flash id is unsupported\n");
		indigo_release_property(suffix);
		return true;
	}
	char original[INDIGO_VALUE_SIZE];
	snprintf(original, sizeof(original), "%s", suffix->items[0].text.value);
	indigo_release_property(suffix);
	printf("    original suffix: '%s'\n", original);
	bool ok = set_suffix(TEST_SUFFIX);
	indigo_property *written = snapshot(camera, "X_CUSTOM_SUFFIX");
	ok = ok && written && written->count && !strcmp(written->items[0].text.value, TEST_SUFFIX);
	indigo_release_property(written);
	// The device keeps its current name until it is replugged.
	ok = ok && strstr(devices[camera].name, "#" TEST_SUFFIX) == NULL;
	// Always restore after the first flash write, including a failed assertion.
	bool restored = set_suffix(original);
	indigo_property *back = snapshot(camera, "X_CUSTOM_SUFFIX");
	restored = restored && back && back->count && !strcmp(back->items[0].text.value, original);
	indigo_release_property(back);
	printf("    suffix write: %s, restoration to '%s': %s\n", ok ? "PASS" : "FAIL", original, restored ? "PASS" : "FAIL");
	return ok && restored;
}

static bool driver_initialized;

// Brings the driver up and selects the camera the session runs against. INDIGO_TEST_DEVICE picks one
// when more than one ASI camera is attached.
static bool begin_session(void) {
	if (indigo_start() != INDIGO_OK || indigo_attach_client(&client) != INDIGO_OK) {
		return false;
	}
	if (driver_entry(INDIGO_DRIVER_INIT, NULL) != INDIGO_OK) {
		return false;
	}
	driver_initialized = true;
	// Let initial USB enumeration settle before selecting a unique camera.
	for (int i = 0; i < 500; i++) {
		indigo_usleep(10000);
	}
	const char *requested = getenv("INDIGO_TEST_DEVICE");
	int matches = 0;
	pthread_mutex_lock(&mutex);
	for (int d = 0; d < MAX_DEVICES; d++) {
		if (devices[d].interface & INDIGO_INTERFACE_CCD) {
			printf("    discovered camera: %s\n", devices[d].name);
			if (!requested || !strcmp(requested, devices[d].name)) {
				camera = d;
				matches++;
			}
		}
	}
	if (matches == 1) {
		for (int d = 0; d < MAX_DEVICES; d++) {
			if ((devices[d].interface & INDIGO_INTERFACE_GUIDER) && devices[d].master == devices[camera].device) {
				guider = d;
			}
		}
	}
	pthread_mutex_unlock(&mutex);
	if (matches != 1) {
		fprintf(stderr, "Expected one camera; found %d matches. Set INDIGO_TEST_DEVICE to an exact discovered name when needed.\n", matches);
		camera = -1;
		return false;
	}
	printf("    selected: %s, guider: %s\n", devices[camera].name, guider < 0 ? "not available (guider scenarios not applicable)" : devices[guider].name);
	// The guider is connected first, so the camera joins an already open session.
	return connect_device(guider) && connect_device(camera) && prepare_client_raw();
}

static void end_session(void) {
	if (camera >= 0) {
		// Abort any unfinished acquisition before disconnecting; disconnected properties may be unchanged.
		indigo_change_switch_property_1(&client, devices[camera].name, "CCD_ABORT_EXPOSURE", "ABORT_EXPOSURE", true);
		if (!disconnect_device(camera)) {
			indigo_test_failures++;
		}
	}
	if (guider >= 0 && !disconnect_device(guider)) {
		indigo_test_failures++;
	}
	if (driver_initialized && driver_entry(INDIGO_DRIVER_SHUTDOWN, NULL) != INDIGO_OK) {
		indigo_test_failures++;
	}
	driver_initialized = false;
	indigo_detach_client(&client);
	indigo_stop();
}

static void asi_reports_identity_and_capabilities(void) {
	indigo_driver_info info = { 0 };
	ASSERT_TRUE(driver_entry(INDIGO_DRIVER_INFO, &info) == INDIGO_OK);
	ASSERT_STREQ("ZWO ASI Camera", info.description);
	ASSERT_EQ_INT(INDIGO_DRIVER_API_3, INDIGO_DRIVER_API_GENERATION(info.version));
	ASSERT_TRUE(info.multi_device_support);
	ASSERT_TRUE((devices[camera].interface & INDIGO_INTERFACE_CCD) != 0);
	if (guider >= 0) {
		ASSERT_TRUE((devices[guider].interface & INDIGO_INTERFACE_GUIDER) != 0);
		ASSERT_TRUE(devices[guider].master == devices[camera].device);
	}
	indigo_property *device_info = snapshot(camera, "INFO");
	ASSERT_TRUE(device_info != NULL);
	for (int i = 0; i < device_info->count; i++) {
		printf("    INFO.%s = %s\n", device_info->items[i].name, device_info->items[i].text.value);
	}
	bool driver_name = false, model = false;
	for (int i = 0; i < device_info->count; i++) {
		if (!strcmp(device_info->items[i].name, "DEVICE_DRIVER")) {
			driver_name = !strcmp(device_info->items[i].text.value, "indigo_ccd_asi");
		}
		if (!strcmp(device_info->items[i].name, "DEVICE_MODEL")) {
			model = *device_info->items[i].text.value != 0;
		}
	}
	indigo_release_property(device_info);
	ASSERT_TRUE(driver_name);
	ASSERT_TRUE(model);
	indigo_property *ccd_info = snapshot(camera, "CCD_INFO");
	ASSERT_TRUE(ccd_info != NULL);
	double width = 0, height = 0;
	for (int i = 0; i < ccd_info->count; i++) {
		if (!strcmp(ccd_info->items[i].name, "WIDTH")) {
			width = ccd_info->items[i].number.value;
		}
		if (!strcmp(ccd_info->items[i].name, "HEIGHT")) {
			height = ccd_info->items[i].number.value;
		}
	}
	indigo_release_property(ccd_info);
	printf("    sensor %.0f x %.0f\n", width, height);
	ASSERT_TRUE(width > 0 && height > 0);
}

static void asi_publishes_the_property_contract(void) {
	const char *required[] = { "INFO", "CONFIG", "PROFILE", "CONNECTION", "CCD_INFO", "CCD_EXPOSURE", "CCD_ABORT_EXPOSURE", "CCD_FRAME", "CCD_BIN", "CCD_MODE", "CCD_FRAME_TYPE", "CCD_IMAGE_FORMAT", "CCD_UPLOAD_MODE", "CCD_IMAGE", "CCD_LOCAL_MODE", "CCD_STREAMING", "X_PIXEL_FORMAT", "X_ADVANCED", "X_PRESETS", "X_CUSTOM_SUFFIX" };
	for (int i = 0; i < ARRAY_SIZE(required); i++) {
		pthread_mutex_lock(&mutex);
		bool found = slot(camera, required[i]) >= 0;
		pthread_mutex_unlock(&mutex);
		if (!found) {
			fprintf(stderr, "    %s is not published\n", required[i]);
		}
		ASSERT_TRUE(found);
	}
	// The camera is found over USB, so it has no port properties and is not a simulator.
	const char *hidden[] = { "DEVICE_PORT", "DEVICE_PORTS", "SIMULATION" };
	for (int i = 0; i < ARRAY_SIZE(hidden); i++) {
		pthread_mutex_lock(&mutex);
		bool found = slot(camera, hidden[i]) >= 0;
		pthread_mutex_unlock(&mutex);
		if (found) {
			fprintf(stderr, "    %s is published but should stay hidden\n", hidden[i]);
		}
		ASSERT_FALSE(found);
	}
	indigo_property *exposure = snapshot(camera, "CCD_EXPOSURE");
	ASSERT_TRUE(exposure && exposure->count);
	printf("    CCD_EXPOSURE range %.6f .. %.3f s\n", exposure->items[0].number.min, exposure->items[0].number.max);
	bool sane = exposure->items[0].number.min >= 0 && exposure->items[0].number.max > exposure->items[0].number.min;
	indigo_release_property(exposure);
	ASSERT_TRUE(sane);
	if (guider >= 0) {
		pthread_mutex_lock(&mutex);
		bool ra = slot(guider, "GUIDER_GUIDE_RA") >= 0, dec = slot(guider, "GUIDER_GUIDE_DEC") >= 0;
		pthread_mutex_unlock(&mutex);
		ASSERT_TRUE(ra && dec);
	}
}

static void asi_exposes_every_pixel_format(void) {
	ASSERT_TRUE(exercise_pixel_formats());
}

static void asi_exposes_bins_and_roi(void) {
	ASSERT_TRUE(exercise_bins_and_roi());
}

static void asi_exposes_every_frame_type(void) {
	ASSERT_TRUE(all_frame_types());
}

static void asi_saves_and_loads_configuration(void) {
	ASSERT_TRUE(exercise_configuration_roundtrip());
}

static void asi_writes_advanced_controls(void) {
	ASSERT_TRUE(exercise_advanced_controls());
}

static void asi_applies_presets(void) {
	ASSERT_TRUE(exercise_presets());
}

static void asi_controls_cooling(void) {
	ASSERT_TRUE(exercise_cooling());
}

static void asi_takes_repeated_short_exposures(void) {
	ASSERT_TRUE(exercise_repeated_exposures());
}

static void asi_takes_fractional_exposures(void) {
	ASSERT_TRUE(exercise_fractional_exposures());
}

static void asi_guides_during_a_long_exposure(void) {
	ASSERT_TRUE(exercise_guided_long_exposure());
}

static void asi_aborts_a_long_exposure_and_reacquires(void) {
	ASSERT_TRUE(exercise_abort_and_reacquire());
}

static void asi_streams_an_exact_frame_count(void) {
	ASSERT_TRUE(exercise_exact_stream());
}

static void asi_streams_indefinitely_and_stops(void) {
	ASSERT_TRUE(exercise_sustained_stream());
}

static void asi_streams_long_frames_and_stops(void) {
	ASSERT_TRUE(exercise_long_frame_stream());
}

static void asi_pulses_every_guide_direction(void) {
	ASSERT_TRUE(exercise_guide_directions());
}

static void asi_guides_on_both_axes_simultaneously(void) {
	ASSERT_TRUE(exercise_simultaneous_guide_axes());
}

static void asi_replaces_an_overlapping_guide_pulse(void) {
	ASSERT_TRUE(exercise_guide_replacement());
}

static void asi_disconnects_the_guider_during_a_pulse(void) {
	ASSERT_TRUE(exercise_guider_disconnect_during_pulse());
}

static void asi_disconnects_the_ccd_with_a_live_guider(void) {
	ASSERT_TRUE(exercise_ccd_disconnect_with_live_guider());
}

static void asi_connects_the_ccd_before_the_guider(void) {
	ASSERT_TRUE(exercise_ccd_first_connection_order());
}

static void asi_reconnects(void) {
	ASSERT_TRUE(exercise_reconnect());
}

static void asi_rejects_changes_during_acquisition(void) {
	ASSERT_TRUE(exercise_rejected_changes_during_acquisition());
}

static void asi_writes_and_restores_the_custom_suffix(void) {
	ASSERT_TRUE(exercise_custom_suffix());
}

static void asi_rejects_shutdown_while_connected(void) {
	ASSERT_TRUE(connect_device(camera));
	ASSERT_TRUE(driver_entry(INDIGO_DRIVER_SHUTDOWN, NULL) == INDIGO_BUSY);
	// The refused shutdown must leave the driver fully operational.
	ASSERT_TRUE(prepare_client_raw());
	unsigned before = frames();
	ASSERT_TRUE(number_value(camera, "CCD_EXPOSURE", "EXPOSURE", 0.1, INDIGO_OK_STATE));
	ASSERT_EQ_INT(before + 1, frames());
}

static void asi_reinitializes(void) {
	ASSERT_TRUE(disconnect_device(camera));
	ASSERT_TRUE(disconnect_device(guider));
	ASSERT_TRUE(driver_entry(INDIGO_DRIVER_SHUTDOWN, NULL) == INDIGO_OK);
	driver_initialized = false;
#ifdef ASI_DYNAMIC_DRIVER
	ASSERT_TRUE(dlclose(driver_library) == 0);
	driver_library = NULL;
	driver_entry = NULL;
	ASSERT_TRUE(load_driver_library());
	printf("    dynamic driver dlclose/dlopen completed\n");
#endif
	ASSERT_TRUE(driver_entry(INDIGO_DRIVER_INIT, NULL) == INDIGO_OK);
	driver_initialized = true;
	ASSERT_TRUE(wait_presence(true));
	ASSERT_TRUE(connect_device(camera));
	ASSERT_TRUE(connect_device(guider));
	ASSERT_TRUE(prepare_client_raw());
	unsigned before = frames();
	ASSERT_TRUE(number_value(camera, "CCD_EXPOSURE", "EXPOSURE", 0.1, INDIGO_OK_STATE));
	ASSERT_EQ_INT(before + 1, frames());
#ifdef ASI_DYNAMIC_DRIVER
	printf("    fresh exposure after dynamic driver reload: PASS\n");
#else
	printf("    driver shutdown/reinitialization: fresh queue and exposure succeeded (SDK library remains loaded)\n");
#endif
}

static void asi_delivered_only_valid_frames(void) {
	pthread_mutex_lock(&mutex);
	unsigned invalid = devices[camera].invalid_frames, total = devices[camera].frames;
	pthread_mutex_unlock(&mutex);
	printf("    %u frames delivered, %u malformed\n", total, invalid);
	ASSERT_TRUE(total > 0);
	ASSERT_EQ_INT(0, invalid);
}

static void asi_survives_transport_loss_while_idle(void) {
	ASSERT_TRUE(physical_cycle("idle"));
}

static void asi_survives_transport_loss_during_exposure(void) {
	unsigned before = revision(camera, "CCD_EXPOSURE");
	indigo_change_number_property_1(&client, devices[camera].name, "CCD_EXPOSURE", "EXPOSURE", 120);
	ASSERT_TRUE(wait_state(camera, "CCD_EXPOSURE", before, INDIGO_BUSY_STATE));
	ASSERT_TRUE(physical_cycle("long exposure"));
}

static void asi_survives_transport_loss_during_streaming(void) {
	unsigned before = frames(), changed = revision(camera, "CCD_STREAMING");
	indigo_change_number_property(&client, devices[camera].name, "CCD_STREAMING", 2, (const char *[]){ "EXPOSURE", "COUNT" }, (double[]){ 0.1, -1 });
	ASSERT_TRUE(wait_state(camera, "CCD_STREAMING", changed, INDIGO_BUSY_STATE));
	double deadline = indigo_monotonic_time() + 20;
	while (frames() < before + 3 && indigo_monotonic_time() < deadline) {
		indigo_usleep(10000);
	}
	ASSERT_TRUE(frames() >= before + 3);
	ASSERT_TRUE(physical_cycle("streaming"));
}

static void asi_survives_transport_loss_during_guiding(void) {
	if (guider < 0) {
		printf("    no ST4 port, removal during guiding is not applicable\n");
		return;
	}
	unsigned before = revision(guider, "GUIDER_GUIDE_RA");
	indigo_change_number_property_1(&client, devices[guider].name, "GUIDER_GUIDE_RA", "EAST", 60000);
	ASSERT_TRUE(wait_state(guider, "GUIDER_GUIDE_RA", before, INDIGO_BUSY_STATE));
	unsigned exposure_before = revision(camera, "CCD_EXPOSURE");
	indigo_change_number_property_1(&client, devices[camera].name, "CCD_EXPOSURE", "EXPOSURE", 120);
	ASSERT_TRUE(wait_state(camera, "CCD_EXPOSURE", exposure_before, INDIGO_BUSY_STATE));
	ASSERT_TRUE(physical_cycle("guiding"));
}

static void asi_writes_the_flash_suffix_across_replug(void) {
	ASSERT_TRUE(suffix_acceptance());
}

static void asi_measures_abort_latency(void) {
	if (abort_agent_only) {
		ASSERT_TRUE(indigo_agent_imager(INDIGO_DRIVER_INIT, NULL) == INDIGO_OK);
		for (int d = 0; d < MAX_DEVICES; d++) {
			if (!strcmp(devices[d].name, "Imager Agent")) {
				imager = d;
			}
		}
		ASSERT_TRUE(imager >= 0);
		ASSERT_TRUE(switch_value(imager, "FILTER_CCD_LIST", devices[camera].name, INDIGO_OK_STATE));
		unsigned features_revision = revision(imager, "AGENT_PROCESS_FEATURES");
		indigo_change_switch_property_1(&client, devices[imager].name, "AGENT_PROCESS_FEATURES", "ENABLE_DITHERING", false);
		ASSERT_TRUE(wait_state(imager, "AGENT_PROCESS_FEATURES", features_revision, INDIGO_OK_STATE));
	}
	bool ok = abort_latency_trials();
	if (abort_agent_only) {
		indigo_change_switch_property_1(&client, devices[imager].name, "AGENT_ABORT_PROCESS", "ABORT", true);
		if (indigo_agent_imager(INDIGO_DRIVER_SHUTDOWN, NULL) != INDIGO_OK) {
			indigo_test_failures++;
		}
		imager = -1;
	}
	ASSERT_TRUE(ok);
}

int main(int argc, char **argv) {
	bool run = false;
	const char *filter = NULL;
	for (int i = 1; i < argc; i++) {
		if (!strcmp(argv[i], "--run")) {
			run = true;
		} else if (!strcmp(argv[i], "--hotplug")) {
			hotplug = true;
		} else if (!strcmp(argv[i], "--acceptance")) {
			acceptance = hotplug = true;
		} else if (!strcmp(argv[i], "--suffix")) {
			suffix_only = true;
		} else if (!strcmp(argv[i], "--abort-latency")) {
			abort_latency_only = true;
		} else if (!strcmp(argv[i], "--abort-agent")) {
			abort_latency_only = abort_agent_only = true;
		} else if (!strcmp(argv[i], "--abort-previews")) {
			abort_latency_only = abort_agent_only = abort_previews_only = true;
		} else if (!strcmp(argv[i], "--debug")) {
			indigo_set_log_level(INDIGO_LOG_DEBUG);
		} else {
			filter = argv[i];
		}
	}
	if (!run) {
		fprintf(stderr, "This test operates a physical ZWO ASI camera. Run with --run [--hotplug|--acceptance|--suffix|--abort-latency|--abort-agent|--abort-previews] [--debug] [name filter].\n");
		return 2;
	}
	setvbuf(stdout, NULL, _IONBF, 0);
	client = (indigo_client){ .name = "ASI hardware test", .version = INDIGO_VERSION_CURRENT, .define_property = define_property, .update_property = update_property, .delete_property = delete_property, .send_message = report_message };
	if (!indigo_test_mkdtemp_home(config_folder)) {
		return 1;
	}
#ifdef ASI_DYNAMIC_DRIVER
	if (!load_driver_library()) {
		return 1;
	}
#endif
	// The dynamic loader build only proves that the driver can be unloaded and reloaded, so it runs
	// the identity, property and acquisition checks plus the reload itself.
	const indigo_test_case tests[] = {
		{ "asi_reports_identity_and_capabilities", asi_reports_identity_and_capabilities },
		{ "asi_publishes_the_property_contract", asi_publishes_the_property_contract },
#ifndef ASI_DYNAMIC_DRIVER
		{ "asi_exposes_every_pixel_format", asi_exposes_every_pixel_format },
		{ "asi_exposes_bins_and_roi", asi_exposes_bins_and_roi },
		{ "asi_exposes_every_frame_type", asi_exposes_every_frame_type },
		{ "asi_saves_and_loads_configuration", asi_saves_and_loads_configuration },
		{ "asi_writes_advanced_controls", asi_writes_advanced_controls },
		{ "asi_applies_presets", asi_applies_presets },
		{ "asi_controls_cooling", asi_controls_cooling },
		{ "asi_takes_fractional_exposures", asi_takes_fractional_exposures },
		{ "asi_guides_during_a_long_exposure", asi_guides_during_a_long_exposure },
		{ "asi_aborts_a_long_exposure_and_reacquires", asi_aborts_a_long_exposure_and_reacquires },
		{ "asi_streams_an_exact_frame_count", asi_streams_an_exact_frame_count },
		{ "asi_streams_indefinitely_and_stops", asi_streams_indefinitely_and_stops },
		{ "asi_streams_long_frames_and_stops", asi_streams_long_frames_and_stops },
		{ "asi_pulses_every_guide_direction", asi_pulses_every_guide_direction },
		{ "asi_guides_on_both_axes_simultaneously", asi_guides_on_both_axes_simultaneously },
		{ "asi_replaces_an_overlapping_guide_pulse", asi_replaces_an_overlapping_guide_pulse },
		{ "asi_disconnects_the_guider_during_a_pulse", asi_disconnects_the_guider_during_a_pulse },
		{ "asi_disconnects_the_ccd_with_a_live_guider", asi_disconnects_the_ccd_with_a_live_guider },
		{ "asi_connects_the_ccd_before_the_guider", asi_connects_the_ccd_before_the_guider },
		{ "asi_rejects_changes_during_acquisition", asi_rejects_changes_during_acquisition },
		{ "asi_writes_and_restores_the_custom_suffix", asi_writes_and_restores_the_custom_suffix },
		{ "asi_rejects_shutdown_while_connected", asi_rejects_shutdown_while_connected },
#endif
		{ "asi_takes_repeated_short_exposures", asi_takes_repeated_short_exposures },
		{ "asi_reconnects", asi_reconnects },
		{ "asi_reinitializes", asi_reinitializes },
		{ "asi_delivered_only_valid_frames", asi_delivered_only_valid_frames }
	};
	const indigo_test_case hotplug_tests[] = {
		{ "asi_survives_transport_loss_while_idle", asi_survives_transport_loss_while_idle },
		{ "asi_survives_transport_loss_during_exposure", asi_survives_transport_loss_during_exposure },
		{ "asi_survives_transport_loss_during_streaming", asi_survives_transport_loss_during_streaming },
		{ "asi_survives_transport_loss_during_guiding", asi_survives_transport_loss_during_guiding }
	};
	const indigo_test_case suffix_tests[] = { { "asi_writes_the_flash_suffix_across_replug", asi_writes_the_flash_suffix_across_replug } };
	const indigo_test_case abort_tests[] = { { "asi_measures_abort_latency", asi_measures_abort_latency } };
	int result = 1;
	if (!begin_session()) {
		indigo_test_failures++;
		goto cleanup;
	}
	if (abort_latency_only) {
		result = indigo_run_tests("ASI hardware", abort_tests, ARRAY_SIZE(abort_tests));
	} else if (suffix_only) {
		result = indigo_run_tests("ASI hardware", suffix_tests, ARRAY_SIZE(suffix_tests));
	} else {
		int matched = 0;
		indigo_test_case selected[ARRAY_SIZE(tests) + ARRAY_SIZE(hotplug_tests) + ARRAY_SIZE(suffix_tests)];
		for (int i = 0; i < ARRAY_SIZE(tests); i++) {
			if (filter == NULL || strstr(tests[i].name, filter)) {
				selected[matched++] = tests[i];
			}
		}
		if (hotplug) {
			for (int i = 0; i < ARRAY_SIZE(hotplug_tests); i++) {
				if (filter == NULL || strstr(hotplug_tests[i].name, filter)) {
					selected[matched++] = hotplug_tests[i];
				}
			}
		}
		if (acceptance && (filter == NULL || strstr(suffix_tests[0].name, filter))) {
			selected[matched++] = suffix_tests[0];
		}
		result = matched ? indigo_run_tests("ASI hardware", selected, matched) : 1;
	}
cleanup:
	end_session();
	for (int d = 0; d < MAX_DEVICES; d++) {
		for (int p = 0; p < MAX_PROPERTIES; p++) {
			indigo_release_property(devices[d].properties[p]);
			devices[d].properties[p] = NULL;
		}
	}
	DIR *dir = opendir(config_folder);
	if (dir) {
		struct dirent *entry;
		while ((entry = readdir(dir))) {
			if (entry->d_name[0] != '.') {
				char path[1024];
				snprintf(path, sizeof(path), "%s/%s", config_folder, entry->d_name);
				unlink(path);
			}
		}
		closedir(dir);
	}
	indigo_test_remove_tree(config_folder);
#ifdef ASI_DYNAMIC_DRIVER
	if (driver_library && dlclose(driver_library) != 0) {
		result = 1;
	}
#endif
	return indigo_test_failures ? 1 : result;
}
