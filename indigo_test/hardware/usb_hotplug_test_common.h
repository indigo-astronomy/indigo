// Copyright (c) 2026 INDIGO initiative
// All rights reserved.
//
// You may use this software under the terms of 'INDIGO Astronomy
// open-source license' (see LICENSE.md).
//
// THIS SOFTWARE IS PROVIDED BY THE AUTHORS 'AS IS' AND ANY EXPRESS
// OR IMPLIED WARRANTIES, INCLUDING, BUT NOT LIMITED TO, THE IMPLIED
// WARRANTIES OF MERCHANTABILITY AND FITNESS FOR A PARTICULAR PURPOSE
// ARE DISCLAIMED. IN NO EVENT SHALL THE AUTHOR BE LIABLE FOR ANY
// DIRECT, INDIRECT, INCIDENTAL, SPECIAL, EXEMPLARY, OR CONSEQUENTIAL
// DAMAGES (INCLUDING, BUT NOT LIMITED TO, PROCUREMENT OF SUBSTITUTE
// GOODS OR SERVICES; LOSS OF USE, DATA, OR PROFITS; OR BUSINESS
// INTERRUPTION) HOWEVER CAUSED AND ON ANY THEORY OF LIABILITY,
// WHETHER IN CONTRACT, STRICT LIABILITY, OR TORT (INCLUDING
// NEGLIGENCE OR OTHERWISE) ARISING IN ANY WAY OUT OF THE USE OF THIS
// SOFTWARE, EVEN IF ADVISED OF THE POSSIBILITY OF SUCH DAMAGE.

// Code is generated by AI

// Switches the power of a single USB port off and on, so a hardware test can exercise the hot-plug
// path of a USB driver without a person pulling a cable. It is the unattended counterpart of the
// "unplug the camera now" prompt the older hardware tests print, and it is what makes a hot-plug
// scenario runnable from a Makefile target or from CI on a remote machine.
//
// The port is switched through the kernel's per-port `disable` attribute, not through libusb and
// not through uhubctl. On a Raspberry Pi 5 root hub a uhubctl power-off is accepted and reported
// back as "off" while the device stays enumerated, so the driver never sees a disconnect and the
// scenario silently tests nothing. Writing 1 to `disable` clears PORT_POWER on a hub that supports
// per-port power switching *and* tears the device down in the USB core, which is the event a
// driver's libusb hot-plug callback is waiting for.
//
// Cutting the power of the wrong port takes the machine down with it, so a port is only ever
// switched after usb_hotplug_protected() has cleared it. A port is protected when a mass storage
// device hangs below it or when the root filesystem is served from below it, which on a machine
// that boots from a USB SSD is the same port.
//
// The attribute is a Linux interface and macOS has no equivalent, so this header compiles
// everywhere but reports the host as unsupported anywhere else. A suite built on it therefore has
// to skip rather than fail when USB_HOTPLUG_SUPPORTED is 0, which keeps the shared test targets
// building and passing on both supported platforms.

#ifndef indigo_usb_hotplug_test_common_h
#define indigo_usb_hotplug_test_common_h

#include <dirent.h>
#include <limits.h>
#include <stdbool.h>
#include <stdio.h>
#include <stdlib.h>
#include <string.h>
#include <sys/stat.h>
#include <unistd.h>
#include <indigo/indigo_bus.h>

#ifdef __linux__
#define USB_HOTPLUG_SUPPORTED 1
#else
#define USB_HOTPLUG_SUPPORTED 0
#endif

#define USB_SYSFS_DEVICES "/sys/bus/usb/devices"
#define USB_HOTPLUG_MAX_PARKED 16

typedef struct {
	char device[64];              // sysfs name of the device on the port, e.g. "4-1" or "1-2.3"
	char disable_path[PATH_MAX];  // the hub port's `disable` attribute
	unsigned vendor, product;
	char product_name[128];
	bool off;
} usb_hotplug_port;

// A sysfs USB device directory is <bus>-<port>[.<port>...]; anything with a colon is an interface
// and anything starting with "usb" is a root hub. Neither can be switched.
static bool usb_hotplug_is_device(const char *name) {
	if (strchr(name, ':') || !strncmp(name, "usb", 3)) {
		return false;
	}
	return strchr(name, '-') != NULL;
}

static bool usb_hotplug_read_attribute(const char *device, const char *attribute, char *value, size_t size) {
	char path[PATH_MAX];
	snprintf(path, sizeof(path), "%s/%s/%s", USB_SYSFS_DEVICES, device, attribute);
	FILE *file = fopen(path, "r");
	if (!file) {
		return false;
	}
	bool ok = fgets(value, (int)size, file) != NULL;
	fclose(file);
	if (ok) {
		value[strcspn(value, "\r\n")] = 0;
	}
	return ok;
}

// The `disable` attribute lives on the port of the *parent* hub, under that hub's first interface,
// in a directory named <hub>-port<n>. The parent of "4-1" is root hub "usb4", the parent of
// "1-2.3" is the hub "1-2".
static bool usb_hotplug_disable_path(const char *device, char *path, size_t size) {
	const char *separator = strrchr(device, '.');
	char parent[64];
	unsigned long port;
	if (separator) {
		snprintf(parent, sizeof(parent), "%.*s", (int)(separator - device), device);
		port = strtoul(separator + 1, NULL, 10);
	} else {
		separator = strchr(device, '-');
		if (!separator) {
			return false;
		}
		snprintf(parent, sizeof(parent), "usb%.*s", (int)(separator - device), device);
		port = strtoul(separator + 1, NULL, 10);
	}
	if (port == 0) {
		return false;
	}
	// A root hub's interface is <bus>-0:1.0, an external hub's is <hub>:1.0.
	char interface[80];
	if (!strncmp(parent, "usb", 3)) {
		snprintf(interface, sizeof(interface), "%s-0:1.0", parent + 3);
	} else {
		snprintf(interface, sizeof(interface), "%s:1.0", parent);
	}
	snprintf(path, size, "%s/%s/%s/%s-port%lu/disable", USB_SYSFS_DEVICES, parent, interface, parent, port);
	return access(path, F_OK) == 0;
}

// The sysfs path of the block device the root filesystem is mounted from, which on a machine that
// boots from a USB disk names every USB device between the host controller and that disk.
static const char *usb_hotplug_root_device_path(void) {
	static char resolved[PATH_MAX];
	static bool looked_up = false;
	if (looked_up) {
		return *resolved ? resolved : NULL;
	}
	looked_up = true;
	FILE *file = fopen("/proc/self/mountinfo", "r");
	if (!file) {
		return NULL;
	}
	char line[4096], major_minor[64] = "";
	while (fgets(line, sizeof(line), file)) {
		// Sized from the scanf width below rather than from PATH_MAX, which is smaller than a
		// mountinfo line on macOS and makes the call look like an overflow to the compiler.
		char device[64], mount_point[4096];
		// mountinfo: id parent major:minor root mount-point ...
		if (sscanf(line, "%*d %*d %63s %*s %4095s", device, mount_point) == 2 && !strcmp(mount_point, "/")) {
			snprintf(major_minor, sizeof(major_minor), "%s", device);
			break;
		}
	}
	fclose(file);
	if (!*major_minor) {
		return NULL;
	}
	char link[PATH_MAX];
	snprintf(link, sizeof(link), "/sys/dev/block/%s", major_minor);
	if (!realpath(link, resolved)) {
		*resolved = 0;
		return NULL;
	}
	return resolved;
}

// True when switching this port off would take a disk, and with it possibly the running system,
// away. Both tests are needed: a data disk that is not the boot disk has no mount below "/" to
// find, and a boot disk behind a hub is only visible as the hub's descendant.
static bool usb_hotplug_protected(const char *device, const char **reason) {
	const char *root = usb_hotplug_root_device_path();
	char needle[80];
	snprintf(needle, sizeof(needle), "/%s/", device);
	if (root && strstr(root, needle)) {
		*reason = "the root filesystem is served from below it";
		return true;
	}
	DIR *dir = opendir(USB_SYSFS_DEVICES);
	if (!dir) {
		*reason = "the USB device list cannot be read";
		return true;
	}
	size_t length = strlen(device);
	bool protect = false;
	struct dirent *entry;
	while ((entry = readdir(dir)) && !protect) {
		// Interfaces of the device itself and of everything below it: "4-1:1.0", "4-1.2:1.0".
		if (strncmp(entry->d_name, device, length) || !strchr(entry->d_name, ':')) {
			continue;
		}
		if (entry->d_name[length] != ':' && entry->d_name[length] != '.') {
			continue;
		}
		char class[16];
		char path[PATH_MAX];
		snprintf(path, sizeof(path), "%s/%s/bInterfaceClass", USB_SYSFS_DEVICES, entry->d_name);
		FILE *file = fopen(path, "r");
		if (file) {
			if (fgets(class, sizeof(class), file) && strtoul(class, NULL, 16) == 8) {
				protect = true;
				*reason = "a USB mass storage device is attached below it";
			}
			fclose(file);
		}
	}
	closedir(dir);
	return protect;
}

// Writing a port attribute needs root. A test is deliberately not run as root, so the write is
// tried directly first, for a system whose udev rules hand the port over to the console user, and
// falls back to a password-less sudo.
static bool usb_hotplug_write(const char *path, const char *value) {
	FILE *file = fopen(path, "w");
	if (file) {
		bool ok = fputs(value, file) >= 0;
		ok = fclose(file) == 0 && ok;
		if (ok) {
			return true;
		}
	}
	const char *sudo = getenv("HW_USB_SUDO");
	char command[PATH_MAX + 128];
	snprintf(command, sizeof(command), "%s sh -c 'echo %s > %s'", sudo && *sudo ? sudo : "sudo -n", value, path);
	int status = system(command);
	if (status != 0) {
		fprintf(stderr, "    cannot write %s to %s, run with HW_USB_SUDO set or grant the port to this user\n", value, path);
		return false;
	}
	return true;
}

static bool usb_hotplug_present(const usb_hotplug_port *port) {
	char path[PATH_MAX];
	snprintf(path, sizeof(path), "%s/%s", USB_SYSFS_DEVICES, port->device);
	return access(path, F_OK) == 0;
}

static bool usb_hotplug_wait_presence(const usb_hotplug_port *port, bool present, double timeout) {
	double deadline = indigo_monotonic_time() + timeout;
	while (indigo_monotonic_time() < deadline) {
		if (usb_hotplug_present(port) == present) {
			return true;
		}
		indigo_usleep(20000);
	}
	fprintf(stderr, "    %s did not %s within %gs\n", port->device, present ? "re-enumerate" : "disappear", timeout);
	return false;
}

// Finds the port of the first device matching one of the vendor ids. The device has to be attached
// when the test starts, because a switched-off port has no device to match and the port it belongs
// to can no longer be derived from the hardware.
static bool usb_hotplug_find(const unsigned *vendors, int vendor_count, usb_hotplug_port *port) {
	if (!USB_HOTPLUG_SUPPORTED) {
		fprintf(stderr, "    switching a USB port off needs a Linux host\n");
		return false;
	}
	DIR *dir = opendir(USB_SYSFS_DEVICES);
	if (!dir) {
		fprintf(stderr, "    %s is not readable, this test needs a Linux host\n", USB_SYSFS_DEVICES);
		return false;
	}
	memset(port, 0, sizeof(*port));
	struct dirent *entry;
	while ((entry = readdir(dir))) {
		char value[64];
		if (!usb_hotplug_is_device(entry->d_name) || !usb_hotplug_read_attribute(entry->d_name, "idVendor", value, sizeof(value))) {
			continue;
		}
		unsigned vendor = (unsigned)strtoul(value, NULL, 16);
		bool wanted = false;
		for (int i = 0; i < vendor_count && !wanted; i++) {
			wanted = vendors[i] == vendor;
		}
		if (!wanted) {
			continue;
		}
		const char *reason = NULL;
		if (usb_hotplug_protected(entry->d_name, &reason)) {
			fprintf(stderr, "    refusing to switch %s: %s\n", entry->d_name, reason);
			continue;
		}
		if (!usb_hotplug_disable_path(entry->d_name, port->disable_path, sizeof(port->disable_path))) {
			fprintf(stderr, "    %s has no switchable hub port\n", entry->d_name);
			continue;
		}
		snprintf(port->device, sizeof(port->device), "%s", entry->d_name);
		port->vendor = vendor;
		if (usb_hotplug_read_attribute(entry->d_name, "idProduct", value, sizeof(value))) {
			port->product = (unsigned)strtoul(value, NULL, 16);
		}
		usb_hotplug_read_attribute(entry->d_name, "product", port->product_name, sizeof(port->product_name));
		break;
	}
	closedir(dir);
	if (!*port->device) {
		fprintf(stderr, "    no switchable USB device of vendor");
		for (int i = 0; i < vendor_count; i++) {
			fprintf(stderr, " %04x", vendors[i]);
		}
		fprintf(stderr, " is attached\n");
		return false;
	}
	return true;
}

static bool usb_hotplug_off(usb_hotplug_port *port, double timeout) {
	printf("    switching USB port of %s off\n", port->device);
	if (!usb_hotplug_write(port->disable_path, "1")) {
		return false;
	}
	port->off = true;
	return usb_hotplug_wait_presence(port, false, timeout);
}

static bool usb_hotplug_on(usb_hotplug_port *port, double timeout) {
	printf("    switching USB port of %s on\n", port->device);
	if (!usb_hotplug_write(port->disable_path, "0")) {
		return false;
	}
	port->off = false;
	return usb_hotplug_wait_presence(port, true, timeout);
}

// Switches one port off and on again, leaving it off for `off_time` so the device fully loses its
// state, and returns once the device is enumerated again.
static bool usb_hotplug_cycle(usb_hotplug_port *port, double off_time, double timeout) {
	if (!usb_hotplug_off(port, timeout)) {
		return false;
	}
	indigo_usleep((unsigned long)(off_time * 1000000));
	return usb_hotplug_on(port, timeout);
}

// Ports switched off by usb_hotplug_park_others(), so they can be switched back on afterwards.
static usb_hotplug_port usb_hotplug_parked[USB_HOTPLUG_MAX_PARKED];
static int usb_hotplug_parked_count;

// Switches off every other switchable USB device port, for a host whose power budget cannot carry
// all attached devices at once. A protected port is never switched, so the system disk keeps its
// power. Call usb_hotplug_unpark_others() before returning from main().
static int usb_hotplug_park_others(const usb_hotplug_port *keep) {
	DIR *dir = opendir(USB_SYSFS_DEVICES);
	if (!dir) {
		return 0;
	}
	struct dirent *entry;
	while ((entry = readdir(dir)) && usb_hotplug_parked_count < USB_HOTPLUG_MAX_PARKED) {
		const char *reason = NULL;
		usb_hotplug_port other;
		if (!usb_hotplug_is_device(entry->d_name) || !strcmp(entry->d_name, keep->device)) {
			continue;
		}
		if (usb_hotplug_protected(entry->d_name, &reason)) {
			continue;
		}
		memset(&other, 0, sizeof(other));
		snprintf(other.device, sizeof(other.device), "%s", entry->d_name);
		if (!usb_hotplug_disable_path(other.device, other.disable_path, sizeof(other.disable_path))) {
			continue;
		}
		usb_hotplug_read_attribute(other.device, "product", other.product_name, sizeof(other.product_name));
		printf("    parking unused USB port of %s (%s)\n", other.device, other.product_name);
		if (usb_hotplug_write(other.disable_path, "1")) {
			other.off = true;
			usb_hotplug_parked[usb_hotplug_parked_count++] = other;
		}
	}
	closedir(dir);
	return usb_hotplug_parked_count;
}

static void usb_hotplug_unpark_others(void) {
	for (int i = 0; i < usb_hotplug_parked_count; i++) {
		printf("    restoring USB port of %s\n", usb_hotplug_parked[i].device);
		usb_hotplug_write(usb_hotplug_parked[i].disable_path, "0");
	}
	usb_hotplug_parked_count = 0;
}

#endif /* indigo_usb_hotplug_test_common_h */
