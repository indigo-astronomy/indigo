// Copyright (c) 2026 INDIGO initiative
// All rights reserved.
//
// You may use this software under the terms of 'INDIGO Astronomy
// open-source license' (see LICENSE.md).
//
// THIS SOFTWARE IS PROVIDED BY THE AUTHORS 'AS IS' AND ANY EXPRESS
// OR IMPLIED WARRANTIES, INCLUDING, BUT NOT LIMITED TO, THE IMPLIED
// WARRANTIES OF MERCHANTABILITY AND FITNESS FOR A PARTICULAR PURPOSE
// ARE DISCLAIMED. IN NO EVENT SHALL THE AUTHOR BE LIABLE FOR ANY
// DIRECT, INDIRECT, INCIDENTAL, SPECIAL, EXEMPLARY, OR CONSEQUENTIAL
// DAMAGES (INCLUDING, BUT NOT LIMITED TO, PROCUREMENT OF SUBSTITUTE
// GOODS OR SERVICES; LOSS OF USE, DATA, OR PROFITS; OR BUSINESS
// INTERRUPTION) HOWEVER CAUSED AND ON ANY THEORY OF LIABILITY,
// WHETHER IN CONTRACT, STRICT LIABILITY, OR TORT (INCLUDING
// NEGLIGENCE OR OTHERWISE) ARISING IN ANY WAY OUT OF THE USE OF THIS
// SOFTWARE, EVEN IF ADVISED OF THE POSSIBILITY OF SUCH DAMAGE.

// Code is generated by AI

// Opt-in acceptance test for a physically connected PegasusAstro DMFC, or for the Arduino sketch
// focuser_dmfc_simulator.ino running on a board. It checks the status line read at the connection, moves to
// absolute positions and by steps both ways, aborts a move, syncs the position, and sets and reads back the
// speed, backlash, direction, LED, encoder and motor type; then it reconnects and runs driver INIT/SHUTDOWN.
//
// THE FOCUSER MOVES. Speed, backlash and motor type are stored in the controller's EEPROM; the session writes back
// every setting and the position it found.
//
// The port comes from DMFC_HW_PORT.

#include <math.h>
#include <stdlib.h>
#include <indigo_drivers/focuser_dmfc/indigo_focuser_dmfc.h>
#include "focuser_hw_common.h"

#define DEVICE_NAME "Pegasus DMFC"

#define SHORT_TIMEOUT 15.0
#define MOVE_TIMEOUT 120.0
#define TRAVEL 2000

static int focuser = -1;
static const char *serial_port = NULL;
static bool state_captured = false, reversed = false, led_on = false, encoder_off = false, stepper = true;
static double initial_position = 0, initial_speed = 0, initial_backlash = 0, base = 0;

static bool select_port(void) {
	if (serial_port == NULL || !*serial_port) {
		fprintf(stderr, "    set DMFC_HW_PORT to the controller's port\n");
		return false;
	}
	printf("Using port %s\n", serial_port);
	return hw_set_text(focuser, DEVICE_PORT_PROPERTY_NAME, DEVICE_PORT_ITEM_NAME, serial_port, INDIGO_OK_STATE, SHORT_TIMEOUT);
}

static bool sync_to(double value) {
	return focuser_hw_set_switch(focuser, FOCUSER_ON_POSITION_SET_PROPERTY_NAME, FOCUSER_ON_POSITION_SET_SYNC_ITEM_NAME, SHORT_TIMEOUT) && focuser_hw_goto(focuser, value, INDIGO_OK_STATE, SHORT_TIMEOUT) && focuser_hw_set_switch(focuser, FOCUSER_ON_POSITION_SET_PROPERTY_NAME, FOCUSER_ON_POSITION_SET_GOTO_ITEM_NAME, SHORT_TIMEOUT);
}

static bool set_number(const char *property, const char *item, double value) {
	return focuser_hw_set_number(focuser, property, item, value, INDIGO_OK_STATE, SHORT_TIMEOUT) && focuser_hw_value(focuser, property, item) == value;
}

static void restore_initial_state(void) {
	if (focuser < 0 || !state_captured || !hw_connected(focuser)) {
		return;
	}
	focuser_hw_idle(focuser, FOCUSER_POSITION_PROPERTY_NAME, MOVE_TIMEOUT);
	if (focuser_hw_switch_is(focuser, FOCUSER_ON_POSITION_SET_PROPERTY_NAME, FOCUSER_ON_POSITION_SET_SYNC_ITEM_NAME)) {
		focuser_hw_set_switch(focuser, FOCUSER_ON_POSITION_SET_PROPERTY_NAME, FOCUSER_ON_POSITION_SET_GOTO_ITEM_NAME, SHORT_TIMEOUT);
	}
	focuser_hw_set_switch(focuser, FOCUSER_REVERSE_MOTION_PROPERTY_NAME, reversed ? FOCUSER_REVERSE_MOTION_ENABLED_ITEM_NAME : FOCUSER_REVERSE_MOTION_DISABLED_ITEM_NAME, SHORT_TIMEOUT);
	focuser_hw_set_switch(focuser, "X_FOCUSER_LED", led_on ? "ENABLED" : "DISABLED", SHORT_TIMEOUT);
	focuser_hw_set_switch(focuser, "X_FOCUSER_ENCODER", encoder_off ? "DISABLED" : "ENABLED", SHORT_TIMEOUT);
	focuser_hw_set_switch(focuser, "X_FOCUSER_MOTOR_TYPE", stepper ? "STEPPER" : "DC", SHORT_TIMEOUT);
	set_number(FOCUSER_BACKLASH_PROPERTY_NAME, FOCUSER_BACKLASH_ITEM_NAME, initial_backlash);
	set_number(FOCUSER_SPEED_PROPERTY_NAME, FOCUSER_SPEED_ITEM_NAME, initial_speed);
	focuser_hw_goto(focuser, initial_position, INDIGO_OK_STATE, MOVE_TIMEOUT);
}

static void dmfc_publishes_the_status(void) {
	char model[INDIGO_VALUE_SIZE] = "", firmware[INDIGO_VALUE_SIZE] = "";
	ASSERT_TRUE((hw_device_interface(focuser) & INDIGO_INTERFACE_FOCUSER) != 0);
	ASSERT_TRUE(hw_text_item(focuser, INFO_PROPERTY_NAME, INFO_DEVICE_MODEL_ITEM_NAME, model, sizeof(model)));
	ASSERT_TRUE(hw_text_item(focuser, INFO_PROPERTY_NAME, INFO_DEVICE_FW_REVISION_ITEM_NAME, firmware, sizeof(firmware)));
	double temperature = focuser_hw_value(focuser, FOCUSER_TEMPERATURE_PROPERTY_NAME, FOCUSER_TEMPERATURE_ITEM_NAME);
	printf("    %s firmware %s, position %g, speed %g, backlash %g, %.1f C, %s motor, LED %s, encoder %s, %s\n", model, firmware, initial_position, initial_speed, initial_backlash, temperature, stepper ? "stepper" : "DC", led_on ? "on" : "off", encoder_off ? "off" : "on", reversed ? "reversed" : "normal");
	ASSERT_TRUE(*model && *firmware && strcmp(firmware, "Unknown"));
	ASSERT_TRUE(initial_speed >= 100 && initial_speed <= 1000);
	// -127 or an out-of-range value marks a missing probe, which leaves the property in ALERT.
	ASSERT_TRUE(hw_property_state(focuser, FOCUSER_TEMPERATURE_PROPERTY_NAME) == INDIGO_ALERT_STATE || (temperature > -55 && temperature < 125));
	static const char *properties[] = { "X_FOCUSER_MOTOR_TYPE", "X_FOCUSER_ENCODER", "X_FOCUSER_LED", FOCUSER_BACKLASH_PROPERTY_NAME, FOCUSER_REVERSE_MOTION_PROPERTY_NAME, FOCUSER_SPEED_PROPERTY_NAME, FOCUSER_ABORT_MOTION_PROPERTY_NAME, FOCUSER_LIMITS_PROPERTY_NAME };
	for (int i = 0; i < ARRAY_SIZE(properties); i++) {
		ASSERT_TRUE(hw_property_defined(focuser, properties[i]));
	}
}

static void dmfc_moves_to_absolute_positions(void) {
	ASSERT_TRUE(set_number(FOCUSER_SPEED_PROPERTY_NAME, FOCUSER_SPEED_ITEM_NAME, 1000));
	ASSERT_TRUE(focuser_hw_goto(focuser, base + TRAVEL, INDIGO_OK_STATE, MOVE_TIMEOUT));
	ASSERT_TRUE(focuser_hw_goto(focuser, base + 13, INDIGO_OK_STATE, MOVE_TIMEOUT));
	ASSERT_TRUE(focuser_hw_goto(focuser, base, INDIGO_OK_STATE, MOVE_TIMEOUT));
	ASSERT_TRUE(focuser_hw_goto(focuser, base, INDIGO_OK_STATE, SHORT_TIMEOUT));
}

// The Pegasus drivers count an inward move as increasing the position (G:+n), the opposite of most focusers, so
// the steps are checked by distance and by the way back.
static void dmfc_moves_by_steps(void) {
	ASSERT_TRUE(focuser_hw_steps(focuser, true, 300, INDIGO_OK_STATE, MOVE_TIMEOUT));
	double outward = focuser_hw_position(focuser);
	ASSERT_EQ_INT(300, abs((int)(outward - base)));
	ASSERT_TRUE(focuser_hw_steps(focuser, false, 300, INDIGO_OK_STATE, MOVE_TIMEOUT));
	ASSERT_EQ_INT((int)base, (int)focuser_hw_position(focuser));
	ASSERT_TRUE(focuser_hw_steps(focuser, false, 300, INDIGO_OK_STATE, MOVE_TIMEOUT));
	ASSERT_EQ_INT((int)(2 * base - outward), (int)focuser_hw_position(focuser));
	ASSERT_TRUE(focuser_hw_goto(focuser, base, INDIGO_OK_STATE, MOVE_TIMEOUT));
}

static void dmfc_aborts_a_move(void) {
	ASSERT_TRUE(set_number(FOCUSER_SPEED_PROPERTY_NAME, FOCUSER_SPEED_ITEM_NAME, 100));
	ASSERT_TRUE(focuser_hw_start_goto(focuser, base + TRAVEL, SHORT_TIMEOUT));
	indigo_usleep(2500000);
	ASSERT_TRUE(focuser_hw_abort(focuser, SHORT_TIMEOUT));
	ASSERT_TRUE(focuser_hw_idle(focuser, FOCUSER_POSITION_PROPERTY_NAME, SHORT_TIMEOUT));
	indigo_usleep(1500000);
	double stopped = focuser_hw_position(focuser);
	printf("    stopped at %g on the way from %g to %g, state %d\n", stopped, base, base + TRAVEL, hw_property_state(focuser, FOCUSER_POSITION_PROPERTY_NAME));
	ASSERT_TRUE(stopped > base && stopped < base + TRAVEL);
	indigo_usleep(1500000);
	ASSERT_EQ_INT((int)stopped, (int)focuser_hw_position(focuser));
	// the idle polls keep the requested target
	double target = NAN;
	ASSERT_TRUE(hw_number_item_target(focuser, FOCUSER_POSITION_PROPERTY_NAME, FOCUSER_POSITION_ITEM_NAME, &target));
	ASSERT_EQ_INT((int)(base + TRAVEL), (int)target);
	ASSERT_TRUE(set_number(FOCUSER_SPEED_PROPERTY_NAME, FOCUSER_SPEED_ITEM_NAME, 1000));
	ASSERT_TRUE(focuser_hw_goto(focuser, base, INDIGO_OK_STATE, MOVE_TIMEOUT));
}

static void dmfc_syncs_the_position(void) {
	ASSERT_TRUE(sync_to(base + 500));
	ASSERT_EQ_INT((int)base + 500, (int)focuser_hw_position(focuser));
	indigo_usleep(1500000);
	ASSERT_EQ_INT((int)base + 500, (int)focuser_hw_position(focuser));
	ASSERT_TRUE(sync_to(base));
}

static void dmfc_changes_the_settings(void) {
	ASSERT_TRUE(set_number(FOCUSER_BACKLASH_PROPERTY_NAME, FOCUSER_BACKLASH_ITEM_NAME, 37));
	ASSERT_TRUE(set_number(FOCUSER_BACKLASH_PROPERTY_NAME, FOCUSER_BACKLASH_ITEM_NAME, 0));
	ASSERT_TRUE(focuser_hw_set_switch(focuser, FOCUSER_REVERSE_MOTION_PROPERTY_NAME, reversed ? FOCUSER_REVERSE_MOTION_DISABLED_ITEM_NAME : FOCUSER_REVERSE_MOTION_ENABLED_ITEM_NAME, SHORT_TIMEOUT));
	ASSERT_TRUE(focuser_hw_set_switch(focuser, "X_FOCUSER_LED", led_on ? "DISABLED" : "ENABLED", SHORT_TIMEOUT));
	ASSERT_TRUE(focuser_hw_set_switch(focuser, "X_FOCUSER_ENCODER", encoder_off ? "ENABLED" : "DISABLED", SHORT_TIMEOUT));
	ASSERT_TRUE(focuser_hw_set_switch(focuser, "X_FOCUSER_MOTOR_TYPE", stepper ? "DC" : "STEPPER", SHORT_TIMEOUT));
	// The controller keeps them: a reconnect reads them back from the status line.
	ASSERT_TRUE(hw_disconnect(focuser, SHORT_TIMEOUT));
	ASSERT_TRUE(hw_connect(focuser, SHORT_TIMEOUT));
	ASSERT_EQ_INT(0, (int)focuser_hw_value(focuser, FOCUSER_BACKLASH_PROPERTY_NAME, FOCUSER_BACKLASH_ITEM_NAME));
	ASSERT_TRUE(focuser_hw_switch_is(focuser, FOCUSER_REVERSE_MOTION_PROPERTY_NAME, reversed ? FOCUSER_REVERSE_MOTION_DISABLED_ITEM_NAME : FOCUSER_REVERSE_MOTION_ENABLED_ITEM_NAME));
	ASSERT_TRUE(focuser_hw_switch_is(focuser, "X_FOCUSER_LED", led_on ? "DISABLED" : "ENABLED"));
	ASSERT_TRUE(focuser_hw_switch_is(focuser, "X_FOCUSER_ENCODER", encoder_off ? "ENABLED" : "DISABLED"));
	ASSERT_TRUE(focuser_hw_switch_is(focuser, "X_FOCUSER_MOTOR_TYPE", stepper ? "DC" : "STEPPER"));
	ASSERT_TRUE(focuser_hw_set_switch(focuser, "X_FOCUSER_MOTOR_TYPE", stepper ? "STEPPER" : "DC", SHORT_TIMEOUT));
	ASSERT_TRUE(focuser_hw_set_switch(focuser, "X_FOCUSER_ENCODER", encoder_off ? "DISABLED" : "ENABLED", SHORT_TIMEOUT));
	ASSERT_TRUE(focuser_hw_set_switch(focuser, "X_FOCUSER_LED", led_on ? "ENABLED" : "DISABLED", SHORT_TIMEOUT));
	ASSERT_TRUE(focuser_hw_set_switch(focuser, FOCUSER_REVERSE_MOTION_PROPERTY_NAME, reversed ? FOCUSER_REVERSE_MOTION_ENABLED_ITEM_NAME : FOCUSER_REVERSE_MOTION_DISABLED_ITEM_NAME, SHORT_TIMEOUT));
	ASSERT_TRUE(set_number(FOCUSER_BACKLASH_PROPERTY_NAME, FOCUSER_BACKLASH_ITEM_NAME, initial_backlash));
}

static void dmfc_reconnects(void) {
	ASSERT_TRUE(hw_disconnect(focuser, SHORT_TIMEOUT));
	ASSERT_TRUE(hw_property_hidden(focuser, FOCUSER_POSITION_PROPERTY_NAME));
	ASSERT_TRUE(hw_connect(focuser, SHORT_TIMEOUT));
	ASSERT_EQ_INT((int)base, (int)focuser_hw_position(focuser));
	ASSERT_EQ_INT(INDIGO_OK_STATE, hw_property_state(focuser, FOCUSER_POSITION_PROPERTY_NAME));
}

static void dmfc_rejects_shutdown_while_connected(void) {
	ASSERT_EQ_INT(INDIGO_BUSY, indigo_focuser_dmfc(INDIGO_DRIVER_SHUTDOWN, NULL));
	ASSERT_TRUE(hw_connected(focuser));
}

static void dmfc_reinitializes(void) {
	ASSERT_TRUE(hw_disconnect(focuser, SHORT_TIMEOUT));
	ASSERT_EQ_INT(INDIGO_OK, indigo_focuser_dmfc(INDIGO_DRIVER_SHUTDOWN, NULL));
	ASSERT_EQ_INT(-1, hw_device_index(DEVICE_NAME));
	ASSERT_EQ_INT(INDIGO_OK, indigo_focuser_dmfc(INDIGO_DRIVER_INIT, NULL));
	focuser = hw_wait_for_device(DEVICE_NAME, SHORT_TIMEOUT);
	ASSERT_TRUE(focuser >= 0);
	ASSERT_TRUE(select_port());
	ASSERT_TRUE(hw_connect(focuser, SHORT_TIMEOUT));
	ASSERT_EQ_INT((int)base, (int)focuser_hw_position(focuser));
}

int main(int argc, char **argv) {
	if (argc < 2 || strcmp(argv[1], "--run")) {
		fprintf(stderr, "Physical DMFC test: run explicitly with --run (or make test-focuser-dmfc-hw).\n");
		return 2;
	}
	setvbuf(stdout, NULL, _IONBF, 0);
	for (int i = 2; i < argc; i++) {
		if (!strcmp(argv[i], "--debug")) {
			indigo_set_log_level(INDIGO_LOG_DEBUG);
		}
	}
	if (!indigo_test_use_private_home()) {
		return 1;
	}
	serial_port = hw_port("DMFC_HW_PORT");
	const indigo_test_case tests[] = {
		{ "dmfc_publishes_the_status", dmfc_publishes_the_status },
		{ "dmfc_moves_to_absolute_positions", dmfc_moves_to_absolute_positions },
		{ "dmfc_moves_by_steps", dmfc_moves_by_steps },
		{ "dmfc_aborts_a_move", dmfc_aborts_a_move },
		{ "dmfc_syncs_the_position", dmfc_syncs_the_position },
		{ "dmfc_changes_the_settings", dmfc_changes_the_settings },
		{ "dmfc_reconnects", dmfc_reconnects },
		{ "dmfc_rejects_shutdown_while_connected", dmfc_rejects_shutdown_while_connected },
		{ "dmfc_reinitializes", dmfc_reinitializes }
	};
	int result = 1;
	bool started = false, initialized = false;
	HW_CHECK(hw_start() == INDIGO_OK);
	started = true;
	HW_CHECK(hw_attach_client("DMFC hardware test") == INDIGO_OK);
	HW_CHECK(indigo_focuser_dmfc(INDIGO_DRIVER_INIT, NULL) == INDIGO_OK);
	initialized = true;
	focuser = hw_wait_for_device(DEVICE_NAME, SHORT_TIMEOUT);
	HW_CHECK(focuser >= 0);
	HW_CHECK(select_port());
	HW_CHECK(hw_connect(focuser, SHORT_TIMEOUT));
	HW_CHECK(focuser_hw_idle(focuser, FOCUSER_POSITION_PROPERTY_NAME, MOVE_TIMEOUT));
	initial_position = focuser_hw_position(focuser);
	initial_speed = focuser_hw_value(focuser, FOCUSER_SPEED_PROPERTY_NAME, FOCUSER_SPEED_ITEM_NAME);
	initial_backlash = focuser_hw_value(focuser, FOCUSER_BACKLASH_PROPERTY_NAME, FOCUSER_BACKLASH_ITEM_NAME);
	reversed = focuser_hw_switch_is(focuser, FOCUSER_REVERSE_MOTION_PROPERTY_NAME, FOCUSER_REVERSE_MOTION_ENABLED_ITEM_NAME);
	led_on = focuser_hw_switch_is(focuser, "X_FOCUSER_LED", "ENABLED");
	encoder_off = focuser_hw_switch_is(focuser, "X_FOCUSER_ENCODER", "DISABLED");
	stepper = focuser_hw_switch_is(focuser, "X_FOCUSER_MOTOR_TYPE", "STEPPER");
	double max = focuser_hw_value(focuser, FOCUSER_LIMITS_PROPERTY_NAME, FOCUSER_LIMITS_MAX_POSITION_ITEM_NAME);
	double min = focuser_hw_value(focuser, FOCUSER_LIMITS_PROPERTY_NAME, FOCUSER_LIMITS_MIN_POSITION_ITEM_NAME);
	// Room for the relative moves on either side of the base.
	base = initial_position < min + 1000 ? min + 1000 : initial_position + TRAVEL + 1000 > max ? max - TRAVEL - 1000 : initial_position;
	state_captured = true;
	result = indigo_run_tests("DMFC hardware", tests, ARRAY_SIZE(tests));
cleanup:
	restore_initial_state();
	if (!hw_disconnect(focuser, SHORT_TIMEOUT)) {
		indigo_test_failures++;
	}
	if (initialized && indigo_focuser_dmfc(INDIGO_DRIVER_SHUTDOWN, NULL) != INDIGO_OK) {
		indigo_test_failures++;
	}
	indigo_detach_client(&hw_client);
	if (started) {
		indigo_stop();
	}
	hw_release_properties();
	indigo_test_remove_private_home();
	return indigo_test_failures ? 1 : result;
}
