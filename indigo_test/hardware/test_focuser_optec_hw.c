// Copyright (c) 2026 INDIGO initiative
// All rights reserved.
//
// You may use this software under the terms of 'INDIGO Astronomy
// open-source license' (see LICENSE.md).
//
// THIS SOFTWARE IS PROVIDED BY THE AUTHORS 'AS IS' AND ANY EXPRESS
// OR IMPLIED WARRANTIES, INCLUDING, BUT NOT LIMITED TO, THE IMPLIED
// WARRANTIES OF MERCHANTABILITY AND FITNESS FOR A PARTICULAR PURPOSE
// ARE DISCLAIMED. IN NO EVENT SHALL THE AUTHOR BE LIABLE FOR ANY
// DIRECT, INDIRECT, INCIDENTAL, SPECIAL, EXEMPLARY, OR CONSEQUENTIAL
// DAMAGES (INCLUDING, BUT NOT LIMITED TO, PROCUREMENT OF SUBSTITUTE
// GOODS OR SERVICES; LOSS OF USE, DATA, OR PROFITS; OR BUSINESS
// INTERRUPTION) HOWEVER CAUSED AND ON ANY THEORY OF LIABILITY,
// WHETHER IN CONTRACT, STRICT LIABILITY, OR TORT (INCLUDING
// NEGLIGENCE OR OTHERWISE) ARISING IN ANY WAY OUT OF THE USE OF THIS
// SOFTWARE, EVEN IF ADVISED OF THE POSSIBILITY OF SUCH DAMAGE.

// Code is generated by AI

// Opt-in acceptance test for a physically connected Optec TCF-S/TCF-S3, or for the Arduino sketch
// focuser_optec_simulator.ino running on a board. The position is read-only, so every move is relative: the suite
// checks the values read at the connection, moves by steps both ways (a long move whose '*' reply arrives only when
// it ends included), applies the reversed direction, writes and reads back the compensation coefficient (kept over a
// reconnect), switches to the automatic mode and back, refuses settings during a move, reconnects and runs driver
// INIT/SHUTDOWN.
//
// THE FOCUSER MOVES. The session writes back the coefficient it found, leaves the manual mode and steps back to the
// position it found.
//
// The port comes from OPTEC_HW_PORT.

#include <math.h>
#include <stdlib.h>
#include <indigo_drivers/focuser_optec/indigo_focuser_optec.h>
#include "focuser_hw_common.h"

#define DEVICE_NAME "Optec TCF-S"

#define SHORT_TIMEOUT 15.0
#define MOVE_TIMEOUT 120.0

static int focuser = -1;
static const char *serial_port = NULL;
static bool state_captured = false, temperature_present = false;
static double initial_position = 0, initial_compensation = 0;

static bool select_port(void) {
	if (serial_port == NULL || !*serial_port) {
		fprintf(stderr, "    set OPTEC_HW_PORT to the focuser's port\n");
		return false;
	}
	printf("Using port %s\n", serial_port);
	return hw_set_text(focuser, DEVICE_PORT_PROPERTY_NAME, DEVICE_PORT_ITEM_NAME, serial_port, INDIGO_OK_STATE, SHORT_TIMEOUT);
}

static bool set_number(const char *property, const char *item, double value) {
	return focuser_hw_set_number(focuser, property, item, value, INDIGO_OK_STATE, SHORT_TIMEOUT) && focuser_hw_value(focuser, property, item) == value;
}

static double value(const char *property, const char *item) {
	return focuser_hw_value(focuser, property, item);
}

static bool wait_defined(const char *name, bool defined, double timeout) {
	double deadline = indigo_monotonic_time() + timeout;
	while (indigo_monotonic_time() < deadline) {
		if (hw_property_defined(focuser, name) == defined) {
			return true;
		}
		indigo_usleep(10000);
	}
	fprintf(stderr, "    timeout: %s is %s\n", name, defined ? "not defined" : "still defined");
	return false;
}

// Steps back to a position with relative moves.
static bool return_to(double position) {
	for (int i = 0; i < 10; i++) {
		double difference = position - focuser_hw_position(focuser);
		if (difference == 0) {
			return true;
		}
		if (!focuser_hw_steps(focuser, difference > 0, fabs(difference), INDIGO_OK_STATE, MOVE_TIMEOUT)) {
			return false;
		}
	}
	return false;
}

static void restore_initial_state(void) {
	if (focuser < 0 || !state_captured || !hw_connected(focuser)) {
		return;
	}
	if (!focuser_hw_switch_is(focuser, FOCUSER_MODE_PROPERTY_NAME, FOCUSER_MODE_MANUAL_ITEM_NAME)) {
		focuser_hw_set_switch(focuser, FOCUSER_MODE_PROPERTY_NAME, FOCUSER_MODE_MANUAL_ITEM_NAME, SHORT_TIMEOUT);
		wait_defined(FOCUSER_STEPS_PROPERTY_NAME, true, SHORT_TIMEOUT);
	}
	focuser_hw_idle(focuser, FOCUSER_STEPS_PROPERTY_NAME, MOVE_TIMEOUT);
	focuser_hw_set_switch(focuser, FOCUSER_REVERSE_MOTION_PROPERTY_NAME, FOCUSER_REVERSE_MOTION_DISABLED_ITEM_NAME, SHORT_TIMEOUT);
	return_to(initial_position);
	set_number(FOCUSER_COMPENSATION_PROPERTY_NAME, FOCUSER_COMPENSATION_ITEM_NAME, initial_compensation);
}

static void optec_publishes_the_values(void) {
	char model[INDIGO_VALUE_SIZE] = "";
	ASSERT_TRUE((hw_device_interface(focuser) & INDIGO_INTERFACE_FOCUSER) != 0);
	ASSERT_TRUE(hw_text_item(focuser, INFO_PROPERTY_NAME, INFO_DEVICE_MODEL_ITEM_NAME, model, sizeof(model)));
	ASSERT_TRUE(!strcmp(model, "Optec TCF-S/TCF-S3"));
	ASSERT_TRUE(initial_position >= 0 && initial_position <= 9999);
	ASSERT_TRUE(initial_compensation >= -999 && initial_compensation <= 999);
	ASSERT_TRUE(!hw_property_defined(focuser, FOCUSER_ABORT_MOTION_PROPERTY_NAME));
	if (temperature_present) {
		double temperature = value(FOCUSER_TEMPERATURE_PROPERTY_NAME, FOCUSER_TEMPERATURE_ITEM_NAME);
		printf("    position %g, compensation %g, %.1f C\n", initial_position, initial_compensation, temperature);
		ASSERT_TRUE(temperature > -40 && temperature < 60);
	} else {
		printf("    position %g, compensation %g, no temperature probe (ER=1)\n", initial_position, initial_compensation);
	}
}

// An outward move increases the position. A 1000-step move takes about five seconds, so its '*' reply comes long
// after the command; the move still ends OK at its target.
static void optec_moves_by_steps(void) {
	double base = focuser_hw_position(focuser);
	double start = indigo_monotonic_time();
	ASSERT_TRUE(focuser_hw_steps(focuser, true, 1000, INDIGO_OK_STATE, MOVE_TIMEOUT));
	double elapsed = indigo_monotonic_time() - start;
	ASSERT_EQ_INT((int)base + 1000, (int)focuser_hw_position(focuser));
	ASSERT_EQ_INT((int)base + 1000, (int)value(FOCUSER_POSITION_PROPERTY_NAME, FOCUSER_POSITION_ITEM_NAME));
	ASSERT_TRUE(focuser_hw_steps(focuser, false, 1250, INDIGO_OK_STATE, MOVE_TIMEOUT));
	ASSERT_EQ_INT((int)base - 250, (int)focuser_hw_position(focuser));
	ASSERT_TRUE(focuser_hw_steps(focuser, true, 250, INDIGO_OK_STATE, MOVE_TIMEOUT));
	ASSERT_EQ_INT((int)base, (int)focuser_hw_position(focuser));
	ASSERT_TRUE(focuser_hw_steps(focuser, true, 1, INDIGO_OK_STATE, MOVE_TIMEOUT));
	ASSERT_TRUE(focuser_hw_steps(focuser, false, 1, INDIGO_OK_STATE, MOVE_TIMEOUT));
	ASSERT_EQ_INT((int)base, (int)focuser_hw_position(focuser));
	ASSERT_TRUE(focuser_hw_steps(focuser, true, 0, INDIGO_OK_STATE, SHORT_TIMEOUT));
	printf("    1000 steps in %.1f s\n", elapsed);
}

// The reversed direction is applied by the driver: an outward step goes the other way.
static void optec_reverses_the_direction(void) {
	double base = focuser_hw_position(focuser);
	ASSERT_TRUE(focuser_hw_set_switch(focuser, FOCUSER_REVERSE_MOTION_PROPERTY_NAME, FOCUSER_REVERSE_MOTION_ENABLED_ITEM_NAME, SHORT_TIMEOUT));
	ASSERT_TRUE(focuser_hw_steps(focuser, true, 100, INDIGO_OK_STATE, MOVE_TIMEOUT));
	ASSERT_EQ_INT((int)base - 100, (int)focuser_hw_position(focuser));
	ASSERT_TRUE(focuser_hw_steps(focuser, false, 100, INDIGO_OK_STATE, MOVE_TIMEOUT));
	ASSERT_TRUE(focuser_hw_set_switch(focuser, FOCUSER_REVERSE_MOTION_PROPERTY_NAME, FOCUSER_REVERSE_MOTION_DISABLED_ITEM_NAME, SHORT_TIMEOUT));
	ASSERT_EQ_INT((int)base, (int)focuser_hw_position(focuser));
}

// A setting requested during a move is refused and keeps the device value.
static void optec_refuses_settings_during_a_move(void) {
	double compensation = value(FOCUSER_COMPENSATION_PROPERTY_NAME, FOCUSER_COMPENSATION_ITEM_NAME);
	unsigned before = hw_revision(focuser, FOCUSER_STEPS_PROPERTY_NAME);
	ASSERT_TRUE(hw_set_switch(focuser, FOCUSER_DIRECTION_PROPERTY_NAME, FOCUSER_DIRECTION_MOVE_OUTWARD_ITEM_NAME, INDIGO_OK_STATE, SHORT_TIMEOUT));
	hw_request_number(focuser, FOCUSER_STEPS_PROPERTY_NAME, FOCUSER_STEPS_ITEM_NAME, 600);
	ASSERT_TRUE(hw_wait_state(focuser, FOCUSER_STEPS_PROPERTY_NAME, before, INDIGO_BUSY_STATE, SHORT_TIMEOUT));
	ASSERT_TRUE(focuser_hw_set_number(focuser, FOCUSER_COMPENSATION_PROPERTY_NAME, FOCUSER_COMPENSATION_ITEM_NAME, compensation == 5 ? 6 : 5, INDIGO_ALERT_STATE, SHORT_TIMEOUT));
	ASSERT_EQ_INT((int)compensation, (int)value(FOCUSER_COMPENSATION_PROPERTY_NAME, FOCUSER_COMPENSATION_ITEM_NAME));
	ASSERT_TRUE(focuser_hw_idle(focuser, FOCUSER_STEPS_PROPERTY_NAME, MOVE_TIMEOUT));
	ASSERT_EQ_INT(INDIGO_OK_STATE, hw_property_state(focuser, FOCUSER_STEPS_PROPERTY_NAME));
	ASSERT_TRUE(focuser_hw_steps(focuser, false, 600, INDIGO_OK_STATE, MOVE_TIMEOUT));
}

// The coefficient is confirmed by a readback of magnitude and sign, and the controller keeps it over a reconnect.
static void optec_changes_the_compensation(void) {
	ASSERT_TRUE(set_number(FOCUSER_COMPENSATION_PROPERTY_NAME, FOCUSER_COMPENSATION_ITEM_NAME, -12));
	ASSERT_TRUE(set_number(FOCUSER_COMPENSATION_PROPERTY_NAME, FOCUSER_COMPENSATION_ITEM_NAME, 345));
	ASSERT_TRUE(hw_disconnect(focuser, SHORT_TIMEOUT));
	ASSERT_TRUE(hw_connect(focuser, SHORT_TIMEOUT));
	ASSERT_EQ_INT(345, (int)value(FOCUSER_COMPENSATION_PROPERTY_NAME, FOCUSER_COMPENSATION_ITEM_NAME));
	ASSERT_TRUE(set_number(FOCUSER_COMPENSATION_PROPERTY_NAME, FOCUSER_COMPENSATION_ITEM_NAME, initial_compensation));
}

// The automatic mode removes the motion controls and the manual mode brings them back with a working move.
static void optec_switches_the_mode(void) {
	double position = focuser_hw_position(focuser);
	ASSERT_TRUE(focuser_hw_set_switch(focuser, FOCUSER_MODE_PROPERTY_NAME, FOCUSER_MODE_AUTOMATIC_ITEM_NAME, SHORT_TIMEOUT));
	ASSERT_TRUE(wait_defined(FOCUSER_STEPS_PROPERTY_NAME, false, SHORT_TIMEOUT));
	ASSERT_TRUE(!hw_property_defined(focuser, FOCUSER_POSITION_PROPERTY_NAME));
	indigo_usleep(2500000);
	ASSERT_TRUE(focuser_hw_set_switch(focuser, FOCUSER_MODE_PROPERTY_NAME, FOCUSER_MODE_MANUAL_ITEM_NAME, SHORT_TIMEOUT));
	ASSERT_TRUE(wait_defined(FOCUSER_STEPS_PROPERTY_NAME, true, SHORT_TIMEOUT));
	ASSERT_TRUE(focuser_hw_steps(focuser, true, 20, INDIGO_OK_STATE, MOVE_TIMEOUT));
	ASSERT_TRUE(focuser_hw_steps(focuser, false, 20, INDIGO_OK_STATE, MOVE_TIMEOUT));
	printf("    position %g before, %g after the automatic mode\n", position, focuser_hw_position(focuser));
}

static void optec_reconnects(void) {
	double position = focuser_hw_position(focuser);
	ASSERT_TRUE(hw_disconnect(focuser, SHORT_TIMEOUT));
	ASSERT_TRUE(hw_property_hidden(focuser, FOCUSER_POSITION_PROPERTY_NAME));
	ASSERT_TRUE(hw_connect(focuser, SHORT_TIMEOUT));
	ASSERT_EQ_INT((int)position, (int)focuser_hw_position(focuser));
	ASSERT_EQ_INT(INDIGO_OK_STATE, hw_property_state(focuser, FOCUSER_POSITION_PROPERTY_NAME));
}

static void optec_rejects_shutdown_while_connected(void) {
	ASSERT_EQ_INT(INDIGO_BUSY, indigo_focuser_optec(INDIGO_DRIVER_SHUTDOWN, NULL));
	ASSERT_TRUE(hw_connected(focuser));
}

static void optec_reinitializes(void) {
	double position = focuser_hw_position(focuser);
	ASSERT_TRUE(hw_disconnect(focuser, SHORT_TIMEOUT));
	ASSERT_EQ_INT(INDIGO_OK, indigo_focuser_optec(INDIGO_DRIVER_SHUTDOWN, NULL));
	ASSERT_EQ_INT(-1, hw_device_index(DEVICE_NAME));
	ASSERT_EQ_INT(INDIGO_OK, indigo_focuser_optec(INDIGO_DRIVER_INIT, NULL));
	focuser = hw_wait_for_device(DEVICE_NAME, SHORT_TIMEOUT);
	ASSERT_TRUE(focuser >= 0);
	ASSERT_TRUE(select_port());
	ASSERT_TRUE(hw_connect(focuser, SHORT_TIMEOUT));
	ASSERT_EQ_INT((int)position, (int)focuser_hw_position(focuser));
}

int main(int argc, char **argv) {
	if (argc < 2 || strcmp(argv[1], "--run")) {
		fprintf(stderr, "Physical Optec TCF-S test: run explicitly with --run (or make test-focuser-optec-hw).\n");
		return 2;
	}
	setvbuf(stdout, NULL, _IONBF, 0);
	for (int i = 2; i < argc; i++) {
		if (!strcmp(argv[i], "--debug")) {
			indigo_set_log_level(INDIGO_LOG_DEBUG);
		}
	}
	if (!indigo_test_use_private_home()) {
		return 1;
	}
	serial_port = hw_port("OPTEC_HW_PORT");
	const indigo_test_case tests[] = {
		{ "optec_publishes_the_values", optec_publishes_the_values },
		{ "optec_moves_by_steps", optec_moves_by_steps },
		{ "optec_reverses_the_direction", optec_reverses_the_direction },
		{ "optec_refuses_settings_during_a_move", optec_refuses_settings_during_a_move },
		{ "optec_changes_the_compensation", optec_changes_the_compensation },
		{ "optec_switches_the_mode", optec_switches_the_mode },
		{ "optec_reconnects", optec_reconnects },
		{ "optec_rejects_shutdown_while_connected", optec_rejects_shutdown_while_connected },
		{ "optec_reinitializes", optec_reinitializes }
	};
	int result = 1;
	bool started = false, initialized = false;
	HW_CHECK(hw_start() == INDIGO_OK);
	started = true;
	HW_CHECK(hw_attach_client("Optec TCF-S hardware test") == INDIGO_OK);
	HW_CHECK(indigo_focuser_optec(INDIGO_DRIVER_INIT, NULL) == INDIGO_OK);
	initialized = true;
	focuser = hw_wait_for_device(DEVICE_NAME, SHORT_TIMEOUT);
	HW_CHECK(focuser >= 0);
	HW_CHECK(select_port());
	HW_CHECK(hw_connect(focuser, SHORT_TIMEOUT));
	HW_CHECK(focuser_hw_idle(focuser, FOCUSER_POSITION_PROPERTY_NAME, MOVE_TIMEOUT));
	temperature_present = hw_property_state(focuser, FOCUSER_TEMPERATURE_PROPERTY_NAME) == INDIGO_OK_STATE;
	initial_position = focuser_hw_position(focuser);
	initial_compensation = value(FOCUSER_COMPENSATION_PROPERTY_NAME, FOCUSER_COMPENSATION_ITEM_NAME);
	state_captured = true;
	// the moves need room on both sides
	HW_CHECK(initial_position >= 1300 && initial_position <= 9999 - 1300);
	result = indigo_run_tests("Optec TCF-S hardware", tests, ARRAY_SIZE(tests));
cleanup:
	restore_initial_state();
	if (!hw_disconnect(focuser, SHORT_TIMEOUT)) {
		indigo_test_failures++;
	}
	if (initialized && indigo_focuser_optec(INDIGO_DRIVER_SHUTDOWN, NULL) != INDIGO_OK) {
		indigo_test_failures++;
	}
	indigo_detach_client(&hw_client);
	if (started) {
		indigo_stop();
	}
	hw_release_properties();
	indigo_test_remove_private_home();
	return indigo_test_failures ? 1 : result;
}
