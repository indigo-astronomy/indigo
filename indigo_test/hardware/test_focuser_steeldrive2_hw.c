// Copyright (c) 2026 INDIGO initiative
// All rights reserved.
//
// You may use this software under the terms of 'INDIGO Astronomy
// open-source license' (see LICENSE.md).
//
// THIS SOFTWARE IS PROVIDED BY THE AUTHORS 'AS IS' AND ANY EXPRESS
// OR IMPLIED WARRANTIES, INCLUDING, BUT NOT LIMITED TO, THE IMPLIED
// WARRANTIES OF MERCHANTABILITY AND FITNESS FOR A PARTICULAR PURPOSE
// ARE DISCLAIMED. IN NO EVENT SHALL THE AUTHOR BE LIABLE FOR ANY
// DIRECT, INDIRECT, INCIDENTAL, SPECIAL, EXEMPLARY, OR CONSEQUENTIAL
// DAMAGES (INCLUDING, BUT NOT LIMITED TO, PROCUREMENT OF SUBSTITUTE
// GOODS OR SERVICES; LOSS OF USE, DATA, OR PROFITS; OR BUSINESS
// INTERRUPTION) HOWEVER CAUSED AND ON ANY THEORY OF LIABILITY,
// WHETHER IN CONTRACT, STRICT LIABILITY, OR TORT (INCLUDING
// NEGLIGENCE OR OTHERWISE) ARISING IN ANY WAY OUT OF THE USE OF THIS
// SOFTWARE, EVEN IF ADVISED OF THE POSSIBILITY OF SUCH DAMAGE.

// Code is generated by AI

// Opt-in acceptance test for a physically connected Baader SteelDriveII, or for the Arduino sketch
// focuser_steeldrive2_simulator.ino running on a board. It checks the values read at the connection, moves to
// absolute positions and by steps both ways, aborts a move, syncs, writes the travel limit, the name, the saved
// values, the compensation settings and mode, the compensation sensor and the end-stop use (all read back and kept
// over a reconnect), zeroes the focuser, sets the heater output and the automatic dew control of the aux device,
// reconnects and runs driver INIT/SHUTDOWN. The factory RESET is not run: it would erase the controller settings.
//
// THE FOCUSER MOVES AND THE HEATER OUTPUT CHANGES. The session writes back everything it found and returns to the
// position it found (zeroing moves to 0 and comes back).
//
// The port comes from STEELDRIVE2_HW_PORT.

#include <math.h>
#include <stdlib.h>
#include <indigo_drivers/focuser_steeldrive2/indigo_focuser_steeldrive2.h>
#include "focuser_hw_common.h"

#define FOCUSER_NAME "SteelDriveII (focuser)"
#define AUX_NAME "SteelDriveII (aux)"
#define SAVED "X_SAVED_VALUES"

#define SHORT_TIMEOUT 15.0
#define MOVE_TIMEOUT 120.0
#define TRAVEL 600

static int focuser = -1, aux = -1;
static const char *serial_port = NULL;
static bool state_captured = false, endstop = false, auto_dew = false;
static double initial_position = 0, initial_limit = 0, initial_saved[6], initial_compensation[3], initial_heater = 0, base = 0;
static char initial_name[INDIGO_VALUE_SIZE] = "", initial_sensor[16] = "AVG";
static const char *saved_item[6] = { "FOCUS", "JOGSTEPS", "SINGLESTEPS", "BKLGT", "TEMP0_OFS", "TEMP1_OFS" };
static const char *compensation_item[3] = { FOCUSER_COMPENSATION_ITEM_NAME, FOCUSER_COMPENSATION_PERIOD_ITEM_NAME, FOCUSER_COMPENSATION_THRESHOLD_ITEM_NAME };

static bool select_port(void) {
	if (serial_port == NULL || !*serial_port) {
		fprintf(stderr, "    set STEELDRIVE2_HW_PORT to the controller's port\n");
		return false;
	}
	printf("Using port %s\n", serial_port);
	return hw_set_text(focuser, DEVICE_PORT_PROPERTY_NAME, DEVICE_PORT_ITEM_NAME, serial_port, INDIGO_OK_STATE, SHORT_TIMEOUT);
}

static double value(int d, const char *property, const char *item) {
	return focuser_hw_value(d, property, item);
}

static bool set_numbers(int d, const char *property, int count, const char **items, const double *values) {
	if (!focuser_hw_idle(d, property, SHORT_TIMEOUT)) {
		return false;
	}
	unsigned before = hw_revision(d, property);
	indigo_change_number_property(&hw_client, hw_device_name(d), property, count, items, values);
	if (!focuser_hw_settles(d, property, before, INDIGO_OK_STATE, SHORT_TIMEOUT)) {
		return false;
	}
	// the poll republishes FOCUSER_LIMITS with its standing state, so the values decide when the request is done
	double deadline = indigo_monotonic_time() + SHORT_TIMEOUT;
	for (int i = 0; i < count; i++) {
		while (fabs(value(d, property, items[i]) - values[i]) > 0.005) {
			if (indigo_monotonic_time() > deadline) {
				fprintf(stderr, "    %s.%s %g, expected %g\n", property, items[i], value(d, property, items[i]), values[i]);
				return false;
			}
			indigo_usleep(10000);
		}
	}
	return hw_property_state(d, property) == INDIGO_OK_STATE;
}

static bool set_limit(double limit) {
	static const char *items[] = { FOCUSER_LIMITS_MIN_POSITION_ITEM_NAME, FOCUSER_LIMITS_MAX_POSITION_ITEM_NAME };
	double values[] = { 0, limit };
	return set_numbers(focuser, FOCUSER_LIMITS_PROPERTY_NAME, 2, items, values);
}

static bool set_name(const char *name) {
	char actual[INDIGO_VALUE_SIZE] = "";
	return hw_set_text(focuser, "X_NAME", "NAME", name, INDIGO_OK_STATE, SHORT_TIMEOUT) && hw_text_item(focuser, "X_NAME", "NAME", actual, sizeof(actual)) && !strcmp(actual, name);
}

static void restore_initial_state(void) {
	if (!state_captured) {
		return;
	}
	if (aux >= 0 && hw_connected(aux)) {
		focuser_hw_set_switch(aux, "X_USE_AUTO_DEW", auto_dew ? AUX_DEW_CONTROL_AUTOMATIC_ITEM_NAME : AUX_DEW_CONTROL_MANUAL_ITEM_NAME, SHORT_TIMEOUT);
		focuser_hw_set_number(aux, AUX_HEATER_OUTLET_PROPERTY_NAME, AUX_HEATER_OUTLET_1_ITEM_NAME, initial_heater, INDIGO_OK_STATE, SHORT_TIMEOUT);
	}
	if (focuser < 0 || !hw_connected(focuser)) {
		return;
	}
	focuser_hw_idle(focuser, FOCUSER_POSITION_PROPERTY_NAME, MOVE_TIMEOUT);
	focuser_hw_set_switch(focuser, FOCUSER_MODE_PROPERTY_NAME, FOCUSER_MODE_MANUAL_ITEM_NAME, SHORT_TIMEOUT);
	focuser_hw_set_switch(focuser, FOCUSER_ON_POSITION_SET_PROPERTY_NAME, FOCUSER_ON_POSITION_SET_GOTO_ITEM_NAME, SHORT_TIMEOUT);
	focuser_hw_set_switch(focuser, "X_USE_ENDSTOP", endstop ? "ENABLED" : "DISABLED", SHORT_TIMEOUT);
	focuser_hw_set_switch(focuser, "X_SELECT_TC_SENSOR", initial_sensor, SHORT_TIMEOUT);
	set_numbers(focuser, SAVED, 6, saved_item, initial_saved);
	set_numbers(focuser, FOCUSER_COMPENSATION_PROPERTY_NAME, 3, compensation_item, initial_compensation);
	set_name(initial_name);
	if (value(focuser, FOCUSER_LIMITS_PROPERTY_NAME, FOCUSER_LIMITS_MAX_POSITION_ITEM_NAME) != initial_limit) {
		set_limit(initial_limit);
	}
	focuser_hw_goto(focuser, initial_position, INDIGO_OK_STATE, MOVE_TIMEOUT);
}

static void steeldrive2_publishes_the_values(void) {
	char firmware[INDIGO_VALUE_SIZE] = "";
	ASSERT_TRUE((hw_device_interface(focuser) & INDIGO_INTERFACE_FOCUSER) != 0);
	ASSERT_TRUE((hw_device_interface(aux) & INDIGO_INTERFACE_AUX) != 0);
	hw_text_item(focuser, INFO_PROPERTY_NAME, INFO_DEVICE_FW_REVISION_ITEM_NAME, firmware, sizeof(firmware));
	double temperature = value(focuser, FOCUSER_TEMPERATURE_PROPERTY_NAME, FOCUSER_TEMPERATURE_ITEM_NAME);
	printf("    %s firmware %s, position %g, limit %g, focus %g, jog %g, single %g, backlight %g, compensation %g/%gs/%g, sensor %s, end-stop %d, heater %g, auto dew %d, %.2f C\n", initial_name, firmware, initial_position, initial_limit, initial_saved[0], initial_saved[1], initial_saved[2], initial_saved[3], initial_compensation[0], initial_compensation[1], initial_compensation[2], initial_sensor, endstop, initial_heater, auto_dew, temperature);
	ASSERT_TRUE(*initial_name && strlen(initial_name) <= 19);
	ASSERT_TRUE(initial_position >= 0 && initial_position <= initial_limit);
	ASSERT_TRUE(initial_saved[2] >= 1 && initial_saved[2] <= initial_saved[1]);
	ASSERT_TRUE(initial_heater >= 0 && initial_heater <= 100);
}

static void steeldrive2_moves_to_absolute_positions(void) {
	ASSERT_TRUE(focuser_hw_goto(focuser, base + TRAVEL, INDIGO_OK_STATE, MOVE_TIMEOUT));
	ASSERT_TRUE(focuser_hw_goto(focuser, base + 11, INDIGO_OK_STATE, MOVE_TIMEOUT));
	ASSERT_TRUE(focuser_hw_goto(focuser, base, INDIGO_OK_STATE, MOVE_TIMEOUT));
	ASSERT_TRUE(focuser_hw_goto(focuser, base, INDIGO_OK_STATE, SHORT_TIMEOUT));
}

// An outward move increases the position; the reversed direction swaps the steps.
static void steeldrive2_moves_by_steps(void) {
	ASSERT_TRUE(focuser_hw_steps(focuser, true, 250, INDIGO_OK_STATE, MOVE_TIMEOUT));
	ASSERT_EQ_INT((int)base + 250, (int)focuser_hw_position(focuser));
	ASSERT_TRUE(focuser_hw_steps(focuser, false, 250, INDIGO_OK_STATE, MOVE_TIMEOUT));
	ASSERT_EQ_INT((int)base, (int)focuser_hw_position(focuser));
	ASSERT_TRUE(focuser_hw_set_switch(focuser, FOCUSER_REVERSE_MOTION_PROPERTY_NAME, FOCUSER_REVERSE_MOTION_ENABLED_ITEM_NAME, SHORT_TIMEOUT));
	ASSERT_TRUE(focuser_hw_steps(focuser, false, 50, INDIGO_OK_STATE, MOVE_TIMEOUT));
	ASSERT_EQ_INT((int)base + 50, (int)focuser_hw_position(focuser));
	ASSERT_TRUE(focuser_hw_steps(focuser, true, 50, INDIGO_OK_STATE, MOVE_TIMEOUT));
	ASSERT_TRUE(focuser_hw_set_switch(focuser, FOCUSER_REVERSE_MOTION_PROPERTY_NAME, FOCUSER_REVERSE_MOTION_DISABLED_ITEM_NAME, SHORT_TIMEOUT));
	ASSERT_EQ_INT((int)base, (int)focuser_hw_position(focuser));
}

// An aborted move ends ALERT at the position where it stopped, and the motor stays there.
static void steeldrive2_aborts_a_move(void) {
	double far = base + TRAVEL > initial_limit ? initial_limit : base + TRAVEL;
	ASSERT_TRUE(focuser_hw_start_goto(focuser, far, SHORT_TIMEOUT));
	indigo_usleep(500000);
	ASSERT_TRUE(focuser_hw_abort(focuser, SHORT_TIMEOUT));
	ASSERT_TRUE(focuser_hw_idle(focuser, FOCUSER_POSITION_PROPERTY_NAME, SHORT_TIMEOUT));
	ASSERT_EQ_INT(INDIGO_ALERT_STATE, hw_property_state(focuser, FOCUSER_POSITION_PROPERTY_NAME));
	double stopped = focuser_hw_position(focuser);
	printf("    stopped at %g on the way from %g to %g\n", stopped, base, far);
	ASSERT_TRUE(stopped > base && stopped < far);
	indigo_usleep(1500000);
	ASSERT_EQ_INT((int)stopped, (int)focuser_hw_position(focuser));
	ASSERT_TRUE(focuser_hw_goto(focuser, base, INDIGO_OK_STATE, MOVE_TIMEOUT));
}

// A sync sets the coordinate without moving; syncing back restores it.
static void steeldrive2_syncs(void) {
	ASSERT_TRUE(focuser_hw_set_switch(focuser, FOCUSER_ON_POSITION_SET_PROPERTY_NAME, FOCUSER_ON_POSITION_SET_SYNC_ITEM_NAME, SHORT_TIMEOUT));
	ASSERT_TRUE(focuser_hw_goto(focuser, base + 123, INDIGO_OK_STATE, SHORT_TIMEOUT));
	indigo_usleep(1000000);
	ASSERT_EQ_INT((int)base + 123, (int)focuser_hw_position(focuser));
	ASSERT_TRUE(focuser_hw_goto(focuser, base, INDIGO_OK_STATE, SHORT_TIMEOUT));
	ASSERT_TRUE(focuser_hw_set_switch(focuser, FOCUSER_ON_POSITION_SET_PROPERTY_NAME, FOCUSER_ON_POSITION_SET_GOTO_ITEM_NAME, SHORT_TIMEOUT));
	ASSERT_EQ_INT((int)base, (int)focuser_hw_position(focuser));
}

// The travel limit is written to the controller, which keeps a move inside it; a limit below the focuser is refused.
static void steeldrive2_keeps_inside_the_limit(void) {
	ASSERT_TRUE(set_limit(base + 100));
	ASSERT_TRUE(focuser_hw_start_goto(focuser, base + 100, SHORT_TIMEOUT));
	ASSERT_TRUE(focuser_hw_idle(focuser, FOCUSER_POSITION_PROPERTY_NAME, MOVE_TIMEOUT));
	ASSERT_EQ_INT((int)base + 100, (int)focuser_hw_position(focuser));
	unsigned before = hw_revision(focuser, FOCUSER_LIMITS_PROPERTY_NAME);
	static const char *items[] = { FOCUSER_LIMITS_MIN_POSITION_ITEM_NAME, FOCUSER_LIMITS_MAX_POSITION_ITEM_NAME };
	double values[] = { 0, base + 50 };
	indigo_change_number_property(&hw_client, hw_device_name(focuser), FOCUSER_LIMITS_PROPERTY_NAME, 2, items, values);
	// the poll republishes the property with its standing state, so the refusal is the ALERT state itself
	ASSERT_TRUE(hw_wait_state(focuser, FOCUSER_LIMITS_PROPERTY_NAME, before, INDIGO_ALERT_STATE, SHORT_TIMEOUT));
	ASSERT_EQ_INT((int)base + 100, (int)value(focuser, FOCUSER_LIMITS_PROPERTY_NAME, FOCUSER_LIMITS_MAX_POSITION_ITEM_NAME));
	ASSERT_TRUE(set_limit(initial_limit));
	ASSERT_TRUE(focuser_hw_goto(focuser, base, INDIGO_OK_STATE, MOVE_TIMEOUT));
}

// The name, saved values, compensation settings, compensation sensor and end-stop use are confirmed by the controller
// and kept over a reconnect.
static void steeldrive2_changes_the_settings(void) {
	double saved[6] = { initial_saved[0] + 7, initial_saved[1] == 40 ? 41 : 40, 3, initial_saved[3] == 30 ? 31 : 30, 1.25, -0.5 };
	double compensation[3] = { -3.5, 12, 0.75 };
	const char *sensor = strcmp(initial_sensor, "SENSOR_1") ? "SENSOR_1" : "SENSOR_0";
	ASSERT_TRUE(set_name("INDIGO_HW_TEST"));
	ASSERT_TRUE(set_numbers(focuser, SAVED, 6, saved_item, saved));
	ASSERT_TRUE(set_numbers(focuser, FOCUSER_COMPENSATION_PROPERTY_NAME, 3, compensation_item, compensation));
	ASSERT_TRUE(focuser_hw_set_switch(focuser, "X_SELECT_TC_SENSOR", sensor, SHORT_TIMEOUT));
	ASSERT_TRUE(focuser_hw_set_switch(focuser, "X_USE_ENDSTOP", endstop ? "DISABLED" : "ENABLED", SHORT_TIMEOUT));
	ASSERT_TRUE(hw_disconnect(aux, SHORT_TIMEOUT));
	ASSERT_TRUE(hw_disconnect(focuser, SHORT_TIMEOUT));
	ASSERT_TRUE(hw_connect(focuser, SHORT_TIMEOUT));
	ASSERT_TRUE(hw_connect(aux, SHORT_TIMEOUT));
	char name[INDIGO_VALUE_SIZE] = "";
	ASSERT_TRUE(hw_text_item(focuser, "X_NAME", "NAME", name, sizeof(name)) && !strcmp(name, "INDIGO_HW_TEST"));
	for (int i = 0; i < 6; i++) {
		ASSERT_TRUE(fabs(value(focuser, SAVED, saved_item[i]) - saved[i]) < 0.005);
	}
	for (int i = 0; i < 3; i++) {
		ASSERT_TRUE(fabs(value(focuser, FOCUSER_COMPENSATION_PROPERTY_NAME, compensation_item[i]) - compensation[i]) < 0.005);
	}
	ASSERT_TRUE(focuser_hw_switch_is(focuser, "X_SELECT_TC_SENSOR", sensor));
	ASSERT_TRUE(focuser_hw_switch_is(focuser, "X_USE_ENDSTOP", endstop ? "DISABLED" : "ENABLED"));
	ASSERT_TRUE(focuser_hw_set_switch(focuser, "X_USE_ENDSTOP", endstop ? "ENABLED" : "DISABLED", SHORT_TIMEOUT));
	ASSERT_TRUE(focuser_hw_set_switch(focuser, "X_SELECT_TC_SENSOR", initial_sensor, SHORT_TIMEOUT));
	ASSERT_TRUE(set_numbers(focuser, FOCUSER_COMPENSATION_PROPERTY_NAME, 3, compensation_item, initial_compensation));
	ASSERT_TRUE(set_numbers(focuser, SAVED, 6, saved_item, initial_saved));
	ASSERT_TRUE(set_name(initial_name));
}

// The compensation mode is confirmed by the controller; in automatic mode a manual move is refused.
static void steeldrive2_switches_the_compensation_mode(void) {
	ASSERT_TRUE(focuser_hw_set_switch(focuser, FOCUSER_MODE_PROPERTY_NAME, FOCUSER_MODE_AUTOMATIC_ITEM_NAME, SHORT_TIMEOUT));
	unsigned before = hw_revision(focuser, FOCUSER_STEPS_PROPERTY_NAME);
	hw_request_number(focuser, FOCUSER_STEPS_PROPERTY_NAME, FOCUSER_STEPS_ITEM_NAME, 10);
	ASSERT_TRUE(focuser_hw_settles(focuser, FOCUSER_STEPS_PROPERTY_NAME, before, INDIGO_ALERT_STATE, SHORT_TIMEOUT));
	ASSERT_TRUE(focuser_hw_set_switch(focuser, FOCUSER_MODE_PROPERTY_NAME, FOCUSER_MODE_MANUAL_ITEM_NAME, SHORT_TIMEOUT));
	ASSERT_TRUE(focuser_hw_goto(focuser, base, INDIGO_OK_STATE, MOVE_TIMEOUT));
}

// Zeroing ends at position 0 (driven to the end stop when it is used, set otherwise).
static void steeldrive2_zeroes(void) {
	unsigned before = hw_revision(focuser, "X_START_ZEROING");
	hw_request_switch(focuser, "X_START_ZEROING", "START", true);
	ASSERT_TRUE(focuser_hw_settles(focuser, "X_START_ZEROING", before, INDIGO_OK_STATE, MOVE_TIMEOUT));
	ASSERT_TRUE(focuser_hw_idle(focuser, FOCUSER_POSITION_PROPERTY_NAME, MOVE_TIMEOUT));
	ASSERT_EQ_INT(0, (int)focuser_hw_position(focuser));
	// zeroing without the end stop only resets the coordinate; the sync puts the focuser back where it was
	if (!endstop) {
		ASSERT_TRUE(focuser_hw_set_switch(focuser, FOCUSER_ON_POSITION_SET_PROPERTY_NAME, FOCUSER_ON_POSITION_SET_SYNC_ITEM_NAME, SHORT_TIMEOUT));
		ASSERT_TRUE(focuser_hw_goto(focuser, base, INDIGO_OK_STATE, SHORT_TIMEOUT));
		ASSERT_TRUE(focuser_hw_set_switch(focuser, FOCUSER_ON_POSITION_SET_PROPERTY_NAME, FOCUSER_ON_POSITION_SET_GOTO_ITEM_NAME, SHORT_TIMEOUT));
	} else {
		ASSERT_TRUE(focuser_hw_goto(focuser, base, INDIGO_OK_STATE, MOVE_TIMEOUT));
	}
	ASSERT_EQ_INT((int)base, (int)focuser_hw_position(focuser));
}

// The heater output and the automatic dew control are confirmed by the controller.
static void steeldrive2_controls_the_heater(void) {
	double heater = initial_heater == 35 ? 36 : 35;
	ASSERT_TRUE(focuser_hw_set_number(aux, AUX_HEATER_OUTLET_PROPERTY_NAME, AUX_HEATER_OUTLET_1_ITEM_NAME, heater, INDIGO_OK_STATE, SHORT_TIMEOUT));
	indigo_usleep(1500000);
	ASSERT_EQ_INT((int)heater, (int)value(aux, AUX_HEATER_OUTLET_PROPERTY_NAME, AUX_HEATER_OUTLET_1_ITEM_NAME));
	ASSERT_TRUE(focuser_hw_set_switch(aux, "X_USE_AUTO_DEW", auto_dew ? AUX_DEW_CONTROL_MANUAL_ITEM_NAME : AUX_DEW_CONTROL_AUTOMATIC_ITEM_NAME, SHORT_TIMEOUT));
	ASSERT_TRUE(focuser_hw_set_switch(aux, "X_USE_AUTO_DEW", auto_dew ? AUX_DEW_CONTROL_AUTOMATIC_ITEM_NAME : AUX_DEW_CONTROL_MANUAL_ITEM_NAME, SHORT_TIMEOUT));
	ASSERT_TRUE(focuser_hw_set_number(aux, AUX_HEATER_OUTLET_PROPERTY_NAME, AUX_HEATER_OUTLET_1_ITEM_NAME, initial_heater, INDIGO_OK_STATE, SHORT_TIMEOUT));
}

// The reboot is refused while the aux device shares the connection.
static void steeldrive2_refuses_reboot_while_shared(void) {
	ASSERT_TRUE(hw_set_switch(focuser, "X_RESET", "REBOOT", INDIGO_ALERT_STATE, SHORT_TIMEOUT));
	ASSERT_TRUE(hw_connected(focuser) && hw_connected(aux));
}

static void steeldrive2_reconnects(void) {
	ASSERT_TRUE(hw_disconnect(aux, SHORT_TIMEOUT));
	ASSERT_TRUE(hw_disconnect(focuser, SHORT_TIMEOUT));
	ASSERT_TRUE(hw_property_hidden(focuser, FOCUSER_POSITION_PROPERTY_NAME));
	ASSERT_TRUE(hw_connect(focuser, SHORT_TIMEOUT));
	ASSERT_TRUE(hw_connect(aux, SHORT_TIMEOUT));
	ASSERT_EQ_INT((int)base, (int)focuser_hw_position(focuser));
	ASSERT_EQ_INT(INDIGO_OK_STATE, hw_property_state(focuser, FOCUSER_POSITION_PROPERTY_NAME));
}

static void steeldrive2_rejects_shutdown_while_connected(void) {
	ASSERT_EQ_INT(INDIGO_BUSY, indigo_focuser_steeldrive2(INDIGO_DRIVER_SHUTDOWN, NULL));
	ASSERT_TRUE(hw_connected(focuser));
}

static void steeldrive2_reinitializes(void) {
	ASSERT_TRUE(hw_disconnect(aux, SHORT_TIMEOUT));
	ASSERT_TRUE(hw_disconnect(focuser, SHORT_TIMEOUT));
	ASSERT_EQ_INT(INDIGO_OK, indigo_focuser_steeldrive2(INDIGO_DRIVER_SHUTDOWN, NULL));
	ASSERT_EQ_INT(-1, hw_device_index(FOCUSER_NAME));
	ASSERT_EQ_INT(INDIGO_OK, indigo_focuser_steeldrive2(INDIGO_DRIVER_INIT, NULL));
	focuser = hw_wait_for_device(FOCUSER_NAME, SHORT_TIMEOUT);
	aux = hw_wait_for_device(AUX_NAME, SHORT_TIMEOUT);
	ASSERT_TRUE(focuser >= 0 && aux >= 0);
	ASSERT_TRUE(select_port());
	ASSERT_TRUE(hw_connect(focuser, SHORT_TIMEOUT));
	ASSERT_TRUE(hw_connect(aux, SHORT_TIMEOUT));
	ASSERT_EQ_INT((int)base, (int)focuser_hw_position(focuser));
}

int main(int argc, char **argv) {
	if (argc < 2 || strcmp(argv[1], "--run")) {
		fprintf(stderr, "Physical SteelDriveII test: run explicitly with --run (or make test-focuser-steeldrive2-hw).\n");
		return 2;
	}
	setvbuf(stdout, NULL, _IONBF, 0);
	for (int i = 2; i < argc; i++) {
		if (!strcmp(argv[i], "--debug")) {
			indigo_set_log_level(INDIGO_LOG_DEBUG);
		}
	}
	if (!indigo_test_use_private_home()) {
		return 1;
	}
	serial_port = hw_port("STEELDRIVE2_HW_PORT");
	const indigo_test_case tests[] = {
		{ "steeldrive2_publishes_the_values", steeldrive2_publishes_the_values },
		{ "steeldrive2_moves_to_absolute_positions", steeldrive2_moves_to_absolute_positions },
		{ "steeldrive2_moves_by_steps", steeldrive2_moves_by_steps },
		{ "steeldrive2_aborts_a_move", steeldrive2_aborts_a_move },
		{ "steeldrive2_syncs", steeldrive2_syncs },
		{ "steeldrive2_keeps_inside_the_limit", steeldrive2_keeps_inside_the_limit },
		{ "steeldrive2_changes_the_settings", steeldrive2_changes_the_settings },
		{ "steeldrive2_switches_the_compensation_mode", steeldrive2_switches_the_compensation_mode },
		{ "steeldrive2_zeroes", steeldrive2_zeroes },
		{ "steeldrive2_controls_the_heater", steeldrive2_controls_the_heater },
		{ "steeldrive2_refuses_reboot_while_shared", steeldrive2_refuses_reboot_while_shared },
		{ "steeldrive2_reconnects", steeldrive2_reconnects },
		{ "steeldrive2_rejects_shutdown_while_connected", steeldrive2_rejects_shutdown_while_connected },
		{ "steeldrive2_reinitializes", steeldrive2_reinitializes }
	};
	int result = 1;
	bool started = false, initialized = false;
	HW_CHECK(hw_start() == INDIGO_OK);
	started = true;
	HW_CHECK(hw_attach_client("SteelDriveII hardware test") == INDIGO_OK);
	HW_CHECK(indigo_focuser_steeldrive2(INDIGO_DRIVER_INIT, NULL) == INDIGO_OK);
	initialized = true;
	focuser = hw_wait_for_device(FOCUSER_NAME, SHORT_TIMEOUT);
	aux = hw_wait_for_device(AUX_NAME, SHORT_TIMEOUT);
	HW_CHECK(focuser >= 0 && aux >= 0);
	HW_CHECK(select_port());
	HW_CHECK(hw_connect(focuser, SHORT_TIMEOUT));
	HW_CHECK(hw_connect(aux, SHORT_TIMEOUT));
	HW_CHECK(focuser_hw_idle(focuser, FOCUSER_POSITION_PROPERTY_NAME, MOVE_TIMEOUT));
	// the motion controls work only in manual mode
	if (!focuser_hw_switch_is(focuser, FOCUSER_MODE_PROPERTY_NAME, FOCUSER_MODE_MANUAL_ITEM_NAME)) {
		HW_CHECK(focuser_hw_set_switch(focuser, FOCUSER_MODE_PROPERTY_NAME, FOCUSER_MODE_MANUAL_ITEM_NAME, SHORT_TIMEOUT));
	}
	initial_position = focuser_hw_position(focuser);
	initial_limit = value(focuser, FOCUSER_LIMITS_PROPERTY_NAME, FOCUSER_LIMITS_MAX_POSITION_ITEM_NAME);
	hw_text_item(focuser, "X_NAME", "NAME", initial_name, sizeof(initial_name));
	for (int i = 0; i < 6; i++) {
		initial_saved[i] = value(focuser, SAVED, saved_item[i]);
	}
	for (int i = 0; i < 3; i++) {
		initial_compensation[i] = value(focuser, FOCUSER_COMPENSATION_PROPERTY_NAME, compensation_item[i]);
	}
	strcpy(initial_sensor, focuser_hw_switch_is(focuser, "X_SELECT_TC_SENSOR", "SENSOR_0") ? "SENSOR_0" : focuser_hw_switch_is(focuser, "X_SELECT_TC_SENSOR", "SENSOR_1") ? "SENSOR_1" : "AVG");
	endstop = focuser_hw_switch_is(focuser, "X_USE_ENDSTOP", "ENABLED");
	auto_dew = focuser_hw_switch_is(aux, "X_USE_AUTO_DEW", AUX_DEW_CONTROL_AUTOMATIC_ITEM_NAME);
	initial_heater = value(aux, AUX_HEATER_OUTLET_PROPERTY_NAME, AUX_HEATER_OUTLET_1_ITEM_NAME);
	base = initial_position < 200 ? 200 : initial_position + TRAVEL > initial_limit ? initial_limit - TRAVEL : initial_position;
	state_captured = true;
	HW_CHECK(initial_limit >= TRAVEL + 200);
	result = indigo_run_tests("SteelDriveII hardware", tests, ARRAY_SIZE(tests));
cleanup:
	restore_initial_state();
	if (!hw_disconnect(aux, SHORT_TIMEOUT) || !hw_disconnect(focuser, SHORT_TIMEOUT)) {
		indigo_test_failures++;
	}
	if (initialized && indigo_focuser_steeldrive2(INDIGO_DRIVER_SHUTDOWN, NULL) != INDIGO_OK) {
		indigo_test_failures++;
	}
	indigo_detach_client(&hw_client);
	if (started) {
		indigo_stop();
	}
	hw_release_properties();
	indigo_test_remove_private_home();
	return indigo_test_failures ? 1 : result;
}
