// Copyright (c) 2026 INDIGO initiative
// All rights reserved.
//
// You may use this software under the terms of 'INDIGO Astronomy
// open-source license' (see LICENSE.md).
//
// THIS SOFTWARE IS PROVIDED BY THE AUTHORS 'AS IS' AND ANY EXPRESS
// OR IMPLIED WARRANTIES, INCLUDING, BUT NOT LIMITED TO, THE IMPLIED
// WARRANTIES OF MERCHANTABILITY AND FITNESS FOR A PARTICULAR PURPOSE
// ARE DISCLAIMED. IN NO EVENT SHALL THE AUTHOR BE LIABLE FOR ANY
// DIRECT, INDIRECT, INCIDENTAL, SPECIAL, EXEMPLARY, OR CONSEQUENTIAL
// DAMAGES (INCLUDING, BUT NOT LIMITED TO, PROCUREMENT OF SUBSTITUTE
// GOODS OR SERVICES; LOSS OF USE, DATA, OR PROFITS; OR BUSINESS
// INTERRUPTION) HOWEVER CAUSED AND ON ANY THEORY OF LIABILITY,
// WHETHER IN CONTRACT, STRICT LIABILITY, OR TORT (INCLUDING
// NEGLIGENCE OR OTHERWISE) ARISING IN ANY WAY OUT OF THE USE OF THIS
// SOFTWARE, EVEN IF ADVISED OF THE POSSIBILITY OF SUCH DAMAGE.

// Code is generated by AI

// Physical PrimaLuce Lab GIOTTO test for indigo_aux_giotto. THE PANEL LIGHTS UP. The run restores the light,
// the brightness, the fading, light-at-power-on and LED settings and the preset it uses.

#include <math.h>
#include <stdlib.h>
#include <indigo_drivers/aux_giotto/indigo_aux_giotto.h>
#include "hardware_test_common.h"

#define DEVICE_NAME "PrimaluceLab GIOTTO"
#define SHORT_TIMEOUT 15.0
// A preset the run names and recalls, and one it expects empty.
#define USED_PRESET "PRESET_8"
#define USED_PRESET_INDEX 8
#define EMPTY_PRESET "PRESET_9"

static int panel = -1;
static const char *serial_port = NULL;
static bool state_captured = false;
static bool initial_light = false;
static double initial_intensity = 0, max_brightness = 0;
static bool initial_fading = true, initial_power_on = false;
static char initial_leds[INDIGO_NAME_SIZE] = "ON";
static char initial_used_name[INDIGO_VALUE_SIZE] = "", initial_empty_name[INDIGO_VALUE_SIZE] = "";

static bool select_port(void) {
	if (serial_port == NULL || !*serial_port) {
		fprintf(stderr, "    set GIOTTO_HW_PORT to the panel's serial port\n");
		return false;
	}
	printf("Using port %s\n", serial_port);
	return hw_set_text(panel, DEVICE_PORT_PROPERTY_NAME, DEVICE_PORT_ITEM_NAME, serial_port, INDIGO_OK_STATE, SHORT_TIMEOUT);
}

static bool set_light(bool on) {
	return hw_set_switch(panel, AUX_LIGHT_SWITCH_PROPERTY_NAME, on ? AUX_LIGHT_SWITCH_ON_ITEM_NAME : AUX_LIGHT_SWITCH_OFF_ITEM_NAME, INDIGO_OK_STATE, SHORT_TIMEOUT);
}

static bool light_is(bool on) {
	bool value = !on;
	return hw_switch_item(panel, AUX_LIGHT_SWITCH_PROPERTY_NAME, AUX_LIGHT_SWITCH_ON_ITEM_NAME, &value) && value == on;
}

static bool intensity_is(double expected) {
	double value = -1;
	return hw_number_item(panel, AUX_LIGHT_INTENSITY_PROPERTY_NAME, AUX_LIGHT_INTENSITY_ITEM_NAME, &value) && value == expected;
}

static bool set_intensity(double value) {
	return hw_set_number(panel, AUX_LIGHT_INTENSITY_PROPERTY_NAME, AUX_LIGHT_INTENSITY_ITEM_NAME, value, INDIGO_OK_STATE, SHORT_TIMEOUT) && intensity_is(value);
}

static bool switch_on(const char *property, const char *item) {
	bool value = false;
	return hw_switch_item(panel, property, item, &value) && value;
}

static void restore_initial_state(void) {
	if (panel < 0 || !state_captured || !hw_connected(panel)) {
		return;
	}
	set_intensity(initial_intensity);
	set_light(initial_light);
	hw_set_switch(panel, "X_FADING", initial_fading ? "ON" : "OFF", INDIGO_OK_STATE, SHORT_TIMEOUT);
	hw_set_switch(panel, "X_POWER_ON_LIGHT", initial_power_on ? "ON" : "OFF", INDIGO_OK_STATE, SHORT_TIMEOUT);
	hw_set_switch(panel, "X_LEDS", initial_leds, INDIGO_OK_STATE, SHORT_TIMEOUT);
	// A preset takes a brightness only while it has a name, so the brightness goes first; on an unnamed preset
	// the request is refused and the brightness is already 0.
	hw_set_number(panel, "X_PRESETS", USED_PRESET, 0, INDIGO_OK_STATE, SHORT_TIMEOUT);
	hw_set_text(panel, "X_PRESET_NAMES", USED_PRESET, initial_used_name, INDIGO_OK_STATE, SHORT_TIMEOUT);
}

static void giotto_publishes_the_property_contract(void) {
	double min = -1, max = -1;
	char model[INDIGO_VALUE_SIZE] = "";
	ASSERT_TRUE((hw_device_interface(panel) & INDIGO_INTERFACE_AUX_LIGHTBOX) != 0);
	ASSERT_STREQ(DEVICE_NAME, hw_device_name(panel));
	ASSERT_TRUE(hw_text_item(panel, INFO_PROPERTY_NAME, INFO_DEVICE_MODEL_ITEM_NAME, model, sizeof(model)));
	ASSERT_TRUE(!strncmp(model, "GIOTTO", 6));
	ASSERT_TRUE(hw_property_defined(panel, AUX_LIGHT_SWITCH_PROPERTY_NAME));
	ASSERT_TRUE(hw_property_defined(panel, "X_STATE"));
	ASSERT_TRUE(hw_property_defined(panel, "X_PRESETS"));
	ASSERT_TRUE(hw_property_defined(panel, "X_PRESET_RECALL"));
	// The intensity is the panel's brightness level up to its factory maximum.
	ASSERT_TRUE(hw_number_item_range(panel, AUX_LIGHT_INTENSITY_PROPERTY_NAME, AUX_LIGHT_INTENSITY_ITEM_NAME, &min, &max));
	ASSERT_EQ_INT(0, (int)min);
	ASSERT_TRUE(max >= 50 && max <= 255);
	double temperature = -100, supply = 0;
	ASSERT_TRUE(hw_number_item(panel, "X_STATE", "TEMPERATURE", &temperature));
	ASSERT_TRUE(hw_number_item(panel, "X_STATE", "VIN_12V", &supply));
	ASSERT_TRUE(temperature > -20 && temperature < 80);
	printf("    %s, brightness %g of %g, light %s, %g °C, %g V\n", model, initial_intensity, max, initial_light ? "on" : "off", temperature, supply);
}

static void giotto_switches_the_light(void) {
	ASSERT_TRUE(set_light(true));
	ASSERT_TRUE(light_is(true));
	ASSERT_TRUE(set_light(false));
	ASSERT_TRUE(light_is(false));
	ASSERT_TRUE(set_light(false));
	ASSERT_TRUE(set_light(true));
	ASSERT_TRUE(set_light(true));
	ASSERT_TRUE(light_is(true));
	ASSERT_TRUE(set_light(false));
}

// Every level is accepted by the panel and confirmed by the next idle polls (2 s apart): a poll would
// publish the panel's own value if it differed.
static void giotto_sets_the_intensity(void) {
	ASSERT_TRUE(set_light(true));
	const double values[] = { 0, 1, 20, 60, max_brightness, 37 };
	for (int i = 0; i < ARRAY_SIZE(values); i++) {
		ASSERT_TRUE(set_intensity(values[i]));
	}
	indigo_usleep(4500000);
	ASSERT_TRUE(intensity_is(37));
	ASSERT_TRUE(hw_property_state(panel, AUX_LIGHT_INTENSITY_PROPERTY_NAME) == INDIGO_OK_STATE);
	// The panel keeps the brightness while the light is off.
	ASSERT_TRUE(set_light(false));
	ASSERT_TRUE(set_intensity(25));
	indigo_usleep(4500000);
	ASSERT_TRUE(light_is(false));
	ASSERT_TRUE(intensity_is(25));
}

static void giotto_uses_presets(void) {
	char text[INDIGO_VALUE_SIZE];
	ASSERT_TRUE(hw_set_text(panel, "X_PRESET_NAMES", USED_PRESET, "INDIGO test", INDIGO_OK_STATE, SHORT_TIMEOUT));
	ASSERT_TRUE(hw_set_number(panel, "X_PRESETS", USED_PRESET, 42, INDIGO_OK_STATE, SHORT_TIMEOUT));
	ASSERT_TRUE(set_light(false));
	ASSERT_TRUE(set_intensity(10));
	// A recall sets the brightness of the preset; the light stays off.
	ASSERT_TRUE(hw_set_switch(panel, "X_PRESET_RECALL", USED_PRESET, INDIGO_OK_STATE, SHORT_TIMEOUT));
	ASSERT_TRUE(intensity_is(42));
	ASSERT_TRUE(light_is(false));
	// An empty preset can neither take a brightness nor be recalled.
	ASSERT_TRUE(hw_text_item(panel, "X_PRESET_NAMES", EMPTY_PRESET, text, sizeof(text)));
	if (*text == 0) {
		double value = -1;
		ASSERT_TRUE(hw_set_number(panel, "X_PRESETS", EMPTY_PRESET, 30, INDIGO_ALERT_STATE, SHORT_TIMEOUT));
		ASSERT_TRUE(hw_number_item(panel, "X_PRESETS", EMPTY_PRESET, &value) && value == 0);
		ASSERT_TRUE(hw_set_switch(panel, "X_PRESET_RECALL", EMPTY_PRESET, INDIGO_ALERT_STATE, SHORT_TIMEOUT));
		ASSERT_TRUE(intensity_is(42));
	} else {
		printf("    %s is named \"%s\", the empty-preset checks are skipped\n", EMPTY_PRESET, text);
	}
	// The used preset is left as found: brightness 0 while it still has a name, then the name.
	ASSERT_TRUE(hw_set_number(panel, "X_PRESETS", USED_PRESET, 0, INDIGO_OK_STATE, SHORT_TIMEOUT));
	ASSERT_TRUE(hw_set_text(panel, "X_PRESET_NAMES", USED_PRESET, initial_used_name, INDIGO_OK_STATE, SHORT_TIMEOUT));
}

static void giotto_changes_the_settings(void) {
	ASSERT_TRUE(hw_set_switch(panel, "X_FADING", initial_fading ? "OFF" : "ON", INDIGO_OK_STATE, SHORT_TIMEOUT));
	ASSERT_TRUE(hw_set_switch(panel, "X_FADING", initial_fading ? "ON" : "OFF", INDIGO_OK_STATE, SHORT_TIMEOUT));
	ASSERT_TRUE(hw_set_switch(panel, "X_POWER_ON_LIGHT", initial_power_on ? "OFF" : "ON", INDIGO_OK_STATE, SHORT_TIMEOUT));
	ASSERT_TRUE(hw_set_switch(panel, "X_POWER_ON_LIGHT", initial_power_on ? "ON" : "OFF", INDIGO_OK_STATE, SHORT_TIMEOUT));
	ASSERT_TRUE(hw_set_switch(panel, "X_LEDS", "DIM", INDIGO_OK_STATE, SHORT_TIMEOUT));
	ASSERT_TRUE(hw_set_switch(panel, "X_LEDS", "MIDDLE", INDIGO_OK_STATE, SHORT_TIMEOUT));
	ASSERT_TRUE(hw_set_switch(panel, "X_LEDS", initial_leds, INDIGO_OK_STATE, SHORT_TIMEOUT));
}

// A disconnect switches the light off; the panel keeps the brightness, which a reconnect reads back.
static void giotto_reconnects(void) {
	ASSERT_TRUE(set_light(true));
	ASSERT_TRUE(set_intensity(33));
	ASSERT_TRUE(hw_disconnect(panel, SHORT_TIMEOUT));
	ASSERT_TRUE(hw_property_hidden(panel, AUX_LIGHT_SWITCH_PROPERTY_NAME));
	ASSERT_TRUE(hw_connect(panel, SHORT_TIMEOUT));
	ASSERT_TRUE(light_is(false));
	ASSERT_TRUE(intensity_is(33));
	ASSERT_TRUE(set_light(true));
	ASSERT_TRUE(set_light(false));
}

static void giotto_rejects_shutdown_while_connected(void) {
	ASSERT_EQ_INT(INDIGO_BUSY, indigo_aux_giotto(INDIGO_DRIVER_SHUTDOWN, NULL));
	ASSERT_TRUE(set_light(true));
	ASSERT_TRUE(set_light(false));
}

static void giotto_reinitializes(void) {
	ASSERT_TRUE(hw_disconnect(panel, SHORT_TIMEOUT));
	ASSERT_EQ_INT(INDIGO_OK, indigo_aux_giotto(INDIGO_DRIVER_SHUTDOWN, NULL));
	ASSERT_EQ_INT(-1, hw_device_index(DEVICE_NAME));
	ASSERT_EQ_INT(INDIGO_OK, indigo_aux_giotto(INDIGO_DRIVER_INIT, NULL));
	panel = hw_wait_for_device(DEVICE_NAME, SHORT_TIMEOUT);
	ASSERT_TRUE(panel >= 0);
	ASSERT_TRUE(select_port());
	ASSERT_TRUE(hw_connect(panel, SHORT_TIMEOUT));
	ASSERT_TRUE(set_light(true));
	ASSERT_TRUE(set_intensity(50));
	ASSERT_TRUE(set_light(false));
}

int main(int argc, char **argv) {
	if (argc < 2 || strcmp(argv[1], "--run")) {
		fprintf(stderr, "Physical GIOTTO test: run explicitly with --run (or make test-aux-giotto-hw).\n");
		return 2;
	}
	setvbuf(stdout, NULL, _IONBF, 0);
	for (int i = 2; i < argc; i++) {
		if (!strcmp(argv[i], "--debug")) {
			indigo_set_log_level(INDIGO_LOG_DEBUG);
		}
	}
	if (!indigo_test_use_private_home()) {
		return 1;
	}
	serial_port = hw_port("GIOTTO_HW_PORT");
	const indigo_test_case tests[] = {
		{ "giotto_publishes_the_property_contract", giotto_publishes_the_property_contract },
		{ "giotto_switches_the_light", giotto_switches_the_light },
		{ "giotto_sets_the_intensity", giotto_sets_the_intensity },
		{ "giotto_uses_presets", giotto_uses_presets },
		{ "giotto_changes_the_settings", giotto_changes_the_settings },
		{ "giotto_reconnects", giotto_reconnects },
		{ "giotto_rejects_shutdown_while_connected", giotto_rejects_shutdown_while_connected },
		{ "giotto_reinitializes", giotto_reinitializes }
	};
	int result = 1;
	bool started = false, initialized = false;
	double min = 0;
	HW_CHECK(hw_start() == INDIGO_OK);
	started = true;
	HW_CHECK(hw_attach_client("GIOTTO hardware test") == INDIGO_OK);
	HW_CHECK(indigo_aux_giotto(INDIGO_DRIVER_INIT, NULL) == INDIGO_OK);
	initialized = true;
	panel = hw_wait_for_device(DEVICE_NAME, SHORT_TIMEOUT);
	HW_CHECK(panel >= 0);
	HW_CHECK(select_port());
	HW_CHECK(hw_connect(panel, SHORT_TIMEOUT));
	initial_light = light_is(true);
	HW_CHECK(hw_number_item(panel, AUX_LIGHT_INTENSITY_PROPERTY_NAME, AUX_LIGHT_INTENSITY_ITEM_NAME, &initial_intensity));
	HW_CHECK(hw_number_item_range(panel, AUX_LIGHT_INTENSITY_PROPERTY_NAME, AUX_LIGHT_INTENSITY_ITEM_NAME, &min, &max_brightness));
	initial_fading = switch_on("X_FADING", "ON");
	initial_power_on = switch_on("X_POWER_ON_LIGHT", "ON");
	const char *leds[] = { "OFF", "DIM", "MIDDLE", "ON" };
	for (int i = 0; i < ARRAY_SIZE(leds); i++) {
		if (switch_on("X_LEDS", leds[i])) {
			snprintf(initial_leds, sizeof(initial_leds), "%s", leds[i]);
		}
	}
	HW_CHECK(hw_text_item(panel, "X_PRESET_NAMES", USED_PRESET, initial_used_name, sizeof(initial_used_name)));
	HW_CHECK(hw_text_item(panel, "X_PRESET_NAMES", EMPTY_PRESET, initial_empty_name, sizeof(initial_empty_name)));
	if (*initial_used_name) {
		fprintf(stderr, "    preset %d is in use (\"%s\"); clear it or change USED_PRESET\n", USED_PRESET_INDEX, initial_used_name);
		HW_CHECK(false);
	}
	state_captured = true;
	result = indigo_run_tests("GIOTTO hardware", tests, ARRAY_SIZE(tests));
cleanup:
	restore_initial_state();
	if (!hw_disconnect(panel, SHORT_TIMEOUT)) {
		indigo_test_failures++;
	}
	if (initialized && indigo_aux_giotto(INDIGO_DRIVER_SHUTDOWN, NULL) != INDIGO_OK) {
		indigo_test_failures++;
	}
	indigo_detach_client(&hw_client);
	if (started) {
		indigo_stop();
	}
	hw_release_properties();
	indigo_test_remove_private_home();
	return indigo_test_failures ? 1 : result;
}
