// Copyright (c) 2026 INDIGO initiative
// All rights reserved.
//
// You may use this software under the terms of 'INDIGO Astronomy
// open-source license' (see LICENSE.md).
//
// THIS SOFTWARE IS PROVIDED BY THE AUTHORS 'AS IS' AND ANY EXPRESS
// OR IMPLIED WARRANTIES, INCLUDING, BUT NOT LIMITED TO, THE IMPLIED
// WARRANTIES OF MERCHANTABILITY AND FITNESS FOR A PARTICULAR PURPOSE
// ARE DISCLAIMED. IN NO EVENT SHALL THE AUTHOR BE LIABLE FOR ANY
// DIRECT, INDIRECT, INCIDENTAL, SPECIAL, EXEMPLARY, OR CONSEQUENTIAL
// DAMAGES (INCLUDING, BUT NOT LIMITED TO, PROCUREMENT OF SUBSTITUTE
// GOODS OR SERVICES; LOSS OF USE, DATA, OR PROFITS; OR BUSINESS
// INTERRUPTION) HOWEVER CAUSED AND ON ANY THEORY OF LIABILITY,
// WHETHER IN CONTRACT, STRICT LIABILITY, OR TORT (INCLUDING
// NEGLIGENCE OR OTHERWISE) ARISING IN ANY WAY OUT OF THE USE OF THIS
// SOFTWARE, EVEN IF ADVISED OF THE POSSIBILITY OF SUCH DAMAGE.

// Code is generated by AI

// Hardware test implemented by OpenAI Codex.

#include <pthread.h>
#include <stdlib.h>
#include <time.h>
#include <indigo/indigo_driver.h>
#include <dlfcn.h>
#include "../test_runner.h"

#define MAX_DEVICES 16
#define MAX_PROPERTIES 128
#define CHECK(condition) do { if (!(condition)) { fprintf(stderr, "%s:%d: %s\n", __FILE__, __LINE__, #condition); indigo_test_failures++; goto cleanup; } } while (0)

typedef struct {
	char name[INDIGO_NAME_SIZE];
	indigo_device *device, *master;
	unsigned interface;
	bool present;
	indigo_property *properties[MAX_PROPERTIES];
	unsigned revisions[MAX_PROPERTIES];
	unsigned frames, invalid_frames;
} observed_device;

static observed_device devices[MAX_DEVICES];
static pthread_mutex_t mutex = PTHREAD_MUTEX_INITIALIZER;
static int camera = -1, guider = -1;
static indigo_result (*driver_entry)(indigo_driver_action, indigo_driver_info *);
static void *driver_library;
static const char *library_path, *entry_symbol;

static bool load_driver(void) {
	driver_library = dlopen(library_path, RTLD_NOW | RTLD_LOCAL);
	if (!driver_library) { fprintf(stderr, "%s\n", dlerror()); return false; }
	driver_entry = (indigo_result (*)(indigo_driver_action, indigo_driver_info *))dlsym(driver_library, entry_symbol);
	return driver_entry != NULL;
}

static indigo_client client;

static int slot(int d, const char *name) {
	for (int p = 0; p < MAX_PROPERTIES; p++) {
		if (devices[d].properties[p] && !strcmp(devices[d].properties[p]->name, name)) {
			return p;
		}
	}
	return -1;
}

static indigo_result observe(indigo_device *device, indigo_property *property, const char *message, bool image_update) {
	pthread_mutex_lock(&mutex);
	int d;
	for (d = 0; d < MAX_DEVICES; d++) {
		if (!*devices[d].name || !strcmp(devices[d].name, property->device)) {
			break;
		}
	}
	if (d < MAX_DEVICES) {
		snprintf(devices[d].name, INDIGO_NAME_SIZE, "%s", property->device);
		devices[d].device = device;
		devices[d].master = device->master_device;
		if (!image_update && !strcmp(property->name, "INFO")) {
			devices[d].present = true;
			for (int i = 0; i < property->count; i++) {
				if (!strcmp(property->items[i].name, "DEVICE_INTERFACE")) {
					devices[d].interface = strtoul(property->items[i].text.value, NULL, 10);
				}
			}
		}
		int p = slot(d, property->name);
		if (p < 0) {
			for (p = 0; p < MAX_PROPERTIES && devices[d].properties[p]; p++) { }
		}
		if (p < MAX_PROPERTIES) {
			indigo_release_property(devices[d].properties[p]);
			devices[d].properties[p] = indigo_copy_property(NULL, property);
			devices[d].revisions[p]++;
		}
		if (image_update && !strcmp(property->name, "CCD_IMAGE") && property->state == INDIGO_OK_STATE && property->count && property->items[0].blob.value) {
			indigo_item *item = property->items;
			indigo_raw_header header = { 0 };
			if (item->blob.size >= sizeof(header)) {
				memcpy(&header, item->blob.value, sizeof(header));
			}
			unsigned bytes = header.signature == INDIGO_RAW_MONO8 ? 1 : (header.signature == INDIGO_RAW_MONO16 ? 2 : (header.signature == INDIGO_RAW_RGB24 ? 3 : (header.signature == INDIGO_RAW_RGB48 ? 6 : 0)));
			if (strcmp(item->blob.format, ".raw") || !bytes || !header.width || !header.height || (uint64_t)header.width * header.height * bytes + sizeof(header) > item->blob.size) {
				devices[d].invalid_frames++;
			}
			devices[d].frames++;
			if (devices[d].frames <= 12 || devices[d].frames % 100 == 0) {
				printf("    frame %u: %u x %u, %ld bytes\n", devices[d].frames, header.width, header.height, item->blob.size);
			}
		}
	}
	pthread_mutex_unlock(&mutex);
	if (message && *message) {
		fprintf(stderr, "    %s %s: %s\n", property->device, property->name, message);
	}
	return INDIGO_OK;
}

static indigo_result define_property(indigo_client *client, indigo_device *device, indigo_property *property, const char *message) {
	return observe(device, property, message, false);
}

static indigo_result update_property(indigo_client *client, indigo_device *device, indigo_property *property, const char *message) {
	return observe(device, property, message, true);
}

static indigo_result delete_property(indigo_client *client, indigo_device *device, indigo_property *property, const char *message) {
	if (!*property->name) {
		pthread_mutex_lock(&mutex);
		for (int d = 0; d < MAX_DEVICES; d++) {
			if (!strcmp(devices[d].name, property->device)) {
				devices[d].present = false;
				for (int p = 0; p < MAX_PROPERTIES; p++) {
					indigo_release_property(devices[d].properties[p]);
					devices[d].properties[p] = NULL;
				}
			}
		}
		pthread_mutex_unlock(&mutex);
	}
	return INDIGO_OK;
}

static bool wait_presence(bool present) {
	for (int i = 0; i < 18000; i++) {
		pthread_mutex_lock(&mutex);
		bool ready = devices[camera].present == present && (guider < 0 || devices[guider].present == present);
		if (present) {
			ready = ready && slot(camera, "CONNECTION") >= 0 && (guider < 0 || slot(guider, "CONNECTION") >= 0);
		}
		pthread_mutex_unlock(&mutex);
		if (ready) {
			return true;
		}
		indigo_usleep(10000);
	}
	fprintf(stderr, "Timed out waiting for physical %s\n", present ? "replug" : "unplug");
	return false;
}

static bool disconnect_device(int d) {
	pthread_mutex_lock(&mutex);
	bool present = devices[d].present;
	pthread_mutex_unlock(&mutex);
	if (!present) {
		return true;
	}
	indigo_change_switch_property_1(&client, devices[d].name, "CONNECTION", "DISCONNECTED", true);
	for (int i = 0; i < 3000; i++) {
		pthread_mutex_lock(&mutex);
		int p = slot(d, "CONNECTION");
		bool disconnected = false;
		if (p >= 0 && devices[d].properties[p]->state == INDIGO_OK_STATE) {
			indigo_property *property = devices[d].properties[p];
			for (int j = 0; j < property->count; j++) {
				if (!strcmp(property->items[j].name, "DISCONNECTED")) {
					disconnected = property->items[j].sw.value;
				}
			}
		}
		pthread_mutex_unlock(&mutex);
		if (disconnected) {
			return true;
		}
		indigo_usleep(10000);
	}
	fprintf(stderr, "Disconnect timeout: %s\n", devices[d].name);
	return false;
}

static unsigned revision(int d, const char *name) {
	pthread_mutex_lock(&mutex);
	int p = slot(d, name);
	unsigned result = p < 0 ? 0 : devices[d].revisions[p];
	pthread_mutex_unlock(&mutex);
	return result;
}

static bool wait_state(int d, const char *name, unsigned after, indigo_property_state state) {
	for (int i = 0; i < 3000; i++) {
		pthread_mutex_lock(&mutex);
		int p = slot(d, name);
		bool ready = p >= 0 && devices[d].revisions[p] > after && devices[d].properties[p]->state == state;
		pthread_mutex_unlock(&mutex);
		if (ready) {
			return true;
		}
		indigo_usleep(10000);
	}
	fprintf(stderr, "Timeout: %s %s expected state %d\n", devices[d].name, name, state);
	return false;
}

static bool switch_value(int d, const char *name, const char *item, indigo_property_state state) {
	printf("Set %s.%s = ON\n", name, item);
	unsigned before = revision(d, name);
	indigo_change_switch_property_1(&client, devices[d].name, name, item, true);
	return wait_state(d, name, before, state);
}

static bool number_value(int d, const char *name, const char *item, double value, indigo_property_state state) {
	printf("Set %s.%s = %.6g\n", name, item, value);
	unsigned before = revision(d, name);
	indigo_change_number_property_1(&client, devices[d].name, name, item, value);
	return wait_state(d, name, before, state);
}

static unsigned frames(void) {
	pthread_mutex_lock(&mutex);
	unsigned result = devices[camera].frames;
	pthread_mutex_unlock(&mutex);
	return result;
}

static indigo_property *snapshot(int d, const char *name) {
	pthread_mutex_lock(&mutex);
	int p = slot(d, name);
	indigo_property *copy = p < 0 ? NULL : indigo_copy_property(NULL, devices[d].properties[p]);
	pthread_mutex_unlock(&mutex);
	return copy;
}

static bool restore(indigo_property *property) {
	if (!property) { return true; }
	unsigned before = revision(camera, property->name);
	indigo_change_property(&client, property);
	return wait_state(camera, property->name, before, INDIGO_OK_STATE);
}

static bool selected(const char *name) {
	const char *scenario = getenv("QHY_HW_CASE");
	return !scenario || !strcmp(scenario, name);
}

static void hardware_workflows(void) {
	bool initialized = false;
	indigo_property *format = NULL, *frame = NULL, *bins = NULL, *gain = NULL, *advanced = NULL, *mode = NULL;
	CHECK(indigo_start() == INDIGO_OK);
	CHECK(indigo_attach_client(&client) == INDIGO_OK);
	indigo_driver_info info;
	CHECK(driver_entry(INDIGO_DRIVER_INFO, &info) == INDIGO_OK);
	printf("Driver %s version 0x%08x, process %zu-bit\n", info.name, info.version, sizeof(void *) * 8);
	CHECK(driver_entry(INDIGO_DRIVER_INIT, NULL) == INDIGO_OK);
	initialized = true;
	const char *requested = getenv("INDIGO_TEST_DEVICE");
	for (int attempt = 0; attempt < 6000; attempt++) {
		bool found = false;
		pthread_mutex_lock(&mutex);
		for (int d = 0; d < MAX_DEVICES; d++) {
			found |= (devices[d].interface & INDIGO_INTERFACE_CCD) && strstr(devices[d].name, requested) && slot(d, "CONNECTION") >= 0;
		}
		pthread_mutex_unlock(&mutex);
		if (found) { break; }
		indigo_usleep(10000);
	}
	int matches = 0;
	pthread_mutex_lock(&mutex);
	for (int d = 0; d < MAX_DEVICES; d++) {
		if (devices[d].interface & INDIGO_INTERFACE_CCD) {
			printf("Discovered %s\n", devices[d].name);
			if (strstr(devices[d].name, requested)) { camera = d; matches++; }
		}
	}
	pthread_mutex_unlock(&mutex);
	CHECK(matches == 1);
	printf("Selected %s\n", devices[camera].name);
	CHECK(switch_value(camera, "CONNECTION", "CONNECTED", INDIGO_OK_STATE));
	// Connection is serialized after hot-plug attachment of all logical siblings.
	pthread_mutex_lock(&mutex);
	for (int d = 0; d < MAX_DEVICES; d++) {
		if ((devices[d].interface & INDIGO_INTERFACE_GUIDER) && devices[d].master == devices[camera].device) { guider = d; }
	}
	pthread_mutex_unlock(&mutex);
	printf("Guider: %s\n", guider >= 0 ? devices[guider].name : "not exposed");
	if (getenv("QHY_HW_CASE") && selected("guide")) { CHECK(guider >= 0); }
	format = snapshot(camera, "X_PIXEL_FORMAT"); frame = snapshot(camera, "CCD_FRAME"); bins = snapshot(camera, "CCD_BIN"); gain = snapshot(camera, "CCD_GAIN"); advanced = snapshot(camera, "X_ADVANCED"); mode = snapshot(camera, "X_READ_MODE");
	CHECK(switch_value(camera, "CCD_UPLOAD_MODE", "CLIENT", INDIGO_OK_STATE));
	CHECK(switch_value(camera, "CCD_IMAGE_FORMAT", "RAW", INDIGO_OK_STATE));
	if (selected("exposure")) {
		double durations[] = { 0.1, 1.5, 2.5, 16.5 };
		for (unsigned i = 0; i < sizeof(durations) / sizeof(durations[0]); i++) {
			unsigned before = frames();
			double start = indigo_monotonic_time();
			printf("Exposure %.3f seconds\n", durations[i]);
			CHECK(number_value(camera, "CCD_EXPOSURE", "EXPOSURE", durations[i], INDIGO_OK_STATE));
			printf("Elapsed %.3f seconds\n", indigo_monotonic_time() - start);
			CHECK(frames() == before + 1);
		}
	}
	if (selected("geometry")) {
		if (format) {
			for (int i = 0; i < format->count; i++) {
				CHECK(switch_value(camera, "X_PIXEL_FORMAT", format->items[i].name, INDIGO_OK_STATE));
				CHECK(number_value(camera, "CCD_EXPOSURE", "EXPOSURE", 0.1, INDIGO_OK_STATE));
			}
			CHECK(restore(format));
		}
		CHECK(indigo_change_number_property(&client, devices[camera].name, "CCD_FRAME", 4, (const char *[]){ "LEFT", "TOP", "WIDTH", "HEIGHT" }, (double []){ 16, 16, 128, 128 }) == INDIGO_OK);
		CHECK(number_value(camera, "CCD_EXPOSURE", "EXPOSURE", 0.1, INDIGO_OK_STATE));
		CHECK(restore(frame));
		indigo_property *modes = snapshot(camera, "CCD_MODE");
		if (modes) {
			for (int i = 0; i < modes->count; i++) {
				if (!switch_value(camera, "CCD_MODE", modes->items[i].name, INDIGO_OK_STATE) || !number_value(camera, "CCD_EXPOSURE", "EXPOSURE", 0.1, INDIGO_OK_STATE)) { indigo_release_property(modes); CHECK(false); }
			}
			indigo_release_property(modes);
		}
		CHECK(restore(bins)); CHECK(restore(format)); CHECK(restore(frame));
	}
	if (selected("settings")) {
		if (gain) { CHECK(number_value(camera, "CCD_GAIN", "GAIN", gain->items[0].number.min, INDIGO_OK_STATE)); CHECK(restore(gain)); }
		if (advanced) { CHECK(restore(advanced)); }
		if (mode) {
			for (int i = 0; i < mode->count; i++) {
				CHECK(switch_value(camera, "X_READ_MODE", mode->items[i].name, INDIGO_OK_STATE));
				CHECK(number_value(camera, "CCD_EXPOSURE", "EXPOSURE", 0.1, INDIGO_OK_STATE));
			}
			CHECK(restore(mode));
		}
	}
	if (selected("abort")) {
		CHECK(number_value(camera, "CCD_EXPOSURE", "EXPOSURE", 5, INDIGO_BUSY_STATE));
		indigo_usleep(500000);
		CHECK(switch_value(camera, "CCD_ABORT_EXPOSURE", "ABORT_EXPOSURE", INDIGO_OK_STATE));
		CHECK(number_value(camera, "CCD_EXPOSURE", "EXPOSURE", 0.1, INDIGO_OK_STATE));
	}
	if (selected("stream")) {
		unsigned before = frames(), rev = revision(camera, "CCD_STREAMING");
		indigo_change_number_property(&client, devices[camera].name, "CCD_STREAMING", 2, (const char *[]){ "EXPOSURE", "COUNT" }, (double []){ 0.1, 3 });
		CHECK(wait_state(camera, "CCD_STREAMING", rev, INDIGO_OK_STATE)); CHECK(frames() == before + 3);
		rev = revision(camera, "CCD_STREAMING"); before = frames();
		indigo_change_number_property(&client, devices[camera].name, "CCD_STREAMING", 2, (const char *[]){ "EXPOSURE", "COUNT" }, (double []){ 0.1, -1 });
		CHECK(wait_state(camera, "CCD_STREAMING", rev, INDIGO_BUSY_STATE));
		for (int i = 0; i < 3000 && frames() < before + 3; i++) { indigo_usleep(10000); }
		CHECK(frames() >= before + 3);
		CHECK(switch_value(camera, "CCD_ABORT_EXPOSURE", "ABORT_EXPOSURE", INDIGO_OK_STATE));
		CHECK(number_value(camera, "CCD_EXPOSURE", "EXPOSURE", 0.1, INDIGO_OK_STATE));
	}
	if (selected("guide") && guider >= 0) {
		CHECK(switch_value(guider, "CONNECTION", "CONNECTED", INDIGO_OK_STATE));
		const char *axis[] = { "GUIDER_GUIDE_RA", "GUIDER_GUIDE_RA", "GUIDER_GUIDE_DEC", "GUIDER_GUIDE_DEC" };
		const char *direction[] = { "EAST", "WEST", "NORTH", "SOUTH" };
		for (int i = 0; i < 4; i++) { CHECK(number_value(guider, axis[i], direction[i], 100, INDIGO_OK_STATE)); }
		CHECK(number_value(camera, "CCD_EXPOSURE", "EXPOSURE", 1.5, INDIGO_BUSY_STATE));
		CHECK(number_value(guider, "GUIDER_GUIDE_RA", "EAST", 100, INDIGO_OK_STATE));
		CHECK(wait_state(camera, "CCD_EXPOSURE", 0, INDIGO_OK_STATE));
		CHECK(disconnect_device(camera)); CHECK(number_value(guider, "GUIDER_GUIDE_RA", "WEST", 100, INDIGO_OK_STATE));
		CHECK(disconnect_device(guider)); CHECK(switch_value(camera, "CONNECTION", "CONNECTED", INDIGO_OK_STATE));
	}
	if (getenv("QHY_HW_CASE") && !selected("exposure")) {
		printf("Selected feature phase completed; reconnect/library reload are tested separately by the exposure scenario\n");
		goto cleanup;
	}
	CHECK(disconnect_device(camera)); CHECK(switch_value(camera, "CONNECTION", "CONNECTED", INDIGO_OK_STATE));
	CHECK(switch_value(camera, "CCD_IMAGE_FORMAT", "RAW", INDIGO_OK_STATE));
	CHECK(number_value(camera, "CCD_EXPOSURE", "EXPOSURE", 0.1, INDIGO_OK_STATE));

	CHECK(disconnect_device(camera));
	CHECK(driver_entry(INDIGO_DRIVER_SHUTDOWN, NULL) == INDIGO_OK); initialized = false;
	CHECK(dlclose(driver_library) == 0); driver_library = NULL;
	CHECK(load_driver());
	CHECK(driver_entry(INDIGO_DRIVER_INIT, NULL) == INDIGO_OK); initialized = true;
	CHECK(wait_presence(true)); CHECK(switch_value(camera, "CONNECTION", "CONNECTED", INDIGO_OK_STATE));
	CHECK(switch_value(camera, "CCD_IMAGE_FORMAT", "RAW", INDIGO_OK_STATE));
	CHECK(number_value(camera, "CCD_EXPOSURE", "EXPOSURE", 0.1, INDIGO_OK_STATE));
	printf("Driver dlclose/dlopen and fresh exposure succeeded; SDK may remain mapped by its own runtime\n");
	pthread_mutex_lock(&mutex); unsigned invalid = devices[camera].invalid_frames; pthread_mutex_unlock(&mutex); CHECK(invalid == 0);
cleanup:
	if (camera >= 0) {
		switch_value(camera, "CCD_ABORT_EXPOSURE", "ABORT_EXPOSURE", INDIGO_OK_STATE);
		indigo_property *connection = snapshot(camera, "CONNECTION");
		if (connection && connection->items[0].sw.value) {
			if (!restore(mode) || !restore(bins) || !restore(format) || !restore(frame) || !restore(gain) || !restore(advanced)) { indigo_test_failures++; }
		}
		indigo_release_property(connection);
		if (!disconnect_device(camera)) { indigo_test_failures++; }
	}
	if (guider >= 0 && !disconnect_device(guider)) { indigo_test_failures++; }
	indigo_release_property(mode); indigo_release_property(bins); indigo_release_property(format); indigo_release_property(frame); indigo_release_property(gain); indigo_release_property(advanced);
	if (initialized && driver_entry(INDIGO_DRIVER_SHUTDOWN, NULL) != INDIGO_OK) { indigo_test_failures++; }
	indigo_detach_client(&client); indigo_stop();
}

int main(int argc, char **argv) {
	if (argc != 4 || strcmp(argv[1], "--run") || !getenv("INDIGO_TEST_DEVICE") || !*getenv("INDIGO_TEST_DEVICE")) {
		fprintf(stderr, "Set INDIGO_TEST_DEVICE to a unique model/name substring and run --run <driver-library> <entry-symbol>. QHY_HW_CASE optionally selects exposure, geometry, settings, abort, stream or guide.\n");
		return 2;
	}
	library_path = argv[2]; entry_symbol = argv[3];
	if (getenv("QHY_HW_DEBUG")) { indigo_set_log_level(INDIGO_LOG_DEBUG); }
	if (!load_driver()) { return 1; }
	setvbuf(stdout, NULL, _IONBF, 0);
	client = (indigo_client){ .name = "QHY hardware test", .version = INDIGO_VERSION_CURRENT, .define_property = define_property, .update_property = update_property, .delete_property = delete_property };
	const indigo_test_case tests[] = { { "QHY physical acceptance", hardware_workflows } };
	int result = indigo_run_tests("QHY hardware", tests, 1);
	for (int d = 0; d < MAX_DEVICES; d++) {
		for (int p = 0; p < MAX_PROPERTIES; p++) { indigo_release_property(devices[d].properties[p]); }
	}
	if (driver_library && dlclose(driver_library)) { result = 1; }
	return result;
}
