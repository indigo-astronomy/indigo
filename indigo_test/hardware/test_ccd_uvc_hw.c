// Copyright (c) 2026 INDIGO initiative
// All rights reserved.
//
// You may use this software under the terms of 'INDIGO Astronomy
// open-source license' (see LICENSE.md).
//
// THIS SOFTWARE IS PROVIDED BY THE AUTHORS 'AS IS' AND ANY EXPRESS
// OR IMPLIED WARRANTIES, INCLUDING, BUT NOT LIMITED TO, THE IMPLIED
// WARRANTIES OF MERCHANTABILITY AND FITNESS FOR A PARTICULAR PURPOSE
// ARE DISCLAIMED. IN NO EVENT SHALL THE AUTHOR BE LIABLE FOR ANY
// DIRECT, INDIRECT, INCIDENTAL, SPECIAL, EXEMPLARY, OR CONSEQUENTIAL
// DAMAGES (INCLUDING, BUT NOT LIMITED TO, PROCUREMENT OF SUBSTITUTE
// GOODS OR SERVICES; LOSS OF USE, DATA, OR PROFITS; OR BUSINESS
// INTERRUPTION) HOWEVER CAUSED AND ON ANY THEORY OF LIABILITY,
// WHETHER IN CONTRACT, STRICT LIABILITY, OR TORT (INCLUDING
// NEGLIGENCE OR OTHERWISE) ARISING IN ANY WAY OUT OF THE USE OF THIS
// SOFTWARE, EVEN IF ADVISED OF THE POSSIBILITY OF SUCH DAMAGE.

// Code is generated by AI

// Physical UVC camera acceptance test implemented by OpenAI Codex.

#include <pthread.h>
#include <math.h>
#include <stdlib.h>

#include <indigo/indigo_driver.h>
#include <indigo_drivers/ccd_uvc/indigo_ccd_uvc.h>

#include "../test_runner.h"

#define MAX_DEVICES 16
#define MAX_PROPERTIES 128
#define CHECK(condition) do { if (!(condition)) { fprintf(stderr, "%s:%d: %s\n", __FILE__, __LINE__, #condition); indigo_test_failures++; return; } } while (0)
#define ARRAY_SIZE(array) (sizeof(array) / sizeof((array)[0]))

typedef struct {
	char name[INDIGO_NAME_SIZE];
	unsigned interface;
	bool present;
	indigo_property *properties[MAX_PROPERTIES];
	unsigned revisions[MAX_PROPERTIES];
	unsigned frames;
	unsigned invalid_frames;
} observed_device;

static observed_device devices[MAX_DEVICES];
static pthread_mutex_t mutex = PTHREAD_MUTEX_INITIALIZER;
static indigo_client client;
static int camera = -1;
static bool hotplug;
static double short_exposure = 0.1;
static double long_exposure = 1;

static int property_slot(int device_index, const char *name) {
	for (int property_index = 0; property_index < MAX_PROPERTIES; property_index++) {
		if (devices[device_index].properties[property_index] && !strcmp(devices[device_index].properties[property_index]->name, name)) {
			return property_index;
		}
	}
	return -1;
}

static indigo_result observe(indigo_device *device, indigo_property *property, const char *message, bool image_update) {
	pthread_mutex_lock(&mutex);
	int device_index;
	for (device_index = 0; device_index < MAX_DEVICES; device_index++) {
		if (!*devices[device_index].name || !strcmp(devices[device_index].name, property->device)) {
			break;
		}
	}
	if (device_index < MAX_DEVICES) {
		snprintf(devices[device_index].name, INDIGO_NAME_SIZE, "%s", property->device);
		if (!image_update && !strcmp(property->name, INFO_PROPERTY_NAME)) {
			devices[device_index].present = true;
			for (int item_index = 0; item_index < property->count; item_index++) {
				if (!strcmp(property->items[item_index].name, INFO_DEVICE_INTERFACE_ITEM_NAME)) {
					devices[device_index].interface = strtoul(property->items[item_index].text.value, NULL, 10);
				}
			}
		}
		int property_index = property_slot(device_index, property->name);
		if (property_index < 0) {
			for (property_index = 0; property_index < MAX_PROPERTIES && devices[device_index].properties[property_index]; property_index++) { }
		}
		if (property_index < MAX_PROPERTIES) {
			indigo_release_property(devices[device_index].properties[property_index]);
			devices[device_index].properties[property_index] = indigo_copy_property(NULL, property);
			devices[device_index].revisions[property_index]++;
		}
		if (image_update && !strcmp(property->name, CCD_IMAGE_PROPERTY_NAME) && property->state == INDIGO_OK_STATE && property->count && property->items[0].blob.value) {
			indigo_item *item = property->items;
			indigo_raw_header header = { 0 };
			if (item->blob.size >= sizeof(header)) {
				memcpy(&header, item->blob.value, sizeof(header));
			}
			unsigned bytes_per_pixel = header.signature == INDIGO_RAW_MONO8 ? 1 : (header.signature == INDIGO_RAW_MONO16 ? 2 : (header.signature == INDIGO_RAW_RGB24 ? 3 : 0));
			if (strcmp(item->blob.format, ".raw") || !bytes_per_pixel || !header.width || !header.height || (uint64_t)header.width * header.height * bytes_per_pixel + sizeof(header) > item->blob.size) {
				devices[device_index].invalid_frames++;
			}
			devices[device_index].frames++;
			printf("    frame %u: %u x %u, %ld bytes\n", devices[device_index].frames, header.width, header.height, item->blob.size);
		}
	}
	pthread_mutex_unlock(&mutex);
	if (message && *message) {
		fprintf(stderr, "    %s %s: %s\n", property->device, property->name, message);
	}
	return INDIGO_OK;
}

static indigo_result define_property(indigo_client *client, indigo_device *device, indigo_property *property, const char *message) {
	return observe(device, property, message, false);
}

static indigo_result update_property(indigo_client *client, indigo_device *device, indigo_property *property, const char *message) {
	return observe(device, property, message, true);
}

static indigo_result report_message(indigo_client *client, indigo_device *device, indigo_property *property, const char *message) {
	fprintf(stderr, "    message: %s\n", message ? message : "");
	return INDIGO_OK;
}

static indigo_result delete_property(indigo_client *client, indigo_device *device, indigo_property *property, const char *message) {
	if (!*property->name) {
		pthread_mutex_lock(&mutex);
		for (int device_index = 0; device_index < MAX_DEVICES; device_index++) {
			if (!strcmp(devices[device_index].name, property->device)) {
				devices[device_index].present = false;
				for (int property_index = 0; property_index < MAX_PROPERTIES; property_index++) {
					indigo_release_property(devices[device_index].properties[property_index]);
					devices[device_index].properties[property_index] = NULL;
				}
			}
		}
		pthread_mutex_unlock(&mutex);
	}
	return INDIGO_OK;
}

static bool select_camera(void) {
	const char *requested = getenv("INDIGO_TEST_DEVICE");
	int matches = 0;
	pthread_mutex_lock(&mutex);
	for (int device_index = 0; device_index < MAX_DEVICES; device_index++) {
		if (devices[device_index].present && (devices[device_index].interface & INDIGO_INTERFACE_CCD)) {
			printf("    discovered camera: %s\n", devices[device_index].name);
			if (!requested || !strcmp(requested, devices[device_index].name)) {
				camera = device_index;
				matches++;
			}
		}
	}
	pthread_mutex_unlock(&mutex);
	if (matches != 1) {
		fprintf(stderr, "Expected one matching UVC camera, found %d. Set INDIGO_TEST_DEVICE to an exact discovered name when needed.\n", matches);
		camera = -1;
		return false;
	}
	printf("    selected: %s\n", devices[camera].name);
	return true;
}

static bool wait_presence(bool present) {
	for (int iteration = 0; iteration < 18000; iteration++) {
		pthread_mutex_lock(&mutex);
		bool ready = camera >= 0 && devices[camera].present == present;
		if (ready && present) {
			ready = property_slot(camera, CONNECTION_PROPERTY_NAME) >= 0;
		}
		pthread_mutex_unlock(&mutex);
		if (ready) {
			return true;
		}
		indigo_usleep(10000);
	}
	fprintf(stderr, "Timed out waiting for physical %s\n", present ? "replug" : "unplug");
	return false;
}

static unsigned property_revision(const char *name) {
	pthread_mutex_lock(&mutex);
	int property_index = property_slot(camera, name);
	unsigned result = property_index < 0 ? 0 : devices[camera].revisions[property_index];
	pthread_mutex_unlock(&mutex);
	return result;
}

static bool wait_state(const char *name, unsigned after, indigo_property_state state) {
	for (int iteration = 0; iteration < 6000; iteration++) {
		pthread_mutex_lock(&mutex);
		int property_index = property_slot(camera, name);
		bool ready = property_index >= 0 && devices[camera].revisions[property_index] > after && devices[camera].properties[property_index]->state == state;
		bool failed = property_index >= 0 && devices[camera].revisions[property_index] > after && devices[camera].properties[property_index]->state == INDIGO_ALERT_STATE && state != INDIGO_ALERT_STATE;
		indigo_property_state actual = property_index < 0 ? INDIGO_IDLE_STATE : devices[camera].properties[property_index]->state;
		pthread_mutex_unlock(&mutex);
		if (ready) {
			return true;
		}
		if (failed) {
			fprintf(stderr, "Failed: %s %s entered state %d while waiting for %d\n", devices[camera].name, name, actual, state);
			return false;
		}
		indigo_usleep(10000);
	}
	fprintf(stderr, "Timeout: %s %s expected state %d\n", devices[camera].name, name, state);
	return false;
}

static bool change_switch(const char *name, const char *item, indigo_property_state state) {
	unsigned before = property_revision(name);
	indigo_change_switch_property_1(&client, devices[camera].name, name, item, true);
	return wait_state(name, before, state);
}

static bool change_number(const char *name, const char *item, double value, indigo_property_state state) {
	unsigned before = property_revision(name);
	indigo_change_number_property_1(&client, devices[camera].name, name, item, value);
	return wait_state(name, before, state);
}

static unsigned frame_count(void) {
	pthread_mutex_lock(&mutex);
	unsigned result = devices[camera].frames;
	pthread_mutex_unlock(&mutex);
	return result;
}

static bool disconnect_camera(void) {
	pthread_mutex_lock(&mutex);
	bool present = camera >= 0 && devices[camera].present;
	int property_index = camera < 0 ? -1 : property_slot(camera, CONNECTION_PROPERTY_NAME);
	bool disconnected = property_index >= 0 && indigo_get_switch(devices[camera].properties[property_index], CONNECTION_DISCONNECTED_ITEM_NAME);
	pthread_mutex_unlock(&mutex);
	if (!present || disconnected) {
		return true;
	}
	return change_switch(CONNECTION_PROPERTY_NAME, CONNECTION_DISCONNECTED_ITEM_NAME, INDIGO_OK_STATE);
}

static bool acquire(double duration) {
	unsigned before = frame_count();
	if (!change_number(CCD_EXPOSURE_PROPERTY_NAME, CCD_EXPOSURE_ITEM_NAME, duration, INDIGO_OK_STATE)) {
		return false;
	}
	return frame_count() == before + 1;
}

static bool setup_exposure_durations(void) {
	pthread_mutex_lock(&mutex);
	int property_index = property_slot(camera, CCD_EXPOSURE_PROPERTY_NAME);
	if (property_index < 0) {
		pthread_mutex_unlock(&mutex);
		return false;
	}
	double minimum = devices[camera].properties[property_index]->items[0].number.min;
	double maximum = devices[camera].properties[property_index]->items[0].number.max;
	pthread_mutex_unlock(&mutex);
	if (minimum <= 0 || maximum < minimum) {
		return false;
	}
	short_exposure = fmin(maximum, fmax(minimum, 0.1));
	long_exposure = fmin(maximum, fmax(minimum, 1.5));
	const char *override = getenv("INDIGO_TEST_SHORT_EXPOSURE");
	if (override) {
		char *end = NULL;
		double value = strtod(override, &end);
		if (!*override || *end || !isfinite(value) || value < minimum || value > maximum) {
			fprintf(stderr, "INDIGO_TEST_SHORT_EXPOSURE must be within %g .. %g s\n", minimum, maximum);
			return false;
		}
		short_exposure = value;
	}
	printf("    exposure range: %g .. %g s; testing %g and %g s\n", minimum, maximum, short_exposure, long_exposure);
	return true;
}

static bool exercise_modes(void) {
	char names[64][INDIGO_NAME_SIZE];
	char original[INDIGO_NAME_SIZE] = "";
	int count = 0;
	int tested = 0;
	const char *filter = getenv("INDIGO_TEST_MODE");
	pthread_mutex_lock(&mutex);
	int property_index = property_slot(camera, CCD_MODE_PROPERTY_NAME);
	if (property_index >= 0) {
		indigo_property *property = devices[camera].properties[property_index];
		count = property->count < 64 ? property->count : 64;
		for (int item_index = 0; item_index < count; item_index++) {
			snprintf(names[item_index], INDIGO_NAME_SIZE, "%s", property->items[item_index].name);
			if (property->items[item_index].sw.value) {
				snprintf(original, sizeof(original), "%s", property->items[item_index].name);
			}
		}
	}
	pthread_mutex_unlock(&mutex);
	for (int item_index = 0; item_index < count; item_index++) {
		if (filter && strcmp(filter, names[item_index])) {
			continue;
		}
		tested++;
		printf("    mode: %s\n", names[item_index]);
		if (!change_switch(CCD_MODE_PROPERTY_NAME, names[item_index], INDIGO_OK_STATE) || !acquire(short_exposure)) {
			return false;
		}
	}
	if (filter && tested == 0) {
		fprintf(stderr, "Requested mode is not advertised: %s\n", filter);
	}
	if (!filter && tested > 0 && original[0] && !change_switch(CCD_MODE_PROPERTY_NAME, original, INDIGO_OK_STATE)) {
		return false;
	}
	return tested > 0;
}

static bool exercise_control(const char *property_name, const char *item_name) {
	double original = 0;
	double test_value = 0;
	bool writable = false;
	pthread_mutex_lock(&mutex);
	int property_index = property_slot(camera, property_name);
	if (property_index >= 0) {
		indigo_property *property = devices[camera].properties[property_index];
		if (!property->hidden && property->perm == INDIGO_RW_PERM && property->count) {
			original = property->items[0].number.value;
			test_value = (property->items[0].number.min + property->items[0].number.max) / 2;
			writable = true;
		}
	}
	pthread_mutex_unlock(&mutex);
	if (!writable) {
		printf("    optional control unavailable/read-only: %s\n", property_name);
		return true;
	}
	return change_number(property_name, item_name, test_value, INDIGO_OK_STATE) && acquire(short_exposure) && change_number(property_name, item_name, original, INDIGO_OK_STATE);
}

static bool session_initialized;

// Every case expects a connected camera that uploads raw images to the client, so the three
// switches that establish it are applied together whenever a case reconnects the camera.
static bool connect_camera(void) {
	return change_switch(CONNECTION_PROPERTY_NAME, CONNECTION_CONNECTED_ITEM_NAME, INDIGO_OK_STATE) &&
		change_switch(CCD_UPLOAD_MODE_PROPERTY_NAME, CCD_UPLOAD_MODE_CLIENT_ITEM_NAME, INDIGO_OK_STATE) &&
		change_switch(CCD_IMAGE_FORMAT_PROPERTY_NAME, CCD_IMAGE_FORMAT_RAW_ITEM_NAME, INDIGO_OK_STATE);
}

// The bus, the driver and the camera selection are shared by every case: bringing them up per case
// would cost a driver reload each time and would report the same discovery failure once per case.
static bool begin_session(void) {
	if (indigo_start() != INDIGO_OK || indigo_attach_client(&client) != INDIGO_OK) {
		return false;
	}
	if (indigo_ccd_uvc(INDIGO_DRIVER_INIT, NULL) != INDIGO_OK) {
		return false;
	}
	session_initialized = true;
	for (int iteration = 0; iteration < 500; iteration++) {
		indigo_usleep(10000);
	}
	return select_camera();
}

static void end_session(void) {
	if (camera >= 0) {
		indigo_change_switch_property_1(&client, devices[camera].name, CCD_ABORT_EXPOSURE_PROPERTY_NAME, CCD_ABORT_EXPOSURE_ITEM_NAME, true);
		if (!disconnect_camera()) {
			indigo_test_failures++;
		}
	}
	if (session_initialized && indigo_ccd_uvc(INDIGO_DRIVER_SHUTDOWN, NULL) != INDIGO_OK) {
		indigo_test_failures++;
	}
	session_initialized = false;
	indigo_detach_client(&client);
	indigo_stop();
}

static void connect_and_exposure_limits(void) {
	CHECK(connect_camera());
	CHECK(setup_exposure_durations());
}

static void short_and_long_exposures(void) {
	CHECK(acquire(short_exposure));
	CHECK(acquire(long_exposure));
}

static void advertised_modes_deliver_frames(void) {
	CHECK(exercise_modes());
}

static void optional_gain_control(void) {
	CHECK(exercise_control(CCD_GAIN_PROPERTY_NAME, CCD_GAIN_ITEM_NAME));
}

static void optional_gamma_control(void) {
	CHECK(exercise_control(CCD_GAMMA_PROPERTY_NAME, CCD_GAMMA_ITEM_NAME));
}

static void exposure_abort_and_reacquire(void) {
	unsigned exposure_revision = property_revision(CCD_EXPOSURE_PROPERTY_NAME);
	indigo_change_number_property_1(&client, devices[camera].name, CCD_EXPOSURE_PROPERTY_NAME, CCD_EXPOSURE_ITEM_NAME, long_exposure);
	CHECK(wait_state(CCD_EXPOSURE_PROPERTY_NAME, exposure_revision, INDIGO_BUSY_STATE));
	CHECK(change_switch(CCD_ABORT_EXPOSURE_PROPERTY_NAME, CCD_ABORT_EXPOSURE_ITEM_NAME, INDIGO_OK_STATE));
	CHECK(wait_state(CCD_EXPOSURE_PROPERTY_NAME, exposure_revision, INDIGO_ALERT_STATE));
	CHECK(acquire(short_exposure));
}

static void finite_streaming(void) {
	unsigned before = frame_count();
	unsigned streaming_revision = property_revision(CCD_STREAMING_PROPERTY_NAME);
	indigo_change_number_property(&client, devices[camera].name, CCD_STREAMING_PROPERTY_NAME, 2, (const char *[]){ CCD_STREAMING_EXPOSURE_ITEM_NAME, CCD_STREAMING_COUNT_ITEM_NAME }, (double []){ short_exposure, 5 });
	CHECK(wait_state(CCD_STREAMING_PROPERTY_NAME, streaming_revision, INDIGO_OK_STATE));
	CHECK(frame_count() == before + 5);
}

static void indefinite_streaming_and_stop(void) {
	unsigned before = frame_count();
	unsigned streaming_revision = property_revision(CCD_STREAMING_PROPERTY_NAME);
	indigo_change_number_property(&client, devices[camera].name, CCD_STREAMING_PROPERTY_NAME, 2, (const char *[]){ CCD_STREAMING_EXPOSURE_ITEM_NAME, CCD_STREAMING_COUNT_ITEM_NAME }, (double []){ short_exposure, -1 });
	CHECK(wait_state(CCD_STREAMING_PROPERTY_NAME, streaming_revision, INDIGO_BUSY_STATE));
	for (int iteration = 0; iteration < 3000 && frame_count() < before + 3; iteration++) {
		indigo_usleep(10000);
	}
	CHECK(frame_count() >= before + 3);
	CHECK(change_switch(CCD_ABORT_EXPOSURE_PROPERTY_NAME, CCD_ABORT_EXPOSURE_ITEM_NAME, INDIGO_OK_STATE));
	CHECK(wait_state(CCD_STREAMING_PROPERTY_NAME, streaming_revision, INDIGO_OK_STATE));
}

static void disconnect_and_reconnect(void) {
	CHECK(disconnect_camera());
	CHECK(connect_camera());
	CHECK(acquire(short_exposure));
}

static void unplug_and_replug_recovery(void) {
	printf("HOTPLUG_READY: unplug USB camera now: %s\n", devices[camera].name);
	CHECK(wait_presence(false));
	printf("HOTPLUG_REMOVED: reconnect the same USB camera now\n");
	CHECK(wait_presence(true));
	CHECK(connect_camera());
	CHECK(acquire(short_exposure));
	printf("HOTPLUG_RECOVERED: exposure succeeded after replug\n");
}

static void driver_shutdown_reinit_and_exposure(void) {
	CHECK(disconnect_camera());
	CHECK(indigo_ccd_uvc(INDIGO_DRIVER_SHUTDOWN, NULL) == INDIGO_OK);
	session_initialized = false;
	CHECK(indigo_ccd_uvc(INDIGO_DRIVER_INIT, NULL) == INDIGO_OK);
	session_initialized = true;
	CHECK(wait_presence(true));
	CHECK(connect_camera());
	CHECK(setup_exposure_durations());
	CHECK(acquire(short_exposure));
}

// Runs last so that it judges every frame the preceding cases collected.
static void received_frames_are_well_formed(void) {
	pthread_mutex_lock(&mutex);
	unsigned frames = devices[camera].frames;
	unsigned invalid_frames = devices[camera].invalid_frames;
	pthread_mutex_unlock(&mutex);
	printf("    %u frame(s) received, %u malformed\n", frames, invalid_frames);
	CHECK(frames > 0);
	CHECK(invalid_frames == 0);
}

int main(int argc, char **argv) {
	if ((argc != 2 && argc != 3) || strcmp(argv[1], "--run") || (argc == 3 && strcmp(argv[2], "--hotplug"))) {
		fprintf(stderr, "Physical UVC camera test: run explicitly with --run (or make test-ccd-uvc-hw).\n");
		return 2;
	}
	hotplug = argc == 3;
	setvbuf(stdout, NULL, _IONBF, 0);
	if (getenv("INDIGO_TEST_DEBUG")) {
		indigo_set_log_level(INDIGO_LOG_DEBUG);
	}
	client = (indigo_client){ .name = "UVC hardware test", .version = INDIGO_VERSION_CURRENT, .define_property = define_property, .update_property = update_property, .delete_property = delete_property, .send_message = report_message };
	const indigo_test_case tests[] = {
		{ "Connect and exposure limits", connect_and_exposure_limits },
		{ "Short and long exposures", short_and_long_exposures },
		{ "Advertised modes deliver frames", advertised_modes_deliver_frames },
		{ "Optional gain control", optional_gain_control },
		{ "Optional gamma control", optional_gamma_control },
		{ "Exposure abort and reacquire", exposure_abort_and_reacquire },
		{ "Finite streaming", finite_streaming },
		{ "Indefinite streaming and stop", indefinite_streaming_and_stop },
		{ "Disconnect and reconnect", disconnect_and_reconnect }
	};
	// Physical interruption is opt-in, and the driver reload has to follow it so that a replug is
	// exercised against the same driver instance the preceding cases used.
	const indigo_test_case hotplug_tests[] = {
		{ "Unplug and replug recovery", unplug_and_replug_recovery }
	};
	const indigo_test_case closing_tests[] = {
		{ "Driver shutdown reinit and fresh exposure", driver_shutdown_reinit_and_exposure },
		{ "Received frames are well formed", received_frames_are_well_formed }
	};
	int result = 1;
	if (begin_session()) {
		indigo_test_case selected[ARRAY_SIZE(tests) + ARRAY_SIZE(hotplug_tests) + ARRAY_SIZE(closing_tests)];
		int matched = 0;
		for (int index = 0; index < ARRAY_SIZE(tests); index++) {
			selected[matched++] = tests[index];
		}
		if (hotplug) {
			for (int index = 0; index < ARRAY_SIZE(hotplug_tests); index++) {
				selected[matched++] = hotplug_tests[index];
			}
		}
		for (int index = 0; index < ARRAY_SIZE(closing_tests); index++) {
			selected[matched++] = closing_tests[index];
		}
		result = indigo_run_tests("UVC hardware", selected, matched);
	} else {
		fprintf(stderr, "No usable physical UVC camera session.\n");
		indigo_test_failures++;
	}
	end_session();
	for (int device_index = 0; device_index < MAX_DEVICES; device_index++) {
		for (int property_index = 0; property_index < MAX_PROPERTIES; property_index++) {
			indigo_release_property(devices[device_index].properties[property_index]);
		}
	}
	return result;
}
