// Copyright (c) 2026 INDIGO initiative
// All rights reserved.
//
// You may use this software under the terms of 'INDIGO Astronomy
// open-source license' (see LICENSE.md).
//
// THIS SOFTWARE IS PROVIDED BY THE AUTHORS 'AS IS' AND ANY EXPRESS
// OR IMPLIED WARRANTIES, INCLUDING, BUT NOT LIMITED TO, THE IMPLIED
// WARRANTIES OF MERCHANTABILITY AND FITNESS FOR A PARTICULAR PURPOSE
// ARE DISCLAIMED. IN NO EVENT SHALL THE AUTHOR BE LIABLE FOR ANY
// DIRECT, INDIRECT, INCIDENTAL, SPECIAL, EXEMPLARY, OR CONSEQUENTIAL
// DAMAGES (INCLUDING, BUT NOT LIMITED TO, PROCUREMENT OF SUBSTITUTE
// GOODS OR SERVICES; LOSS OF USE, DATA, OR PROFITS; OR BUSINESS
// INTERRUPTION) HOWEVER CAUSED AND ON ANY THEORY OF LIABILITY,
// WHETHER IN CONTRACT, STRICT LIABILITY, OR TORT (INCLUDING
// NEGLIGENCE OR OTHERWISE) ARISING IN ANY WAY OUT OF THE USE OF THIS
// SOFTWARE, EVEN IF ADVISED OF THE POSSIBILITY OF SUCH DAMAGE.

// Code is generated by AI

// Physical Meade DSI camera acceptance test. The DSI is a CCD-only camera: it has no guide port,
// cooler, live video or filter wheel, so the guider, cooling and streaming rows of the camera
// standard do not apply. Binning and the temperature sensor depend on the model and are exercised
// only where the connected camera advertises them.
//
// With --hotplug the camera's USB port is switched off and on through its sysfs `disable` attribute
// (usb_hotplug_test_common.h), so the hot-plug cases run unattended on Linux; elsewhere they wait
// for a person to pull and replug the cable.

#include <pthread.h>
#include <math.h>
#include <stdlib.h>

#include <indigo/indigo_driver.h>
#include <indigo_drivers/ccd_dsi/indigo_ccd_dsi.h>

#include "../test_runner.h"
#include "hardware_device_record.h"
#include "usb_hotplug_test_common.h"

#define ARRAY_SIZE(a) (sizeof(a) / sizeof((a)[0]))
#define MAX_DEVICES 16
#define MAX_PROPERTIES 128
#define DSI_VENDOR 0x156c
#define DRIVER_LABEL "Meade DSI Camera"
#define DRIVER_NAME "indigo_ccd_dsi"

typedef struct {
	char name[INDIGO_NAME_SIZE];
	unsigned interface;
	bool present;
	indigo_property *properties[MAX_PROPERTIES];
	unsigned revisions[MAX_PROPERTIES];
	unsigned frames, invalid_frames;
	indigo_raw_header last_header;
} observed_device;

static observed_device devices[MAX_DEVICES];
static pthread_mutex_t mutex = PTHREAD_MUTEX_INITIALIZER;
static indigo_client client;
static int camera = -1;
static bool driver_initialized;
static usb_hotplug_port usb_port;
static bool usb_switch;

static int property_slot(int device_index, const char *name) {
	for (int property_index = 0; property_index < MAX_PROPERTIES; property_index++) {
		if (devices[device_index].properties[property_index] && !strcmp(devices[device_index].properties[property_index]->name, name)) {
			return property_index;
		}
	}
	return -1;
}

static indigo_result observe(indigo_device *device, indigo_property *property, const char *message, bool update) {
	pthread_mutex_lock(&mutex);
	int device_index;
	for (device_index = 0; device_index < MAX_DEVICES; device_index++) {
		if (!*devices[device_index].name || !strcmp(devices[device_index].name, property->device)) {
			break;
		}
	}
	if (device_index < MAX_DEVICES) {
		snprintf(devices[device_index].name, INDIGO_NAME_SIZE, "%s", property->device);
		// Presence follows the definition of INFO and the device-wide delete only. A late update of a
		// device that was just withdrawn must not bring it back.
		if (!update && !strcmp(property->name, INFO_PROPERTY_NAME)) {
			devices[device_index].present = true;
			for (int item_index = 0; item_index < property->count; item_index++) {
				if (!strcmp(property->items[item_index].name, INFO_DEVICE_INTERFACE_ITEM_NAME)) {
					devices[device_index].interface = (unsigned)strtoul(property->items[item_index].text.value, NULL, 10);
				}
			}
		}
		int property_index = property_slot(device_index, property->name);
		if (property_index < 0) {
			for (property_index = 0; property_index < MAX_PROPERTIES && devices[device_index].properties[property_index]; property_index++) { }
		}
		if (property_index < MAX_PROPERTIES) {
			indigo_release_property(devices[device_index].properties[property_index]);
			devices[device_index].properties[property_index] = indigo_copy_property(NULL, property);
			devices[device_index].revisions[property_index]++;
		}
		if (update && !strcmp(property->name, CCD_IMAGE_PROPERTY_NAME) && property->state == INDIGO_OK_STATE && property->count && property->items[0].blob.value) {
			indigo_item *item = property->items;
			indigo_raw_header header = { 0 };
			if (item->blob.size >= (long)sizeof(header)) {
				memcpy(&header, item->blob.value, sizeof(header));
			}
			// The driver hands over 16 bit data; a colour model adds BAYERPAT but stays a mono raw frame.
			if (strcmp(item->blob.format, ".raw") || header.signature != INDIGO_RAW_MONO16 || !header.width || !header.height || (uint64_t)header.width * header.height * 2 + sizeof(header) > (uint64_t)item->blob.size) {
				devices[device_index].invalid_frames++;
			}
			devices[device_index].last_header = header;
			devices[device_index].frames++;
			printf("    frame %u: %u x %u, %ld bytes\n", devices[device_index].frames, header.width, header.height, item->blob.size);
		}
	}
	pthread_mutex_unlock(&mutex);
	if (message && *message) {
		printf("    %s %s: %s\n", property->device, property->name, message);
	}
	return INDIGO_OK;
}

static indigo_result define_property(indigo_client *client, indigo_device *device, indigo_property *property, const char *message) {
	return observe(device, property, message, false);
}

static indigo_result update_property(indigo_client *client, indigo_device *device, indigo_property *property, const char *message) {
	return observe(device, property, message, true);
}

static indigo_result report_message(indigo_client *client, indigo_device *device, indigo_property *property, const char *message) {
	printf("    message: %s\n", message ? message : "");
	return INDIGO_OK;
}

static indigo_result delete_property(indigo_client *client, indigo_device *device, indigo_property *property, const char *message) {
	pthread_mutex_lock(&mutex);
	for (int device_index = 0; device_index < MAX_DEVICES; device_index++) {
		if (strcmp(devices[device_index].name, property->device)) {
			continue;
		}
		for (int property_index = 0; property_index < MAX_PROPERTIES; property_index++) {
			indigo_property *known = devices[device_index].properties[property_index];
			if (known && (!*property->name || !strcmp(known->name, property->name))) {
				indigo_release_property(known);
				devices[device_index].properties[property_index] = NULL;
				devices[device_index].revisions[property_index] = 0;
			}
		}
		if (!*property->name) {
			devices[device_index].present = false;
		}
	}
	pthread_mutex_unlock(&mutex);
	return INDIGO_OK;
}

static unsigned revision(const char *name) {
	pthread_mutex_lock(&mutex);
	int property_index = property_slot(camera, name);
	unsigned result = property_index < 0 ? 0 : devices[camera].revisions[property_index];
	pthread_mutex_unlock(&mutex);
	return result;
}

static indigo_property *snapshot(const char *name) {
	pthread_mutex_lock(&mutex);
	int property_index = property_slot(camera, name);
	indigo_property *result = property_index < 0 ? NULL : indigo_copy_property(NULL, devices[camera].properties[property_index]);
	pthread_mutex_unlock(&mutex);
	return result;
}

static indigo_item *find_item(indigo_property *property, const char *name) {
	for (int item_index = 0; property && item_index < property->count; item_index++) {
		if (!strcmp(property->items[item_index].name, name)) {
			return property->items + item_index;
		}
	}
	return NULL;
}

static double number(const char *property_name, const char *item_name) {
	indigo_property *property = snapshot(property_name);
	indigo_item *item = find_item(property, item_name);
	double result = item ? item->number.value : NAN;
	indigo_release_property(property);
	return result;
}

// Waits for a publication newer than `after` in the requested state. ALERT ends the wait early unless
// it is the state asked for, so a refused request is reported at once instead of timing out.
static bool wait_state(const char *name, unsigned after, indigo_property_state state, double timeout) {
	double deadline = indigo_monotonic_time() + timeout;
	while (indigo_monotonic_time() < deadline) {
		pthread_mutex_lock(&mutex);
		int property_index = property_slot(camera, name);
		bool fresh = property_index >= 0 && devices[camera].revisions[property_index] > after;
		indigo_property_state actual = property_index < 0 ? INDIGO_IDLE_STATE : devices[camera].properties[property_index]->state;
		pthread_mutex_unlock(&mutex);
		if (fresh && actual == state) {
			return true;
		}
		if (fresh && actual == INDIGO_ALERT_STATE) {
			printf("    %s entered ALERT while waiting for state %d\n", name, state);
			return false;
		}
		indigo_usleep(10000);
	}
	printf("    timeout: %s did not reach state %d within %g s\n", name, state, timeout);
	return false;
}

static bool change_switch(const char *name, const char *item, indigo_property_state state) {
	unsigned before = revision(name);
	indigo_change_switch_property_1(&client, devices[camera].name, name, item, true);
	return wait_state(name, before, state, 60);
}

static bool change_number(const char *name, const char *item, double value, indigo_property_state state) {
	unsigned before = revision(name);
	indigo_change_number_property_1(&client, devices[camera].name, name, item, value);
	return wait_state(name, before, state, 60);
}

static bool connected(void) {
	indigo_property *connection = snapshot(CONNECTION_PROPERTY_NAME);
	indigo_item *item = find_item(connection, CONNECTION_CONNECTED_ITEM_NAME);
	bool result = connection && item && item->sw.value && connection->state == INDIGO_OK_STATE;
	indigo_release_property(connection);
	return result;
}

static bool connect_camera(void) {
	if (connected()) {
		return true;
	}
	return change_switch(CONNECTION_PROPERTY_NAME, CONNECTION_CONNECTED_ITEM_NAME, INDIGO_OK_STATE) && change_switch(CCD_UPLOAD_MODE_PROPERTY_NAME, CCD_UPLOAD_MODE_CLIENT_ITEM_NAME, INDIGO_OK_STATE) && change_switch(CCD_IMAGE_FORMAT_PROPERTY_NAME, CCD_IMAGE_FORMAT_RAW_ITEM_NAME, INDIGO_OK_STATE);
}

static bool disconnect_camera(void) {
	pthread_mutex_lock(&mutex);
	bool present = camera >= 0 && devices[camera].present;
	pthread_mutex_unlock(&mutex);
	if (!present || !connected()) {
		return true;
	}
	return change_switch(CONNECTION_PROPERTY_NAME, CONNECTION_DISCONNECTED_ITEM_NAME, INDIGO_OK_STATE);
}

static unsigned frames(void) {
	pthread_mutex_lock(&mutex);
	unsigned result = devices[camera].frames;
	pthread_mutex_unlock(&mutex);
	return result;
}

static indigo_raw_header last_header(void) {
	pthread_mutex_lock(&mutex);
	indigo_raw_header result = devices[camera].last_header;
	pthread_mutex_unlock(&mutex);
	return result;
}

// One completed exposure delivers exactly one frame of the expected size.
static bool acquire(double duration, unsigned width, unsigned height) {
	unsigned before = frames();
	double start = indigo_monotonic_time();
	if (!change_number(CCD_EXPOSURE_PROPERTY_NAME, CCD_EXPOSURE_ITEM_NAME, duration, INDIGO_OK_STATE)) {
		return false;
	}
	double elapsed = indigo_monotonic_time() - start;
	indigo_raw_header header = last_header();
	printf("    %g s exposure completed in %.3f s\n", duration, elapsed);
	if (frames() != before + 1) {
		printf("    expected one frame, received %u\n", frames() - before);
		return false;
	}
	if (header.width != width || header.height != height) {
		printf("    expected a %u x %u frame, received %u x %u\n", width, height, header.width, header.height);
		return false;
	}
	return elapsed >= duration * 0.95;
}

static unsigned full_width(void) {
	return (unsigned)number(CCD_INFO_PROPERTY_NAME, CCD_INFO_WIDTH_ITEM_NAME);
}

static unsigned full_height(void) {
	return (unsigned)number(CCD_INFO_PROPERTY_NAME, CCD_INFO_HEIGHT_ITEM_NAME);
}

static bool acquire_full(double duration) {
	return acquire(duration, full_width(), full_height());
}

static bool visible(const char *name) {
	indigo_property *property = snapshot(name);
	bool result = property && !property->hidden;
	indigo_release_property(property);
	return result;
}

static bool wait_presence(bool present, double timeout) {
	double deadline = indigo_monotonic_time() + timeout;
	while (indigo_monotonic_time() < deadline) {
		pthread_mutex_lock(&mutex);
		bool ready = devices[camera].present == present && (!present || property_slot(camera, CONNECTION_PROPERTY_NAME) >= 0);
		pthread_mutex_unlock(&mutex);
		if (ready) {
			return true;
		}
		indigo_usleep(10000);
	}
	printf("    %s was not %s within %g s\n", devices[camera].name, present ? "published again" : "withdrawn", timeout);
	return false;
}

static bool begin_session(void) {
	if (hw_start() != INDIGO_OK || indigo_attach_client(&client) != INDIGO_OK) {
		return false;
	}
	if (indigo_ccd_dsi(INDIGO_DRIVER_INIT, NULL) != INDIGO_OK) {
		return false;
	}
	driver_initialized = true;
	// Let the initial USB enumeration settle before selecting a unique camera.
	indigo_usleep(5000000);
	const char *requested = getenv("INDIGO_TEST_DEVICE");
	int matches = 0;
	pthread_mutex_lock(&mutex);
	for (int device_index = 0; device_index < MAX_DEVICES; device_index++) {
		if (devices[device_index].present && (devices[device_index].interface & INDIGO_INTERFACE_CCD)) {
			printf("    discovered camera: %s\n", devices[device_index].name);
			if (!requested || strstr(devices[device_index].name, requested)) {
				camera = device_index;
				matches++;
			}
		}
	}
	pthread_mutex_unlock(&mutex);
	if (matches != 1) {
		fprintf(stderr, "Expected one camera; found %d matches. Set INDIGO_TEST_DEVICE to a unique substring of the discovered name when needed.\n", matches);
		camera = -1;
		return false;
	}
	printf("    selected: %s\n", devices[camera].name);
	return connect_camera();
}

static void end_session(void) {
	if (camera >= 0) {
		indigo_change_switch_property_1(&client, devices[camera].name, CCD_ABORT_EXPOSURE_PROPERTY_NAME, CCD_ABORT_EXPOSURE_ITEM_NAME, true);
		if (!disconnect_camera()) {
			indigo_test_failures++;
		}
	}
	if (driver_initialized && indigo_ccd_dsi(INDIGO_DRIVER_SHUTDOWN, NULL) != INDIGO_OK) {
		indigo_test_failures++;
	}
	driver_initialized = false;
	indigo_detach_client(&client);
	indigo_stop();
}

static void dsi_reports_identity_and_capabilities(void) {
	indigo_driver_info info = { 0 };
	ASSERT_TRUE(indigo_ccd_dsi(INDIGO_DRIVER_INFO, &info) == INDIGO_OK);
	ASSERT_STREQ(DRIVER_LABEL, info.description);
	ASSERT_EQ_INT(INDIGO_DRIVER_API_3, INDIGO_DRIVER_API_GENERATION(info.version));
	ASSERT_TRUE(info.multi_device_support);
	ASSERT_TRUE((devices[camera].interface & INDIGO_INTERFACE_CCD) != 0);
	indigo_property *device_info = snapshot(INFO_PROPERTY_NAME);
	ASSERT_TRUE(device_info != NULL);
	for (int item_index = 0; item_index < device_info->count; item_index++) {
		printf("    INFO.%s = %s\n", device_info->items[item_index].name, device_info->items[item_index].text.value);
	}
	indigo_item *driver = find_item(device_info, INFO_DEVICE_DRIVER_ITEM_NAME);
	indigo_item *model = find_item(device_info, INFO_DEVICE_MODEL_ITEM_NAME);
	indigo_item *serial = find_item(device_info, INFO_DEVICE_SERIAL_NUM_ITEM_NAME);
	bool identified = driver && !strcmp(driver->text.value, DRIVER_NAME) && model && *model->text.value && serial && *serial->text.value;
	indigo_release_property(device_info);
	ASSERT_TRUE(identified);
}

static void dsi_publishes_the_property_contract(void) {
	ASSERT_TRUE(connected());
	unsigned width = full_width(), height = full_height();
	printf("    sensor %u x %u, pixel %g x %g um\n", width, height, number(CCD_INFO_PROPERTY_NAME, CCD_INFO_PIXEL_WIDTH_ITEM_NAME), number(CCD_INFO_PROPERTY_NAME, CCD_INFO_PIXEL_HEIGHT_ITEM_NAME));
	ASSERT_TRUE(width > 0 && height > 0);
	indigo_property *frame = snapshot(CCD_FRAME_PROPERTY_NAME);
	ASSERT_TRUE(frame != NULL);
	indigo_item *frame_width = find_item(frame, CCD_FRAME_WIDTH_ITEM_NAME);
	indigo_item *frame_height = find_item(frame, CCD_FRAME_HEIGHT_ITEM_NAME);
	indigo_item *bits = find_item(frame, CCD_FRAME_BITS_PER_PIXEL_ITEM_NAME);
	// The DSI reads out the whole sensor, so the frame is fixed and published read-only.
	bool frame_ok = frame->perm == INDIGO_RO_PERM && frame_width && frame_width->number.value == width && frame_width->number.max == width && frame_height && frame_height->number.value == height && frame_height->number.max == height && bits && bits->number.value == 16;
	indigo_release_property(frame);
	ASSERT_TRUE(frame_ok);
	indigo_property *mode = snapshot(CCD_MODE_PROPERTY_NAME);
	ASSERT_TRUE(mode != NULL);
	int mode_count = mode->count;
	bool has_1x1 = find_item(mode, "BIN_1x1") != NULL, has_2x2 = find_item(mode, "BIN_2x2") != NULL;
	for (int item_index = 0; item_index < mode->count; item_index++) {
		printf("    CCD_MODE.%s = %s%s\n", mode->items[item_index].name, mode->items[item_index].label, mode->items[item_index].sw.value ? " (selected)" : "");
	}
	indigo_release_property(mode);
	ASSERT_TRUE(has_1x1);
	ASSERT_TRUE(mode_count == 1 || (mode_count == 2 && has_2x2));
	// CCD_BIN is offered exactly when the camera can bin, which is when CCD_MODE has a 2x2 mode.
	ASSERT_EQ_INT(mode_count == 2, visible(CCD_BIN_PROPERTY_NAME));
	printf("    CCD_BIN %s, CCD_INFO max bin %g x %g\n", visible(CCD_BIN_PROPERTY_NAME) ? "visible" : "hidden", number(CCD_INFO_PROPERTY_NAME, CCD_INFO_MAX_HORIZONTAL_BIN_ITEM_NAME), number(CCD_INFO_PROPERTY_NAME, CCD_INFO_MAX_VERTICAL_BIN_ITEM_NAME));
	const char *controls[] = { CCD_GAIN_PROPERTY_NAME, CCD_OFFSET_PROPERTY_NAME };
	for (unsigned i = 0; i < ARRAY_SIZE(controls); i++) {
		indigo_property *control = snapshot(controls[i]);
		bool control_ok = control && !control->hidden && control->perm == INDIGO_RW_PERM && control->count == 1 && control->items[0].number.min == 0 && control->items[0].number.max == 100;
		if (control) {
			printf("    %s = %g (%g .. %g)\n", controls[i], control->items[0].number.value, control->items[0].number.min, control->items[0].number.max);
		}
		indigo_release_property(control);
		ASSERT_TRUE(control_ok);
	}
	// Uncooled camera without live video: these must not be offered.
	ASSERT_FALSE(visible(CCD_COOLER_PROPERTY_NAME));
	ASSERT_FALSE(visible(CCD_COOLER_POWER_PROPERTY_NAME));
	ASSERT_FALSE(visible(CCD_STREAMING_PROPERTY_NAME));
	indigo_property *temperature = snapshot(CCD_TEMPERATURE_PROPERTY_NAME);
	if (temperature && !temperature->hidden) {
		bool read_only = temperature->perm == INDIGO_RO_PERM;
		printf("    CCD_TEMPERATURE = %g C (read-only sensor)\n", temperature->items[0].number.value);
		indigo_release_property(temperature);
		ASSERT_TRUE(read_only);
	} else {
		printf("    CCD_TEMPERATURE not offered: this model has no sensor\n");
		indigo_release_property(temperature);
	}
}

static void dsi_takes_short_and_long_exposures(void) {
	const double durations[] = { 0.1, 1.5, 5 };
	for (unsigned i = 0; i < ARRAY_SIZE(durations); i++) {
		ASSERT_TRUE(acquire_full(durations[i]));
	}
}

static void dsi_exposes_every_mode(void) {
	indigo_property *mode = snapshot(CCD_MODE_PROPERTY_NAME);
	ASSERT_TRUE(mode != NULL);
	char names[2][INDIGO_NAME_SIZE] = { "", "" };
	int count = mode->count < 2 ? mode->count : 2;
	for (int item_index = 0; item_index < count; item_index++) {
		snprintf(names[item_index], INDIGO_NAME_SIZE, "%s", mode->items[item_index].name);
	}
	indigo_release_property(mode);
	for (int item_index = 0; item_index < count; item_index++) {
		unsigned bin = strcmp(names[item_index], "BIN_2x2") ? 1 : 2;
		printf("    mode %s\n", names[item_index]);
		ASSERT_TRUE(change_switch(CCD_MODE_PROPERTY_NAME, names[item_index], INDIGO_OK_STATE));
		// A model that cannot bin keeps CCD_BIN hidden, so it is never published to a client.
		if (visible(CCD_BIN_PROPERTY_NAME)) {
			ASSERT_EQ_INT(bin, (int)number(CCD_BIN_PROPERTY_NAME, CCD_BIN_HORIZONTAL_ITEM_NAME));
			ASSERT_EQ_INT(bin, (int)number(CCD_BIN_PROPERTY_NAME, CCD_BIN_VERTICAL_ITEM_NAME));
		}
		ASSERT_TRUE(acquire(0.1, full_width() / bin, full_height() / bin));
	}
	ASSERT_TRUE(change_switch(CCD_MODE_PROPERTY_NAME, "BIN_1x1", INDIGO_OK_STATE));
}

// The DSI bins both axes together, so a client that changes one axis gets the other one along.
static void dsi_bins_both_axes_together(void) {
	if (!visible(CCD_BIN_PROPERTY_NAME)) {
		printf("    not applicable: this model does not bin\n");
		return;
	}
	ASSERT_TRUE(change_number(CCD_BIN_PROPERTY_NAME, CCD_BIN_HORIZONTAL_ITEM_NAME, 2, INDIGO_OK_STATE));
	printf("    requested horizontal 2: published %g x %g\n", number(CCD_BIN_PROPERTY_NAME, CCD_BIN_HORIZONTAL_ITEM_NAME), number(CCD_BIN_PROPERTY_NAME, CCD_BIN_VERTICAL_ITEM_NAME));
	ASSERT_EQ_INT(2, (int)number(CCD_BIN_PROPERTY_NAME, CCD_BIN_VERTICAL_ITEM_NAME));
	ASSERT_TRUE(acquire(0.1, full_width() / 2, full_height() / 2));
	ASSERT_TRUE(change_number(CCD_BIN_PROPERTY_NAME, CCD_BIN_VERTICAL_ITEM_NAME, 1, INDIGO_OK_STATE));
	printf("    requested vertical 1: published %g x %g\n", number(CCD_BIN_PROPERTY_NAME, CCD_BIN_HORIZONTAL_ITEM_NAME), number(CCD_BIN_PROPERTY_NAME, CCD_BIN_VERTICAL_ITEM_NAME));
	ASSERT_EQ_INT(1, (int)number(CCD_BIN_PROPERTY_NAME, CCD_BIN_HORIZONTAL_ITEM_NAME));
	ASSERT_TRUE(acquire_full(0.1));
}

// An accepted control commits value and target together, is used for an exposure and is restored.
static void exercise_control(const char *name, const char *item) {
	double original = number(name, item);
	ASSERT_TRUE(isfinite(original));
	double requested = original < 50 ? 73 : 21;
	ASSERT_TRUE(change_number(name, item, requested, INDIGO_OK_STATE));
	indigo_property *accepted = snapshot(name);
	bool committed = accepted && accepted->items[0].number.value == requested && accepted->items[0].number.target == requested;
	indigo_release_property(accepted);
	ASSERT_TRUE(committed);
	ASSERT_TRUE(acquire_full(0.1));
	ASSERT_TRUE(change_number(name, item, original, INDIGO_OK_STATE));
	ASSERT_EQ_INT((int)original, (int)number(name, item));
	printf("    %s %g -> %g -> %g\n", name, original, requested, original);
}

static void dsi_writes_the_gain(void) {
	exercise_control(CCD_GAIN_PROPERTY_NAME, CCD_GAIN_ITEM_NAME);
}

static void dsi_writes_the_offset(void) {
	exercise_control(CCD_OFFSET_PROPERTY_NAME, CCD_OFFSET_ITEM_NAME);
}

static void dsi_exposes_every_frame_type(void) {
	const char *types[] = { CCD_FRAME_TYPE_LIGHT_ITEM_NAME, CCD_FRAME_TYPE_BIAS_ITEM_NAME, CCD_FRAME_TYPE_DARK_ITEM_NAME, CCD_FRAME_TYPE_FLAT_ITEM_NAME, CCD_FRAME_TYPE_DARKFLAT_ITEM_NAME };
	for (unsigned i = 0; i < ARRAY_SIZE(types); i++) {
		printf("    frame type %s\n", types[i]);
		ASSERT_TRUE(change_switch(CCD_FRAME_TYPE_PROPERTY_NAME, types[i], INDIGO_OK_STATE));
		unsigned before = frames();
		ASSERT_TRUE(change_number(CCD_EXPOSURE_PROPERTY_NAME, CCD_EXPOSURE_ITEM_NAME, 0.1, INDIGO_OK_STATE));
		ASSERT_EQ_INT(before + 1, frames());
	}
	ASSERT_TRUE(change_switch(CCD_FRAME_TYPE_PROPERTY_NAME, CCD_FRAME_TYPE_LIGHT_ITEM_NAME, INDIGO_OK_STATE));
}

static void dsi_aborts_a_long_exposure_and_reacquires(void) {
	unsigned before = frames();
	unsigned exposure_revision = revision(CCD_EXPOSURE_PROPERTY_NAME);
	indigo_change_number_property_1(&client, devices[camera].name, CCD_EXPOSURE_PROPERTY_NAME, CCD_EXPOSURE_ITEM_NAME, 10);
	ASSERT_TRUE(wait_state(CCD_EXPOSURE_PROPERTY_NAME, exposure_revision, INDIGO_BUSY_STATE, 10));
	indigo_usleep(1000000);
	exposure_revision = revision(CCD_EXPOSURE_PROPERTY_NAME);
	double start = indigo_monotonic_time();
	indigo_change_switch_property_1(&client, devices[camera].name, CCD_ABORT_EXPOSURE_PROPERTY_NAME, CCD_ABORT_EXPOSURE_ITEM_NAME, true);
	ASSERT_TRUE(wait_state(CCD_EXPOSURE_PROPERTY_NAME, exposure_revision, INDIGO_ALERT_STATE, 10));
	printf("    abort acknowledged after %.3f s\n", indigo_monotonic_time() - start);
	// The aborted exposure must not deliver its frame late.
	indigo_usleep(11000000);
	ASSERT_EQ_INT(before, frames());
	ASSERT_TRUE(acquire_full(0.1));
}

static void dsi_reports_the_temperature(void) {
	if (!visible(CCD_TEMPERATURE_PROPERTY_NAME)) {
		printf("    not applicable: this model has no temperature sensor\n");
		return;
	}
	indigo_property *temperature = snapshot(CCD_TEMPERATURE_PROPERTY_NAME);
	ASSERT_TRUE(temperature != NULL);
	double value = temperature->items[0].number.value, minimum = temperature->items[0].number.min, maximum = temperature->items[0].number.max;
	indigo_release_property(temperature);
	printf("    %g C within %g .. %g\n", value, minimum, maximum);
	ASSERT_TRUE(value >= minimum && value <= maximum);
}

static void dsi_takes_repeated_short_exposures(void) {
	for (int i = 0; i < 10; i++) {
		ASSERT_TRUE(acquire_full(0.1));
	}
}

static void dsi_reconnects(void) {
	indigo_property *before = snapshot(INFO_PROPERTY_NAME);
	char model[INDIGO_VALUE_SIZE] = "";
	indigo_item *item = find_item(before, INFO_DEVICE_MODEL_ITEM_NAME);
	if (item) {
		snprintf(model, sizeof(model), "%s", item->text.value);
	}
	indigo_release_property(before);
	for (int cycle = 0; cycle < 3; cycle++) {
		ASSERT_TRUE(disconnect_camera());
		ASSERT_TRUE(connect_camera());
		indigo_property *after = snapshot(INFO_PROPERTY_NAME);
		item = find_item(after, INFO_DEVICE_MODEL_ITEM_NAME);
		bool same = item && !strcmp(item->text.value, model);
		indigo_release_property(after);
		ASSERT_TRUE(same);
		ASSERT_TRUE(acquire_full(0.1));
	}
}

static void dsi_rejects_shutdown_while_connected(void) {
	ASSERT_TRUE(connect_camera());
	ASSERT_TRUE(indigo_ccd_dsi(INDIGO_DRIVER_SHUTDOWN, NULL) == INDIGO_BUSY);
	// The refused shutdown must leave the camera fully operational.
	ASSERT_TRUE(acquire_full(0.1));
}

static void dsi_reinitializes(void) {
	ASSERT_TRUE(disconnect_camera());
	ASSERT_TRUE(indigo_ccd_dsi(INDIGO_DRIVER_SHUTDOWN, NULL) == INDIGO_OK);
	driver_initialized = false;
	ASSERT_TRUE(wait_presence(false, 10));
	ASSERT_TRUE(indigo_ccd_dsi(INDIGO_DRIVER_INIT, NULL) == INDIGO_OK);
	driver_initialized = true;
	ASSERT_TRUE(wait_presence(true, 30));
	ASSERT_TRUE(connect_camera());
	ASSERT_TRUE(acquire_full(0.1));
}

// Pulls the camera off the bus, by switching its port where the host allows it and by asking a person
// otherwise, and checks that the driver withdraws it, publishes it again and takes a fresh image.
static bool unplug_and_replug(void) {
	if (usb_switch) {
		if (!usb_hotplug_off(&usb_port, 30)) {
			return false;
		}
	} else {
		printf("HOTPLUG_READY: unplug %s now\n", devices[camera].name);
	}
	if (!wait_presence(false, usb_switch ? 30 : 180)) {
		return false;
	}
	if (usb_switch) {
		indigo_usleep(2000000);
		// The DSI comes back without firmware, so udev loads it and the camera enumerates a second time.
		if (!usb_hotplug_on(&usb_port, 60)) {
			return false;
		}
	} else {
		printf("HOTPLUG_REMOVED: replug %s now\n", devices[camera].name);
	}
	if (!wait_presence(true, usb_switch ? 60 : 180)) {
		return false;
	}
	return connect_camera() && acquire_full(0.1);
}

static void dsi_survives_unplug_while_connected(void) {
	ASSERT_TRUE(connect_camera());
	ASSERT_TRUE(unplug_and_replug());
}

static void dsi_survives_unplug_during_exposure(void) {
	ASSERT_TRUE(connect_camera());
	unsigned exposure_revision = revision(CCD_EXPOSURE_PROPERTY_NAME);
	indigo_change_number_property_1(&client, devices[camera].name, CCD_EXPOSURE_PROPERTY_NAME, CCD_EXPOSURE_ITEM_NAME, 10);
	ASSERT_TRUE(wait_state(CCD_EXPOSURE_PROPERTY_NAME, exposure_revision, INDIGO_BUSY_STATE, 10));
	indigo_usleep(1000000);
	ASSERT_TRUE(unplug_and_replug());
}

static void dsi_delivered_only_valid_frames(void) {
	pthread_mutex_lock(&mutex);
	unsigned invalid = devices[camera].invalid_frames, total = devices[camera].frames;
	pthread_mutex_unlock(&mutex);
	printf("    %u frames, %u invalid\n", total, invalid);
	ASSERT_EQ_INT(0, invalid);
}

int main(int argc, char **argv) {
	bool run = false, hotplug = false;
	const char *filter = NULL;
	for (int i = 1; i < argc; i++) {
		if (!strcmp(argv[i], "--run")) {
			run = true;
		} else if (!strcmp(argv[i], "--hotplug")) {
			hotplug = true;
		} else if (!strcmp(argv[i], "--debug")) {
			indigo_set_log_level(INDIGO_LOG_DEBUG);
		} else {
			filter = argv[i];
		}
	}
	if (!run) {
		fprintf(stderr, "This test operates a physical Meade DSI camera. Run with --run [--hotplug] [--debug] [name filter] (or make test-ccd-dsi-hw). INDIGO_TEST_DEVICE selects the camera by a unique name substring when more than one is attached.\n");
		return 2;
	}
	if (!indigo_test_use_private_home()) {
		return 1;
	}
	setvbuf(stdout, NULL, _IONBF, 0);
	client = (indigo_client){ .name = "DSI hardware test", .version = INDIGO_VERSION_CURRENT, .define_property = define_property, .update_property = update_property, .delete_property = delete_property, .send_message = report_message };
	if (hotplug && USB_HOTPLUG_SUPPORTED) {
		// The port is found while the camera is attached: a switched-off port has no device to match.
		usb_switch = usb_hotplug_find((const unsigned []){ DSI_VENDOR }, 1, &usb_port);
		if (!usb_switch) {
			indigo_test_remove_private_home();
			return 1;
		}
		printf("Switching USB port of %s (%04x:%04x %s)\n", usb_port.device, usb_port.vendor, usb_port.product, usb_port.product_name);
	}
	const indigo_test_case tests[] = {
		{ "dsi_reports_identity_and_capabilities", dsi_reports_identity_and_capabilities },
		{ "dsi_publishes_the_property_contract", dsi_publishes_the_property_contract },
		{ "dsi_takes_short_and_long_exposures", dsi_takes_short_and_long_exposures },
		{ "dsi_exposes_every_mode", dsi_exposes_every_mode },
		{ "dsi_bins_both_axes_together", dsi_bins_both_axes_together },
		{ "dsi_writes_the_gain", dsi_writes_the_gain },
		{ "dsi_writes_the_offset", dsi_writes_the_offset },
		{ "dsi_exposes_every_frame_type", dsi_exposes_every_frame_type },
		{ "dsi_aborts_a_long_exposure_and_reacquires", dsi_aborts_a_long_exposure_and_reacquires },
		{ "dsi_reports_the_temperature", dsi_reports_the_temperature },
		{ "dsi_takes_repeated_short_exposures", dsi_takes_repeated_short_exposures },
		{ "dsi_reconnects", dsi_reconnects },
		{ "dsi_rejects_shutdown_while_connected", dsi_rejects_shutdown_while_connected },
		{ "dsi_reinitializes", dsi_reinitializes },
		{ "dsi_delivered_only_valid_frames", dsi_delivered_only_valid_frames }
	};
	const indigo_test_case hotplug_tests[] = {
		{ "dsi_survives_unplug_while_connected", dsi_survives_unplug_while_connected },
		{ "dsi_survives_unplug_during_exposure", dsi_survives_unplug_during_exposure }
	};
	int result = 1;
	if (!begin_session()) {
		indigo_test_failures++;
		goto cleanup;
	}
	{
		indigo_test_case selected[ARRAY_SIZE(tests) + ARRAY_SIZE(hotplug_tests)];
		int matched = 0;
		for (unsigned i = 0; i < ARRAY_SIZE(tests); i++) {
			if (filter == NULL || strstr(tests[i].name, filter)) {
				selected[matched++] = tests[i];
			}
		}
		for (unsigned i = 0; hotplug && i < ARRAY_SIZE(hotplug_tests); i++) {
			if (filter == NULL || strstr(hotplug_tests[i].name, filter)) {
				selected[matched++] = hotplug_tests[i];
			}
		}
		result = matched ? indigo_run_tests("DSI hardware", selected, matched) : 1;
	}
cleanup:
	if (usb_port.off) {
		usb_hotplug_on(&usb_port, 60);
	}
	end_session();
	for (int device_index = 0; device_index < MAX_DEVICES; device_index++) {
		for (int property_index = 0; property_index < MAX_PROPERTIES; property_index++) {
			indigo_release_property(devices[device_index].properties[property_index]);
			devices[device_index].properties[property_index] = NULL;
		}
	}
	indigo_test_remove_private_home();
	return indigo_test_failures ? 1 : result;
}
