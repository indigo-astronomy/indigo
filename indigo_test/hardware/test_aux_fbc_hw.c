// Copyright (c) 2026 INDIGO initiative
// All rights reserved.
//
// You may use this software under the terms of 'INDIGO Astronomy
// open-source license' (see LICENSE.md).
//
// THIS SOFTWARE IS PROVIDED BY THE AUTHORS 'AS IS' AND ANY EXPRESS
// OR IMPLIED WARRANTIES, INCLUDING, BUT NOT LIMITED TO, THE IMPLIED
// WARRANTIES OF MERCHANTABILITY AND FITNESS FOR A PARTICULAR PURPOSE
// ARE DISCLAIMED. IN NO EVENT SHALL THE AUTHOR BE LIABLE FOR ANY
// DIRECT, INDIRECT, INCIDENTAL, SPECIAL, EXEMPLARY, OR CONSEQUENTIAL
// DAMAGES (INCLUDING, BUT NOT LIMITED TO, PROCUREMENT OF SUBSTITUTE
// GOODS OR SERVICES; LOSS OF USE, DATA, OR PROFITS; OR BUSINESS
// INTERRUPTION) HOWEVER CAUSED AND ON ANY THEORY OF LIABILITY,
// WHETHER IN CONTRACT, STRICT LIABILITY, OR TORT (INCLUDING
// NEGLIGENCE OR OTHERWISE) ARISING IN ANY WAY OUT OF THE USE OF THIS
// SOFTWARE, EVEN IF ADVISED OF THE POSSIBILITY OF SUCH DAMAGE.

// Code is generated by AI

// Opt-in acceptance test for a physically connected Lacerta FBC flat box controller in SerialMode, or
// for the Arduino sketch aux_fbc_simulator.ino running on a board. It checks the identification and
// mode handshake, sets the intensity, fires a light impulse and a shutter exposure and waits them out,
// reconnects and runs driver INIT/SHUTDOWN.
//
// THE PANEL LIGHTS UP AND THE SHUTTER OUTPUT FIRES. The session restores the intensity it found.
//
// The port comes from FBC_HW_PORT, or from the port the driver matched by its FTDI pattern.

#include <math.h>
#include <stdlib.h>
#include <indigo_drivers/aux_fbc/indigo_aux_fbc.h>
#include "hardware_test_common.h"

#define DEVICE_NAME "Lacerta FBC"

#define SHORT_TIMEOUT 15.0
#define TIMED_DURATION 2

static int fbc = -1;
static const char *serial_port = NULL;
static double initial_intensity = 0;
static bool state_captured = false;

static bool select_port(void) {
	if (serial_port == NULL || !*serial_port) {
		char detected[INDIGO_VALUE_SIZE] = "";
		if (hw_text_item(fbc, DEVICE_PORT_PROPERTY_NAME, DEVICE_PORT_ITEM_NAME, detected, sizeof(detected)) && *detected) {
			printf("Using the port the driver detected: %s\n", detected);
			return true;
		}
		fprintf(stderr, "    set FBC_HW_PORT to the controller's serial port\n");
		return false;
	}
	printf("Using port %s\n", serial_port);
	return hw_set_text(fbc, DEVICE_PORT_PROPERTY_NAME, DEVICE_PORT_ITEM_NAME, serial_port, INDIGO_OK_STATE, SHORT_TIMEOUT);
}

static bool set_intensity(double percent) {
	double value = -1;
	return hw_set_number(fbc, AUX_LIGHT_INTENSITY_PROPERTY_NAME, AUX_LIGHT_INTENSITY_ITEM_NAME, percent, INDIGO_OK_STATE, SHORT_TIMEOUT) && hw_number_item(fbc, AUX_LIGHT_INTENSITY_PROPERTY_NAME, AUX_LIGHT_INTENSITY_ITEM_NAME, &value) && value == percent;
}

// The driver counts a timed output down second by second while it is BUSY and ends OK at zero.
static bool run_timed(const char *property, const char *item, double seconds) {
	unsigned before = hw_revision(fbc, property);
	double started = indigo_monotonic_time();
	hw_request_number(fbc, property, item, seconds);
	if (!hw_wait_state(fbc, property, before, INDIGO_BUSY_STATE, SHORT_TIMEOUT)) {
		return false;
	}
	if (!hw_wait_settled(fbc, property, INDIGO_OK_STATE, seconds + SHORT_TIMEOUT)) {
		return false;
	}
	double elapsed = indigo_monotonic_time() - started, value = -1;
	printf("    %s of %g s took %.2f s\n", property, seconds, elapsed);
	return elapsed > seconds - 0.5 && hw_number_item(fbc, property, item, &value) && value == 0;
}

static void restore_initial_state(void) {
	if (fbc >= 0 && state_captured && hw_connected(fbc)) {
		set_intensity(initial_intensity);
	}
}

static void fbc_reports_identity_and_capabilities(void) {
	char model[INDIGO_VALUE_SIZE] = "", firmware[INDIGO_VALUE_SIZE] = "";
	ASSERT_TRUE((hw_device_interface(fbc) & INDIGO_INTERFACE_AUX_LIGHTBOX) != 0);
	ASSERT_STREQ(DEVICE_NAME, hw_device_name(fbc));
	ASSERT_TRUE(hw_text_item(fbc, INFO_PROPERTY_NAME, INFO_DEVICE_MODEL_ITEM_NAME, model, sizeof(model)));
	ASSERT_STREQ("Lacerta FBC", model);
	// The V answer fills the firmware revision.
	ASSERT_TRUE(hw_text_item(fbc, INFO_PROPERTY_NAME, INFO_DEVICE_FW_REVISION_ITEM_NAME, firmware, sizeof(firmware)));
	ASSERT_TRUE(*firmware && strcmp(firmware, "Unknown"));
	printf("    %s firmware %s, intensity %g%%\n", model, firmware, initial_intensity);
}

static void fbc_publishes_the_property_contract(void) {
	double min = -1, max = -1;
	ASSERT_TRUE(hw_property_defined(fbc, AUX_LIGHT_INTENSITY_PROPERTY_NAME));
	ASSERT_TRUE(hw_property_defined(fbc, AUX_LIGHT_IMPULSE_PROPERTY_NAME));
	ASSERT_TRUE(hw_property_defined(fbc, CCD_EXPOSURE_PROPERTY_NAME));
	ASSERT_TRUE(hw_number_item_range(fbc, AUX_LIGHT_INTENSITY_PROPERTY_NAME, AUX_LIGHT_INTENSITY_ITEM_NAME, &min, &max));
	ASSERT_EQ_INT(0, (int)min);
	ASSERT_EQ_INT(100, (int)max);
}

static void fbc_sets_the_intensity(void) {
	static const double values[] = { 0, 1, 50, 99, 100, 37 };
	for (int i = 0; i < ARRAY_SIZE(values); i++) {
		ASSERT_TRUE(set_intensity(values[i]));
	}
	// Repeating a request is answered the same way.
	ASSERT_TRUE(set_intensity(37));
}

static void fbc_fires_a_light_impulse(void) {
	ASSERT_TRUE(run_timed(AUX_LIGHT_IMPULSE_PROPERTY_NAME, AUX_LIGHT_IMPULSE_DURATION_ITEM_NAME, TIMED_DURATION));
	// A fraction of a second is waited out as well.
	ASSERT_TRUE(run_timed(AUX_LIGHT_IMPULSE_PROPERTY_NAME, AUX_LIGHT_IMPULSE_DURATION_ITEM_NAME, 1));
}

static void fbc_controls_the_shutter(void) {
	ASSERT_TRUE(run_timed(CCD_EXPOSURE_PROPERTY_NAME, CCD_EXPOSURE_ITEM_NAME, TIMED_DURATION));
}

static void fbc_reconnects(void) {
	ASSERT_TRUE(set_intensity(60));
	ASSERT_TRUE(hw_disconnect(fbc, SHORT_TIMEOUT));
	ASSERT_TRUE(hw_property_hidden(fbc, AUX_LIGHT_IMPULSE_PROPERTY_NAME));
	ASSERT_TRUE(hw_connect(fbc, SHORT_TIMEOUT));
	ASSERT_TRUE(hw_property_defined(fbc, AUX_LIGHT_IMPULSE_PROPERTY_NAME));
	ASSERT_TRUE(set_intensity(20));
	ASSERT_TRUE(run_timed(AUX_LIGHT_IMPULSE_PROPERTY_NAME, AUX_LIGHT_IMPULSE_DURATION_ITEM_NAME, 1));
}

static void fbc_rejects_shutdown_while_connected(void) {
	ASSERT_EQ_INT(INDIGO_BUSY, indigo_aux_fbc(INDIGO_DRIVER_SHUTDOWN, NULL));
	ASSERT_TRUE(set_intensity(25));
}

static void fbc_reinitializes(void) {
	ASSERT_TRUE(hw_disconnect(fbc, SHORT_TIMEOUT));
	ASSERT_EQ_INT(INDIGO_OK, indigo_aux_fbc(INDIGO_DRIVER_SHUTDOWN, NULL));
	ASSERT_EQ_INT(-1, hw_device_index(DEVICE_NAME));
	ASSERT_EQ_INT(INDIGO_OK, indigo_aux_fbc(INDIGO_DRIVER_INIT, NULL));
	fbc = hw_wait_for_device(DEVICE_NAME, SHORT_TIMEOUT);
	ASSERT_TRUE(fbc >= 0);
	ASSERT_TRUE(select_port());
	ASSERT_TRUE(hw_connect(fbc, SHORT_TIMEOUT));
	ASSERT_TRUE(set_intensity(80));
}

int main(int argc, char **argv) {
	if (argc < 2 || strcmp(argv[1], "--run")) {
		fprintf(stderr, "Physical Lacerta FBC test: run explicitly with --run (or make test-aux-fbc-hw).\n");
		return 2;
	}
	setvbuf(stdout, NULL, _IONBF, 0);
	for (int i = 2; i < argc; i++) {
		if (!strcmp(argv[i], "--debug")) {
			indigo_set_log_level(INDIGO_LOG_DEBUG);
		}
	}
	// AUX_LIGHT_INTENSITY is persistent, so the session keeps its configuration out of the user's own folder.
	if (!indigo_test_use_private_home()) {
		return 1;
	}
	serial_port = hw_port("FBC_HW_PORT");
	const indigo_test_case tests[] = {
		{ "fbc_reports_identity_and_capabilities", fbc_reports_identity_and_capabilities },
		{ "fbc_publishes_the_property_contract", fbc_publishes_the_property_contract },
		{ "fbc_sets_the_intensity", fbc_sets_the_intensity },
		{ "fbc_fires_a_light_impulse", fbc_fires_a_light_impulse },
		{ "fbc_controls_the_shutter", fbc_controls_the_shutter },
		{ "fbc_reconnects", fbc_reconnects },
		{ "fbc_rejects_shutdown_while_connected", fbc_rejects_shutdown_while_connected },
		{ "fbc_reinitializes", fbc_reinitializes }
	};
	int result = 1;
	bool started = false, initialized = false;
	HW_CHECK(hw_start() == INDIGO_OK);
	started = true;
	HW_CHECK(hw_attach_client("Lacerta FBC hardware test") == INDIGO_OK);
	HW_CHECK(indigo_aux_fbc(INDIGO_DRIVER_INIT, NULL) == INDIGO_OK);
	initialized = true;
	fbc = hw_wait_for_device(DEVICE_NAME, SHORT_TIMEOUT);
	HW_CHECK(fbc >= 0);
	HW_CHECK(select_port());
	HW_CHECK(hw_connect(fbc, SHORT_TIMEOUT));
	HW_CHECK(hw_number_item(fbc, AUX_LIGHT_INTENSITY_PROPERTY_NAME, AUX_LIGHT_INTENSITY_ITEM_NAME, &initial_intensity));
	state_captured = true;
	result = indigo_run_tests("Lacerta FBC hardware", tests, ARRAY_SIZE(tests));
cleanup:
	restore_initial_state();
	if (!hw_disconnect(fbc, SHORT_TIMEOUT)) {
		indigo_test_failures++;
	}
	if (initialized && indigo_aux_fbc(INDIGO_DRIVER_SHUTDOWN, NULL) != INDIGO_OK) {
		indigo_test_failures++;
	}
	indigo_detach_client(&hw_client);
	if (started) {
		indigo_stop();
	}
	hw_release_properties();
	indigo_test_remove_private_home();
	return indigo_test_failures ? 1 : result;
}
