// Copyright (c) 2026 INDIGO initiative
// All rights reserved.
//
// You may use this software under the terms of 'INDIGO Astronomy
// open-source license' (see LICENSE.md).
//
// THIS SOFTWARE IS PROVIDED BY THE AUTHORS 'AS IS' AND ANY EXPRESS
// OR IMPLIED WARRANTIES, INCLUDING, BUT NOT LIMITED TO, THE IMPLIED
// WARRANTIES OF MERCHANTABILITY AND FITNESS FOR A PARTICULAR PURPOSE
// ARE DISCLAIMED. IN NO EVENT SHALL THE AUTHOR BE LIABLE FOR ANY
// DIRECT, INDIRECT, INCIDENTAL, SPECIAL, EXEMPLARY, OR CONSEQUENTIAL
// DAMAGES (INCLUDING, BUT NOT LIMITED TO, PROCUREMENT OF SUBSTITUTE
// GOODS OR SERVICES; LOSS OF USE, DATA, OR PROFITS; OR BUSINESS
// INTERRUPTION) HOWEVER CAUSED AND ON ANY THEORY OF LIABILITY,
// WHETHER IN CONTRACT, STRICT LIABILITY, OR TORT (INCLUDING
// NEGLIGENCE OR OTHERWISE) ARISING IN ANY WAY OUT OF THE USE OF THIS
// SOFTWARE, EVEN IF ADVISED OF THE POSSIBILITY OF SUCH DAMAGE.

// Code is generated by AI

#ifndef MOUNTSIM_TEST_COMMON_H
#define MOUNTSIM_TEST_COMMON_H
#include "../integration/serial_simulator_test_common.h"

// run_mountsim.py owns the app and byte-transparent relay for this case.
static bool mountsim_attach(external_serial_simulator *session) {
	const char *port = getenv("MOUNTSIM_PTY");
	if (port == NULL || strlen(port) >= sizeof(session->port)) {
		fprintf(stderr, "Run this suite through mountsim/run_mountsim.py\n");
		return false;
	}
	strcpy(session->port, port);
	return true;
}

static bool mountsim_trace_path(char *path, size_t size) {
	const char *trace = getenv("MOUNTSIM_TRACE");
	if (trace == NULL || strlen(trace) >= size) {
		return false;
	}
	strcpy(path, trace);
	return true;
}
// The launcher can remove/recreate its PTY pair to test a real transport hangup.
static bool mountsim_transport(external_serial_simulator *session, bool reconnect) {
	const char *path = getenv("MOUNTSIM_TRANSPORT_CONTROL");
	if (path == NULL) {
		return false;
	}
	char temporary[PATH_MAX], reply[PATH_MAX];
	snprintf(temporary, sizeof(temporary), "%s.tmp", path);
	snprintf(reply, sizeof(reply), "%s.reply", path);
	unlink(reply);
	FILE *file = fopen(temporary, "w");
	if (file == NULL) {
		return false;
	}
	fprintf(file, "%s\n", reconnect ? "reconnect" : "disconnect");
	fclose(file);
	if (rename(temporary, path)) {
		return false;
	}
	for (int i = 0; i < 100; i++) {
		file = fopen(reply, "r");
		if (file != NULL) {
			char result[PATH_MAX] = "";
			bool read = fgets(result, sizeof(result), file) != NULL;
			fclose(file);
			if (!read) {
				indigo_usleep(20000);
				continue;
			}
			result[strcspn(result, "\r\n")] = 0;
			if (reconnect && !strncmp(result, "/dev/", 5)) {
				strcpy(session->port, result);
				return true;
			}
			return !reconnect && !strcmp(result, "disconnected");
		}
		indigo_usleep(20000);
	}
	return false;
}
#endif
