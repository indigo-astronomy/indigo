// Copyright (c) 2026 INDIGO initiative
// All rights reserved.
//
// You may use this software under the terms of 'INDIGO Astronomy
// open-source license' (see LICENSE.md).
//
// THIS SOFTWARE IS PROVIDED BY THE AUTHORS 'AS IS' AND ANY EXPRESS
// OR IMPLIED WARRANTIES, INCLUDING, BUT NOT LIMITED TO, THE IMPLIED
// WARRANTIES OF MERCHANTABILITY AND FITNESS FOR A PARTICULAR PURPOSE
// ARE DISCLAIMED. IN NO EVENT SHALL THE AUTHOR BE LIABLE FOR ANY
// DIRECT, INDIRECT, INCIDENTAL, SPECIAL, EXEMPLARY, OR CONSEQUENTIAL
// DAMAGES (INCLUDING, BUT NOT LIMITED TO, PROCUREMENT OF SUBSTITUTE
// GOODS OR SERVICES; LOSS OF USE, DATA, OR PROFITS; OR BUSINESS
// INTERRUPTION) HOWEVER CAUSED AND ON ANY THEORY OF LIABILITY,
// WHETHER IN CONTRACT, STRICT LIABILITY, OR TORT (INCLUDING
// NEGLIGENCE OR OTHERWISE) ARISING IN ANY WAY OUT OF THE USE OF THIS
// SOFTWARE, EVEN IF ADVISED OF THE POSSIBILITY OF SUCH DAMAGE.

// Code is generated by AI

#include <indigo_drivers/mount_lx200/indigo_mount_lx200.h>
#include <indigo/indigo_align.h>
#include <indigo/indigo_uni_io.h>
#include "mountsim_test_common.h"
static const simulator_driver_case lx200_mount = {
	"Mount LX200",
	"indigo_mount_lx200",
	"Mount LX200",
	indigo_mount_lx200,
	false,
	NULL, 0, NULL, 0, NULL, 0, NULL, 0
};

static const simulator_driver_case lx200_guider = {
	"Mount LX200 (guider)",
	"indigo_mount_lx200",
	"Mount LX200 (guider)",
	indigo_mount_lx200,
	false,
	NULL, 0, NULL, 0, NULL, 0, NULL, 0
};

static bool io_switch(const simulator_driver_case *device, const char *property, const char *item, bool value, indigo_property_state state) {
	unsigned int revision = property_revision(property);
	return indigo_change_switch_property_1(&simulator_test_client, device->device_name, property, item, value) == INDIGO_OK && wait_for_property_state_seen_after(property, state, revision);
}

static bool io_number(const simulator_driver_case *device, const char *property, const char *item, double value, indigo_property_state state) {
	unsigned int revision = property_revision(property);
	return indigo_change_number_property_1(&simulator_test_client, device->device_name, property, item, value) == INDIGO_OK && wait_for_property_state_seen_after(property, state, revision);
}

static bool io_numbers(const simulator_driver_case *device, const char *property, const char *item1, double value1, const char *item2, double value2, indigo_property_state state) {
	unsigned int revision = property_revision(property);
	const char *items[] = { item1, item2 };
	double values[] = { value1, value2 };
	return indigo_change_number_property(&simulator_test_client, device->device_name, property, 2, items, values) == INDIGO_OK && wait_for_property_state_seen_after(property, state, revision);
}

static bool io_coordinates(double ra, double dec, indigo_property_state state) {
	return io_numbers(&lx200_mount, MOUNT_EQUATORIAL_COORDINATES_PROPERTY_NAME, MOUNT_EQUATORIAL_COORDINATES_RA_ITEM_NAME, ra, MOUNT_EQUATORIAL_COORDINATES_DEC_ITEM_NAME, dec, state);
}

static bool io_sync(double ra, double dec, indigo_property_state state) {
	return io_switch(&lx200_mount, MOUNT_ON_COORDINATES_SET_PROPERTY_NAME, MOUNT_ON_COORDINATES_SET_SYNC_ITEM_NAME, true, INDIGO_OK_STATE) && io_coordinates(ra, dec, state);
}

static bool io_goto(double ra, double dec, indigo_property_state state) {
	return io_switch(&lx200_mount, MOUNT_ON_COORDINATES_SET_PROPERTY_NAME, MOUNT_ON_COORDINATES_SET_TRACK_ITEM_NAME, true, INDIGO_OK_STATE) && io_coordinates(ra, dec, state);
}

static bool io_utc(const char *time, const char *offset, indigo_property_state state) {
	unsigned int revision = property_revision(UTC_TIME_PROPERTY_NAME);
	const char *items[] = { UTC_TIME_ITEM_NAME, UTC_OFFSET_ITEM_NAME };
	const char *values[] = { time, offset };
	return indigo_change_text_property(&simulator_test_client, lx200_mount.device_name, UTC_TIME_PROPERTY_NAME, 2, items, values) == INDIGO_OK && wait_for_property_state_seen_after(UTC_TIME_PROPERTY_NAME, state, revision);
}

static bool io_site(double latitude, double longitude, indigo_property_state state) {
	unsigned int revision = property_revision(GEOGRAPHIC_COORDINATES_PROPERTY_NAME);
	const char *items[] = { GEOGRAPHIC_COORDINATES_LATITUDE_ITEM_NAME, GEOGRAPHIC_COORDINATES_LONGITUDE_ITEM_NAME };
	double values[] = { latitude, longitude };
	return indigo_change_number_property(&simulator_test_client, lx200_mount.device_name, GEOGRAPHIC_COORDINATES_PROPERTY_NAME, 2, items, values) == INDIGO_OK && wait_for_property_state_seen_after(GEOGRAPHIC_COORDINATES_PROPERTY_NAME, state, revision);
}

static bool switch_value(const char *property, const char *item) {
	indigo_item *cached = find_cached_item(property, item);
	return cached != NULL && cached->sw.value;
}

static bool wait_switch(const char *property, const char *item, bool value) {
	for (int i = 0; i < 100; i++) {
		if (find_cached_item(property, item) != NULL && switch_value(property, item) == value) {
			return true;
		}
		indigo_usleep(100000);
	}
	return false;
}

static double number_value(const char *property, const char *item) {
	indigo_item *cached = find_cached_item(property, item);
	return cached != NULL ? cached->number.value : NAN;
}

// Waits until value - reference exceeds delta (or falls below -delta when delta < 0).
static bool wait_number_change(const char *property, const char *item, double reference, double delta) {
	for (int i = 0; i < 100; i++) {
		double change = number_value(property, item) - reference;
		if ((delta > 0 && change > delta) || (delta < 0 && change < delta)) {
			return true;
		}
		indigo_usleep(100000);
	}
	fprintf(stderr, "  %s.%s did not change by %g from %g (now %g)\n", property, item, delta, reference, number_value(property, item));
	return false;
}

static bool fresh_coordinates(void) {
	unsigned revision = property_revision(MOUNT_EQUATORIAL_COORDINATES_PROPERTY_NAME);
	for (int i = 0; i < 100; i++) {
		if (property_revision(MOUNT_EQUATORIAL_COORDINATES_PROPERTY_NAME) >= revision + 2) { return true; }
		indigo_usleep(100000);
	}
	return false;
}

// Samples a readback over milliseconds and requires it to stay within tolerance.
static bool number_stays(const char *property, const char *item, double tolerance, int milliseconds) {
	double reference = number_value(property, item);
	unsigned initial_revision = property_revision(property);
	for (int elapsed = 0; elapsed < milliseconds; elapsed += 100) {
		indigo_usleep(100000);
		if (fabs(number_value(property, item) - reference) > tolerance) {
			fprintf(stderr, "  %s.%s moved from %g to %g\n", property, item, reference, number_value(property, item));
			return false;
		}
	}
	return property_revision(property) >= initial_revision + 2;
}

static uint64_t io_monotonic_ns(void) {
#if defined(__APPLE__)
	return clock_gettime_nsec_np(CLOCK_MONOTONIC);
#else
	struct timespec now;
	clock_gettime(CLOCK_MONOTONIC, &now);
	return (uint64_t)now.tv_sec * 1000000000 + now.tv_nsec;
#endif
}

static atomic_uint_fast64_t guide_completed[2];
static atomic_uint_fast64_t guide_alerted[2];
static atomic_uint_fast64_t coordinates_ok_after;

static indigo_result timed_client_update(indigo_client *client, indigo_device *device, indigo_property *property, const char *message) {
	printf("PROPERTY %s %s state=%d", property->device, property->name, property->state);
	for (int i = 0; i < property->count; i++) {
		if (property->type == INDIGO_NUMBER_VECTOR) { printf(" %s=%g", property->items[i].name, property->items[i].number.value); }
		if (property->type == INDIGO_SWITCH_VECTOR) { printf(" %s=%d", property->items[i].name, property->items[i].sw.value); }
	}
	puts("");
	if (!strcmp(property->device, lx200_guider.device_name)) {
		int axis = !strcmp(property->name, GUIDER_GUIDE_RA_PROPERTY_NAME) ? 0 : !strcmp(property->name, GUIDER_GUIDE_DEC_PROPERTY_NAME) ? 1 : -1;
		if (axis >= 0 && property->state == INDIGO_OK_STATE) {
			atomic_store(guide_completed + axis, io_monotonic_ns());
		} else if (axis >= 0 && property->state == INDIGO_ALERT_STATE) {
			atomic_store(guide_alerted + axis, io_monotonic_ns());
		}
	} else if (!strcmp(property->device, lx200_mount.device_name) && !strcmp(property->name, MOUNT_EQUATORIAL_COORDINATES_PROPERTY_NAME) && property->state == INDIGO_OK_STATE) {
		uint_fast64_t expected = 0;
		atomic_compare_exchange_strong(&coordinates_ok_after, &expected, io_monotonic_ns());
	}
	return simulator_client_update_property(client, device, property, message);
}

static bool wait_motion(const char *property) {
	for (int i = 0; i < 600; i++) {
		indigo_property *p = find_cached_property(property);
		if (p && p->state == INDIGO_OK_STATE) { return true; }
		if (p && p->state == INDIGO_ALERT_STATE) { return false; }
		indigo_usleep(100000);
	}
	return false;
}

static double last_command(const char *wanted) {
	char path[PATH_MAX], line[2048];
	if (!mountsim_trace_path(path, sizeof(path))) { return 0; }
	FILE *file = fopen(path, "r");
	if (!file) { return 0; }
	double found = 0;
	while (fgets(line, sizeof(line), file)) {
		char *cursor, *end, command[256];
		double timestamp = strtod(line, &cursor);
		int n = 0;
		while (n < 255) {
			unsigned long byte = strtoul(cursor, &end, 16);
			if (end == cursor) { break; }
			command[n++] = byte;
			cursor = end;
		}
		command[n] = 0;
		if (!strcmp(command, wanted)) { found = timestamp; }
	}
	fclose(file);
	return found;
}

static bool wait_command_after(const char *command, double previous) {
	for (int i = 0; i < 500; i++) {
		if (last_command(command) > previous) { return true; }
		indigo_usleep(10000);
	}
	return false;
}

static bool start_mount(external_serial_simulator *session) {
	simulator_test_client.update_property = timed_client_update;
	if (getenv("MOUNTSIM_MODEL") && !strcmp(getenv("MOUNTSIM_MODEL"), "LX200Classic")) {
		if (!mountsim_attach(session) || !bring_up_serial_driver(&lx200_mount)) { return false; }
		enumerate_simulator_device();
		if (!io_switch(&lx200_mount, "X_MOUNT_TYPE", "CLASSIC", true, INDIGO_OK_STATE) || !connect_serial_device(&lx200_mount, session->port) || !io_number(&lx200_mount, MOUNT_EPOCH_PROPERTY_NAME, MOUNT_EPOCH_ITEM_NAME, 0, INDIGO_OK_STATE)) { return false; }
		unsigned revision = property_revision(MOUNT_EQUATORIAL_COORDINATES_PROPERTY_NAME);
		return wait_for_property_state_seen_after(MOUNT_EQUATORIAL_COORDINATES_PROPERTY_NAME, INDIGO_OK_STATE, revision);
	}
	return mountsim_attach(session) && start_serial_driver(&lx200_mount, session->port) && io_number(&lx200_mount, MOUNT_EPOCH_PROPERTY_NAME, MOUNT_EPOCH_ITEM_NAME, 0, INDIGO_OK_STATE);
}

static bool unpark(void) {
	if (getenv("MOUNTSIM_MODEL") && !strcmp(getenv("MOUNTSIM_MODEL"), "LX200Classic")) { return true; }
	return io_switch(&lx200_mount, MOUNT_PARK_PROPERTY_NAME, MOUNT_PARK_UNPARKED_ITEM_NAME, true, INDIGO_OK_STATE) && wait_switch(MOUNT_PARK_PROPERTY_NAME, MOUNT_PARK_UNPARKED_ITEM_NAME, true);
}

static bool position(double *ra) {
	if (!unpark() || !io_site(48, 17, INDIGO_OK_STATE) || !wait_motion(MOUNT_EQUATORIAL_COORDINATES_PROPERTY_NAME)) { return false; }
	time_t now = time(NULL);
	*ra = fmod(indigo_lst(&now, 17) + 23, 24);
	return io_sync(*ra, 40.25, INDIGO_OK_STATE) && wait_for_number_item_value(MOUNT_EQUATORIAL_COORDINATES_PROPERTY_NAME, MOUNT_EQUATORIAL_COORDINATES_DEC_ITEM_NAME, 40.25, .002) && wait_motion(MOUNT_EQUATORIAL_COORDINATES_PROPERTY_NAME);
}

static void lx200_identity_reconnect(void) {
	external_serial_simulator session = { 0 };
	SERIAL_CHECK_TRUE(start_mount(&session));
	assert_device_interface(INDIGO_INTERFACE_MOUNT);
	assert_switch_item_value("X_MOUNT_TYPE", "STARGO", true);
	SERIAL_CHECK_TRUE(!strcmp(find_cached_item(MOUNT_INFO_PROPERTY_NAME, MOUNT_INFO_MODEL_ITEM_NAME)->text.value, "Avalon StarGO"));
	unsigned revision = property_revision(MOUNT_EQUATORIAL_COORDINATES_PROPERTY_NAME);
	SERIAL_CHECK_TRUE(wait_for_property_state_seen_after(MOUNT_EQUATORIAL_COORDINATES_PROPERTY_NAME, INDIGO_OK_STATE, revision));
	const char *props[] = { MOUNT_HOME_PROPERTY_NAME, MOUNT_PARK_PROPERTY_NAME, MOUNT_GUIDE_RATE_PROPERTY_NAME, MOUNT_TRACKING_PROPERTY_NAME, MOUNT_TRACK_RATE_PROPERTY_NAME, MOUNT_MOTION_RA_PROPERTY_NAME, MOUNT_MOTION_DEC_PROPERTY_NAME, MOUNT_SLEW_RATE_PROPERTY_NAME, GEOGRAPHIC_COORDINATES_PROPERTY_NAME };
	for (int i = 0; i < ARRAY_SIZE(props); i++) { SERIAL_CHECK_TRUE(find_cached_property(props[i]) != NULL); }
	disconnect_serial_device(&lx200_mount);
	SERIAL_CHECK_TRUE(connect_serial_device(&lx200_mount, session.port));
	SERIAL_CHECK_TRUE(wait_for_property_state(MOUNT_EQUATORIAL_COORDINATES_PROPERTY_NAME, INDIGO_OK_STATE));
cleanup:
	stop_serial_driver(&lx200_mount);
}

static void lx200_sync_signed_readback(void) {
	external_serial_simulator session = { 0 };
	SERIAL_CHECK_TRUE(start_mount(&session));
	SERIAL_CHECK_TRUE(unpark());
	const double dec[] = { 40.25, -0.5, -20.375 };
	for (int i = 0; i < ARRAY_SIZE(dec); i++) {
		SERIAL_CHECK_TRUE(io_sync(8.125, dec[i], INDIGO_OK_STATE));
		SERIAL_CHECK_TRUE(wait_for_number_item_value(MOUNT_EQUATORIAL_COORDINATES_PROPERTY_NAME, MOUNT_EQUATORIAL_COORDINATES_RA_ITEM_NAME, 8.125, .002));
		SERIAL_CHECK_TRUE(wait_for_number_item_value(MOUNT_EQUATORIAL_COORDINATES_PROPERTY_NAME, MOUNT_EQUATORIAL_COORDINATES_DEC_ITEM_NAME, dec[i], .002));
		SERIAL_CHECK_TRUE(wait_motion(MOUNT_EQUATORIAL_COORDINATES_PROPERTY_NAME));
	}
	SERIAL_CHECK_TRUE(last_command(":CM") > 0 && last_command(":MS") == 0);
cleanup:
	stop_serial_driver(&lx200_mount);
}

static void lx200_goto_busy_abort_recovery(void) {
	external_serial_simulator session = { 0 };
	double ra;
	SERIAL_CHECK_TRUE(start_mount(&session));
	SERIAL_CHECK_TRUE(position(&ra));
	SERIAL_CHECK_TRUE(io_goto(ra, 50.25, INDIGO_BUSY_STATE));
	SERIAL_CHECK_TRUE(wait_motion(MOUNT_EQUATORIAL_COORDINATES_PROPERTY_NAME));
	SERIAL_CHECK_TRUE(wait_for_number_item_value(MOUNT_EQUATORIAL_COORDINATES_PROPERTY_NAME, MOUNT_EQUATORIAL_COORDINATES_DEC_ITEM_NAME, 50.25, .01));
	SERIAL_CHECK_TRUE(wait_for_number_item_value(MOUNT_EQUATORIAL_COORDINATES_PROPERTY_NAME, MOUNT_EQUATORIAL_COORDINATES_RA_ITEM_NAME, ra, .002));
	SERIAL_CHECK_TRUE(io_goto(ra, 50.25, INDIGO_BUSY_STATE));
	SERIAL_CHECK_TRUE(wait_motion(MOUNT_EQUATORIAL_COORDINATES_PROPERTY_NAME));
	double previous = last_command(":MS");
	SERIAL_CHECK_TRUE(io_goto(ra, 10, INDIGO_BUSY_STATE));
	SERIAL_CHECK_TRUE(wait_command_after(":MS", previous));
	double sent = last_command(":MS");
	SERIAL_CHECK_EQ_INT(INDIGO_OK, indigo_change_number_property_1(&simulator_test_client, lx200_mount.device_name, MOUNT_EQUATORIAL_COORDINATES_PROPERTY_NAME, MOUNT_EQUATORIAL_COORDINATES_DEC_ITEM_NAME, 20));
	indigo_usleep(200000);
	SERIAL_CHECK_TRUE(last_command(":MS") == sent);
	SERIAL_CHECK_TRUE(io_switch(&lx200_mount, MOUNT_ABORT_MOTION_PROPERTY_NAME, MOUNT_ABORT_MOTION_ITEM_NAME, true, INDIGO_OK_STATE));
	SERIAL_CHECK_TRUE(wait_motion(MOUNT_EQUATORIAL_COORDINATES_PROPERTY_NAME));
	previous = last_command(":MS");
	SERIAL_CHECK_TRUE(io_goto(ra, 45, INDIGO_BUSY_STATE));
	SERIAL_CHECK_TRUE(wait_command_after(":MS", previous));
	SERIAL_CHECK_TRUE(wait_motion(MOUNT_EQUATORIAL_COORDINATES_PROPERTY_NAME));
	SERIAL_CHECK_TRUE(wait_for_number_item_value(MOUNT_EQUATORIAL_COORDINATES_PROPERTY_NAME, MOUNT_EQUATORIAL_COORDINATES_DEC_ITEM_NAME, 45, .01));
cleanup:
	stop_serial_driver(&lx200_mount);
}

static void lx200_rejected_goto_recovers(void) {
	external_serial_simulator session = { 0 };
	double ra;
	SERIAL_CHECK_TRUE(start_mount(&session));
	SERIAL_CHECK_TRUE(position(&ra));
	SERIAL_CHECK_TRUE(io_goto(fmod(ra + 12, 24), -60, INDIGO_ALERT_STATE));
	SERIAL_CHECK_TRUE(io_goto(ra, 45, INDIGO_BUSY_STATE));
	SERIAL_CHECK_TRUE(wait_motion(MOUNT_EQUATORIAL_COORDINATES_PROPERTY_NAME));
	SERIAL_CHECK_TRUE(wait_for_number_item_value(MOUNT_EQUATORIAL_COORDINATES_PROPERTY_NAME, MOUNT_EQUATORIAL_COORDINATES_DEC_ITEM_NAME, 45, .01));
cleanup:
	stop_serial_driver(&lx200_mount);
}

static void lx200_rejects_unsupported_accessories(void) {
	external_serial_simulator session = { 0 };
	SERIAL_CHECK_TRUE(start_mount(&session));
	const char *names[] = { "Mount LX200 (focuser)", "Mount LX200 (aux)" };
	for (int i = 0; i < ARRAY_SIZE(names); i++) {
		simulator_driver_case accessory = lx200_mount;
		accessory.device_name = names[i];
		reset_simulator_context(&accessory);
		enumerate_simulator_device();
		unsigned revision = property_revision(CONNECTION_PROPERTY_NAME);
		SERIAL_CHECK_EQ_INT(INDIGO_OK, indigo_change_switch_property_1(&simulator_test_client, names[i], CONNECTION_PROPERTY_NAME, CONNECTION_CONNECTED_ITEM_NAME, true));
		SERIAL_CHECK_TRUE(wait_for_property_state_seen_after(CONNECTION_PROPERTY_NAME, INDIGO_ALERT_STATE, revision));
		assert_switch_item_value(CONNECTION_PROPERTY_NAME, CONNECTION_DISCONNECTED_ITEM_NAME, true);
	}
	reset_simulator_context(&lx200_mount);
	enumerate_simulator_device();
	SERIAL_CHECK_TRUE(fresh_coordinates());
	SERIAL_CHECK_TRUE(wait_for_property_state(MOUNT_EQUATORIAL_COORDINATES_PROPERTY_NAME, INDIGO_OK_STATE));
cleanup:
	reset_simulator_context(&lx200_mount);
	enumerate_simulator_device();
	stop_serial_driver(&lx200_mount);
}

static void lx200_tracking_and_rates(void) {
	external_serial_simulator session = { 0 };
	SERIAL_CHECK_TRUE(start_mount(&session));
	SERIAL_CHECK_TRUE(unpark());
	const char *rates[] = { MOUNT_TRACK_RATE_SIDEREAL_ITEM_NAME, MOUNT_TRACK_RATE_SOLAR_ITEM_NAME, MOUNT_TRACK_RATE_LUNAR_ITEM_NAME };
	const char *commands[] = { ":TQ", ":TS", ":TL" };
	for (int i = 0; i < 3; i++) {
		SERIAL_CHECK_TRUE(io_switch(&lx200_mount, MOUNT_TRACK_RATE_PROPERTY_NAME, rates[i], true, INDIGO_OK_STATE));
		SERIAL_CHECK_TRUE(io_switch(&lx200_mount, MOUNT_TRACKING_PROPERTY_NAME, MOUNT_TRACKING_ON_ITEM_NAME, true, INDIGO_OK_STATE));
		SERIAL_CHECK_TRUE(wait_command_after(commands[i], 0));
		indigo_usleep(1500000);
		assert_switch_item_value(MOUNT_TRACKING_PROPERTY_NAME, MOUNT_TRACKING_ON_ITEM_NAME, true);
		SERIAL_CHECK_TRUE(io_switch(&lx200_mount, MOUNT_TRACKING_PROPERTY_NAME, MOUNT_TRACKING_OFF_ITEM_NAME, true, INDIGO_OK_STATE));
		indigo_usleep(1500000);
		assert_switch_item_value(MOUNT_TRACKING_PROPERTY_NAME, MOUNT_TRACKING_OFF_ITEM_NAME, true);
	}
cleanup:
	stop_serial_driver(&lx200_mount);
}

static void lx200_site_and_guide_rate_roundtrip(void) {
	external_serial_simulator session = { 0 };
	SERIAL_CHECK_TRUE(start_mount(&session));
	SERIAL_CHECK_TRUE(io_site(-33.5, 289.75, INDIGO_OK_STATE));
	SERIAL_CHECK_TRUE(io_numbers(&lx200_mount, MOUNT_GUIDE_RATE_PROPERTY_NAME, MOUNT_GUIDE_RATE_RA_ITEM_NAME, 40, MOUNT_GUIDE_RATE_DEC_ITEM_NAME, 60, INDIGO_OK_STATE));
	disconnect_serial_device(&lx200_mount);
	SERIAL_CHECK_TRUE(connect_serial_device(&lx200_mount, session.port));
	SERIAL_CHECK_TRUE(wait_for_number_item_value(GEOGRAPHIC_COORDINATES_PROPERTY_NAME, GEOGRAPHIC_COORDINATES_LATITUDE_ITEM_NAME, -33.5, .001));
	SERIAL_CHECK_TRUE(wait_for_number_item_value(GEOGRAPHIC_COORDINATES_PROPERTY_NAME, GEOGRAPHIC_COORDINATES_LONGITUDE_ITEM_NAME, 289.75, .001));
	SERIAL_CHECK_TRUE(wait_for_number_item_value(MOUNT_GUIDE_RATE_PROPERTY_NAME, MOUNT_GUIDE_RATE_RA_ITEM_NAME, 40, .01));
	SERIAL_CHECK_TRUE(wait_for_number_item_value(MOUNT_GUIDE_RATE_PROPERTY_NAME, MOUNT_GUIDE_RATE_DEC_ITEM_NAME, 60, .01));
cleanup:
	stop_serial_driver(&lx200_mount);
}

static void lx200_manual_axes_rates_stops(void) {
	external_serial_simulator session = { 0 };
	double ra;
	SERIAL_CHECK_TRUE(start_mount(&session));
	SERIAL_CHECK_TRUE(position(&ra));
	const char *rates[] = { MOUNT_SLEW_RATE_GUIDE_ITEM_NAME, MOUNT_SLEW_RATE_CENTERING_ITEM_NAME, MOUNT_SLEW_RATE_FIND_ITEM_NAME, MOUNT_SLEW_RATE_MAX_ITEM_NAME };
	const char *rate_commands[] = { ":RG2", ":RC0", ":RC1", ":RC3" };
	if (getenv("MOUNTSIM_MODEL") && !strcmp(getenv("MOUNTSIM_MODEL"), "LX200Classic")) { rate_commands[0] = ":RG"; rate_commands[1] = ":RC"; rate_commands[2] = ":RM"; rate_commands[3] = ":RS"; }
	const char *props[] = { MOUNT_MOTION_DEC_PROPERTY_NAME, MOUNT_MOTION_DEC_PROPERTY_NAME, MOUNT_MOTION_RA_PROPERTY_NAME, MOUNT_MOTION_RA_PROPERTY_NAME };
	const char *items[] = { MOUNT_MOTION_NORTH_ITEM_NAME, MOUNT_MOTION_SOUTH_ITEM_NAME, MOUNT_MOTION_WEST_ITEM_NAME, MOUNT_MOTION_EAST_ITEM_NAME };
	const char *commands[] = { ":Mn", ":Ms", ":Mw", ":Me" };
	for (int rate = 0; rate < 4; rate++) {
		SERIAL_CHECK_TRUE(io_switch(&lx200_mount, MOUNT_SLEW_RATE_PROPERTY_NAME, rates[rate], true, INDIGO_OK_STATE));
		for (int direction = 0; direction < 4; direction++) {
			double sent = last_command(commands[direction]);
			SERIAL_CHECK_TRUE(io_switch(&lx200_mount, props[direction], items[direction], true, INDIGO_BUSY_STATE));
			SERIAL_CHECK_TRUE(wait_command_after(rate_commands[rate], 0) && wait_command_after(commands[direction], sent));
			SERIAL_CHECK_TRUE(io_switch(&lx200_mount, props[direction], items[direction], false, INDIGO_OK_STATE));
		}
	}
	for (int direction = 0; direction < 4; direction++) {
		const char *coordinate = direction < 2 ? MOUNT_EQUATORIAL_COORDINATES_DEC_ITEM_NAME : MOUNT_EQUATORIAL_COORDINATES_RA_ITEM_NAME;
		SERIAL_CHECK_TRUE(io_switch(&lx200_mount, props[direction], items[direction], true, INDIGO_BUSY_STATE));
		SERIAL_CHECK_TRUE(fresh_coordinates());
		double before = number_value(MOUNT_EQUATORIAL_COORDINATES_PROPERTY_NAME, coordinate);
		SERIAL_CHECK_TRUE(wait_number_change(MOUNT_EQUATORIAL_COORDINATES_PROPERTY_NAME, coordinate, before, direction == 0 ? .1 : direction == 1 ? -.1 : direction == 2 ? .01 : -.01));
		SERIAL_CHECK_TRUE(io_switch(&lx200_mount, props[direction], items[direction], false, INDIGO_OK_STATE));
	}
	SERIAL_CHECK_TRUE(io_switch(&lx200_mount, MOUNT_MOTION_DEC_PROPERTY_NAME, MOUNT_MOTION_NORTH_ITEM_NAME, true, INDIGO_BUSY_STATE));
	SERIAL_CHECK_TRUE(io_switch(&lx200_mount, MOUNT_MOTION_RA_PROPERTY_NAME, MOUNT_MOTION_EAST_ITEM_NAME, true, INDIGO_BUSY_STATE));
	SERIAL_CHECK_TRUE(fresh_coordinates());
	double initial_dec = number_value(MOUNT_EQUATORIAL_COORDINATES_PROPERTY_NAME, MOUNT_EQUATORIAL_COORDINATES_DEC_ITEM_NAME);
	double initial_ra = number_value(MOUNT_EQUATORIAL_COORDINATES_PROPERTY_NAME, MOUNT_EQUATORIAL_COORDINATES_RA_ITEM_NAME);
	SERIAL_CHECK_TRUE(wait_number_change(MOUNT_EQUATORIAL_COORDINATES_PROPERTY_NAME, MOUNT_EQUATORIAL_COORDINATES_DEC_ITEM_NAME, initial_dec, .1));
	SERIAL_CHECK_TRUE(wait_number_change(MOUNT_EQUATORIAL_COORDINATES_PROPERTY_NAME, MOUNT_EQUATORIAL_COORDINATES_RA_ITEM_NAME, initial_ra, -.01));
	SERIAL_CHECK_TRUE(io_switch(&lx200_mount, MOUNT_MOTION_DEC_PROPERTY_NAME, MOUNT_MOTION_SOUTH_ITEM_NAME, true, INDIGO_BUSY_STATE));
	SERIAL_CHECK_TRUE(fresh_coordinates());
	initial_dec = number_value(MOUNT_EQUATORIAL_COORDINATES_PROPERTY_NAME, MOUNT_EQUATORIAL_COORDINATES_DEC_ITEM_NAME);
	initial_ra = number_value(MOUNT_EQUATORIAL_COORDINATES_PROPERTY_NAME, MOUNT_EQUATORIAL_COORDINATES_RA_ITEM_NAME);
	SERIAL_CHECK_TRUE(wait_number_change(MOUNT_EQUATORIAL_COORDINATES_PROPERTY_NAME, MOUNT_EQUATORIAL_COORDINATES_DEC_ITEM_NAME, initial_dec, -.1));
	SERIAL_CHECK_TRUE(wait_number_change(MOUNT_EQUATORIAL_COORDINATES_PROPERTY_NAME, MOUNT_EQUATORIAL_COORDINATES_RA_ITEM_NAME, initial_ra, -.01));
	SERIAL_CHECK_TRUE(io_switch(&lx200_mount, MOUNT_ABORT_MOTION_PROPERTY_NAME, MOUNT_ABORT_MOTION_ITEM_NAME, true, INDIGO_OK_STATE));
	indigo_usleep(1500000);
	SERIAL_CHECK_TRUE(number_stays(MOUNT_EQUATORIAL_COORDINATES_PROPERTY_NAME, MOUNT_EQUATORIAL_COORDINATES_DEC_ITEM_NAME, .002, 3000));
cleanup:
	stop_serial_driver(&lx200_mount);
}

static bool at_pole(void) {
	double ra = 0, dec = 90;
	indigo_eq_to_j2k(0, &ra, &dec);
	return wait_for_number_item_value(MOUNT_EQUATORIAL_COORDINATES_PROPERTY_NAME, MOUNT_EQUATORIAL_COORDINATES_DEC_ITEM_NAME, dec, .01);
}

static void lx200_park_home_and_rejection(void) {
	external_serial_simulator session = { 0 };
	double ra;
	SERIAL_CHECK_TRUE(start_mount(&session));
	SERIAL_CHECK_TRUE(position(&ra));
	SERIAL_CHECK_TRUE(io_switch(&lx200_mount, MOUNT_PARK_PROPERTY_NAME, MOUNT_PARK_PARKED_ITEM_NAME, true, INDIGO_BUSY_STATE));
	SERIAL_CHECK_TRUE(wait_motion(MOUNT_PARK_PROPERTY_NAME));
	SERIAL_CHECK_TRUE(at_pole());
	assert_switch_item_value(MOUNT_TRACKING_PROPERTY_NAME, MOUNT_TRACKING_OFF_ITEM_NAME, true);
	SERIAL_CHECK_TRUE(io_switch(&lx200_mount, MOUNT_MOTION_DEC_PROPERTY_NAME, MOUNT_MOTION_NORTH_ITEM_NAME, true, INDIGO_ALERT_STATE));
	SERIAL_CHECK_TRUE(unpark());
	SERIAL_CHECK_TRUE(io_sync(ra, 70, INDIGO_OK_STATE));
	SERIAL_CHECK_TRUE(io_switch(&lx200_mount, MOUNT_HOME_PROPERTY_NAME, MOUNT_HOME_ITEM_NAME, true, INDIGO_BUSY_STATE));
	SERIAL_CHECK_TRUE(wait_motion(MOUNT_HOME_PROPERTY_NAME));
	SERIAL_CHECK_TRUE(at_pole());
cleanup:
	stop_serial_driver(&lx200_mount);
}

static void lx200_park_abort_recovery(void) {
	external_serial_simulator session = { 0 };
	double ra;
	SERIAL_CHECK_TRUE(start_mount(&session));
	SERIAL_CHECK_TRUE(position(&ra));
	SERIAL_CHECK_TRUE(io_switch(&lx200_mount, MOUNT_PARK_PROPERTY_NAME, MOUNT_PARK_PARKED_ITEM_NAME, true, INDIGO_BUSY_STATE));
	SERIAL_CHECK_TRUE(wait_command_after(":X362", 0));
	SERIAL_CHECK_TRUE(io_switch(&lx200_mount, MOUNT_ABORT_MOTION_PROPERTY_NAME, MOUNT_ABORT_MOTION_ITEM_NAME, true, INDIGO_OK_STATE));
	SERIAL_CHECK_TRUE(wait_motion(MOUNT_PARK_PROPERTY_NAME));
	assert_switch_item_value(MOUNT_PARK_PROPERTY_NAME, MOUNT_PARK_UNPARKED_ITEM_NAME, true);
	disconnect_serial_device(&lx200_mount);
	SERIAL_CHECK_TRUE(connect_serial_device(&lx200_mount, session.port));
	SERIAL_CHECK_TRUE(io_sync(ra, 40, INDIGO_OK_STATE));
	SERIAL_CHECK_TRUE(wait_for_number_item_value(MOUNT_EQUATORIAL_COORDINATES_PROPERTY_NAME, MOUNT_EQUATORIAL_COORDINATES_DEC_ITEM_NAME, 40, .01));
cleanup:
	stop_serial_driver(&lx200_mount);
}

static void lx200_guider_motion_readback(void) {
	external_serial_simulator session = { 0 };
	double ra;
	bool guide_connected = false;
	SERIAL_CHECK_TRUE(start_mount(&session));
	SERIAL_CHECK_TRUE(position(&ra));
	SERIAL_CHECK_TRUE(io_switch(&lx200_mount, MOUNT_TRACKING_PROPERTY_NAME, MOUNT_TRACKING_ON_ITEM_NAME, true, INDIGO_OK_STATE));
	SERIAL_CHECK_TRUE(io_numbers(&lx200_mount, MOUNT_GUIDE_RATE_PROPERTY_NAME, MOUNT_GUIDE_RATE_RA_ITEM_NAME, 50, MOUNT_GUIDE_RATE_DEC_ITEM_NAME, 50, INDIGO_OK_STATE));
	double before = number_value(MOUNT_EQUATORIAL_COORDINATES_PROPERTY_NAME, MOUNT_EQUATORIAL_COORDINATES_DEC_ITEM_NAME);
	SERIAL_CHECK_TRUE(connect_serial_device(&lx200_guider, NULL));
	guide_connected = true;
	SERIAL_CHECK_TRUE(io_number(&lx200_guider, GUIDER_GUIDE_DEC_PROPERTY_NAME, GUIDER_GUIDE_NORTH_ITEM_NAME, 2000, INDIGO_OK_STATE));
	reset_simulator_context(&lx200_mount);
	enumerate_simulator_device();
	SERIAL_CHECK_TRUE(wait_number_change(MOUNT_EQUATORIAL_COORDINATES_PROPERTY_NAME, MOUNT_EQUATORIAL_COORDINATES_DEC_ITEM_NAME, before, .002));
	SERIAL_CHECK_TRUE(number_stays(MOUNT_EQUATORIAL_COORDINATES_PROPERTY_NAME, MOUNT_EQUATORIAL_COORDINATES_DEC_ITEM_NAME, .0006, 3000));
cleanup:
	if (guide_connected) { disconnect_serial_device(&lx200_guider); }
	reset_simulator_context(&lx200_mount);
	enumerate_simulator_device();
	stop_serial_driver(&lx200_mount);
}

static void transport_loss(bool active) {
	external_serial_simulator session = { 0 };
	double ra;
	SERIAL_CHECK_TRUE(start_mount(&session));
	SERIAL_CHECK_TRUE(position(&ra));
	SERIAL_CHECK_TRUE(wait_for_property_state(MOUNT_EQUATORIAL_COORDINATES_PROPERTY_NAME, INDIGO_OK_STATE));
	if (active) { SERIAL_CHECK_TRUE(io_goto(ra, 70, INDIGO_BUSY_STATE)); }
	SERIAL_CHECK_TRUE(mountsim_transport(&session, false));
	SERIAL_CHECK_TRUE(wait_for_property_state(MOUNT_EQUATORIAL_COORDINATES_PROPERTY_NAME, INDIGO_ALERT_STATE));
	disconnect_serial_device(&lx200_mount);
	SERIAL_CHECK_TRUE(mountsim_transport(&session, true));
	SERIAL_CHECK_TRUE(connect_serial_device(&lx200_mount, session.port));
	SERIAL_CHECK_TRUE(io_switch(&lx200_mount, MOUNT_ABORT_MOTION_PROPERTY_NAME, MOUNT_ABORT_MOTION_ITEM_NAME, true, INDIGO_OK_STATE));
	SERIAL_CHECK_TRUE(wait_for_property_state(MOUNT_EQUATORIAL_COORDINATES_PROPERTY_NAME, INDIGO_OK_STATE));
	SERIAL_CHECK_TRUE(io_sync(ra, 40, INDIGO_OK_STATE));
	SERIAL_CHECK_TRUE(wait_for_number_item_value(MOUNT_EQUATORIAL_COORDINATES_PROPERTY_NAME, MOUNT_EQUATORIAL_COORDINATES_DEC_ITEM_NAME, 40, .01));
cleanup:
	stop_serial_driver(&lx200_mount);
}

static void lx200_idle_transport_loss(void) { transport_loss(false); }

static void lx200_active_transport_loss(void) { transport_loss(true); }

static void lx200_guider_timing_and_shared_lifecycle(void) {
	external_serial_simulator session = { 0 };
	bool mount_connected = false;
	bool classic = getenv("MOUNTSIM_MODEL") && !strcmp(getenv("MOUNTSIM_MODEL"), "LX200Classic");
	double errors[72], percentages[72];
	int samples = 0;
	SERIAL_CHECK_TRUE(mountsim_attach(&session));
	simulator_test_client.update_property = timed_client_update;
	if (classic) {
		SERIAL_CHECK_TRUE(start_mount(&session));
		mount_connected = true;
		SERIAL_CHECK_TRUE(connect_serial_device(&lx200_guider, NULL));
		disconnect_serial_device(&lx200_mount);
		mount_connected = false;
		reset_simulator_context(&lx200_guider);
		enumerate_simulator_device();
	} else {
		SERIAL_CHECK_TRUE(start_shared_serial_device(&lx200_guider, lx200_mount.device_name, session.port));
	}
	assert_device_interface(INDIGO_INTERFACE_GUIDER);
	const char *props[] = { GUIDER_GUIDE_DEC_PROPERTY_NAME, GUIDER_GUIDE_DEC_PROPERTY_NAME, GUIDER_GUIDE_RA_PROPERTY_NAME, GUIDER_GUIDE_RA_PROPERTY_NAME };
	const char *items[] = { GUIDER_GUIDE_NORTH_ITEM_NAME, GUIDER_GUIDE_SOUTH_ITEM_NAME, GUIDER_GUIDE_EAST_ITEM_NAME, GUIDER_GUIDE_WEST_ITEM_NAME };
	const char letters[] = "nsew";
	const int durations[] = { 20, 100, 500 };
	for (int workload = 0; workload < 2; workload++) {
		if (workload) {
			mount_connected = connect_serial_device(&lx200_mount, NULL);
			SERIAL_CHECK_TRUE(mount_connected);
			SERIAL_CHECK_TRUE(unpark());
			if (classic) {
				double ra;
				SERIAL_CHECK_TRUE(position(&ra));
				SERIAL_CHECK_TRUE(io_goto(ra, 40.5, INDIGO_BUSY_STATE));
				SERIAL_CHECK_TRUE(wait_motion(MOUNT_EQUATORIAL_COORDINATES_PROPERTY_NAME));
			} else {
				SERIAL_CHECK_TRUE(io_switch(&lx200_mount, MOUNT_TRACKING_PROPERTY_NAME, MOUNT_TRACKING_ON_ITEM_NAME, true, INDIGO_OK_STATE));
			}
			reset_simulator_context(&lx200_guider);
			enumerate_simulator_device();
		}
		for (int direction = 0; direction < 4; direction++) {
			for (int sample = -1; sample < 9; sample++) {
				int duration = sample < 0 ? 20 : durations[sample % 3];
				char command[32];
				if (classic) { snprintf(command, sizeof(command), ":M%c", letters[direction]); } else { snprintf(command, sizeof(command), ":Mg%c%04d", letters[direction], duration); }
				int axis = direction < 2 ? 1 : 0;
				atomic_store(guide_completed + axis, 0);
				unsigned revision = property_revision(props[direction]);
				SERIAL_CHECK_TRUE(io_number(&lx200_guider, props[direction], items[direction], duration, INDIGO_BUSY_STATE));
				SERIAL_CHECK_TRUE(wait_for_property_state_seen_after(props[direction], INDIGO_OK_STATE, revision));
				double entered = last_command(command), completed = atomic_load(guide_completed + axis) / 1e9;
				if (classic) {
					snprintf(command, sizeof(command), ":Q%c", letters[direction]);
					completed = last_command(command);
				}
				SERIAL_CHECK_TRUE(entered > 0 && completed >= entered && completed - entered < 5);
				SERIAL_CHECK_TRUE(number_value(props[direction], items[direction]) == 0);
				if (sample >= 0) {
					double error = (completed - entered) * 1000 - duration;
					errors[samples] = error;
					percentages[samples++] = error * 100 / duration;
					printf("PULSE %s %c requested=%d actual=%.3f error=%.3f ms\n", workload ? "tracking/polling" : "idle", letters[direction], duration, (completed - entered) * 1000, error);
				}
			}
		}
	}
	double zero_before = last_command(":Mgn0000");
	SERIAL_CHECK_TRUE(io_number(&lx200_guider, GUIDER_GUIDE_DEC_PROPERTY_NAME, GUIDER_GUIDE_NORTH_ITEM_NAME, 0, INDIGO_OK_STATE));
	SERIAL_CHECK_TRUE(last_command(":Mgn0000") == zero_before);
	SERIAL_CHECK_TRUE(io_number(&lx200_guider, GUIDER_GUIDE_DEC_PROPERTY_NAME, GUIDER_GUIDE_NORTH_ITEM_NAME, 1000, INDIGO_BUSY_STATE));
	SERIAL_CHECK_TRUE(io_number(&lx200_guider, GUIDER_GUIDE_DEC_PROPERTY_NAME, GUIDER_GUIDE_SOUTH_ITEM_NAME, 100, INDIGO_OK_STATE));
	SERIAL_CHECK_TRUE(io_number(&lx200_guider, GUIDER_GUIDE_RA_PROPERTY_NAME, GUIDER_GUIDE_EAST_ITEM_NAME, 200, INDIGO_BUSY_STATE));
	SERIAL_CHECK_TRUE(io_number(&lx200_guider, GUIDER_GUIDE_DEC_PROPERTY_NAME, GUIDER_GUIDE_NORTH_ITEM_NAME, 100, INDIGO_OK_STATE));
	SERIAL_CHECK_TRUE(wait_for_property_state(GUIDER_GUIDE_RA_PROPERTY_NAME, INDIGO_OK_STATE));
	disconnect_serial_device(&lx200_guider);
	reset_simulator_context(&lx200_mount);
	enumerate_simulator_device();
	if (!classic) { SERIAL_CHECK_TRUE(io_switch(&lx200_mount, MOUNT_TRACKING_PROPERTY_NAME, MOUNT_TRACKING_OFF_ITEM_NAME, true, INDIGO_OK_STATE)); }
	SERIAL_CHECK_TRUE(connect_serial_device(&lx200_guider, NULL));
	disconnect_serial_device(&lx200_mount);
	mount_connected = false;
	reset_simulator_context(&lx200_guider);
	enumerate_simulator_device();
	SERIAL_CHECK_TRUE(io_number(&lx200_guider, GUIDER_GUIDE_RA_PROPERTY_NAME, GUIDER_GUIDE_WEST_ITEM_NAME, 20, INDIGO_OK_STATE));
	SERIAL_CHECK_TRUE(io_number(&lx200_guider, GUIDER_GUIDE_RA_PROPERTY_NAME, GUIDER_GUIDE_WEST_ITEM_NAME, 2000, INDIGO_BUSY_STATE));
	disconnect_serial_device(&lx200_guider);
	SERIAL_CHECK_TRUE(connect_serial_device(&lx200_guider, NULL));
	SERIAL_CHECK_TRUE(io_number(&lx200_guider, GUIDER_GUIDE_RA_PROPERTY_NAME, GUIDER_GUIDE_EAST_ITEM_NAME, 20, INDIGO_OK_STATE));
	for (int i = 0; i < samples; i++) {
		for (int j = i + 1; j < samples; j++) {
			if (errors[j] < errors[i]) { double swap = errors[i]; errors[i] = errors[j]; errors[j] = swap; }
		}
	}
	double sum = 0, square = 0, absolute = 0, percent_sum = 0, percent_max = 0;
	for (int i = 0; i < samples; i++) {
		sum += errors[i]; square += errors[i] * errors[i]; absolute = fmax(absolute, fabs(errors[i])); percent_sum += percentages[i]; percent_max = fmax(percent_max, fabs(percentages[i]));
	}
	printf("TIMING n=%d min=%.3f mean=%.3f median=%.3f p95=%.3f p99=%.3f max=%.3f stddev=%.3f max_abs=%.3f ms signed_mean_percent=%.3f max_abs_percent=%.3f\n", samples, errors[0], sum / samples, (errors[35] + errors[36]) / 2, errors[68], errors[71], errors[71], sqrt(fmax(0, square / samples - sum * sum / samples / samples)), absolute, percent_sum / samples, percent_max);
cleanup:
	if (mount_connected) { disconnect_serial_device(&lx200_mount); }
	reset_simulator_context(&lx200_guider);
	enumerate_simulator_device();
	stop_serial_driver(&lx200_guider);
}

static void classic_identity_reconnect(void) {
	external_serial_simulator session = { 0 };
	SERIAL_CHECK_TRUE(start_mount(&session));
	assert_device_interface(INDIGO_INTERFACE_MOUNT);
	assert_switch_item_value("X_MOUNT_TYPE", "CLASSIC", true);
	const char *visible[] = { MOUNT_INFO_PROPERTY_NAME, UTC_TIME_PROPERTY_NAME, GEOGRAPHIC_COORDINATES_PROPERTY_NAME, MOUNT_EQUATORIAL_COORDINATES_PROPERTY_NAME, MOUNT_MOTION_RA_PROPERTY_NAME, MOUNT_MOTION_DEC_PROPERTY_NAME, MOUNT_SLEW_RATE_PROPERTY_NAME };
	const char *absent[] = { MOUNT_PARK_PROPERTY_NAME, MOUNT_HOME_PROPERTY_NAME, MOUNT_TRACKING_PROPERTY_NAME };
	for (int i = 0; i < ARRAY_SIZE(visible); i++) { SERIAL_CHECK_TRUE(find_cached_property(visible[i]) != NULL); }
	for (int i = 0; i < ARRAY_SIZE(absent); i++) { SERIAL_CHECK_TRUE(!has_defined_property(absent[i])); }
	unsigned revision = property_revision(MOUNT_EQUATORIAL_COORDINATES_PROPERTY_NAME);
	SERIAL_CHECK_TRUE(wait_for_property_state_seen_after(MOUNT_EQUATORIAL_COORDINATES_PROPERTY_NAME, INDIGO_OK_STATE, revision));
	disconnect_serial_device(&lx200_mount);
	SERIAL_CHECK_TRUE(connect_serial_device(&lx200_mount, session.port));
	revision = property_revision(MOUNT_EQUATORIAL_COORDINATES_PROPERTY_NAME);
	SERIAL_CHECK_TRUE(wait_for_property_state_seen_after(MOUNT_EQUATORIAL_COORDINATES_PROPERTY_NAME, INDIGO_OK_STATE, revision));
cleanup:
	stop_serial_driver(&lx200_mount);
}

static void classic_site_clock_roundtrip(void) {
	external_serial_simulator session = { 0 };
	SERIAL_CHECK_TRUE(start_mount(&session));
	SERIAL_CHECK_TRUE(io_site(-33.5, 289.75, INDIGO_OK_STATE));
	SERIAL_CHECK_TRUE(io_utc("2026-09-23T12:34:56", "2", INDIGO_OK_STATE));
	disconnect_serial_device(&lx200_mount);
	SERIAL_CHECK_TRUE(connect_serial_device(&lx200_mount, session.port));
	SERIAL_CHECK_TRUE(wait_for_number_item_value(GEOGRAPHIC_COORDINATES_PROPERTY_NAME, GEOGRAPHIC_COORDINATES_LATITUDE_ITEM_NAME, -33.5, .001));
	SERIAL_CHECK_TRUE(wait_for_number_item_value(GEOGRAPHIC_COORDINATES_PROPERTY_NAME, GEOGRAPHIC_COORDINATES_LONGITUDE_ITEM_NAME, 289.75, .001));
	indigo_item *utc = find_cached_item(UTC_TIME_PROPERTY_NAME, UTC_TIME_ITEM_NAME);
	SERIAL_CHECK_TRUE(utc != NULL);
	time_t requested = indigo_isogmtotime("2026-09-23T12:34:56");
	time_t reported = indigo_isogmtotime(utc->text.value);
	SERIAL_CHECK_TRUE(reported >= requested && reported - requested < 30);
	SERIAL_CHECK_TRUE(!strcmp(find_cached_item(UTC_TIME_PROPERTY_NAME, UTC_OFFSET_ITEM_NAME)->text.value, "2"));
cleanup:
	stop_serial_driver(&lx200_mount);
}

static void classic_rejected_goto_recovery(void) {
	external_serial_simulator session = { 0 };
	double ra;
	SERIAL_CHECK_TRUE(start_mount(&session));
	SERIAL_CHECK_TRUE(position(&ra));
	time_t now = time(NULL);
	double below = fmod(indigo_lst(&now, 17) + 12, 24);
	SERIAL_CHECK_TRUE(io_goto(below, -60, INDIGO_ALERT_STATE));
	SERIAL_CHECK_TRUE(io_sync(ra, 40.25, INDIGO_OK_STATE));
	SERIAL_CHECK_TRUE(wait_for_number_item_value(MOUNT_EQUATORIAL_COORDINATES_PROPERTY_NAME, MOUNT_EQUATORIAL_COORDINATES_DEC_ITEM_NAME, 40.25, .002));
	SERIAL_CHECK_TRUE(wait_motion(MOUNT_EQUATORIAL_COORDINATES_PROPERTY_NAME));
	SERIAL_CHECK_TRUE(io_goto(ra, 45, INDIGO_BUSY_STATE));
	SERIAL_CHECK_TRUE(wait_motion(MOUNT_EQUATORIAL_COORDINATES_PROPERTY_NAME));
	SERIAL_CHECK_TRUE(wait_for_number_item_value(MOUNT_EQUATORIAL_COORDINATES_PROPERTY_NAME, MOUNT_EQUATORIAL_COORDINATES_DEC_ITEM_NAME, 45, .01));
cleanup:
	stop_serial_driver(&lx200_mount);
}

static void classic_coordinate_boundaries(void) {
	external_serial_simulator session = { 0 };
	SERIAL_CHECK_TRUE(start_mount(&session));
	const double ras[] = { 23.99, .01, 12.345 };
	const double decs[] = { 89.5, -89.5, -.5 };
	for (int i = 0; i < ARRAY_SIZE(ras); i++) {
		SERIAL_CHECK_TRUE(wait_motion(MOUNT_EQUATORIAL_COORDINATES_PROPERTY_NAME));
		SERIAL_CHECK_TRUE(io_sync(ras[i], decs[i], INDIGO_OK_STATE));
		SERIAL_CHECK_TRUE(wait_for_number_item_value(MOUNT_EQUATORIAL_COORDINATES_PROPERTY_NAME, MOUNT_EQUATORIAL_COORDINATES_RA_ITEM_NAME, ras[i], .002));
		SERIAL_CHECK_TRUE(wait_for_number_item_value(MOUNT_EQUATORIAL_COORDINATES_PROPERTY_NAME, MOUNT_EQUATORIAL_COORDINATES_DEC_ITEM_NAME, decs[i], .002));
	}
cleanup:
	stop_serial_driver(&lx200_mount);
}

static void classic_rates_readback(void) {
	external_serial_simulator session = { 0 };
	SERIAL_CHECK_TRUE(start_mount(&session));
	const char *items[] = { MOUNT_TRACK_RATE_SOLAR_ITEM_NAME, MOUNT_TRACK_RATE_LUNAR_ITEM_NAME, MOUNT_TRACK_RATE_SIDEREAL_ITEM_NAME };
	const char *commands[] = { ":ST60.0", ":ST57.9", ":TQ" };
	for (int i = 0; i < ARRAY_SIZE(items); i++) {
		SERIAL_CHECK_TRUE(io_switch(&lx200_mount, MOUNT_TRACK_RATE_PROPERTY_NAME, items[i], true, INDIGO_OK_STATE));
		SERIAL_CHECK_TRUE(wait_command_after(commands[i], 0));
		disconnect_serial_device(&lx200_mount);
		SERIAL_CHECK_TRUE(connect_serial_device(&lx200_mount, session.port));
		assert_switch_item_value(MOUNT_TRACK_RATE_PROPERTY_NAME, items[i], true);
	}
cleanup:
	stop_serial_driver(&lx200_mount);
}

static void classic_protocol_tracking_frequency(void) {
	external_serial_simulator session = { 0 };
	indigo_uni_handle *handle = NULL;
	char reply[64] = { 0 };
	SERIAL_CHECK_TRUE(mountsim_attach(&session));
	handle = indigo_uni_open_serial_with_config(session.port, "9600-8N1", INDIGO_LOG_DEBUG);
	SERIAL_CHECK_TRUE(handle != NULL);
	SERIAL_CHECK_TRUE(indigo_uni_printf(handle, ":GT#") > 0);
	SERIAL_CHECK_TRUE(indigo_uni_read_section2(handle, reply, sizeof(reply) - 1, "#", NULL, 3000000, 3000000) > 0);
	printf("CLASSIC GT=%s\n", reply);
	SERIAL_CHECK_TRUE(fabs(strtod(reply, NULL) - 60.1) < .1);
cleanup:
	indigo_uni_close(&handle);
}

static void classic_guider_motion_readback(void) {
	external_serial_simulator session = { 0 };
	bool guide_connected = false;
	SERIAL_CHECK_TRUE(start_mount(&session));
	double ra;
	SERIAL_CHECK_TRUE(position(&ra));
	SERIAL_CHECK_TRUE(io_goto(ra, 40.5, INDIGO_BUSY_STATE));
	SERIAL_CHECK_TRUE(wait_motion(MOUNT_EQUATORIAL_COORDINATES_PROPERTY_NAME));
	SERIAL_CHECK_TRUE(connect_serial_device(&lx200_guider, NULL));
	guide_connected = true;
	const char *props[] = { GUIDER_GUIDE_DEC_PROPERTY_NAME, GUIDER_GUIDE_DEC_PROPERTY_NAME, GUIDER_GUIDE_RA_PROPERTY_NAME, GUIDER_GUIDE_RA_PROPERTY_NAME };
	const char *items[] = { GUIDER_GUIDE_NORTH_ITEM_NAME, GUIDER_GUIDE_SOUTH_ITEM_NAME, GUIDER_GUIDE_EAST_ITEM_NAME, GUIDER_GUIDE_WEST_ITEM_NAME };
	const char letters[] = "nsew";
	for (int direction = 0; direction < 4; direction++) {
		reset_simulator_context(&lx200_mount);
		enumerate_simulator_device();
		SERIAL_CHECK_TRUE(wait_motion(MOUNT_EQUATORIAL_COORDINATES_PROPERTY_NAME));
		const char *coordinate = direction < 2 ? MOUNT_EQUATORIAL_COORDINATES_DEC_ITEM_NAME : MOUNT_EQUATORIAL_COORDINATES_RA_ITEM_NAME;
		double before = number_value(MOUNT_EQUATORIAL_COORDINATES_PROPERTY_NAME, coordinate);
		reset_simulator_context(&lx200_guider);
		enumerate_simulator_device();
		SERIAL_CHECK_TRUE(io_number(&lx200_guider, props[direction], items[direction], 2000, INDIGO_BUSY_STATE));
		SERIAL_CHECK_TRUE(wait_for_property_state(props[direction], INDIGO_OK_STATE));
		char command[16];
		snprintf(command, sizeof(command), ":M%c", letters[direction]);
		SERIAL_CHECK_TRUE(last_command(command) > 0);
		double started = last_command(command);
		snprintf(command, sizeof(command), ":Q%c", letters[direction]);
		SERIAL_CHECK_TRUE(last_command(command) - started >= 1.9);
		reset_simulator_context(&lx200_mount);
		enumerate_simulator_device();
		double delta = direction == 0 ? .002 : direction == 1 ? -.002 : direction == 2 ? -.0001 : .0001;
		SERIAL_CHECK_TRUE(wait_number_change(MOUNT_EQUATORIAL_COORDINATES_PROPERTY_NAME, coordinate, before, delta));
	}
	SERIAL_CHECK_TRUE(last_command(":Mgn2000") == 0 && last_command(":Mgs2000") == 0 && last_command(":Mge2000") == 0 && last_command(":Mgw2000") == 0);
cleanup:
	if (guide_connected) {
		reset_simulator_context(&lx200_guider);
		enumerate_simulator_device();
		disconnect_serial_device(&lx200_guider);
	}
	reset_simulator_context(&lx200_mount);
	enumerate_simulator_device();
	stop_serial_driver(&lx200_mount);
}

static void classic_guider_conflicts_and_recovery(void) {
	external_serial_simulator session = { 0 };
	bool guide_connected = false;
	double ra;
	SERIAL_CHECK_TRUE(start_mount(&session));
	SERIAL_CHECK_TRUE(position(&ra));
	SERIAL_CHECK_TRUE(connect_serial_device(&lx200_guider, NULL));
	guide_connected = true;
	SERIAL_CHECK_TRUE(io_number(&lx200_guider, GUIDER_GUIDE_DEC_PROPERTY_NAME, GUIDER_GUIDE_NORTH_ITEM_NAME, 3000, INDIGO_BUSY_STATE));
	indigo_usleep(1200000);
	SERIAL_CHECK_TRUE(io_number(&lx200_guider, GUIDER_GUIDE_RA_PROPERTY_NAME, GUIDER_GUIDE_WEST_ITEM_NAME, 3000, INDIGO_BUSY_STATE));
	reset_simulator_context(&lx200_mount);
	enumerate_simulator_device();
	SERIAL_CHECK_TRUE(io_switch(&lx200_mount, MOUNT_MOTION_DEC_PROPERTY_NAME, MOUNT_MOTION_SOUTH_ITEM_NAME, true, INDIGO_ALERT_STATE));
	SERIAL_CHECK_TRUE(last_command(":Ms") == 0);
	reset_simulator_context(&lx200_guider);
	enumerate_simulator_device();
	SERIAL_CHECK_TRUE(io_number(&lx200_guider, GUIDER_GUIDE_DEC_PROPERTY_NAME, GUIDER_GUIDE_SOUTH_ITEM_NAME, 2000, INDIGO_BUSY_STATE));
	SERIAL_CHECK_TRUE(wait_command_after(":Ms", 0));
	SERIAL_CHECK_TRUE(last_command(":Qn") > 0 && last_command(":Ms") >= last_command(":Qn"));
	SERIAL_CHECK_TRUE(io_number(&lx200_guider, GUIDER_GUIDE_DEC_PROPERTY_NAME, GUIDER_GUIDE_SOUTH_ITEM_NAME, 0, INDIGO_OK_STATE));
	SERIAL_CHECK_TRUE(last_command(":Qs") >= last_command(":Ms"));
	SERIAL_CHECK_EQ_INT(INDIGO_BUSY_STATE, find_cached_property(GUIDER_GUIDE_RA_PROPERTY_NAME)->state);
	reset_simulator_context(&lx200_mount);
	enumerate_simulator_device();
	SERIAL_CHECK_TRUE(io_switch(&lx200_mount, MOUNT_ABORT_MOTION_PROPERTY_NAME, MOUNT_ABORT_MOTION_ITEM_NAME, true, INDIGO_OK_STATE));
	SERIAL_CHECK_TRUE(last_command(":Qw") >= last_command(":Mw"));
	reset_simulator_context(&lx200_guider);
	enumerate_simulator_device();
	SERIAL_CHECK_TRUE(wait_for_property_state(GUIDER_GUIDE_RA_PROPERTY_NAME, INDIGO_OK_STATE));
	reset_simulator_context(&lx200_mount);
	enumerate_simulator_device();
	SERIAL_CHECK_TRUE(io_switch(&lx200_mount, MOUNT_SLEW_RATE_PROPERTY_NAME, MOUNT_SLEW_RATE_MAX_ITEM_NAME, true, INDIGO_OK_STATE));
	SERIAL_CHECK_TRUE(io_switch(&lx200_mount, MOUNT_MOTION_RA_PROPERTY_NAME, MOUNT_MOTION_EAST_ITEM_NAME, true, INDIGO_BUSY_STATE));
	SERIAL_CHECK_TRUE(wait_command_after(":Me", 0));
	reset_simulator_context(&lx200_guider);
	enumerate_simulator_device();
	SERIAL_CHECK_TRUE(io_number(&lx200_guider, GUIDER_GUIDE_DEC_PROPERTY_NAME, GUIDER_GUIDE_NORTH_ITEM_NAME, 2000, INDIGO_ALERT_STATE));
	reset_simulator_context(&lx200_mount);
	enumerate_simulator_device();
	SERIAL_CHECK_TRUE(io_switch(&lx200_mount, MOUNT_MOTION_RA_PROPERTY_NAME, MOUNT_MOTION_EAST_ITEM_NAME, false, INDIGO_OK_STATE));
	SERIAL_CHECK_TRUE(wait_motion(MOUNT_EQUATORIAL_COORDINATES_PROPERTY_NAME));
	reset_simulator_context(&lx200_guider);
	enumerate_simulator_device();
	double sent = last_command(":Mn");
	SERIAL_CHECK_TRUE(io_number(&lx200_guider, GUIDER_GUIDE_DEC_PROPERTY_NAME, GUIDER_GUIDE_NORTH_ITEM_NAME, 3000, INDIGO_BUSY_STATE));
	SERIAL_CHECK_TRUE(wait_command_after(":Mn", sent));
	disconnect_serial_device(&lx200_guider);
	guide_connected = false;
	SERIAL_CHECK_TRUE(last_command(":Qn") >= last_command(":Mn"));
	SERIAL_CHECK_TRUE(connect_serial_device(&lx200_guider, NULL));
	guide_connected = true;
	sent = last_command(":Mw");
	SERIAL_CHECK_TRUE(io_number(&lx200_guider, GUIDER_GUIDE_RA_PROPERTY_NAME, GUIDER_GUIDE_WEST_ITEM_NAME, 3000, INDIGO_BUSY_STATE));
	SERIAL_CHECK_TRUE(wait_command_after(":Mw", sent));
	disconnect_serial_device(&lx200_mount);
	SERIAL_CHECK_TRUE(last_command(":Qw") >= last_command(":Mw"));
	SERIAL_CHECK_TRUE(connect_serial_device(&lx200_mount, session.port));
	reset_simulator_context(&lx200_guider);
	enumerate_simulator_device();
	sent = last_command(":Ms");
	SERIAL_CHECK_TRUE(io_number(&lx200_guider, GUIDER_GUIDE_DEC_PROPERTY_NAME, GUIDER_GUIDE_SOUTH_ITEM_NAME, 3000, INDIGO_BUSY_STATE));
	SERIAL_CHECK_TRUE(wait_command_after(":Ms", sent));
	SERIAL_CHECK_TRUE(mountsim_transport(&session, false));
	SERIAL_CHECK_TRUE(wait_for_property_state(GUIDER_GUIDE_DEC_PROPERTY_NAME, INDIGO_ALERT_STATE));
	disconnect_serial_device(&lx200_guider);
	guide_connected = false;
	disconnect_serial_device(&lx200_mount);
	SERIAL_CHECK_TRUE(mountsim_transport(&session, true));
	SERIAL_CHECK_TRUE(connect_serial_device(&lx200_mount, session.port));
	SERIAL_CHECK_TRUE(io_switch(&lx200_mount, MOUNT_MOTION_DEC_PROPERTY_NAME, MOUNT_MOTION_NORTH_ITEM_NAME, true, INDIGO_BUSY_STATE));
	SERIAL_CHECK_TRUE(io_switch(&lx200_mount, MOUNT_MOTION_DEC_PROPERTY_NAME, MOUNT_MOTION_NORTH_ITEM_NAME, false, INDIGO_OK_STATE));
	SERIAL_CHECK_TRUE(connect_serial_device(&lx200_guider, NULL));
	guide_connected = true;
	SERIAL_CHECK_TRUE(io_number(&lx200_guider, GUIDER_GUIDE_DEC_PROPERTY_NAME, GUIDER_GUIDE_NORTH_ITEM_NAME, 100, INDIGO_OK_STATE));
cleanup:
	if (guide_connected) {
		reset_simulator_context(&lx200_guider);
		enumerate_simulator_device();
		disconnect_serial_device(&lx200_guider);
	}
	reset_simulator_context(&lx200_mount);
	enumerate_simulator_device();
	stop_serial_driver(&lx200_mount);
}

int main(int argc, char **argv) {
	if (!indigo_test_use_private_home()) { return 2; }
	setvbuf(stdout, NULL, _IONBF, 0);
	if (getenv("MOUNTSIM_DEBUG")) { indigo_set_log_level(INDIGO_LOG_DEBUG); }
	const indigo_test_case classic_tests[] = {
		{ "classic_identity_reconnect", classic_identity_reconnect },
		{ "classic_rejects_unsupported_accessories", lx200_rejects_unsupported_accessories },
		{ "classic_protocol_tracking_frequency", classic_protocol_tracking_frequency },
		{ "classic_rates_readback", classic_rates_readback },
		{ "classic_rejected_goto_recovery", classic_rejected_goto_recovery },
		{ "classic_coordinate_boundaries", classic_coordinate_boundaries },
		{ "classic_sync_signed_readback", lx200_sync_signed_readback },
		{ "classic_goto_busy_abort_recovery", lx200_goto_busy_abort_recovery },
		{ "classic_manual_axes_rates_stops", lx200_manual_axes_rates_stops },
		{ "classic_site_clock_roundtrip", classic_site_clock_roundtrip },
		{ "classic_idle_transport_loss", lx200_idle_transport_loss },
		{ "classic_active_transport_loss", lx200_active_transport_loss },
		{ "classic_guider_motion_readback", classic_guider_motion_readback },
		{ "classic_guider_conflicts_and_recovery", classic_guider_conflicts_and_recovery },
		{ "classic_guider_timing_and_shared_lifecycle", lx200_guider_timing_and_shared_lifecycle }
	};
	const indigo_test_case stargo_tests[] = {
		{ "lx200_rejects_unsupported_accessories", lx200_rejects_unsupported_accessories },
		{ "lx200_rejected_goto_recovers", lx200_rejected_goto_recovers },
		{ "lx200_guider_motion_readback", lx200_guider_motion_readback },
		{ "lx200_park_abort_recovery", lx200_park_abort_recovery },
		{ "lx200_identity_reconnect", lx200_identity_reconnect },
		{ "lx200_sync_signed_readback", lx200_sync_signed_readback },
		{ "lx200_goto_busy_abort_recovery", lx200_goto_busy_abort_recovery },
		{ "lx200_tracking_and_rates", lx200_tracking_and_rates },
		{ "lx200_site_and_guide_rate_roundtrip", lx200_site_and_guide_rate_roundtrip },
		{ "lx200_manual_axes_rates_stops", lx200_manual_axes_rates_stops },
		{ "lx200_park_home_and_rejection", lx200_park_home_and_rejection },
		{ "lx200_idle_transport_loss", lx200_idle_transport_loss },
		{ "lx200_active_transport_loss", lx200_active_transport_loss },
		{ "lx200_guider_timing_and_shared_lifecycle", lx200_guider_timing_and_shared_lifecycle }
	};
	bool classic = getenv("MOUNTSIM_MODEL") && !strcmp(getenv("MOUNTSIM_MODEL"), "LX200Classic");
	const indigo_test_case *tests = classic ? classic_tests : stargo_tests;
	int count = classic ? ARRAY_SIZE(classic_tests) : ARRAY_SIZE(stargo_tests);
	int result = 2;
	if (argc == 2 && !strcmp(argv[1], "--list")) {
		for (int i = 0; i < count; i++) { puts(tests[i].name); }
		result = 0;
	} else if (argc == 2) {
		for (int i = 0; i < count; i++) {
			if (!strcmp(argv[1], tests[i].name)) { result = indigo_run_tests(classic ? "MountSim 2.3 (LX200Classic)" : "MountSim 2.3 (StarGO)", tests + i, 1); break; }
		}
	}
	indigo_test_remove_private_home();
	return result;
}
