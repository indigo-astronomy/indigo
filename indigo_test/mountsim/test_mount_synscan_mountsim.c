// Copyright (c) 2026 INDIGO initiative
// All rights reserved.
//
// You may use this software under the terms of 'INDIGO Astronomy
// open-source license' (see LICENSE.md).
//
// THIS SOFTWARE IS PROVIDED BY THE AUTHORS 'AS IS' AND ANY EXPRESS
// OR IMPLIED WARRANTIES, INCLUDING, BUT NOT LIMITED TO, THE IMPLIED
// WARRANTIES OF MERCHANTABILITY AND FITNESS FOR A PARTICULAR PURPOSE
// ARE DISCLAIMED. IN NO EVENT SHALL THE AUTHOR BE LIABLE FOR ANY
// DIRECT, INDIRECT, INCIDENTAL, SPECIAL, EXEMPLARY, OR CONSEQUENTIAL
// DAMAGES (INCLUDING, BUT NOT LIMITED TO, PROCUREMENT OF SUBSTITUTE
// GOODS OR SERVICES; LOSS OF USE, DATA, OR PROFITS; OR BUSINESS
// INTERRUPTION) HOWEVER CAUSED AND ON ANY THEORY OF LIABILITY,
// WHETHER IN CONTRACT, STRICT LIABILITY, OR TORT (INCLUDING
// NEGLIGENCE OR OTHERWISE) ARISING IN ANY WAY OUT OF THE USE OF THIS
// SOFTWARE, EVEN IF ADVISED OF THE POSSIBILITY OF SUCH DAMAGE.

// Code is generated by AI

#include <pthread.h>
#include <fcntl.h>
#include <termios.h>
#include <indigo/indigo_align.h>
#include <indigo_drivers/mount_synscan/indigo_mount_synscan.h>
#include "mountsim_test_common.h"
#define MAX_DEVICES 8
#define MAX_PROPERTIES 96
#define SHORT_TIMEOUT 15.0
#define MOTION_TIMEOUT 180.0
#define MOUNT_DEVICE_NAME "Mount SynScan"
#define GUIDER_DEVICE_NAME "Mount SynScan (guider)"
#define AUX_DEVICE_NAME "Mount SynScan (aux)"
#define CHECK(condition) do { if (!(condition)) { fprintf(stderr, "%s:%d: %s\n", __FILE__, __LINE__, #condition); indigo_test_failures++; goto cleanup; } } while (0)
typedef struct {
	char name[INDIGO_NAME_SIZE];
	indigo_device *device;
	unsigned interface;
	bool present;
	char names[MAX_PROPERTIES][INDIGO_NAME_SIZE];
	indigo_property *properties[MAX_PROPERTIES];
	unsigned revisions[MAX_PROPERTIES], seen[MAX_PROPERTIES][4];
} observed_device;
static observed_device devices[MAX_DEVICES];
static pthread_mutex_t mutex = PTHREAD_MUTEX_INITIALIZER;
static unsigned event_epoch;
static int mount = -1, guider = -1, aux = -1;
static char last_message_text[INDIGO_VALUE_SIZE];
static indigo_client client;
static bool bus_started, client_attached, driver_initialized;
static external_serial_simulator session;
static double wire_now(void);

static bool raw_command(int fd, const char *request, char *reply, size_t capacity) {
	char command[32];
	int length = snprintf(command, sizeof(command), "%s\r", request);
	if (length <= 0 || length >= sizeof(command) || write(fd, command, length) != length) { return false; }
	size_t used = 0;
	double deadline = wire_now() + 3;
	while (wire_now() < deadline && used + 1 < capacity) {
		char byte;
		ssize_t count = read(fd, &byte, 1);
		if (count == 1) {
			if (byte == '\r') { reply[used] = 0; return true; }
			reply[used++] = byte;
		} else if (count < 0 && errno != EAGAIN && errno != EINTR) {
			return false;
		} else {
			indigo_usleep(1000);
		}
	}
	return false;
}

// Match the launcher's Python CLOCK_MONOTONIC timestamps, including on macOS where
// INDIGO's clock_gettime compatibility symbol maps to gettimeofday.
static double wire_now(void) {
#ifdef __APPLE__
	return clock_gettime_nsec_np(CLOCK_MONOTONIC) / 1000000000.0;
#else
	struct timespec now;
	clock_gettime(CLOCK_MONOTONIC, &now);
	return now.tv_sec + now.tv_nsec / 1000000000.0;
#endif
}

static int slot(int d, const char *name) {
	if (d < 0 || d >= MAX_DEVICES) { return -1; }
	for (int p = 0; p < MAX_PROPERTIES; p++) {
		if (!strcmp(devices[d].names[p], name)) {
			return p;
		}
	}
	return -1;
}

static indigo_result observe(indigo_device *device, indigo_property *property, const char *message) {
	pthread_mutex_lock(&mutex);
	int d;
	for (d = 0; d < MAX_DEVICES; d++) {
		if (!*devices[d].name || !strcmp(devices[d].name, property->device)) {
			break;
		}
	}
	if (d < MAX_DEVICES) {
		snprintf(devices[d].name, INDIGO_NAME_SIZE, "%s", property->device);
		devices[d].device = device;
		devices[d].present = true;
		if (!strcmp(property->name, INFO_PROPERTY_NAME)) {
			for (int i = 0; i < property->count; i++) {
				if (!strcmp(property->items[i].name, INFO_DEVICE_INTERFACE_ITEM_NAME)) {
					devices[d].interface = (unsigned)strtoul(property->items[i].text.value, NULL, 10);
				}
			}
		}
		int p = slot(d, property->name);
		if (p < 0) {
			for (p = 0; p < MAX_PROPERTIES && *devices[d].names[p]; p++) { }
		}
		if (p < MAX_PROPERTIES) {
			indigo_release_property(devices[d].properties[p]);
			devices[d].properties[p] = indigo_copy_property(NULL, property);
			snprintf(devices[d].names[p], INDIGO_NAME_SIZE, "%s", property->name);
			devices[d].revisions[p] = ++event_epoch;
			devices[d].seen[p][property->state] = event_epoch;
			printf("PROPERTY %s %s state=%d epoch=%u\n", property->device, property->name, property->state, event_epoch);
		}
	}
	pthread_mutex_unlock(&mutex);
	if (message && *message) {
		fprintf(stderr, "    %s %s: %s\n", property->device, property->name, message);
	}
	return INDIGO_OK;
}

static indigo_result define_property(indigo_client *client, indigo_device *device, indigo_property *property, const char *message) {
	return observe(device, property, message);
}

static indigo_result update_property(indigo_client *client, indigo_device *device, indigo_property *property, const char *message) {
	return observe(device, property, message);
}

static indigo_result report_message(indigo_client *client, indigo_device *device, indigo_property *property, const char *message) {
	if (message && *message) {
		pthread_mutex_lock(&mutex);
		snprintf(last_message_text, INDIGO_VALUE_SIZE, "%s", message);
		pthread_mutex_unlock(&mutex);
	}
	return INDIGO_OK;
}

static indigo_result delete_property(indigo_client *client, indigo_device *device, indigo_property *property, const char *message) {
	pthread_mutex_lock(&mutex);
	for (int d = 0; d < MAX_DEVICES; d++) {
		if (strcmp(devices[d].name, property->device)) { continue; }
		for (int p = 0; p < MAX_PROPERTIES; p++) {
			if (!*property->name || !strcmp(devices[d].names[p], property->name)) {
				indigo_release_property(devices[d].properties[p]);
				devices[d].properties[p] = NULL;
				devices[d].revisions[p] = ++event_epoch;
			}
		}
		if (!*property->name) { devices[d].present = false; devices[d].device = NULL; }
	}
	pthread_mutex_unlock(&mutex);
	return INDIGO_OK;
}

static int device_index(const char *name) {
	pthread_mutex_lock(&mutex);
	int result = -1;
	for (int d = 0; d < MAX_DEVICES; d++) {
		if (devices[d].present && !strcmp(devices[d].name, name)) {
			result = d;
		}
	}
	pthread_mutex_unlock(&mutex);
	return result;
}

static unsigned revision(int d, const char *name) {
	pthread_mutex_lock(&mutex);
	int p = slot(d, name);
	unsigned result = p < 0 ? 0 : devices[d].revisions[p];
	pthread_mutex_unlock(&mutex);
	return result;
}


static bool property_defined(int d, const char *name) {
	pthread_mutex_lock(&mutex);
	int p = slot(d, name);
	bool found = p >= 0 && devices[d].properties[p] != NULL;
	pthread_mutex_unlock(&mutex);
	return found;
}

static bool number_item(int d, const char *name, const char *item, double *value) {
	pthread_mutex_lock(&mutex);
	int p = slot(d, name);
	bool found = false;
	if (p >= 0 && devices[d].properties[p] != NULL) {
		indigo_property *property = devices[d].properties[p];
		for (int i = 0; i < property->count && !found; i++) {
			if (!strcmp(property->items[i].name, item)) {
				*value = property->items[i].number.value;
				found = true;
			}
		}
	}
	pthread_mutex_unlock(&mutex);
	if (!found) {
		fprintf(stderr, "    missing number item %s.%s\n", name, item);
	}
	return found;
}

static bool number_target(int d, const char *name, const char *item, double *value) {
	pthread_mutex_lock(&mutex);
	int p = slot(d, name);
	bool found = false;
	if (p >= 0 && devices[d].properties[p] != NULL) {
		indigo_property *property = devices[d].properties[p];
		for (int i = 0; i < property->count && !found; i++) {
			if (!strcmp(property->items[i].name, item)) {
				*value = property->items[i].number.target;
				found = true;
			}
		}
	}
	pthread_mutex_unlock(&mutex);
	return found;
}

static bool switch_item(int d, const char *name, const char *item, bool *value) {
	pthread_mutex_lock(&mutex);
	int p = slot(d, name);
	bool found = false;
	if (p >= 0 && devices[d].properties[p] != NULL) {
		indigo_property *property = devices[d].properties[p];
		for (int i = 0; i < property->count && !found; i++) {
			if (!strcmp(property->items[i].name, item)) {
				*value = property->items[i].sw.value;
				found = true;
			}
		}
	}
	pthread_mutex_unlock(&mutex);
	if (!found) {
		fprintf(stderr, "    missing switch item %s.%s\n", name, item);
	}
	return found;
}

static bool text_item(int d, const char *name, const char *item, char *value, size_t size) {
	pthread_mutex_lock(&mutex);
	int p = slot(d, name);
	bool found = false;
	if (p >= 0 && devices[d].properties[p] != NULL) {
		indigo_property *property = devices[d].properties[p];
		for (int i = 0; i < property->count && !found; i++) {
			if (!strcmp(property->items[i].name, item)) {
				snprintf(value, size, "%s", property->items[i].text.value);
				found = true;
			}
		}
	}
	pthread_mutex_unlock(&mutex);
	if (!found) {
		fprintf(stderr, "    missing text item %s.%s\n", name, item);
	}
	return found;
}

static indigo_property_state property_state(int d, const char *name) {
	pthread_mutex_lock(&mutex);
	int p = slot(d, name);
	indigo_property_state state = p < 0 || !devices[d].properties[p] ? INDIGO_IDLE_STATE : devices[d].properties[p]->state;
	pthread_mutex_unlock(&mutex);
	return state;
}

// Waits for a newer revision of the property in the requested state. A revision gate is required
// because the mount keeps republishing polled properties, so a stale OK must not satisfy a wait.
static bool wait_state(int d, const char *name, unsigned after, indigo_property_state state, double timeout) {
	double deadline = wire_now() + timeout;
	while (wire_now() < deadline) {
		pthread_mutex_lock(&mutex);
		int p = slot(d, name);
		bool ready = p >= 0 && devices[d].seen[p][state] > after;
		pthread_mutex_unlock(&mutex);
		if (ready) {
			return true;
		}
		indigo_usleep(20000);
	}
	// Report what the property actually settled on. A mount that stopped answering reports ALERT
	// on every request, which must not be mistaken for a property stuck in BUSY.
	fprintf(stderr, "    timeout: %s %s expected state %d, last published state %d\n", devices[d].name, name, state, property_state(d, name));
	return false;
}

// Waits for the property to settle out of BUSY, then reports the state it settled in. Coordinate
// and park properties are published by the poll handler while an operation runs, so the terminal
// state is the first non-BUSY revision after the request was accepted.
static bool wait_settled(int d, const char *name, indigo_property_state state, double timeout) {
	double deadline = wire_now() + timeout;
	while (wire_now() < deadline) {
		if (property_state(d, name) == state) {
			return true;
		}
		indigo_usleep(50000);
	}
	fprintf(stderr, "    timeout: %s %s did not settle in state %d (state %d)\n", devices[d].name, name, state, property_state(d, name));
	return false;
}

static bool set_switch(int d, const char *name, const char *item, indigo_property_state expected, double timeout) {
	unsigned before = revision(d, name);
	indigo_change_switch_property_1(&client, devices[d].name, name, item, true);
	return wait_state(d, name, before, expected, timeout);
}

static bool set_number(int d, const char *name, const char *item, double value, indigo_property_state expected, double timeout) {
	unsigned before = revision(d, name);
	indigo_change_number_property_1(&client, devices[d].name, name, item, value);
	return wait_state(d, name, before, expected, timeout);
}

static bool set_text(int d, const char *name, const char *item, const char *value, indigo_property_state expected, double timeout) {
	unsigned before = revision(d, name);
	indigo_change_text_property_1(&client, devices[d].name, name, item, value);
	return wait_state(d, name, before, expected, timeout);
}

// Right ascension difference in hours, normalized to the shortest way around the circle. The
// offset added before the modulo must be a whole number of days so that a zero difference stays
// zero.
static double ra_difference(double a, double b) {
	double difference = fmod(a - b + 48.0, 24.0);
	if (difference > 12.0) {
		difference -= 24.0;
	}
	return difference;
}

static bool set_coordinates(int d, double ra, double dec, indigo_property_state expected, double timeout) {
	static const char *items[] = { MOUNT_EQUATORIAL_COORDINATES_RA_ITEM_NAME, MOUNT_EQUATORIAL_COORDINATES_DEC_ITEM_NAME };
	double values[] = { ra, dec };
	unsigned before = revision(d, MOUNT_EQUATORIAL_COORDINATES_PROPERTY_NAME);
	indigo_change_number_property(&client, devices[d].name, MOUNT_EQUATORIAL_COORDINATES_PROPERTY_NAME, 2, items, values);
	return wait_state(d, MOUNT_EQUATORIAL_COORDINATES_PROPERTY_NAME, before, expected, timeout);
}


static bool connected(int d) {
	bool value = false;
	return d >= 0 && switch_item(d, CONNECTION_PROPERTY_NAME, CONNECTION_CONNECTED_ITEM_NAME, &value) && value;
}

static bool connect_device(int d) {
	return d >= 0 && set_switch(d, CONNECTION_PROPERTY_NAME, CONNECTION_CONNECTED_ITEM_NAME, INDIGO_OK_STATE, SHORT_TIMEOUT) && connected(d);
}

static bool disconnect_device(int d) {
	return !connected(d) || (set_switch(d, CONNECTION_PROPERTY_NAME, CONNECTION_DISCONNECTED_ITEM_NAME, INDIGO_OK_STATE, SHORT_TIMEOUT) && !connected(d));
}

static bool initialize(void) {
	memset(devices, 0, sizeof(devices));
	memset(&session, 0, sizeof(session));
	bus_started = client_attached = driver_initialized = false;
	event_epoch = 0;
	mount = guider = aux = -1;
	last_message_text[0] = 0;
	client = (indigo_client){ .name = "EQMOD MountSim acceptance", .version = INDIGO_VERSION_CURRENT, .define_property = define_property, .update_property = update_property, .delete_property = delete_property, .send_message = report_message };
	if (!mountsim_attach(&session) || indigo_start() != INDIGO_OK) { return false; }
	bus_started = true;
	if (indigo_attach_client(&client) != INDIGO_OK) { return false; }
	client_attached = true;
	if (indigo_mount_synscan(INDIGO_DRIVER_INIT, NULL) != INDIGO_OK) { return false; }
	driver_initialized = true;
	double deadline = wire_now() + SHORT_TIMEOUT;
	while (wire_now() < deadline) {
		mount = device_index(MOUNT_DEVICE_NAME);
		guider = device_index(GUIDER_DEVICE_NAME);
		aux = device_index(AUX_DEVICE_NAME);
		if (mount >= 0 && guider >= 0 && aux >= 0) {
			return set_text(mount, DEVICE_PORT_PROPERTY_NAME, DEVICE_PORT_ITEM_NAME, session.port, INDIGO_OK_STATE, SHORT_TIMEOUT);
		}
		indigo_usleep(20000);
	}
	return false;
}

static void cleanup_session(void) {
	if (connected(mount)) {
		set_switch(mount, MOUNT_ABORT_MOTION_PROPERTY_NAME, MOUNT_ABORT_MOTION_ITEM_NAME, INDIGO_OK_STATE, SHORT_TIMEOUT);
		set_switch(mount, MOUNT_TRACKING_PROPERTY_NAME, MOUNT_TRACKING_OFF_ITEM_NAME, INDIGO_OK_STATE, SHORT_TIMEOUT);
	}
	if (!disconnect_device(aux)) { indigo_test_failures++; }
	if (!disconnect_device(guider)) { indigo_test_failures++; }
	if (!disconnect_device(mount)) { indigo_test_failures++; }
	if (driver_initialized && indigo_mount_synscan(INDIGO_DRIVER_SHUTDOWN, NULL) != INDIGO_OK) { indigo_test_failures++; }
	driver_initialized = false;
	if (client_attached) { indigo_detach_client(&client); }
	client_attached = false;
	if (bus_started) { indigo_stop(); }
	bus_started = false;
	for (int d = 0; d < MAX_DEVICES; d++) {
		for (int p = 0; p < MAX_PROPERTIES; p++) {
			indigo_release_property(devices[d].properties[p]);
			devices[d].properties[p] = NULL;
		}
	}
}

static bool site_and_unpark(void) {
	const char *items[] = { GEOGRAPHIC_COORDINATES_LATITUDE_ITEM_NAME, GEOGRAPHIC_COORDINATES_LONGITUDE_ITEM_NAME };
	double values[] = { 45.586750, -122.808251 };
	unsigned before = revision(mount, GEOGRAPHIC_COORDINATES_PROPERTY_NAME);
	indigo_change_number_property(&client, MOUNT_DEVICE_NAME, GEOGRAPHIC_COORDINATES_PROPERTY_NAME, 2, items, values);
	return wait_state(mount, GEOGRAPHIC_COORDINATES_PROPERTY_NAME, before, INDIGO_OK_STATE, SHORT_TIMEOUT) && set_switch(mount, MOUNT_PARK_PROPERTY_NAME, MOUNT_PARK_UNPARKED_ITEM_NAME, INDIGO_OK_STATE, SHORT_TIMEOUT);
}

static bool fresh_coordinates(void) {
	unsigned before = revision(mount, MOUNT_EQUATORIAL_COORDINATES_PROPERTY_NAME);
	return wait_state(mount, MOUNT_EQUATORIAL_COORDINATES_PROPERTY_NAME, before, INDIGO_OK_STATE, SHORT_TIMEOUT);
}

static bool arrive(double ra, double dec) {
	if (!set_coordinates(mount, ra, dec, INDIGO_BUSY_STATE, SHORT_TIMEOUT)) { return false; }
	unsigned before = revision(mount, MOUNT_EQUATORIAL_COORDINATES_PROPERTY_NAME);
	double deadline = wire_now() + MOTION_TIMEOUT;
	while (wire_now() < deadline) {
		double actual_ra = NAN, actual_dec = NAN;
		if (revision(mount, MOUNT_EQUATORIAL_COORDINATES_PROPERTY_NAME) > before && property_state(mount, MOUNT_EQUATORIAL_COORDINATES_PROPERTY_NAME) == INDIGO_OK_STATE && number_item(mount, MOUNT_EQUATORIAL_COORDINATES_PROPERTY_NAME, MOUNT_EQUATORIAL_COORDINATES_RA_ITEM_NAME, &actual_ra) && number_item(mount, MOUNT_EQUATORIAL_COORDINATES_PROPERTY_NAME, MOUNT_EQUATORIAL_COORDINATES_DEC_ITEM_NAME, &actual_dec) && fabs(ra_difference(actual_ra, ra)) < .02 && fabs(actual_dec - dec) < .1) { return true; }
		indigo_usleep(20000);
	}
	double actual_ra = NAN, actual_dec = NAN;
	number_item(mount, MOUNT_EQUATORIAL_COORDINATES_PROPERTY_NAME, MOUNT_EQUATORIAL_COORDINATES_RA_ITEM_NAME, &actual_ra);
	number_item(mount, MOUNT_EQUATORIAL_COORDINATES_PROPERTY_NAME, MOUNT_EQUATORIAL_COORDINATES_DEC_ITEM_NAME, &actual_dec);
	fprintf(stderr, "GOTO did not arrive: target RA %.6f DEC %.6f, actual RA %.6f DEC %.6f, state %d\n", ra, dec, actual_ra, actual_dec, property_state(mount, MOUNT_EQUATORIAL_COORDINATES_PROPERTY_NAME));
	return false;
}

static double command_after(const char *wanted, double after, bool prefix);
static bool coordinates(double *ra, double *dec);

static void eqmod_identity_initialization_poll(void) {
	char model[INDIGO_VALUE_SIZE], firmware[INDIGO_VALUE_SIZE];
	double ra, dec;
	CHECK(initialize());
	CHECK(connect_device(mount));
	CHECK(site_and_unpark());
	CHECK(text_item(mount, MOUNT_INFO_PROPERTY_NAME, MOUNT_INFO_MODEL_ITEM_NAME, model, sizeof(model)) && !strcmp(model, "EQ6"));
	CHECK(text_item(mount, MOUNT_INFO_PROPERTY_NAME, MOUNT_INFO_FIRMWARE_ITEM_NAME, firmware, sizeof(firmware)) && !strcmp(firmware, "0.00"));
	CHECK(fresh_coordinates());
	CHECK(number_item(mount, MOUNT_EQUATORIAL_COORDINATES_PROPERTY_NAME, MOUNT_EQUATORIAL_COORDINATES_RA_ITEM_NAME, &ra) && isfinite(ra));
	CHECK(number_item(mount, MOUNT_EQUATORIAL_COORDINATES_PROPERTY_NAME, MOUNT_EQUATORIAL_COORDINATES_DEC_ITEM_NAME, &dec) && isfinite(dec));
	CHECK(disconnect_device(mount));
	CHECK(!property_defined(mount, MOUNT_EQUATORIAL_COORDINATES_PROPERTY_NAME));
	CHECK(connect_device(mount));
	CHECK(fresh_coordinates());
cleanup:
	cleanup_session();
}

static void eqmod_shared_lifetimes(void) {
	CHECK(initialize());
	CHECK(connect_device(guider));
	CHECK(set_number(guider, GUIDER_GUIDE_DEC_PROPERTY_NAME, GUIDER_GUIDE_NORTH_ITEM_NAME, 100, INDIGO_BUSY_STATE, SHORT_TIMEOUT));
	CHECK(wait_settled(guider, GUIDER_GUIDE_DEC_PROPERTY_NAME, INDIGO_OK_STATE, SHORT_TIMEOUT));
	CHECK(connect_device(mount));
	CHECK(fresh_coordinates());
	CHECK(set_switch(aux, CONNECTION_PROPERTY_NAME, CONNECTION_CONNECTED_ITEM_NAME, INDIGO_ALERT_STATE, SHORT_TIMEOUT));
	CHECK(!connected(aux));
	CHECK(fresh_coordinates());
	CHECK(disconnect_device(mount));
	CHECK(set_number(guider, GUIDER_GUIDE_DEC_PROPERTY_NAME, GUIDER_GUIDE_SOUTH_ITEM_NAME, 100, INDIGO_BUSY_STATE, SHORT_TIMEOUT));
	CHECK(wait_settled(guider, GUIDER_GUIDE_DEC_PROPERTY_NAME, INDIGO_OK_STATE, SHORT_TIMEOUT));
	CHECK(disconnect_device(guider));
	CHECK(connect_device(mount));
	CHECK(connect_device(guider));
	CHECK(disconnect_device(guider));
	CHECK(fresh_coordinates());
cleanup:
	cleanup_session();
}

static void eqmod_sync_goto_convergence(void) {
	time_t now = time(NULL);
	double ra = fmod(indigo_lst(&now, -122.808251) + 23, 24);
	double reached_ra, reached_dec;
	bool tracking;
	CHECK(initialize());
	CHECK(connect_device(mount));
	CHECK(site_and_unpark());
	CHECK(set_switch(mount, MOUNT_ON_COORDINATES_SET_PROPERTY_NAME, MOUNT_ON_COORDINATES_SET_SYNC_ITEM_NAME, INDIGO_OK_STATE, SHORT_TIMEOUT));
	CHECK(set_coordinates(mount, ra, 40, INDIGO_OK_STATE, SHORT_TIMEOUT));
	CHECK(set_switch(mount, MOUNT_ON_COORDINATES_SET_PROPERTY_NAME, MOUNT_ON_COORDINATES_SET_TRACK_ITEM_NAME, INDIGO_OK_STATE, SHORT_TIMEOUT));
	CHECK(arrive(ra + .02, 40.1));
	CHECK(set_switch(mount, MOUNT_ON_COORDINATES_SET_PROPERTY_NAME, MOUNT_ON_COORDINATES_SET_SYNC_ITEM_NAME, INDIGO_OK_STATE, SHORT_TIMEOUT));
	double sync_after = wire_now();
	double sync_ra = fmod(ra + .01, 24);
	CHECK(set_coordinates(mount, sync_ra, 40.05, INDIGO_OK_STATE, SHORT_TIMEOUT));
	CHECK(fresh_coordinates() && coordinates(&reached_ra, &reached_dec));
	CHECK(fabs(ra_difference(reached_ra, sync_ra)) < .02 && fabs(reached_dec - 40.05) < .1);
	CHECK(command_after(":J1", sync_after, false) == 0 && command_after(":J2", sync_after, false) == 0);
	CHECK(set_switch(mount, MOUNT_ON_COORDINATES_SET_PROPERTY_NAME, MOUNT_ON_COORDINATES_SET_TRACK_ITEM_NAME, INDIGO_OK_STATE, SHORT_TIMEOUT));
	CHECK(arrive(ra + .03, 40.2));
	CHECK(switch_item(mount, MOUNT_TRACKING_PROPERTY_NAME, MOUNT_TRACKING_ON_ITEM_NAME, &tracking) && tracking);
	CHECK(coordinates(&reached_ra, &reached_dec));
	CHECK(set_coordinates(mount, reached_ra, reached_dec, INDIGO_BUSY_STATE, SHORT_TIMEOUT));
	CHECK(wait_settled(mount, MOUNT_EQUATORIAL_COORDINATES_PROPERTY_NAME, INDIGO_OK_STATE, MOTION_TIMEOUT));
	CHECK(set_switch(mount, MOUNT_ON_COORDINATES_SET_PROPERTY_NAME, MOUNT_ON_COORDINATES_SET_SLEW_ITEM_NAME, INDIGO_OK_STATE, SHORT_TIMEOUT));
	CHECK(arrive(ra + .05, 40.4));
	CHECK(switch_item(mount, MOUNT_TRACKING_PROPERTY_NAME, MOUNT_TRACKING_ON_ITEM_NAME, &tracking) && !tracking);
cleanup:
	cleanup_session();
}

// Read complete TX frames only; launcher strips CR from trace, not transport.
static double command_after(const char *wanted, double after, bool prefix) {
	char path[PATH_MAX], line[2048];
	if (!mountsim_trace_path(path, sizeof(path))) { return 0; }
	FILE *file = fopen(path, "r");
	if (!file) { return 0; }
	double found = 0;
	while (fgets(line, sizeof(line), file)) {
		char *cursor, *end, command[256];
		double timestamp = strtod(line, &cursor);
		int count = 0;
		while (count < 255) {
			unsigned long byte = strtoul(cursor, &end, 16);
			if (end == cursor) { break; }
			command[count++] = byte;
			cursor = end;
		}
		command[count] = 0;
		if (timestamp > after && (prefix ? !strncmp(command, wanted, strlen(wanted)) : !strcmp(command, wanted))) { found = timestamp; break; }
	}
	fclose(file);
	return found;
}

static bool wait_command_after(const char *wanted, double after) {
	double deadline = wire_now() + SHORT_TIMEOUT;
	while (wire_now() < deadline) {
		if (command_after(wanted, after, false) > 0) { return true; }
		indigo_usleep(1000);
	}
	fprintf(stderr, "No forwarded command %s after %.9f\n", wanted, after);
	return false;
}

// EQ6 constants come from EQMotor.m's 9024000 steps/revolution and EQMod.m's
// 64935 Hz controller. The driver uses the same period formula for both axes.
static void period_command(char *command, size_t size, int axis, double arcseconds_per_second) {
	const double sidereal = 360.0 * 3600.0 / 86164.090530833;
	if (fabs(arcseconds_per_second) > 128 * sidereal) {
		arcseconds_per_second /= 16;
	}
	long period = lrint(64935.0 / (fabs(arcseconds_per_second) * 9024000.0 / (360.0 * 3600.0)));
	if (period > 0 && period < 6) { period = 6; }
	snprintf(command, size, ":I%d%02lX%02lX%02lX", axis, period & 0xff, (period >> 8) & 0xff, (period >> 16) & 0xff);
}

static bool switch_value_request(int d, const char *property, const char *item, bool value) {
	unsigned before = revision(d, property);
	indigo_change_switch_property_1(&client, devices[d].name, property, item, value);
	return wait_state(d, property, before, INDIGO_OK_STATE, SHORT_TIMEOUT);
}

static bool coordinates(double *ra, double *dec) {
	return number_item(mount, MOUNT_EQUATORIAL_COORDINATES_PROPERTY_NAME, MOUNT_EQUATORIAL_COORDINATES_RA_ITEM_NAME, ra) && number_item(mount, MOUNT_EQUATORIAL_COORDINATES_PROPERTY_NAME, MOUNT_EQUATORIAL_COORDINATES_DEC_ITEM_NAME, dec);
}

static bool coordinate_targets(double *ra, double *dec) {
	return number_target(mount, MOUNT_EQUATORIAL_COORDINATES_PROPERTY_NAME, MOUNT_EQUATORIAL_COORDINATES_RA_ITEM_NAME, ra) && number_target(mount, MOUNT_EQUATORIAL_COORDINATES_PROPERTY_NAME, MOUNT_EQUATORIAL_COORDINATES_DEC_ITEM_NAME, dec);
}

static bool fresh_coordinates(void);

static bool at_saved_position(double ha, double dec) {
	double lst, ra, actual_dec;
	return fresh_coordinates() && number_item(mount, MOUNT_LST_TIME_PROPERTY_NAME, MOUNT_LST_TIME_ITEM_NAME, &lst) && coordinates(&ra, &actual_dec) && fabs(ra_difference(ra, lst - ha)) < .04 && fabs(actual_dec - dec) < .1;
}

static bool setup_pointing(double *ra) {
	time_t now = time(NULL);
	*ra = fmod(indigo_lst(&now, -122.808251) + 23, 24);
	return initialize() && connect_device(mount) && site_and_unpark() && set_switch(mount, MOUNT_ON_COORDINATES_SET_PROPERTY_NAME, MOUNT_ON_COORDINATES_SET_SYNC_ITEM_NAME, INDIGO_OK_STATE, SHORT_TIMEOUT) && set_coordinates(mount, *ra, 40, INDIGO_OK_STATE, SHORT_TIMEOUT) && set_switch(mount, MOUNT_ON_COORDINATES_SET_PROPERTY_NAME, MOUNT_ON_COORDINATES_SET_TRACK_ITEM_NAME, INDIGO_OK_STATE, SHORT_TIMEOUT);
}

static bool moved(bool use_ra, double reference, double minimum, double timeout) {
	double deadline = wire_now() + timeout;
	unsigned before = revision(mount, MOUNT_EQUATORIAL_COORDINATES_PROPERTY_NAME);
	while (wire_now() < deadline) {
		double ra, dec;
		if (revision(mount, MOUNT_EQUATORIAL_COORDINATES_PROPERTY_NAME) > before && coordinates(&ra, &dec) && fabs(use_ra ? ra_difference(ra, reference) * 15 : dec - reference) >= minimum) { return true; }
		indigo_usleep(20000);
	}
	return false;
}

static void eqmod_busy_abort_recovery(void) {
	double ra;
	double accepted_ra, accepted_dec;
	bool tracking;
	CHECK(setup_pointing(&ra));
	CHECK(set_switch(mount, MOUNT_TRACKING_PROPERTY_NAME, MOUNT_TRACKING_ON_ITEM_NAME, INDIGO_OK_STATE, SHORT_TIMEOUT));
	double started_after = wire_now();
	CHECK(set_coordinates(mount, ra + .2, 65, INDIGO_BUSY_STATE, SHORT_TIMEOUT));
	CHECK(wait_command_after(":J2", started_after));
	CHECK(coordinate_targets(&accepted_ra, &accepted_dec));
	fprintf(stderr, "BUSY accepted targets RA %.6f DEC %.6f, requested RA %.6f DEC 65\n", accepted_ra, accepted_dec, ra + .2);
	CHECK(fabs(ra_difference(accepted_ra, ra + .2)) < .0001 && fabs(accepted_dec - 65) < .0001);
	unsigned before = revision(mount, MOUNT_EQUATORIAL_COORDINATES_PROPERTY_NAME);
	// A second request must not replace the accepted target. Its BUSY refusal may be only a message.
	const char *items[] = { MOUNT_EQUATORIAL_COORDINATES_RA_ITEM_NAME, MOUNT_EQUATORIAL_COORDINATES_DEC_ITEM_NAME };
	double values[] = { ra + .4, 20 };
	indigo_change_number_property(&client, MOUNT_DEVICE_NAME, MOUNT_EQUATORIAL_COORDINATES_PROPERTY_NAME, 2, items, values);
	CHECK(coordinate_targets(&accepted_ra, &accepted_dec));
	fprintf(stderr, "BUSY after second request RA %.6f DEC %.6f, state %d\n", accepted_ra, accepted_dec, property_state(mount, MOUNT_EQUATORIAL_COORDINATES_PROPERTY_NAME));
	CHECK(fabs(ra_difference(accepted_ra, ra + .2)) < .0001 && fabs(accepted_dec - 65) < .0001);
	CHECK(set_switch(mount, MOUNT_ABORT_MOTION_PROPERTY_NAME, MOUNT_ABORT_MOTION_ITEM_NAME, INDIGO_OK_STATE, SHORT_TIMEOUT));
	CHECK(wait_state(mount, MOUNT_EQUATORIAL_COORDINATES_PROPERTY_NAME, before, INDIGO_ALERT_STATE, SHORT_TIMEOUT));
	CHECK(switch_item(mount, MOUNT_TRACKING_PROPERTY_NAME, MOUNT_TRACKING_ON_ITEM_NAME, &tracking) && !tracking);
	CHECK(fresh_coordinates());
	CHECK(arrive(ra, 40));
cleanup:
	cleanup_session();
}

static void eqmod_manual_axes_rates(void) {
	double ra, start_ra, start_dec;
	const double sidereal = 360.0 * 3600.0 / 86164.090530833;
	const double ra_factors[] = { 2, 32, 100, 825 };
	const double dec_factors[] = { 1, 32, 100, 825 };
	const char *rates[] = { MOUNT_SLEW_RATE_GUIDE_ITEM_NAME, MOUNT_SLEW_RATE_CENTERING_ITEM_NAME, MOUNT_SLEW_RATE_FIND_ITEM_NAME, MOUNT_SLEW_RATE_MAX_ITEM_NAME };
	const char *properties[] = { MOUNT_MOTION_RA_PROPERTY_NAME, MOUNT_MOTION_RA_PROPERTY_NAME, MOUNT_MOTION_DEC_PROPERTY_NAME, MOUNT_MOTION_DEC_PROPERTY_NAME };
	const char *directions[] = { MOUNT_MOTION_WEST_ITEM_NAME, MOUNT_MOTION_EAST_ITEM_NAME, MOUNT_MOTION_NORTH_ITEM_NAME, MOUNT_MOTION_SOUTH_ITEM_NAME };
	CHECK(setup_pointing(&ra));
	CHECK(set_switch(mount, MOUNT_TRACKING_PROPERTY_NAME, MOUNT_TRACKING_OFF_ITEM_NAME, INDIGO_OK_STATE, SHORT_TIMEOUT));
	for (int rate = 0; rate < ARRAY_SIZE(rates); rate++) {
		CHECK(set_switch(mount, MOUNT_SLEW_RATE_PROPERTY_NAME, rates[rate], INDIGO_OK_STATE, SHORT_TIMEOUT));
		for (int direction = 0; direction < 4; direction++) {
			int axis = direction < 2 ? 1 : 2;
			int reverse = direction == 1 || direction == 2;
			char mode_command[16], expected_period[16], start_command[8], stop_command[8];
			snprintf(mode_command, sizeof(mode_command), ":G%d%d%d", axis, rate == 3 ? 3 : 1, reverse);
			snprintf(start_command, sizeof(start_command), ":J%d", axis);
			snprintf(stop_command, sizeof(stop_command), ":K%d", axis);
			period_command(expected_period, sizeof(expected_period), axis, (direction < 2 ? ra_factors[rate] : dec_factors[rate]) * sidereal);
			CHECK(fresh_coordinates() && coordinates(&start_ra, &start_dec));
			double stamp = wire_now();
			CHECK(set_switch(mount, properties[direction], directions[direction], INDIGO_OK_STATE, SHORT_TIMEOUT));
			CHECK(command_after(mode_command, stamp, false) > 0);
			CHECK(command_after(expected_period, stamp, false) > 0);
			CHECK(command_after(start_command, stamp, false) > 0);
			CHECK(moved(direction < 2, direction < 2 ? start_ra : start_dec, .001, 6));
			CHECK(switch_value_request(mount, properties[direction], directions[direction], false));
			CHECK(command_after(stop_command, stamp, false) > 0);
		}
	}
	CHECK(set_switch(mount, MOUNT_SLEW_RATE_PROPERTY_NAME, MOUNT_SLEW_RATE_FIND_ITEM_NAME, INDIGO_OK_STATE, SHORT_TIMEOUT));
	CHECK(set_switch(mount, MOUNT_MOTION_RA_PROPERTY_NAME, MOUNT_MOTION_WEST_ITEM_NAME, INDIGO_OK_STATE, SHORT_TIMEOUT));
	CHECK(set_switch(mount, MOUNT_MOTION_DEC_PROPERTY_NAME, MOUNT_MOTION_NORTH_ITEM_NAME, INDIGO_OK_STATE, SHORT_TIMEOUT));
	CHECK(switch_value_request(mount, MOUNT_MOTION_RA_PROPERTY_NAME, MOUNT_MOTION_WEST_ITEM_NAME, false));
	CHECK(fresh_coordinates() && coordinates(&start_ra, &start_dec));
	CHECK(moved(false, start_dec, .005, 6));
	CHECK(set_switch(mount, MOUNT_MOTION_DEC_PROPERTY_NAME, MOUNT_MOTION_SOUTH_ITEM_NAME, INDIGO_OK_STATE, SHORT_TIMEOUT));
	CHECK(set_switch(mount, MOUNT_ABORT_MOTION_PROPERTY_NAME, MOUNT_ABORT_MOTION_ITEM_NAME, INDIGO_OK_STATE, SHORT_TIMEOUT));
cleanup:
	cleanup_session();
}

static void eqmod_tracking_rates(void) {
	const double arcseconds[] = { 15.0, 14.511415, 360.0 * 3600.0 / 86164.090530833 };
	const char *rates[] = { MOUNT_TRACK_RATE_SOLAR_ITEM_NAME, MOUNT_TRACK_RATE_LUNAR_ITEM_NAME, MOUNT_TRACK_RATE_SIDEREAL_ITEM_NAME };
	CHECK(initialize() && connect_device(mount) && site_and_unpark());
	CHECK(set_switch(mount, MOUNT_TRACKING_PROPERTY_NAME, MOUNT_TRACKING_ON_ITEM_NAME, INDIGO_OK_STATE, SHORT_TIMEOUT));
	for (int i = 0; i < ARRAY_SIZE(rates); i++) {
		double stamp = wire_now();
		char period[16];
		period_command(period, sizeof(period), 1, arcseconds[i]);
		CHECK(set_switch(mount, MOUNT_TRACK_RATE_PROPERTY_NAME, rates[i], INDIGO_OK_STATE, SHORT_TIMEOUT));
		CHECK(command_after(period, stamp, false) > 0);
		CHECK(command_after(":J1", stamp, false) > 0);
		CHECK(fresh_coordinates());
	}
	CHECK(set_switch(mount, MOUNT_TRACKING_PROPERTY_NAME, MOUNT_TRACKING_OFF_ITEM_NAME, INDIGO_OK_STATE, SHORT_TIMEOUT));
	// Independent protocol expectations, intentionally able to reproduce percent-to-P conversion errors.
	const double percentages[] = { 100, 75, 50, 25, 12.5 };
	for (int i = 0; i < ARRAY_SIZE(percentages); i++) {
		double stamp = wire_now();
		char command[16];
		CHECK(set_number(mount, MOUNT_GUIDE_RATE_PROPERTY_NAME, MOUNT_GUIDE_RATE_RA_ITEM_NAME, percentages[i], INDIGO_OK_STATE, SHORT_TIMEOUT));
		snprintf(command, sizeof(command), ":P1%d", i);
		CHECK(command_after(command, stamp, false) > 0);
	}
cleanup:
	cleanup_session();
}

static void eqmod_park_home(void) {
	double ra, reached_ra, reached_dec;
	double park_ha, park_dec, home_ha, home_dec, refused_ra, refused_dec;
	bool value;
	CHECK(setup_pointing(&ra));
	CHECK(set_switch(mount, MOUNT_PARK_SET_PROPERTY_NAME, MOUNT_PARK_SET_CURRENT_ITEM_NAME, INDIGO_OK_STATE, SHORT_TIMEOUT));
	CHECK(set_switch(mount, MOUNT_HOME_SET_PROPERTY_NAME, MOUNT_HOME_SET_CURRENT_ITEM_NAME, INDIGO_OK_STATE, SHORT_TIMEOUT));
	CHECK(number_item(mount, MOUNT_PARK_POSITION_PROPERTY_NAME, MOUNT_PARK_POSITION_HA_ITEM_NAME, &park_ha));
	CHECK(number_item(mount, MOUNT_PARK_POSITION_PROPERTY_NAME, MOUNT_PARK_POSITION_DEC_ITEM_NAME, &park_dec));
	CHECK(number_item(mount, MOUNT_HOME_POSITION_PROPERTY_NAME, MOUNT_HOME_POSITION_HA_ITEM_NAME, &home_ha));
	CHECK(number_item(mount, MOUNT_HOME_POSITION_PROPERTY_NAME, MOUNT_HOME_POSITION_DEC_ITEM_NAME, &home_dec));
	CHECK(arrive(ra + .05, 41));
	CHECK(set_switch(mount, MOUNT_PARK_PROPERTY_NAME, MOUNT_PARK_PARKED_ITEM_NAME, INDIGO_OK_STATE, MOTION_TIMEOUT));
	CHECK(switch_item(mount, MOUNT_PARK_PROPERTY_NAME, MOUNT_PARK_PARKED_ITEM_NAME, &value) && value);
	CHECK(coordinates(&reached_ra, &reached_dec) && fabs(reached_dec - 40) < .1);
	CHECK(at_saved_position(park_ha, park_dec));
	CHECK(switch_item(mount, MOUNT_TRACKING_PROPERTY_NAME, MOUNT_TRACKING_ON_ITEM_NAME, &value) && !value);
	CHECK(set_switch(mount, MOUNT_TRACKING_PROPERTY_NAME, MOUNT_TRACKING_ON_ITEM_NAME, INDIGO_ALERT_STATE, SHORT_TIMEOUT));
	CHECK(switch_item(mount, MOUNT_TRACKING_PROPERTY_NAME, MOUNT_TRACKING_ON_ITEM_NAME, &value) && !value);
	CHECK(set_switch(mount, MOUNT_MOTION_RA_PROPERTY_NAME, MOUNT_MOTION_WEST_ITEM_NAME, INDIGO_ALERT_STATE, SHORT_TIMEOUT));
	CHECK(set_switch(mount, MOUNT_MOTION_DEC_PROPERTY_NAME, MOUNT_MOTION_NORTH_ITEM_NAME, INDIGO_ALERT_STATE, SHORT_TIMEOUT));
	CHECK(coordinate_targets(&refused_ra, &refused_dec));
	CHECK(set_coordinates(mount, ra, 41, INDIGO_ALERT_STATE, SHORT_TIMEOUT));
	CHECK(coordinate_targets(&reached_ra, &reached_dec) && fabs(ra_difference(reached_ra, refused_ra)) < .0001 && fabs(reached_dec - refused_dec) < .0001);
	CHECK(disconnect_device(mount) && connect_device(mount));
	CHECK(number_item(mount, MOUNT_PARK_POSITION_PROPERTY_NAME, MOUNT_PARK_POSITION_HA_ITEM_NAME, &reached_ra) && fabs(reached_ra - park_ha) < .0001);
	CHECK(number_item(mount, MOUNT_PARK_POSITION_PROPERTY_NAME, MOUNT_PARK_POSITION_DEC_ITEM_NAME, &reached_dec) && fabs(reached_dec - park_dec) < .0001);
	CHECK(at_saved_position(park_ha, park_dec));
	CHECK(set_switch(mount, MOUNT_PARK_PROPERTY_NAME, MOUNT_PARK_UNPARKED_ITEM_NAME, INDIGO_OK_STATE, SHORT_TIMEOUT));
	CHECK(arrive(ra + .05, 41));
	CHECK(set_switch(mount, MOUNT_HOME_PROPERTY_NAME, MOUNT_HOME_ITEM_NAME, INDIGO_OK_STATE, MOTION_TIMEOUT));
	CHECK(coordinates(&reached_ra, &reached_dec) && fabs(reached_dec - 40) < .1);
	CHECK(at_saved_position(home_ha, home_dec));
	CHECK(switch_item(mount, MOUNT_TRACKING_PROPERTY_NAME, MOUNT_TRACKING_ON_ITEM_NAME, &value) && !value);
cleanup:
	cleanup_session();
}

static void eqmod_park_home_interruption(void) {
	double ra;
	const char *properties[] = { MOUNT_PARK_PROPERTY_NAME, MOUNT_HOME_PROPERTY_NAME };
	const char *items[] = { MOUNT_PARK_PARKED_ITEM_NAME, MOUNT_HOME_ITEM_NAME };
	CHECK(setup_pointing(&ra));
	CHECK(set_number(mount, MOUNT_PARK_POSITION_PROPERTY_NAME, MOUNT_PARK_POSITION_DEC_ITEM_NAME, 70, INDIGO_OK_STATE, SHORT_TIMEOUT));
	CHECK(set_number(mount, MOUNT_HOME_POSITION_PROPERTY_NAME, MOUNT_HOME_POSITION_DEC_ITEM_NAME, 70, INDIGO_OK_STATE, SHORT_TIMEOUT));
	for (int i = 0; i < 2; i++) {
		unsigned before = revision(mount, properties[i]);
		double started_after = wire_now();
		CHECK(set_switch(mount, properties[i], items[i], INDIGO_BUSY_STATE, SHORT_TIMEOUT));
		CHECK(wait_command_after(":J2", started_after));
		CHECK(set_switch(mount, MOUNT_ABORT_MOTION_PROPERTY_NAME, MOUNT_ABORT_MOTION_ITEM_NAME, INDIGO_OK_STATE, SHORT_TIMEOUT));
		CHECK(wait_state(mount, properties[i], before, INDIGO_ALERT_STATE, SHORT_TIMEOUT));
		CHECK(site_and_unpark() && arrive(ra, 40));
		started_after = wire_now();
		CHECK(set_switch(mount, properties[i], items[i], INDIGO_BUSY_STATE, SHORT_TIMEOUT));
		CHECK(wait_command_after(":J2", started_after));
		CHECK(disconnect_device(mount));
		CHECK(connect_device(mount) && site_and_unpark() && fresh_coordinates());
		CHECK(arrive(ra, 40));
	}
cleanup:
	cleanup_session();
}

static bool pulse(const char *property, const char *item, double duration) {
	unsigned before = revision(guider, property);
	if (!set_number(guider, property, item, duration, INDIGO_BUSY_STATE, SHORT_TIMEOUT) || !wait_state(guider, property, before, INDIGO_OK_STATE, SHORT_TIMEOUT)) { return false; }
	double value;
	return number_item(guider, property, item, &value) && value == 0;
}

static void eqmod_guider_functional(void) {
	double ra;
	const char *properties[] = { GUIDER_GUIDE_RA_PROPERTY_NAME, GUIDER_GUIDE_RA_PROPERTY_NAME, GUIDER_GUIDE_DEC_PROPERTY_NAME, GUIDER_GUIDE_DEC_PROPERTY_NAME };
	const char *items[] = { GUIDER_GUIDE_EAST_ITEM_NAME, GUIDER_GUIDE_WEST_ITEM_NAME, GUIDER_GUIDE_NORTH_ITEM_NAME, GUIDER_GUIDE_SOUTH_ITEM_NAME };
	const char *modes[] = { ":G110", ":G110", ":G211", ":G210" };
	const char *ra_periods[] = { ":I1D80400", ":I19D0100" };
	CHECK(setup_pointing(&ra));
	CHECK(connect_device(guider));
	CHECK(set_switch(mount, MOUNT_TRACKING_PROPERTY_NAME, MOUNT_TRACKING_ON_ITEM_NAME, INDIGO_OK_STATE, SHORT_TIMEOUT));
	for (int i = 0; i < 4; i++) {
		char start[8], stop[8];
		int axis = i < 2 ? 1 : 2;
		snprintf(start, sizeof(start), ":J%d", axis);
		snprintf(stop, sizeof(stop), ":K%d", axis);
		double since = wire_now();
		CHECK(pulse(properties[i], items[i], 500));
		CHECK(command_after(modes[i], since, false) > 0);
		if (i < 2) { CHECK(command_after(ra_periods[i], since, false) > 0); }
		CHECK(command_after(start, since, false) > 0);
		CHECK(command_after(stop, since, false) > 0);
	}
	CHECK(set_number(guider, GUIDER_GUIDE_RA_PROPERTY_NAME, GUIDER_GUIDE_EAST_ITEM_NAME, 0, INDIGO_OK_STATE, SHORT_TIMEOUT));
	CHECK(set_number(guider, GUIDER_GUIDE_DEC_PROPERTY_NAME, GUIDER_GUIDE_NORTH_ITEM_NAME, 0, INDIGO_OK_STATE, SHORT_TIMEOUT));
	double replacement_after = wire_now();
	CHECK(set_number(guider, GUIDER_GUIDE_DEC_PROPERTY_NAME, GUIDER_GUIDE_NORTH_ITEM_NAME, 500, INDIGO_BUSY_STATE, SHORT_TIMEOUT));
	CHECK(wait_command_after(":J2", replacement_after));
	CHECK(property_state(guider, GUIDER_GUIDE_DEC_PROPERTY_NAME) == INDIGO_BUSY_STATE);
	CHECK(pulse(GUIDER_GUIDE_DEC_PROPERTY_NAME, GUIDER_GUIDE_SOUTH_ITEM_NAME, 100));
	CHECK(command_after(":G210", replacement_after, false) > 0);
	unsigned ra_before = revision(guider, GUIDER_GUIDE_RA_PROPERTY_NAME);
	double overlap_after = wire_now();
	CHECK(set_number(guider, GUIDER_GUIDE_RA_PROPERTY_NAME, GUIDER_GUIDE_EAST_ITEM_NAME, 500, INDIGO_BUSY_STATE, SHORT_TIMEOUT));
	CHECK(wait_command_after(":J1", overlap_after));
	CHECK(property_state(guider, GUIDER_GUIDE_RA_PROPERTY_NAME) == INDIGO_BUSY_STATE);
	CHECK(pulse(GUIDER_GUIDE_DEC_PROPERTY_NAME, GUIDER_GUIDE_NORTH_ITEM_NAME, 100));
	CHECK(command_after(":G211", overlap_after, false) > 0);
	CHECK(wait_state(guider, GUIDER_GUIDE_RA_PROPERTY_NAME, ra_before, INDIGO_OK_STATE, SHORT_TIMEOUT));
	double disconnect_after = wire_now();
	CHECK(set_number(guider, GUIDER_GUIDE_DEC_PROPERTY_NAME, GUIDER_GUIDE_NORTH_ITEM_NAME, 2000, INDIGO_BUSY_STATE, SHORT_TIMEOUT));
	CHECK(wait_command_after(":J2", disconnect_after));
	CHECK(disconnect_device(guider));
	CHECK(fresh_coordinates());
	CHECK(connect_device(guider));
	CHECK(pulse(GUIDER_GUIDE_DEC_PROPERTY_NAME, GUIDER_GUIDE_SOUTH_ITEM_NAME, 100));
cleanup:
	cleanup_session();
}

static void transport_loss(int activity) {
	double ra;
	CHECK(setup_pointing(&ra));
	CHECK(fresh_coordinates());
	double started_after = wire_now();
	if (activity == 1) {
		CHECK(set_coordinates(mount, ra + .2, 65, INDIGO_BUSY_STATE, SHORT_TIMEOUT));
		CHECK(wait_command_after(":J2", started_after));
	}
	if (activity == 2) {
		CHECK(connect_device(guider));
		CHECK(set_number(guider, GUIDER_GUIDE_DEC_PROPERTY_NAME, GUIDER_GUIDE_NORTH_ITEM_NAME, 2000, INDIGO_BUSY_STATE, SHORT_TIMEOUT));
		CHECK(wait_command_after(":J2", started_after));
	}
	unsigned before = revision(mount, MOUNT_EQUATORIAL_COORDINATES_PROPERTY_NAME);
	unsigned guider_before = activity == 2 ? revision(guider, GUIDER_GUIDE_DEC_PROPERTY_NAME) : 0;
	CHECK(mountsim_transport(&session, false));
	double lost_deadline = wire_now() + SHORT_TIMEOUT;
	while (wire_now() < lost_deadline && (connected(mount) || property_defined(mount, MOUNT_EQUATORIAL_COORDINATES_PROPERTY_NAME))) { indigo_usleep(20000); }
	CHECK(!connected(mount) && !property_defined(mount, MOUNT_EQUATORIAL_COORDINATES_PROPERTY_NAME));
	if (activity == 1) { CHECK(wait_state(mount, MOUNT_EQUATORIAL_COORDINATES_PROPERTY_NAME, before, INDIGO_ALERT_STATE, SHORT_TIMEOUT)); }
	if (activity == 2) {
		CHECK(wait_state(guider, GUIDER_GUIDE_DEC_PROPERTY_NAME, guider_before, INDIGO_ALERT_STATE, SHORT_TIMEOUT));
	}
	CHECK(disconnect_device(guider));
	CHECK(disconnect_device(mount));
	CHECK(mountsim_transport(&session, true));
	CHECK(set_text(mount, DEVICE_PORT_PROPERTY_NAME, DEVICE_PORT_ITEM_NAME, session.port, INDIGO_OK_STATE, SHORT_TIMEOUT));
	CHECK(connect_device(mount) && site_and_unpark());
	CHECK(set_switch(mount, MOUNT_ABORT_MOTION_PROPERTY_NAME, MOUNT_ABORT_MOTION_ITEM_NAME, INDIGO_OK_STATE, SHORT_TIMEOUT));
	CHECK(fresh_coordinates() && arrive(ra, 40));
	if (activity == 2) {
		CHECK(connect_device(guider));
		CHECK(pulse(GUIDER_GUIDE_DEC_PROPERTY_NAME, GUIDER_GUIDE_SOUTH_ITEM_NAME, 100));
	}
cleanup:
	cleanup_session();
}

static void eqmod_transport_idle(void) { transport_loss(0); }

static void eqmod_transport_motion(void) { transport_loss(1); }

static void eqmod_transport_pulse(void) { transport_loss(2); }

static void statistics(const char *name, double *values, int count) {
	double sum = 0, square = 0, maximum_absolute = 0;
	for (int i = 0; i < count; i++) {
		sum += values[i];
		square += values[i] * values[i];
		maximum_absolute = fmax(maximum_absolute, fabs(values[i]));
	}
	for (int i = 0; i < count; i++) {
		for (int j = i + 1; j < count; j++) {
			if (values[j] < values[i]) { double temporary = values[i]; values[i] = values[j]; values[j] = temporary; }
		}
	}
	double median = count % 2 ? values[count / 2] : (values[count / 2 - 1] + values[count / 2]) / 2;
	printf("TIMING %s n=%d min=%.6f mean=%.6f median=%.6f p95=%.6f p99=%.6f max=%.6f stddev=%.6f max_abs=%.6f\n", name, count, values[0], sum / count, median, values[(int)ceil(.95 * count) - 1], values[(int)ceil(.99 * count) - 1], values[count - 1], sqrt(fmax(0, square / count - sum * sum / count / count)), maximum_absolute);
}

static void eqmod_guider_timing_mode(int workload) {
	double ra;
	const char *properties[] = { GUIDER_GUIDE_RA_PROPERTY_NAME, GUIDER_GUIDE_RA_PROPERTY_NAME, GUIDER_GUIDE_DEC_PROPERTY_NAME, GUIDER_GUIDE_DEC_PROPERTY_NAME };
	const char *items[] = { GUIDER_GUIDE_EAST_ITEM_NAME, GUIDER_GUIDE_WEST_ITEM_NAME, GUIDER_GUIDE_NORTH_ITEM_NAME, GUIDER_GUIDE_SOUTH_ITEM_NAME };
	const int durations[] = { 20, 100, 500 };
	CHECK(setup_pointing(&ra));
	CHECK(connect_device(guider));
	CHECK(set_switch(mount, MOUNT_TRACKING_PROPERTY_NAME, MOUNT_TRACKING_ON_ITEM_NAME, INDIGO_OK_STATE, SHORT_TIMEOUT));
		for (int direction = 0; direction < 4; direction++) {
			double errors[9], percentages[9], restoration[9];
			for (int sample = -1; sample < 9; sample++) {
				int duration = sample < 0 ? 100 : durations[sample % 3];
				const char *other_property = direction < 2 ? GUIDER_GUIDE_DEC_PROPERTY_NAME : GUIDER_GUIDE_RA_PROPERTY_NAME;
				const char *other_item = direction < 2 ? GUIDER_GUIDE_NORTH_ITEM_NAME : GUIDER_GUIDE_EAST_ITEM_NAME;
				unsigned other_before = revision(guider, other_property);
				if (workload) {
					double other_started_after = wire_now();
					CHECK(set_number(guider, other_property, other_item, 1000, INDIGO_BUSY_STATE, SHORT_TIMEOUT));
					CHECK(wait_command_after(direction < 2 ? ":J2" : ":J1", other_started_after));
				}
				double before = wire_now();
				CHECK(pulse(properties[direction], items[direction], duration));
				double started = command_after(direction < 2 ? ":J1" : ":J2", before, false);
				double stopped = command_after(direction < 2 ? ":K1" : ":K2", started, false);
				CHECK(started > before && stopped >= started && stopped - started < SHORT_TIMEOUT);
				double restored = direction < 2 ? command_after(":J1", stopped, false) : stopped;
				CHECK(restored >= stopped);
				if (sample >= 0) {
					errors[sample] = (stopped - started) * 1000 - duration;
					percentages[sample] = errors[sample] * 100 / duration;
					restoration[sample] = (restored - stopped) * 1000;
					CHECK(isfinite(errors[sample]) && isfinite(percentages[sample]) && isfinite(restoration[sample]));
					printf("PULSE workload=%s direction=%s requested_ms=%d command_edge_ms=%.6f error_ms=%.6f error_percent=%.6f tracking_restore_ms=%.6f\n", workload ? "tracking+other-axis-guide+polling" : "tracking+idle-polling", items[direction], duration, (stopped - started) * 1000, errors[sample], percentages[sample], restoration[sample]);
				}
				if (workload) { CHECK(wait_state(guider, other_property, other_before, INDIGO_OK_STATE, SHORT_TIMEOUT)); }
			}
			printf("ENDPOINTS direction=%s workload=%d explicit J-to-K forwarded software transport edges; host/relay scheduling included; no physical pulse claim\n", items[direction], workload);
			statistics("signed-error-ms", errors, 9);
			statistics("signed-error-percent", percentages, 9);
			if (direction < 2) { statistics("tracking-restoration-ms", restoration, 9); }
	}
cleanup:
	cleanup_session();
}

static void eqmod_guider_timing_idle(void) { eqmod_guider_timing_mode(0); }

static void eqmod_guider_timing_overlap(void) { eqmod_guider_timing_mode(1); }

static void eqmod_raw_controller_contract(void) {
	int fd = -1;
	char reply[64], first[2][64];
	CHECK(mountsim_attach(&session));
	fd = open(session.port, O_RDWR | O_NOCTTY | O_NONBLOCK);
	CHECK(fd >= 0);
	struct termios options;
	CHECK(tcgetattr(fd, &options) == 0);
	cfmakeraw(&options);
	CHECK(tcsetattr(fd, TCSANOW, &options) == 0);
	CHECK(raw_command(fd, ":s1", reply, sizeof(reply)) && !strcmp(reply, "!00"));
	CHECK(raw_command(fd, ":s2", reply, sizeof(reply)) && !strcmp(reply, "!00"));
	CHECK(raw_command(fd, ":x1", reply, sizeof(reply)) && !strcmp(reply, "!00"));
	CHECK(raw_command(fd, ":I1", reply, sizeof(reply)) && !strcmp(reply, "!01"));
	CHECK(raw_command(fd, ":P19", reply, sizeof(reply)) && !strcmp(reply, "!03"));
	for (int axis = 1; axis <= 2; axis++) {
		char command[16];
		snprintf(command, sizeof(command), ":F%d", axis);
		CHECK(raw_command(fd, command, reply, sizeof(reply)) && !strcmp(reply, "="));
		snprintf(command, sizeof(command), ":f%d", axis);
		CHECK(raw_command(fd, command, first[axis - 1], sizeof(first[0])) && first[axis - 1][0] == '=');
	}
	CHECK(raw_command(fd, ":q1010000", reply, sizeof(reply)) && !strcmp(reply, "=000000"));
	for (int axis = 1; axis <= 2; axis++) {
		char command[16];
		snprintf(command, sizeof(command), ":f%d", axis);
		CHECK(raw_command(fd, command, reply, sizeof(reply)) && !strcmp(reply, first[axis - 1]));
	}
	CHECK(raw_command(fd, ":E1341280", reply, sizeof(reply)) && !strcmp(reply, "="));
	CHECK(raw_command(fd, ":j1", reply, sizeof(reply)) && !strcmp(reply, "=341280"));
	CHECK(raw_command(fd, ":E2FEFFFF", reply, sizeof(reply)) && !strcmp(reply, "="));
	CHECK(raw_command(fd, ":j2", reply, sizeof(reply)) && !strcmp(reply, "=FEFFFF"));
	CHECK(raw_command(fd, ":G100", reply, sizeof(reply)) && !strcmp(reply, "="));
	CHECK(raw_command(fd, ":H1400D03", reply, sizeof(reply)) && !strcmp(reply, "="));
	CHECK(raw_command(fd, ":M1F40100", reply, sizeof(reply)) && !strcmp(reply, "="));
	CHECK(raw_command(fd, ":J1", reply, sizeof(reply)) && !strcmp(reply, "="));
	CHECK(raw_command(fd, ":E1000080", reply, sizeof(reply)) && !strcmp(reply, "!02"));
	indigo_usleep(200000);
	CHECK(raw_command(fd, ":j1", reply, sizeof(reply)) && strcmp(reply, "=341280") && strcmp(reply, "=741F83"));
	double deadline = wire_now() + 10;
	do {
		CHECK(raw_command(fd, ":f1", reply, sizeof(reply)) && reply[0] == '=');
		if (reply[2] == '0') { break; }
		indigo_usleep(20000);
	} while (wire_now() < deadline);
	CHECK(wire_now() < deadline);
	CHECK(raw_command(fd, ":j1", reply, sizeof(reply)) && !strcmp(reply, "=741F83"));
	CHECK(raw_command(fd, ":G210", reply, sizeof(reply)) && !strcmp(reply, "="));
	CHECK(raw_command(fd, ":I26C0200", reply, sizeof(reply)) && !strcmp(reply, "="));
	CHECK(raw_command(fd, ":J2", reply, sizeof(reply)) && !strcmp(reply, "="));
	indigo_usleep(500000);
	CHECK(raw_command(fd, ":j2", reply, sizeof(reply)) && strcmp(reply, "=FEFFFF"));
	CHECK(raw_command(fd, ":K2", reply, sizeof(reply)) && !strcmp(reply, "="));
cleanup:
	if (fd >= 0) { close(fd); }
}

int main(int argc, char **argv) {
	if (!indigo_test_use_private_home()) { return 2; }
	const indigo_test_case tests[] = {
		{ "eqmod_raw_controller_contract", eqmod_raw_controller_contract },
		{ "eqmod_identity_initialization_poll", eqmod_identity_initialization_poll },
		{ "eqmod_shared_lifetimes", eqmod_shared_lifetimes },
		{ "eqmod_sync_goto_convergence", eqmod_sync_goto_convergence },
		{ "eqmod_busy_abort_recovery", eqmod_busy_abort_recovery },
		{ "eqmod_manual_axes_rates", eqmod_manual_axes_rates },
		{ "eqmod_tracking_rates", eqmod_tracking_rates },
		{ "eqmod_park_home", eqmod_park_home },
		{ "eqmod_park_home_interruption", eqmod_park_home_interruption },
		{ "eqmod_guider_functional", eqmod_guider_functional },
		{ "eqmod_transport_idle", eqmod_transport_idle },
		{ "eqmod_transport_motion", eqmod_transport_motion },
		{ "eqmod_transport_pulse", eqmod_transport_pulse },
		{ "eqmod_guider_timing_idle", eqmod_guider_timing_idle },
		{ "eqmod_guider_timing_overlap", eqmod_guider_timing_overlap }
	};
	int result = 2;
	setvbuf(stdout, NULL, _IONBF, 0);
	if (argc == 2 && !strcmp(argv[1], "--list")) {
		for (int i = 0; i < ARRAY_SIZE(tests); i++) { puts(tests[i].name); }
		result = 0;
	} else if (argc == 2) {
		for (int i = 0; i < ARRAY_SIZE(tests); i++) {
			if (!strcmp(argv[1], tests[i].name)) {
				printf("MountSim %s (%s)\n", getenv("MOUNTSIM_VERSION"), getenv("MOUNTSIM_MODEL"));
				result = indigo_run_tests("EQMOD MountSim acceptance", &tests[i], 1);
				break;
			}
		}
	}
	indigo_test_remove_private_home();
	return result;
}
