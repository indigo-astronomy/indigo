// Copyright (c) 2026 INDIGO initiative
// All rights reserved.
//
// You may use this software under the terms of 'INDIGO Astronomy
// open-source license' (see LICENSE.md).
//
// THIS SOFTWARE IS PROVIDED BY THE AUTHORS 'AS IS' AND ANY EXPRESS
// OR IMPLIED WARRANTIES, INCLUDING, BUT NOT LIMITED TO, THE IMPLIED
// WARRANTIES OF MERCHANTABILITY AND FITNESS FOR A PARTICULAR PURPOSE
// ARE DISCLAIMED. IN NO EVENT SHALL THE AUTHOR BE LIABLE FOR ANY
// DIRECT, INDIRECT, INCIDENTAL, SPECIAL, EXEMPLARY, OR CONSEQUENTIAL
// DAMAGES (INCLUDING, BUT NOT LIMITED TO, PROCUREMENT OF SUBSTITUTE
// GOODS OR SERVICES; LOSS OF USE, DATA, OR PROFITS; OR BUSINESS
// INTERRUPTION) HOWEVER CAUSED AND ON ANY THEORY OF LIABILITY,
// WHETHER IN CONTRACT, STRICT LIABILITY, OR TORT (INCLUDING
// NEGLIGENCE OR OTHERWISE) ARISING IN ANY WAY OUT OF THE USE OF THIS
// SOFTWARE, EVEN IF ADVISED OF THE POSSIBILITY OF SUCH DAMAGE.

// Code is generated by AI

#include <indigo_drivers/mount_nexstar/indigo_mount_nexstar.h>
#include "mountsim_test_common.h"
#include <errno.h>
#include <fcntl.h>
#include <termios.h>
#include <unistd.h>
typedef struct {
	double timestamp;
	unsigned char bytes[18];
	size_t size;
} nexstar_frame;

static size_t nexstar_command_size(unsigned char command) {
	switch (command) {
		case 'P': return 8;
		case 'H':
		case 'W': return 9;
		case 'K':
		case 'T': return 2;
		case 'r':
		case 's':
		case 'b': return 18;
		case 'R':
		case 'S':
		case 'B': return 10;
		case 'E':
		case 'e':
		case 'Z':
		case 'z':
		case 'V':
		case 'v':
		case 'J':
		case 'L':
		case 'M':
		case 'm':
		case 'p':
		case 'h':
		case 'w':
		case 't': return 1;
		default: return 0;
	}
}

// Read forwarding records, reconstruct fragmented/coalesced commands, retain
// timestamp of the final byte so edges mean a complete forwarded command.
// Trailing partial frames are legitimate during a live read and are omitted.
static int nexstar_read_frames(nexstar_frame *frames, size_t capacity) {
	char path[PATH_MAX], line[200000];
	if (!mountsim_trace_path(path, sizeof(path))) {
		return -1;
	}
	FILE *file = fopen(path, "r");
	if (file == NULL) {
		return -1;
	}
	nexstar_frame pending = { 0 };
	size_t wanted = 0, count = 0;
	while (fgets(line, sizeof(line), file)) {
		char *cursor, *end;
		double timestamp = strtod(line, &cursor);
		if (cursor == line || !isfinite(timestamp)) {
			fclose(file);
			return -1;
		}
		for (;;) {
			unsigned long byte = strtoul(cursor, &end, 16);
			if (end == cursor) {
				break;
			}
			cursor = end;
			if (byte > 255 || (pending.size == 0 && (wanted = nexstar_command_size(byte)) == 0)) {
				fclose(file);
				return -1;
			}
			pending.bytes[pending.size++] = byte;
			if (pending.size == wanted) {
				if (count >= capacity) {
					fclose(file);
					return -1;
				}
				pending.timestamp = timestamp;
				frames[count++] = pending;
				pending.size = 0;
			}
		}
	}
	fclose(file);
	return (int)count;
}

// Restrict to one normal pulse. Replacement/abort must have separate assertions.
static bool nexstar_guide_edges(const nexstar_frame *frames, int count, double after, int axis, int direction, double *on, double *off) {
	*on = *off = 0;
	for (int i = 0; i < count; i++) {
		const nexstar_frame *frame = frames + i;
		if (frame->timestamp < after || frame->size != 8 || frame->bytes[0] != 'P' || frame->bytes[1] != 2 || frame->bytes[2] != axis || frame->bytes[7] != 0) {
			continue;
		}
		int operation = frame->bytes[3], rate = frame->bytes[4];
		if (operation != 0x24 && operation != 0x25) {
			continue;
		}
		if (*on == 0 && operation == direction && rate != 0) {
			*on = frame->timestamp;
		} else if (*on != 0 && rate == 0) {
			*off = frame->timestamp;
			return *off >= *on;
		} else if (*on != 0 && rate != 0) {
			return false;
		}
	}
	return false;
}

// Raw axis probing is legal only while no INDIGO logical device owns the PTY.
static bool nexstar_raw_exchange(int fd, const char *command, size_t length, char *reply, size_t capacity) {
	if (fd < 0 || capacity < 2 || tcflush(fd, TCIFLUSH) != 0) {
		return false;
	}
	for (size_t sent = 0; sent < length;) {
		ssize_t count = write(fd, command + sent, length - sent);
		if (count > 0) {
			sent += count;
		} else if (count < 0 && errno == EAGAIN) {
			indigo_usleep(10000);
		} else {
			return false;
		}
	}
	size_t received = 0;
	for (int attempt = 0; attempt < 300 && received + 1 < capacity; attempt++) {
		ssize_t count = read(fd, reply + received, capacity - received - 1);
		if (count > 0) {
			received += count;
			if (memchr(reply, '#', received) != NULL) {
				reply[received] = 0;
				return true;
			}
		} else if (count < 0 && errno != EAGAIN) {
			return false;
		}
		indigo_usleep(10000);
	}
	return false;
}

static bool nexstar_decode_axis_reply(const char *reply, int digits, double *polar, double *declination) {
	if (strlen(reply) != (size_t)(2 * digits + 2) || reply[digits] != ',' || reply[2 * digits + 1] != '#') {
		return false;
	}
	char part[9];
	memcpy(part, reply, digits);
	part[digits] = 0;
	char *end;
	unsigned long first = strtoul(part, &end, 16);
	if (*end != 0) {
		return false;
	}
	memcpy(part, reply + digits + 1, digits);
	part[digits] = 0;
	unsigned long second = strtoul(part, &end, 16);
	if (*end != 0) {
		return false;
	}
	double scale = digits == 8 ? 4294967296.0 : 65536.0;
	*polar = first * 360.0 / scale;
	*declination = second * 360.0 / scale;
	return true;
}


static const simulator_driver_case nexstar_mount = {
	"NexStar Mount", "indigo_mount_nexstar", "Mount Nexstar", indigo_mount_nexstar, false,
	NULL, 0, NULL, 0, NULL, 0, NULL, 0
};

typedef struct {
	const char *selection;
	const char *name;
	const char *vendor;
	int model;
	bool altaz;
	bool gps;
} nexstar_model;

static const nexstar_model models[] = {
	{ "CGE", "CGE", "Celestron", 5, false, true },
	{ "SE", "NexStar 6/8 SE", "Celestron", 12, true, true },
	{ "CGEM", "CGEM DX", "Celestron", 14, false, true },
	{ "AVX", "Advanced VX", "Celestron", 20, false, true },
	{ "CGX", "CGX", "Celestron", 23, false, true },
	{ "SynScan", "HEQ5 Series", "Sky-Watcher", 1, false, false }
};

static const simulator_driver_case nexstar_guider = {
	"NexStar guider", "indigo_mount_nexstar", "Mount Nexstar (guider)", indigo_mount_nexstar, false,
	NULL, 0, NULL, 0, NULL, 0, NULL, 0
};
static const simulator_driver_case nexstar_gps = {
	"NexStar GPS", "indigo_mount_nexstar", "Mount Nexstar (gps)", indigo_mount_nexstar, false,
	NULL, 0, NULL, 0, NULL, 0, NULL, 0
};

static const nexstar_model *model;

// Each launcher invocation runs one case; track bus lifetime independently of
// the currently selected logical device's connection cache.
static bool fixture_started;
static bool connection_attempted[3];

static int logical_index(const simulator_driver_case *device) {
	return device == &nexstar_mount ? 0 : device == &nexstar_guider ? 1 : 2;
}

static bool fixture_connect(const simulator_driver_case *device, const char *port) {
	connection_attempted[logical_index(device)] = true;
	return connect_serial_device(device, port);
}

static bool fixture_disconnect(const simulator_driver_case *device) {
	if (context.driver_case != device) {
		reset_simulator_context(device);
	}
	enumerate_simulator_device();
	indigo_property *connection = find_cached_property(CONNECTION_PROPERTY_NAME);
	indigo_item *disconnected = find_cached_item(CONNECTION_PROPERTY_NAME, CONNECTION_DISCONNECTED_ITEM_NAME);
	if (connection != NULL && disconnected != NULL && disconnected->sw.value && connection->state != INDIGO_BUSY_STATE) {
		connection_attempted[logical_index(device)] = false;
		return true;
	}
	disconnect_serial_device(device);
	bool done = !context.connected && context.disconnected && context.last_connection_state == INDIGO_OK_STATE;
	if (done) {
		connection_attempted[logical_index(device)] = false;
	}
	return done;
}

static bool start_mount_fixture(const char *port) {
	fixture_started = bring_up_serial_driver(&nexstar_mount);
	return fixture_started && fixture_connect(&nexstar_mount, port);
}

static void stop_mount_fixture(void) {
	if (fixture_started) {
		const simulator_driver_case *devices[] = { &nexstar_mount, &nexstar_guider, &nexstar_gps };
		for (int i = 2; i >= 0; i--) {
			if (connection_attempted[i]) {
				if (!fixture_disconnect(devices[i])) {
					fprintf(stderr, "Cleanup disconnect failed for %s\n", devices[i]->device_name);
					indigo_test_failures++;
				}
			}
		}
		tear_down_serial_driver(&nexstar_mount);
		fixture_started = false;
	}
}

static double wire_now(void) {
#if defined(__APPLE__)
	return clock_gettime_nsec_np(CLOCK_MONOTONIC) / 1e9;
#else
	struct timespec now;
	clock_gettime(CLOCK_MONOTONIC, &now);
	return now.tv_sec + now.tv_nsec / 1e9;
#endif
}

// BUSY may precede queued transport work. Observe a complete forwarded command
// before tests create conflicts, cancellation or a transport loss.
static bool await_wire_start(double after, unsigned char opcode, int axis) {
	nexstar_frame *frames = calloc(32768, sizeof(*frames));
	if (frames == NULL) {
		return false;
	}
	bool found = false;
	for (int attempt = 0; attempt < 1000 && !found; attempt++) {
		int count = nexstar_read_frames(frames, 32768);
		if (count < 0) {
			fprintf(stderr, "Wire parser returned %d after=%g\n", count, after);
			break;
		}
		for (int i = 0; i < count; i++) {
			nexstar_frame *frame = frames + i;
			if (frame->timestamp >= after && frame->bytes[0] == opcode && (opcode != 'P' || (frame->size == 8 && frame->bytes[2] == axis && (frame->bytes[3] == 0x24 || frame->bytes[3] == 0x25) && frame->bytes[4] != 0))) {
				found = true;
				break;
			}
		}
		if (!found) {
			indigo_usleep(10000);
		}
	}
	if (!found) {
		int count = nexstar_read_frames(frames, 32768);
		fprintf(stderr, "No wire command opcode=%u axis=%d after=%.9f count=%d\n", opcode, axis, after, count);
		if (count > 0) {
			fprintf(stderr, "Last wire command %.9f %02x %02x %02x %02x %02x size=%zu\n", frames[count - 1].timestamp, frames[count - 1].bytes[0], frames[count - 1].bytes[1], frames[count - 1].bytes[2], frames[count - 1].bytes[3], frames[count - 1].bytes[4], frames[count - 1].size);
		}
	}
	free(frames);
	return found;
}

static bool change_switch(const char *property, const char *item, bool value, indigo_property_state state) {
	unsigned int revision = property_revision(property);
	double after = wire_now();
	bool accepted = indigo_change_switch_property_1(&simulator_test_client, nexstar_mount.device_name, property, item, value) == INDIGO_OK && wait_for_property_state_seen_after(property, state, revision);
	if (accepted && value && state == INDIGO_BUSY_STATE) {
		if (!strcmp(property, MOUNT_MOTION_RA_PROPERTY_NAME) || !strcmp(property, MOUNT_MOTION_DEC_PROPERTY_NAME)) {
			return await_wire_start(after, 'P', !strcmp(property, MOUNT_MOTION_RA_PROPERTY_NAME) ? 16 : 17);
		}
		if (!strcmp(property, MOUNT_PARK_PROPERTY_NAME)) {
			return await_wire_start(after, 'b', 0);
		}
	}
	return accepted;
}

static bool change_coordinates(double ra, double dec, indigo_property_state state) {
	unsigned int revision = property_revision(MOUNT_EQUATORIAL_COORDINATES_PROPERTY_NAME);
	const char *items[] = { MOUNT_EQUATORIAL_COORDINATES_RA_ITEM_NAME, MOUNT_EQUATORIAL_COORDINATES_DEC_ITEM_NAME };
	double values[] = { ra, dec };
	double after = wire_now();
	return indigo_change_number_property(&simulator_test_client, nexstar_mount.device_name, MOUNT_EQUATORIAL_COORDINATES_PROPERTY_NAME, 2, items, values) == INDIGO_OK && wait_for_property_state_seen_after(MOUNT_EQUATORIAL_COORDINATES_PROPERTY_NAME, state, revision) && (state != INDIGO_BUSY_STATE || await_wire_start(after, 'r', 0));
}

static double number_value(const char *property, const char *item) {
	indigo_item *cached = find_cached_item(property, item);
	return cached ? cached->number.value : NAN;
}

static atomic_uint observed_lst_updates;
static pthread_mutex_t observation_mutex = PTHREAD_MUTEX_INITIALIZER;
static double observed_ra, observed_dec;
static unsigned int coordinate_updates;
static indigo_property_state observed_coordinate_state;

static bool fresh_coordinates(void) {
	unsigned int revision = atomic_load(&observed_lst_updates);
	for (int i = 0; i < 100; i++) {
		if (atomic_load(&observed_lst_updates) >= revision + 2) {
			pthread_mutex_lock(&observation_mutex);
			bool fresh = coordinate_updates > 0 && isfinite(observed_ra) && isfinite(observed_dec);
			pthread_mutex_unlock(&observation_mutex);
			return fresh;
		}
		indigo_usleep(100000);
	}
	return false;
}

static bool wait_for_state_long(const char *property_name, indigo_property_state state) {
	for (int i = 0; i < 2500; i++) {
		indigo_property *property = find_cached_property(property_name);
		if (property != NULL && property->state == state) {
			return true;
		}
		indigo_usleep(100000);
	}
	return false;
}

static void nexstar_mechanical_axis_index_and_timed_motion(void) {
	external_serial_simulator session = { 0 };
	int fd = -1;
	char reply[32];
	double polar, declination;
	SERIAL_CHECK_TRUE(mountsim_attach(&session));
	fd = open(session.port, O_RDWR | O_NOCTTY | O_NONBLOCK);
	SERIAL_CHECK_TRUE(fd >= 0);
	SERIAL_CHECK_TRUE(nexstar_raw_exchange(fd, "z", 1, reply, sizeof(reply)));
	SERIAL_CHECK_TRUE(nexstar_decode_axis_reply(reply, 8, &polar, &declination));
	SERIAL_CHECK_TRUE(fabs(polar - 90) < 0.01 && fabs(declination - 90) < 0.01);
	char command[19];
	snprintf(command, sizeof(command), "b%08X,%08X", (unsigned int)llround(95.0 * 4294967296.0 / 360.0), (unsigned int)llround(85.0 * 4294967296.0 / 360.0));
	SERIAL_CHECK_TRUE(nexstar_raw_exchange(fd, command, 18, reply, sizeof(reply)) && !strcmp(reply, "#"));
	indigo_usleep(150000);
	SERIAL_CHECK_TRUE(nexstar_raw_exchange(fd, "L", 1, reply, sizeof(reply)) && !strcmp(reply, "1#"));
	SERIAL_CHECK_TRUE(nexstar_raw_exchange(fd, "z", 1, reply, sizeof(reply)));
	SERIAL_CHECK_TRUE(nexstar_decode_axis_reply(reply, 8, &polar, &declination));
	SERIAL_CHECK_TRUE((polar > 90.05 && polar < 94.95) || (declination < 89.95 && declination > 85.05));
	bool arrived = false;
	for (int attempt = 0; attempt < 150; attempt++) {
		SERIAL_CHECK_TRUE(nexstar_raw_exchange(fd, "L", 1, reply, sizeof(reply)));
		if (!strcmp(reply, "0#")) {
			arrived = true;
			break;
		}
		indigo_usleep(100000);
	}
	SERIAL_CHECK_TRUE(arrived);
	SERIAL_CHECK_TRUE(nexstar_raw_exchange(fd, "z", 1, reply, sizeof(reply)));
	SERIAL_CHECK_TRUE(nexstar_decode_axis_reply(reply, 8, &polar, &declination));
	SERIAL_CHECK_TRUE(fabs(polar - 95) < 0.02 && fabs(declination - 85) < 0.02);
	snprintf(command, sizeof(command), "B%04X,%04X", (unsigned int)llround(90.0 * 65536.0 / 360.0), (unsigned int)llround(90.0 * 65536.0 / 360.0));
	SERIAL_CHECK_TRUE(nexstar_raw_exchange(fd, command, 10, reply, sizeof(reply)) && !strcmp(reply, "#"));
	arrived = false;
	for (int attempt = 0; attempt < 150; attempt++) {
		SERIAL_CHECK_TRUE(nexstar_raw_exchange(fd, "L", 1, reply, sizeof(reply)));
		if (!strcmp(reply, "0#")) {
			arrived = true;
			break;
		}
		indigo_usleep(100000);
	}
	SERIAL_CHECK_TRUE(arrived);
	SERIAL_CHECK_TRUE(nexstar_raw_exchange(fd, "Z", 1, reply, sizeof(reply)));
	SERIAL_CHECK_TRUE(nexstar_decode_axis_reply(reply, 4, &polar, &declination));
	SERIAL_CHECK_TRUE(fabs(polar - 90) < 0.02 && fabs(declination - 90) < 0.02);
	// CGE and CGEM manuals specify rates 1 and 2 as 0.5x and 1x sidereal. Measure the DEC motor axis directly.
	double displacement[2];
	for (int index = 0; index < 2; index++) {
		unsigned char move[] = { 'P', 2, 17, 0x24, (unsigned char)(index + 1), 0, 0, 0 };
		SERIAL_CHECK_TRUE(nexstar_raw_exchange(fd, "z", 1, reply, sizeof(reply)));
		SERIAL_CHECK_TRUE(nexstar_decode_axis_reply(reply, 8, &polar, &declination));
		double before = declination;
		SERIAL_CHECK_TRUE(nexstar_raw_exchange(fd, (const char *)move, sizeof(move), reply, sizeof(reply)) && !strcmp(reply, "#"));
		indigo_usleep(2500000);
		move[4] = 0;
		SERIAL_CHECK_TRUE(nexstar_raw_exchange(fd, (const char *)move, sizeof(move), reply, sizeof(reply)) && !strcmp(reply, "#"));
		SERIAL_CHECK_TRUE(nexstar_raw_exchange(fd, "z", 1, reply, sizeof(reply)));
		SERIAL_CHECK_TRUE(nexstar_decode_axis_reply(reply, 8, &polar, &declination));
		displacement[index] = remainder(declination - before, 360);
	}
	fprintf(stderr, "%s rate1/2 DEC motor displacement: %.6f / %.6f degrees\n", model->selection, displacement[0], displacement[1]);
	SERIAL_CHECK_TRUE(displacement[0] > 0.001 && displacement[1] > displacement[0] * 1.6 && displacement[1] < displacement[0] * 2.4);
cleanup:
	if (fd >= 0) {
		close(fd);
	}
}

static void nexstar_cgem_documented_higher_manual_rates(void) {
	external_serial_simulator session = { 0 };
	int fd = -1;
	char reply[32];
	double polar, declination, displacement[2];
	const int rates[] = { 3, 7 };
	const int durations_us[] = { 1200000, 700000 };
	SERIAL_CHECK_TRUE(mountsim_attach(&session));
	fd = open(session.port, O_RDWR | O_NOCTTY | O_NONBLOCK);
	SERIAL_CHECK_TRUE(fd >= 0);
	for (int index = 0; index < 2; index++) {
		SERIAL_CHECK_TRUE(nexstar_raw_exchange(fd, "z", 1, reply, sizeof(reply)));
		SERIAL_CHECK_TRUE(nexstar_decode_axis_reply(reply, 8, &polar, &declination));
		double before = declination;
		unsigned char move[] = { 'P', 2, 17, 0x24, (unsigned char)rates[index], 0, 0, 0 };
		SERIAL_CHECK_TRUE(nexstar_raw_exchange(fd, (const char *)move, sizeof(move), reply, sizeof(reply)) && !strcmp(reply, "#"));
		indigo_usleep(durations_us[index]);
		move[4] = 0;
		SERIAL_CHECK_TRUE(nexstar_raw_exchange(fd, (const char *)move, sizeof(move), reply, sizeof(reply)) && !strcmp(reply, "#"));
		SERIAL_CHECK_TRUE(nexstar_raw_exchange(fd, "z", 1, reply, sizeof(reply)));
		SERIAL_CHECK_TRUE(nexstar_decode_axis_reply(reply, 8, &polar, &declination));
		displacement[index] = remainder(declination - before, 360.0);
	}
	fprintf(stderr, "CGEM rate3/7 DEC motor displacement: %.6f / %.6f degrees\n", displacement[0], displacement[1]);
	SERIAL_CHECK_TRUE(displacement[0] > 0.012 && displacement[0] < 0.035);
	SERIAL_CHECK_TRUE(displacement[1] > 0.45 && displacement[1] < 1.0);
cleanup:
	if (fd >= 0) {
		close(fd);
	}
}

static void nexstar_avx_cgx_documented_manual_rates(void) {
	external_serial_simulator session = { 0 };
	int fd = -1;
	char reply[32];
	double polar, declination, displacement[4];
	const int rates[] = { 1, 2, 7, 9 };
	const int durations_us[] = { 2500000, 2500000, 700000, 500000 };
	SERIAL_CHECK_TRUE(mountsim_attach(&session));
	fd = open(session.port, O_RDWR | O_NOCTTY | O_NONBLOCK);
	SERIAL_CHECK_TRUE(fd >= 0);
	for (int index = 0; index < ARRAY_SIZE(rates); index++) {
		SERIAL_CHECK_TRUE(nexstar_raw_exchange(fd, "z", 1, reply, sizeof(reply)));
		SERIAL_CHECK_TRUE(nexstar_decode_axis_reply(reply, 8, &polar, &declination));
		double before = declination;
		unsigned char move[] = { 'P', 2, 17, 0x24, (unsigned char)rates[index], 0, 0, 0 };
		SERIAL_CHECK_TRUE(nexstar_raw_exchange(fd, (const char *)move, sizeof(move), reply, sizeof(reply)) && !strcmp(reply, "#"));
		indigo_usleep(durations_us[index]);
		move[4] = 0;
		SERIAL_CHECK_TRUE(nexstar_raw_exchange(fd, (const char *)move, sizeof(move), reply, sizeof(reply)) && !strcmp(reply, "#"));
		SERIAL_CHECK_TRUE(nexstar_raw_exchange(fd, "z", 1, reply, sizeof(reply)));
		SERIAL_CHECK_TRUE(nexstar_decode_axis_reply(reply, 8, &polar, &declination));
		displacement[index] = remainder(declination - before, 360.0);
	}
	fprintf(stderr, "%s rate1/2/7/9 DEC motor displacement: %.6f / %.6f / %.6f / %.6f degrees\n", model->selection, displacement[0], displacement[1], displacement[2], displacement[3]);
	SERIAL_CHECK_TRUE(displacement[0] > 0.015 && displacement[0] < 0.035);
	SERIAL_CHECK_TRUE(displacement[1] > displacement[0] * 1.6 && displacement[1] < displacement[0] * 2.4);
	SERIAL_CHECK_TRUE(displacement[2] > 0.45 && displacement[2] < 0.95);
	SERIAL_CHECK_TRUE(displacement[3] > 1.5 && displacement[3] < 2.5);
cleanup:
	if (fd >= 0) {
		close(fd);
	}
}

static void nexstar_se_axis_index_and_timed_motion(void) {
	external_serial_simulator session = { 0 };
	int fd = -1;
	char reply[32], command[19];
	double polar, declination;
	SERIAL_CHECK_TRUE(mountsim_attach(&session));
	fd = open(session.port, O_RDWR | O_NOCTTY | O_NONBLOCK);
	SERIAL_CHECK_TRUE(fd >= 0);
	SERIAL_CHECK_TRUE(nexstar_raw_exchange(fd, "z", 1, reply, sizeof(reply)));
	SERIAL_CHECK_TRUE(nexstar_decode_axis_reply(reply, 8, &polar, &declination));
	SERIAL_CHECK_TRUE(fabs(remainder(polar, 360)) < 0.02 && fabs(remainder(declination - 90, 360)) < 0.02);
	snprintf(command, sizeof(command), "b%08X,%08X", (unsigned int)llround(5.0 * 4294967296.0 / 360.0), (unsigned int)llround(85.0 * 4294967296.0 / 360.0));
	SERIAL_CHECK_TRUE(nexstar_raw_exchange(fd, command, 18, reply, sizeof(reply)) && !strcmp(reply, "#"));
	indigo_usleep(150000);
	SERIAL_CHECK_TRUE(nexstar_raw_exchange(fd, "L", 1, reply, sizeof(reply)) && !strcmp(reply, "1#"));
	SERIAL_CHECK_TRUE(nexstar_raw_exchange(fd, "z", 1, reply, sizeof(reply)));
	SERIAL_CHECK_TRUE(nexstar_decode_axis_reply(reply, 8, &polar, &declination));
	SERIAL_CHECK_TRUE((polar > 0.05 && polar < 4.95) || (declination < 89.95 && declination > 85.05));
	bool arrived = false;
	for (int attempt = 0; attempt < 150; attempt++) {
		SERIAL_CHECK_TRUE(nexstar_raw_exchange(fd, "L", 1, reply, sizeof(reply)));
		if (!strcmp(reply, "0#")) {
			arrived = true;
			break;
		}
		indigo_usleep(100000);
	}
	SERIAL_CHECK_TRUE(arrived);
	SERIAL_CHECK_TRUE(nexstar_raw_exchange(fd, "z", 1, reply, sizeof(reply)));
	SERIAL_CHECK_TRUE(nexstar_decode_axis_reply(reply, 8, &polar, &declination));
	SERIAL_CHECK_TRUE(fabs(remainder(polar - 5, 360)) < 0.02 && fabs(remainder(declination - 85, 360)) < 0.02);
	snprintf(command, sizeof(command), "B%04X,%04X", 0, (unsigned int)llround(90.0 * 65536.0 / 360.0));
	SERIAL_CHECK_TRUE(nexstar_raw_exchange(fd, command, 10, reply, sizeof(reply)) && !strcmp(reply, "#"));
	arrived = false;
	for (int attempt = 0; attempt < 150; attempt++) {
		SERIAL_CHECK_TRUE(nexstar_raw_exchange(fd, "L", 1, reply, sizeof(reply)));
		if (!strcmp(reply, "0#")) {
			arrived = true;
			break;
		}
		indigo_usleep(100000);
	}
	SERIAL_CHECK_TRUE(arrived);
	SERIAL_CHECK_TRUE(nexstar_raw_exchange(fd, "Z", 1, reply, sizeof(reply)));
	SERIAL_CHECK_TRUE(nexstar_decode_axis_reply(reply, 4, &polar, &declination));
	SERIAL_CHECK_TRUE(fabs(remainder(polar, 360)) < 0.02 && fabs(remainder(declination - 90, 360)) < 0.02);
cleanup:
	if (fd >= 0) {
		close(fd);
	}
}

static void nexstar_model_identity_and_reconnect(void) {
	external_serial_simulator session = { 0 };
	SERIAL_CHECK_TRUE(mountsim_attach(&session));
	SERIAL_CHECK_TRUE(start_mount_fixture(session.port));
	assert_device_interface(INDIGO_INTERFACE_MOUNT);
	indigo_item *vendor = find_cached_item(MOUNT_INFO_PROPERTY_NAME, MOUNT_INFO_VENDOR_ITEM_NAME);
	SERIAL_CHECK_TRUE(vendor != NULL && !strcmp(vendor->text.value, model->vendor));
	indigo_item *identity = find_cached_item(MOUNT_INFO_PROPERTY_NAME, MOUNT_INFO_MODEL_ITEM_NAME);
	SERIAL_CHECK_TRUE(identity != NULL && !strcmp(identity->text.value, model->name));
	if (model->altaz) {
		SERIAL_CHECK_TRUE(find_cached_property("TRACKING_MODE") != NULL);
		SERIAL_CHECK_TRUE(find_cached_property(MOUNT_GUIDE_RATE_PROPERTY_NAME) == NULL);
	}
	SERIAL_CHECK_TRUE(fresh_coordinates());
	SERIAL_CHECK_TRUE(isfinite(number_value(MOUNT_EQUATORIAL_COORDINATES_PROPERTY_NAME, MOUNT_EQUATORIAL_COORDINATES_RA_ITEM_NAME)));
	SERIAL_CHECK_EQ_INT(0, context.update_without_define_count);
	SERIAL_CHECK_TRUE(fixture_disconnect(&nexstar_mount));
	SERIAL_CHECK_TRUE(fixture_connect(&nexstar_mount, session.port));
	SERIAL_CHECK_TRUE(fresh_coordinates());
cleanup:
	stop_mount_fixture();
}

static void nexstar_sync_has_fresh_device_readback(void) {
	external_serial_simulator session = { 0 };
	SERIAL_CHECK_TRUE(mountsim_attach(&session));
	SERIAL_CHECK_TRUE(start_mount_fixture(session.port));
	if (model->altaz) {
		SERIAL_CHECK_TRUE(change_switch("TRACKING_MODE", "EQ", true, INDIGO_OK_STATE));
	}
	SERIAL_CHECK_TRUE(fresh_coordinates());
	SERIAL_CHECK_TRUE(change_switch(MOUNT_TRACKING_PROPERTY_NAME, MOUNT_TRACKING_ON_ITEM_NAME, true, INDIGO_OK_STATE));
	double ra = number_value(MOUNT_EQUATORIAL_COORDINATES_PROPERTY_NAME, MOUNT_EQUATORIAL_COORDINATES_RA_ITEM_NAME);
	double dec = number_value(MOUNT_EQUATORIAL_COORDINATES_PROPERTY_NAME, MOUNT_EQUATORIAL_COORDINATES_DEC_ITEM_NAME);
	SERIAL_CHECK_TRUE(isfinite(ra) && isfinite(dec));
	// A nearby offset avoids forcing an arbitrary target through the GUI mount.
	ra = fmod(ra + 0.003, 24.0);
	dec += dec > 85 ? -0.037 : 0.037;
	SERIAL_CHECK_TRUE(change_switch(MOUNT_ON_COORDINATES_SET_PROPERTY_NAME, MOUNT_ON_COORDINATES_SET_SYNC_ITEM_NAME, true, INDIGO_OK_STATE));
	SERIAL_CHECK_TRUE(change_coordinates(ra, dec, INDIGO_OK_STATE));
	SERIAL_CHECK_TRUE(fresh_coordinates());
	double ra_error = remainder(number_value(MOUNT_EQUATORIAL_COORDINATES_PROPERTY_NAME, MOUNT_EQUATORIAL_COORDINATES_RA_ITEM_NAME) - ra, 24.0);
	double dec_error = number_value(MOUNT_EQUATORIAL_COORDINATES_PROPERTY_NAME, MOUNT_EQUATORIAL_COORDINATES_DEC_ITEM_NAME) - dec;
	fprintf(stderr, "SYNC actual error RA=%g hours Dec=%g degrees\n", ra_error, dec_error);
	SERIAL_CHECK_TRUE(fabs(ra_error) < 0.001 && fabs(dec_error) < 0.01);
cleanup:
	stop_mount_fixture();
}

// Observation stays independent of whichever logical device the shared cache selects.
// Preserve the prior callback pointer exactly; never restore a presumed generic callback.
static indigo_result (*previous_update)(indigo_client *, indigo_device *, indigo_property *, const char *);
static atomic_uint guide_updates[2], guide_states[2][4];
static indigo_result observe_update(indigo_client *client, indigo_device *device, indigo_property *property, const char *message) {
	printf("PROPERTY %s %s %d", property->device, property->name, property->state);
	for (int i = 0; i < property->count; i++) {
		if (property->type == INDIGO_NUMBER_VECTOR) {
			printf(" %s=%g", property->items[i].name, property->items[i].number.value);
		} else if (property->type == INDIGO_SWITCH_VECTOR) {
			printf(" %s=%d", property->items[i].name, property->items[i].sw.value);
		}
	}
	puts("");
	if (!strcmp(property->device, nexstar_mount.device_name) && !strcmp(property->name, MOUNT_LST_TIME_PROPERTY_NAME)) {
		atomic_fetch_add(&observed_lst_updates, 1);
	}
	if (!strcmp(property->device, nexstar_mount.device_name) && !strcmp(property->name, MOUNT_EQUATORIAL_COORDINATES_PROPERTY_NAME)) {
		pthread_mutex_lock(&observation_mutex);
		for (int i = 0; i < property->count; i++) {
			if (!strcmp(property->items[i].name, MOUNT_EQUATORIAL_COORDINATES_RA_ITEM_NAME)) {
				observed_ra = property->items[i].number.value;
			} else if (!strcmp(property->items[i].name, MOUNT_EQUATORIAL_COORDINATES_DEC_ITEM_NAME)) {
				observed_dec = property->items[i].number.value;
			}
		}
		coordinate_updates++;
		observed_coordinate_state = property->state;
		pthread_mutex_unlock(&observation_mutex);
	}
	if (!strcmp(property->device, nexstar_guider.device_name)) {
		int axis = !strcmp(property->name, GUIDER_GUIDE_RA_PROPERTY_NAME) ? 0 : !strcmp(property->name, GUIDER_GUIDE_DEC_PROPERTY_NAME) ? 1 : -1;
		if (axis >= 0) {
			unsigned int revision = atomic_fetch_add(guide_updates + axis, 1) + 1;
			atomic_store(&guide_states[axis][property->state], revision);
		}
	}
	return previous_update(client, device, property, message);
}

static unsigned int snapshot_coordinates(double *ra, double *dec, indigo_property_state *state) {
	pthread_mutex_lock(&observation_mutex);
	*ra = observed_ra;
	*dec = observed_dec;
	if (state != NULL) {
		*state = observed_coordinate_state;
	}
	unsigned int revision = coordinate_updates;
	pthread_mutex_unlock(&observation_mutex);
	return revision;
}

static bool await_guiding_state(int axis, indigo_property_state state, unsigned int revision) {
	for (int i = 0; i < 1000; i++) {
		if (atomic_load(&guide_states[axis][state]) > revision) {
			return true;
		}
		indigo_usleep(10000);
	}
	return false;
}

static bool await_coordinates(double ra, double dec, unsigned int revision, double tolerance) {
	for (int i = 0; i < 600; i++) {
		double current_ra, current_dec;
		indigo_property_state state;
		unsigned int current = snapshot_coordinates(&current_ra, &current_dec, &state);
		if (current > revision && state == INDIGO_OK_STATE && fabs(remainder(current_ra - ra, 24) * 15) < tolerance && fabs(current_dec - dec) < tolerance) {
			return true;
		}
		indigo_usleep(100000);
	}
	return false;
}

static bool change_numbers(const char *property, const char *first, double first_value, const char *second, double second_value) {
	unsigned int revision = property_revision(property);
	const char *items[] = { first, second };
	double values[] = { first_value, second_value };
	return indigo_change_number_property(&simulator_test_client, nexstar_mount.device_name, property, second ? 2 : 1, items, values) == INDIGO_OK && wait_for_property_state_seen_after(property, INDIGO_OK_STATE, revision);
}

static bool start_case(external_serial_simulator *session) {
	if (!mountsim_attach(session) || !start_mount_fixture(session->port)) {
		return false;
	}
	if (model->altaz && (!change_switch("TRACKING_MODE", "EQ", true, INDIGO_OK_STATE) || !find_cached_item("TRACKING_MODE", "EQ")->sw.value)) {
		return false;
	}
	return change_switch(MOUNT_PARK_PROPERTY_NAME, MOUNT_PARK_UNPARKED_ITEM_NAME, true, INDIGO_OK_STATE) && fresh_coordinates();
}

static bool reachable_goto(double offset, double declination) {
	double lst = number_value(MOUNT_LST_TIME_PROPERTY_NAME, MOUNT_LST_TIME_ITEM_NAME);
	double ra = fmod(lst + offset + 24, 24);
	double old_ra, old_dec;
	unsigned int revision = snapshot_coordinates(&old_ra, &old_dec, NULL);
	return isfinite(lst) && change_switch(MOUNT_ON_COORDINATES_SET_PROPERTY_NAME, MOUNT_ON_COORDINATES_SET_TRACK_ITEM_NAME, true, INDIGO_OK_STATE) && change_coordinates(ra, declination, INDIGO_BUSY_STATE) && await_coordinates(ra, declination, revision, 0.05) && wait_for_property_state(MOUNT_EQUATORIAL_COORDINATES_PROPERTY_NAME, INDIGO_OK_STATE);
}

static bool coordinates_move(int axis, double sign, double minimum, int milliseconds) {
	double ra, dec;
	unsigned int revision = snapshot_coordinates(&ra, &dec, NULL);
	for (int elapsed = 0; elapsed < milliseconds; elapsed += 100) {
		indigo_usleep(100000);
		double next_ra, next_dec;
		unsigned int next = snapshot_coordinates(&next_ra, &next_dec, NULL);
		double change = axis == 0 ? remainder(next_ra - ra, 24) * 15 : next_dec - dec;
		if (next > revision && sign * change > minimum) {
			return true;
		}
	}
	return false;
}

static bool coordinates_change(int axis, double minimum, int milliseconds) {
	double ra, dec;
	unsigned int revision = snapshot_coordinates(&ra, &dec, NULL);
	for (int elapsed = 0; elapsed < milliseconds; elapsed += 100) {
		indigo_usleep(100000);
		double next_ra, next_dec;
		unsigned int next = snapshot_coordinates(&next_ra, &next_dec, NULL);
		double change = axis == 0 ? remainder(next_ra - ra, 24) * 15 : next_dec - dec;
		if (next > revision && fabs(change) > minimum) {
			return true;
		}
	}
	return false;
}

static bool coordinates_stable(int axis, double tolerance, int milliseconds) {
	double ra, dec;
	snapshot_coordinates(&ra, &dec, NULL);
	unsigned int lst_revision = atomic_load(&observed_lst_updates);
	for (int elapsed = 0; elapsed < milliseconds; elapsed += 100) {
		indigo_usleep(100000);
		double next_ra, next_dec;
		snapshot_coordinates(&next_ra, &next_dec, NULL);
		double change = axis == 0 ? remainder(next_ra - ra, 24) * 15 : next_dec - dec;
		if (fabs(change) > tolerance) {
			return false;
		}
	}
	return atomic_load(&observed_lst_updates) > lst_revision;
}

static bool pulse(int axis, const char *direction, double duration, bool finish) {
	const char *property = axis == 0 ? GUIDER_GUIDE_RA_PROPERTY_NAME : GUIDER_GUIDE_DEC_PROPERTY_NAME;
	unsigned int revision = atomic_load(guide_updates + axis);
	double after = wire_now();
	if (indigo_change_number_property_1(&simulator_test_client, nexstar_guider.device_name, property, direction, duration) != INDIGO_OK) {
		return false;
	}
	bool busy = duration == 0 || await_guiding_state(axis, INDIGO_BUSY_STATE, revision);
	bool wire = duration == 0 || (busy && await_wire_start(after, 'P', axis ? 17 : 16));
	bool done = !finish || await_guiding_state(axis, INDIGO_OK_STATE, revision);
	if (!busy || !wire || !done) {
		fprintf(stderr, "Guide pulse %s %g ms: busy=%d wire=%d done=%d revision=%u updates=%u\n", direction, duration, busy, wire, done, revision, atomic_load(guide_updates + axis));
	}
	return busy && wire && done;
}

static void nexstar_goto_arrives_and_handles_already_target(void) {
	external_serial_simulator session = { 0 };
	int raw_fd = -1;
	SERIAL_CHECK_TRUE(start_case(&session));
	SERIAL_CHECK_TRUE(reachable_goto(-0.8, 35));
	double ra, dec;
	unsigned int revision = snapshot_coordinates(&ra, &dec, NULL);
	SERIAL_CHECK_TRUE(change_coordinates(ra, dec, INDIGO_BUSY_STATE));
	SERIAL_CHECK_TRUE(await_coordinates(ra, dec, revision, 0.05));
	SERIAL_CHECK_TRUE(wait_for_property_state(MOUNT_EQUATORIAL_COORDINATES_PROPERTY_NAME, INDIGO_OK_STATE));
	if (model->altaz) {
		char reply[16];
		SERIAL_CHECK_TRUE(fixture_disconnect(&nexstar_mount));
		raw_fd = open(session.port, O_RDWR | O_NOCTTY | O_NONBLOCK);
		SERIAL_CHECK_TRUE(raw_fd >= 0);
		SERIAL_CHECK_TRUE(nexstar_raw_exchange(raw_fd, "t", 1, reply, sizeof(reply)) && reply[0] == 2 && reply[1] == '#');
	}
cleanup:
	if (raw_fd >= 0) {
		close(raw_fd);
	}
	stop_mount_fixture();
}

static void nexstar_abort_and_busy_conflict_recover(void) {
	external_serial_simulator session = { 0 };
	SERIAL_CHECK_TRUE(start_case(&session));
	SERIAL_CHECK_TRUE(reachable_goto(-1.0, 30));
	double ra, dec;
	snapshot_coordinates(&ra, &dec, NULL);
	SERIAL_CHECK_TRUE(change_coordinates(fmod(ra + 2, 24), 50, INDIGO_BUSY_STATE));
	// Framework owns BUSY exclusion. Preserve requested original target and observe no second slew.
	SERIAL_CHECK_EQ_INT(INDIGO_OK, indigo_change_number_property_1(&simulator_test_client, nexstar_mount.device_name, MOUNT_EQUATORIAL_COORDINATES_PROPERTY_NAME, MOUNT_EQUATORIAL_COORDINATES_DEC_ITEM_NAME, 10));
	SERIAL_CHECK_TRUE(change_switch(MOUNT_ABORT_MOTION_PROPERTY_NAME, MOUNT_ABORT_MOTION_ITEM_NAME, true, INDIGO_OK_STATE));
	SERIAL_CHECK_TRUE(fresh_coordinates());
	SERIAL_CHECK_TRUE(coordinates_stable(1, 0.02, 1500));
	SERIAL_CHECK_TRUE(reachable_goto(-0.9, 31));
cleanup:
	stop_mount_fixture();
}

static void nexstar_manual_directions_rates_and_axis_stop(void) {
	external_serial_simulator session = { 0 };
	static const char *rates[] = { MOUNT_SLEW_RATE_GUIDE_ITEM_NAME, MOUNT_SLEW_RATE_CENTERING_ITEM_NAME, MOUNT_SLEW_RATE_FIND_ITEM_NAME, MOUNT_SLEW_RATE_MAX_ITEM_NAME };
	static const char *directions[] = { MOUNT_MOTION_EAST_ITEM_NAME, MOUNT_MOTION_WEST_ITEM_NAME, MOUNT_MOTION_NORTH_ITEM_NAME, MOUNT_MOTION_SOUTH_ITEM_NAME };
	SERIAL_CHECK_TRUE(start_case(&session));
	SERIAL_CHECK_TRUE(reachable_goto(-1, 30));
	for (int rate = 0; rate < ARRAY_SIZE(rates); rate++) {
		SERIAL_CHECK_TRUE(change_switch(MOUNT_SLEW_RATE_PROPERTY_NAME, rates[rate], true, INDIGO_OK_STATE));
		for (int direction = 0; direction < ARRAY_SIZE(directions); direction++) {
			int axis = direction / 2;
			const char *property = axis ? MOUNT_MOTION_DEC_PROPERTY_NAME : MOUNT_MOTION_RA_PROPERTY_NAME;
			SERIAL_CHECK_TRUE(change_switch(property, directions[direction], true, INDIGO_BUSY_STATE));
			SERIAL_CHECK_TRUE(coordinates_move(axis, direction % 2 ? -1 : 1, 0.001, 4000));
			SERIAL_CHECK_TRUE(change_switch(property, directions[direction], false, INDIGO_OK_STATE));
			SERIAL_CHECK_TRUE(fresh_coordinates());
			SERIAL_CHECK_TRUE(coordinates_stable(axis, 0.01, 1200));
		}
	}
	SERIAL_CHECK_TRUE(change_switch(MOUNT_SLEW_RATE_PROPERTY_NAME, MOUNT_SLEW_RATE_FIND_ITEM_NAME, true, INDIGO_OK_STATE));
	SERIAL_CHECK_TRUE(change_switch(MOUNT_MOTION_RA_PROPERTY_NAME, MOUNT_MOTION_EAST_ITEM_NAME, true, INDIGO_BUSY_STATE));
	SERIAL_CHECK_TRUE(change_switch(MOUNT_MOTION_DEC_PROPERTY_NAME, MOUNT_MOTION_NORTH_ITEM_NAME, true, INDIGO_BUSY_STATE));
	SERIAL_CHECK_TRUE(change_switch(MOUNT_MOTION_RA_PROPERTY_NAME, MOUNT_MOTION_EAST_ITEM_NAME, false, INDIGO_OK_STATE));
	SERIAL_CHECK_TRUE(coordinates_move(1, 1, 0.01, 2000));
	SERIAL_CHECK_TRUE(change_switch(MOUNT_ABORT_MOTION_PROPERTY_NAME, MOUNT_ABORT_MOTION_ITEM_NAME, true, INDIGO_OK_STATE));
cleanup:
	stop_mount_fixture();
}

static void nexstar_se_documented_manual_rates(void) {
	external_serial_simulator session = { 0 };
	int fd = -1;
	char reply[32];
	double ra, dec, displacement[2];
	SERIAL_CHECK_TRUE(start_case(&session));
	SERIAL_CHECK_TRUE(reachable_goto(-1, 30));
	SERIAL_CHECK_TRUE(fixture_disconnect(&nexstar_mount));
	fd = open(session.port, O_RDWR | O_NOCTTY | O_NONBLOCK);
	SERIAL_CHECK_TRUE(fd >= 0);
	for (int rate = 1; rate <= 2; rate++) {
		SERIAL_CHECK_TRUE(nexstar_raw_exchange(fd, "e", 1, reply, sizeof(reply)));
		SERIAL_CHECK_TRUE(nexstar_decode_axis_reply(reply, 8, &ra, &dec));
		double before = dec;
		unsigned char move[] = { 'P', 2, 17, 0x24, (unsigned char)rate, 0, 0, 0 };
		SERIAL_CHECK_TRUE(nexstar_raw_exchange(fd, (const char *)move, sizeof(move), reply, sizeof(reply)) && !strcmp(reply, "#"));
		indigo_usleep(2500000);
		move[4] = 0;
		SERIAL_CHECK_TRUE(nexstar_raw_exchange(fd, (const char *)move, sizeof(move), reply, sizeof(reply)) && !strcmp(reply, "#"));
		SERIAL_CHECK_TRUE(nexstar_raw_exchange(fd, "e", 1, reply, sizeof(reply)));
		SERIAL_CHECK_TRUE(nexstar_decode_axis_reply(reply, 8, &ra, &dec));
		displacement[rate - 1] = remainder(dec - before, 360.0);
	}
	fprintf(stderr, "SE rate1/2 DEC motor displacement: %.6f / %.6f degrees\n", displacement[0], displacement[1]);
	SERIAL_CHECK_TRUE(displacement[0] > 0.004 && displacement[0] < 0.0065);
	SERIAL_CHECK_TRUE(displacement[1] > 0.008 && displacement[1] < 0.013);
cleanup:
	if (fd >= 0) {
		close(fd);
	}
	stop_mount_fixture();
}

static void nexstar_tracking_and_site_roundtrip(void) {
	external_serial_simulator session = { 0 };
	int raw_fd = -1;
	char reply[16];
	SERIAL_CHECK_TRUE(start_case(&session));
	SERIAL_CHECK_TRUE(change_numbers(GEOGRAPHIC_COORDINATES_PROPERTY_NAME, GEOGRAPHIC_COORDINATES_LATITUDE_ITEM_NAME, 48.125, GEOGRAPHIC_COORDINATES_LONGITUDE_ITEM_NAME, 342.75));
	if (model->altaz) {
		SERIAL_CHECK_TRUE(change_switch("TRACKING_MODE", "AUTO", true, INDIGO_OK_STATE));
	}
	SERIAL_CHECK_TRUE(fixture_disconnect(&nexstar_mount));
	if (model->altaz) {
		unsigned char north[] = { 'T', 2 }, south[] = { 'T', 3 };
		raw_fd = open(session.port, O_RDWR | O_NOCTTY | O_NONBLOCK);
		SERIAL_CHECK_TRUE(raw_fd >= 0);
		SERIAL_CHECK_TRUE(nexstar_raw_exchange(raw_fd, (const char *)north, sizeof(north), reply, sizeof(reply)) && !strcmp(reply, "#"));
		SERIAL_CHECK_TRUE(nexstar_raw_exchange(raw_fd, "t", 1, reply, sizeof(reply)) && reply[0] == 2 && reply[1] == '#');
		SERIAL_CHECK_TRUE(nexstar_raw_exchange(raw_fd, (const char *)south, sizeof(south), reply, sizeof(reply)) && !strcmp(reply, "#"));
		SERIAL_CHECK_TRUE(nexstar_raw_exchange(raw_fd, "t", 1, reply, sizeof(reply)) && reply[0] == 3 && reply[1] == '#');
		close(raw_fd);
		raw_fd = -1;
	}
	SERIAL_CHECK_TRUE(fixture_connect(&nexstar_mount, session.port));
	SERIAL_CHECK_TRUE(wait_for_number_item_value(GEOGRAPHIC_COORDINATES_PROPERTY_NAME, GEOGRAPHIC_COORDINATES_LATITUDE_ITEM_NAME, 48.125, 0.001));
	SERIAL_CHECK_TRUE(wait_for_number_item_value(GEOGRAPHIC_COORDINATES_PROPERTY_NAME, GEOGRAPHIC_COORDINATES_LONGITUDE_ITEM_NAME, 342.75, 0.001));
	if (model->altaz) {
		SERIAL_CHECK_TRUE(find_cached_item("TRACKING_MODE", "EQ")->sw.value);
	}
	SERIAL_CHECK_TRUE(change_switch(MOUNT_TRACKING_PROPERTY_NAME, MOUNT_TRACKING_OFF_ITEM_NAME, true, INDIGO_OK_STATE));
	SERIAL_CHECK_TRUE(fresh_coordinates());
	SERIAL_CHECK_TRUE(find_cached_item(MOUNT_TRACKING_PROPERTY_NAME, MOUNT_TRACKING_OFF_ITEM_NAME)->sw.value);
	SERIAL_CHECK_TRUE(change_switch(MOUNT_TRACKING_PROPERTY_NAME, MOUNT_TRACKING_ON_ITEM_NAME, true, INDIGO_OK_STATE));
	SERIAL_CHECK_TRUE(fresh_coordinates());
	SERIAL_CHECK_TRUE(find_cached_item(MOUNT_TRACKING_PROPERTY_NAME, MOUNT_TRACKING_ON_ITEM_NAME)->sw.value);
	if (model->altaz) {
		SERIAL_CHECK_TRUE(change_numbers(GEOGRAPHIC_COORDINATES_PROPERTY_NAME, GEOGRAPHIC_COORDINATES_LATITUDE_ITEM_NAME, -48.125, GEOGRAPHIC_COORDINATES_LONGITUDE_ITEM_NAME, 342.75));
		SERIAL_CHECK_TRUE(change_switch(MOUNT_TRACKING_PROPERTY_NAME, MOUNT_TRACKING_OFF_ITEM_NAME, true, INDIGO_OK_STATE));
		SERIAL_CHECK_TRUE(change_switch(MOUNT_TRACKING_PROPERTY_NAME, MOUNT_TRACKING_ON_ITEM_NAME, true, INDIGO_OK_STATE));
		SERIAL_CHECK_TRUE(reachable_goto(-1, -30));
		SERIAL_CHECK_TRUE(fixture_disconnect(&nexstar_mount));
		raw_fd = open(session.port, O_RDWR | O_NOCTTY | O_NONBLOCK);
		SERIAL_CHECK_TRUE(raw_fd >= 0);
		SERIAL_CHECK_TRUE(nexstar_raw_exchange(raw_fd, "t", 1, reply, sizeof(reply)) && reply[0] == 3 && reply[1] == '#');
	}
cleanup:
	if (raw_fd >= 0) {
		close(raw_fd);
	}
	stop_mount_fixture();
}

static void nexstar_clock_write_advances_and_reconnects(void) {
	external_serial_simulator session = { 0 };
	SERIAL_CHECK_TRUE(start_case(&session));
	const char *items[] = { UTC_TIME_ITEM_NAME, UTC_OFFSET_ITEM_NAME };
	const char *values[] = { "2026-09-23T12:34:56", "-4" };
	unsigned int revision = property_revision(UTC_TIME_PROPERTY_NAME);
	SERIAL_CHECK_EQ_INT(INDIGO_OK, indigo_change_text_property(&simulator_test_client, nexstar_mount.device_name, UTC_TIME_PROPERTY_NAME, 2, items, values));
	SERIAL_CHECK_TRUE(wait_for_property_state_seen_after(UTC_TIME_PROPERTY_NAME, INDIGO_OK_STATE, revision));
	SERIAL_CHECK_TRUE(fresh_coordinates());
	indigo_item *utc = find_cached_item(UTC_TIME_PROPERTY_NAME, UTC_TIME_ITEM_NAME);
	SERIAL_CHECK_TRUE(utc != NULL);
	char expected_utc[] = "2026-09-23T12:34:56";
	time_t wanted = indigo_isogmtotime(expected_utc), first = indigo_isogmtotime(utc->text.value);
	fprintf(stderr, "Clock write expected=%s first=%s offset=%s delta=%ld\n", expected_utc, utc->text.value, find_cached_item(UTC_TIME_PROPERTY_NAME, UTC_OFFSET_ITEM_NAME)->text.value, (long)(first - wanted));
	SERIAL_CHECK_TRUE(first >= wanted && first <= wanted + 15);
	SERIAL_CHECK_TRUE(fixture_disconnect(&nexstar_mount));
	SERIAL_CHECK_TRUE(fixture_connect(&nexstar_mount, session.port));
	SERIAL_CHECK_TRUE(fresh_coordinates());
	utc = find_cached_item(UTC_TIME_PROPERTY_NAME, UTC_TIME_ITEM_NAME);
	SERIAL_CHECK_TRUE(utc != NULL && indigo_isogmtotime(utc->text.value) > first);
	SERIAL_CHECK_TRUE(!strcmp(find_cached_item(UTC_TIME_PROPERTY_NAME, UTC_OFFSET_ITEM_NAME)->text.value, "-4"));
	SERIAL_CHECK_TRUE(change_switch(MOUNT_SET_HOST_TIME_PROPERTY_NAME, MOUNT_SET_HOST_TIME_ITEM_NAME, true, INDIGO_OK_STATE));
cleanup:
	stop_mount_fixture();
}

static void nexstar_st4_rates_read_back(void) {
	external_serial_simulator session = { 0 };
	SERIAL_CHECK_TRUE(start_case(&session));
	// Celestron 4.29 advertises this capability; absence is a failure, not a skip.
	SERIAL_CHECK_TRUE(find_cached_property(MOUNT_GUIDE_RATE_PROPERTY_NAME) != NULL);
	SERIAL_CHECK_TRUE(change_numbers(MOUNT_GUIDE_RATE_PROPERTY_NAME, MOUNT_GUIDE_RATE_RA_ITEM_NAME, 41, MOUNT_GUIDE_RATE_DEC_ITEM_NAME, 67));
	SERIAL_CHECK_TRUE(fixture_disconnect(&nexstar_mount));
	SERIAL_CHECK_TRUE(fixture_connect(&nexstar_mount, session.port));
	SERIAL_CHECK_TRUE(wait_for_number_item_value(MOUNT_GUIDE_RATE_PROPERTY_NAME, MOUNT_GUIDE_RATE_RA_ITEM_NAME, 41, 1.01));
	SERIAL_CHECK_TRUE(wait_for_number_item_value(MOUNT_GUIDE_RATE_PROPERTY_NAME, MOUNT_GUIDE_RATE_DEC_ITEM_NAME, 67, 1.01));
cleanup:
	stop_mount_fixture();
}

static void nexstar_park_completes_before_tracking_off(void) {
	external_serial_simulator session = { 0 };
	nexstar_frame *frames = calloc(32768, sizeof(*frames));
	int raw_fd = -1;
	SERIAL_CHECK_TRUE(frames != NULL);
	SERIAL_CHECK_TRUE(start_case(&session));
	SERIAL_CHECK_TRUE(reachable_goto(-1, 35));
	SERIAL_CHECK_TRUE(change_numbers(MOUNT_PARK_POSITION_PROPERTY_NAME, MOUNT_PARK_POSITION_HA_ITEM_NAME, -1, MOUNT_PARK_POSITION_DEC_ITEM_NAME, 35));
	double park_after = wire_now();
	SERIAL_CHECK_TRUE(change_switch(MOUNT_PARK_PROPERTY_NAME, MOUNT_PARK_PARKED_ITEM_NAME, true, INDIGO_BUSY_STATE));
	SERIAL_CHECK_TRUE(coordinates_change(0, 0.02, 3000) || coordinates_change(1, 0.02, 3000));
	SERIAL_CHECK_TRUE(wait_for_state_long(MOUNT_PARK_PROPERTY_NAME, INDIGO_OK_STATE));
	SERIAL_CHECK_TRUE(fresh_coordinates());
	SERIAL_CHECK_TRUE(find_cached_item(MOUNT_TRACKING_PROPERTY_NAME, MOUNT_TRACKING_OFF_ITEM_NAME)->sw.value);
	SERIAL_CHECK_TRUE(coordinates_stable(1, 0.02, 1500));
	SERIAL_CHECK_TRUE(change_switch(MOUNT_MOTION_DEC_PROPERTY_NAME, MOUNT_MOTION_NORTH_ITEM_NAME, true, INDIGO_ALERT_STATE));
	SERIAL_CHECK_TRUE(!find_cached_item(MOUNT_MOTION_DEC_PROPERTY_NAME, MOUNT_MOTION_NORTH_ITEM_NAME)->sw.value);
	int frame_count = nexstar_read_frames(frames, 32768);
	SERIAL_CHECK_TRUE(frame_count >= 0);
	double target_polar = NAN, target_dec = NAN;
	for (int i = 0; i < frame_count; i++) {
		if (frames[i].timestamp >= park_after && frames[i].size == 18 && frames[i].bytes[0] == 'b') {
			char encoded[19];
			memcpy(encoded, frames[i].bytes + 1, 17);
			encoded[17] = '#';
			encoded[18] = 0;
			SERIAL_CHECK_TRUE(nexstar_decode_axis_reply(encoded, 8, &target_polar, &target_dec));
		}
	}
	SERIAL_CHECK_TRUE(isfinite(target_polar) && isfinite(target_dec));
	SERIAL_CHECK_TRUE(fixture_disconnect(&nexstar_mount));
	raw_fd = open(session.port, O_RDWR | O_NOCTTY | O_NONBLOCK);
	SERIAL_CHECK_TRUE(raw_fd >= 0);
	char axis_reply[32];
	SERIAL_CHECK_TRUE(nexstar_raw_exchange(raw_fd, "z", 1, axis_reply, sizeof(axis_reply)));
	double actual_polar, actual_dec;
	SERIAL_CHECK_TRUE(nexstar_decode_axis_reply(axis_reply, 8, &actual_polar, &actual_dec));
	SERIAL_CHECK_TRUE(fabs(remainder(actual_polar - target_polar, 360.0)) < 0.05 && fabs(remainder(actual_dec - target_dec, 360.0)) < 0.05);
	close(raw_fd);
	raw_fd = -1;
	SERIAL_CHECK_TRUE(fixture_connect(&nexstar_mount, session.port));
	SERIAL_CHECK_TRUE(change_switch(MOUNT_PARK_PROPERTY_NAME, MOUNT_PARK_UNPARKED_ITEM_NAME, true, INDIGO_OK_STATE));
	SERIAL_CHECK_TRUE(reachable_goto(-0.8, 35));
cleanup:
	if (raw_fd >= 0) {
		close(raw_fd);
	}
	free(frames);
	stop_mount_fixture();
}

static void nexstar_southern_default_park_keeps_signed_pole(void) {
	external_serial_simulator session = { 0 };
	nexstar_frame *frames = calloc(32768, sizeof(*frames));
	int raw_fd = -1;
	SERIAL_CHECK_TRUE(frames != NULL);
	SERIAL_CHECK_TRUE(start_case(&session));
	SERIAL_CHECK_TRUE(change_numbers(GEOGRAPHIC_COORDINATES_PROPERTY_NAME, GEOGRAPHIC_COORDINATES_LATITUDE_ITEM_NAME, -48, GEOGRAPHIC_COORDINATES_LONGITUDE_ITEM_NAME, 342.75));
	SERIAL_CHECK_TRUE(change_switch(MOUNT_PARK_SET_PROPERTY_NAME, MOUNT_PARK_SET_DEFAULT_ITEM_NAME, true, INDIGO_OK_STATE));
	SERIAL_CHECK_TRUE(wait_for_number_item_value(MOUNT_PARK_POSITION_PROPERTY_NAME, MOUNT_PARK_POSITION_HA_ITEM_NAME, 6, 0.01));
	SERIAL_CHECK_TRUE(wait_for_number_item_value(MOUNT_PARK_POSITION_PROPERTY_NAME, MOUNT_PARK_POSITION_DEC_ITEM_NAME, -90, 0.01));
	double after = wire_now();
	SERIAL_CHECK_TRUE(change_switch(MOUNT_PARK_PROPERTY_NAME, MOUNT_PARK_PARKED_ITEM_NAME, true, INDIGO_BUSY_STATE));
	SERIAL_CHECK_TRUE(coordinates_change(1, 0.02, 3000));
	SERIAL_CHECK_TRUE(wait_for_state_long(MOUNT_PARK_PROPERTY_NAME, INDIGO_OK_STATE));
	int frame_count = nexstar_read_frames(frames, 32768);
	SERIAL_CHECK_TRUE(frame_count >= 0);
	bool signed_axis = false;
	for (int i = 0; i < frame_count; i++) {
		if (frames[i].timestamp >= after && frames[i].size == 18 && frames[i].bytes[0] == 'b') {
			char encoded[19];
			memcpy(encoded, frames[i].bytes + 1, 17);
			encoded[17] = '#';
			encoded[18] = 0;
			double polar, declination;
			SERIAL_CHECK_TRUE(nexstar_decode_axis_reply(encoded, 8, &polar, &declination));
			signed_axis = fabs(remainder(declination - 270, 360.0)) < 0.02;
		}
	}
	SERIAL_CHECK_TRUE(signed_axis);
	SERIAL_CHECK_TRUE(fixture_disconnect(&nexstar_mount));
	raw_fd = open(session.port, O_RDWR | O_NOCTTY | O_NONBLOCK);
	SERIAL_CHECK_TRUE(raw_fd >= 0);
	char axis_reply[32];
	SERIAL_CHECK_TRUE(nexstar_raw_exchange(raw_fd, "z", 1, axis_reply, sizeof(axis_reply)));
	double polar, declination;
	SERIAL_CHECK_TRUE(nexstar_decode_axis_reply(axis_reply, 8, &polar, &declination));
	SERIAL_CHECK_TRUE(fabs(remainder(declination - 270, 360.0)) < 0.05);
cleanup:
	if (raw_fd >= 0) {
		close(raw_fd);
	}
	free(frames);
	stop_mount_fixture();
}

static void nexstar_gps_fix_and_shared_lifetime(void) {
	external_serial_simulator session = { 0 };
	SERIAL_CHECK_TRUE(start_case(&session));
	SERIAL_CHECK_TRUE(fixture_connect(&nexstar_gps, NULL));
	assert_device_interface(INDIGO_INTERFACE_GPS);
	unsigned int revision = property_revision(GEOGRAPHIC_COORDINATES_PROPERTY_NAME);
	SERIAL_CHECK_TRUE(wait_for_property_state_after(GEOGRAPHIC_COORDINATES_PROPERTY_NAME, INDIGO_OK_STATE, revision));
	indigo_item *fix = find_cached_item(GPS_STATUS_PROPERTY_NAME, GPS_STATUS_3D_FIX_ITEM_NAME);
	SERIAL_CHECK_TRUE(fix != NULL && fix->light.value == INDIGO_OK_STATE);
	SERIAL_CHECK_TRUE(isfinite(number_value(GEOGRAPHIC_COORDINATES_PROPERTY_NAME, GEOGRAPHIC_COORDINATES_LATITUDE_ITEM_NAME)));
	SERIAL_CHECK_TRUE(find_cached_item(UTC_TIME_PROPERTY_NAME, UTC_TIME_ITEM_NAME) != NULL);
	SERIAL_CHECK_TRUE(fixture_disconnect(&nexstar_gps));
	reset_simulator_context(&nexstar_mount);
	enumerate_simulator_device();
	SERIAL_CHECK_TRUE(fresh_coordinates());
	SERIAL_CHECK_TRUE(fixture_connect(&nexstar_gps, NULL));
cleanup:
	stop_mount_fixture();
}

static void nexstar_guider_directions_replacement_and_independent_axes(void) {
	external_serial_simulator session = { 0 };
	nexstar_frame *frames = calloc(32768, sizeof(*frames));
	SERIAL_CHECK_TRUE(frames != NULL);
	SERIAL_CHECK_TRUE(start_case(&session));
	SERIAL_CHECK_TRUE(reachable_goto(-1, 30));
	SERIAL_CHECK_TRUE(fixture_connect(&nexstar_guider, NULL));
	static const char *directions[] = { GUIDER_GUIDE_EAST_ITEM_NAME, GUIDER_GUIDE_WEST_ITEM_NAME, GUIDER_GUIDE_NORTH_ITEM_NAME, GUIDER_GUIDE_SOUTH_ITEM_NAME };
	for (int i = 0; i < ARRAY_SIZE(directions); i++) {
		double before_ra, before_dec, after_ra, after_dec;
		snapshot_coordinates(&before_ra, &before_dec, NULL);
		SERIAL_CHECK_TRUE(pulse(i / 2, directions[i], 2500, true));
		SERIAL_CHECK_TRUE(fresh_coordinates());
		snapshot_coordinates(&after_ra, &after_dec, NULL);
		double displacement = i / 2 ? after_dec - before_dec : remainder(after_ra - before_ra, 24) * 15;
		fprintf(stderr, "Guide %s sky displacement %.6f degrees\n", directions[i], displacement);
		SERIAL_CHECK_TRUE((i % 2 ? -1 : 1) * displacement > 0.001);
	}
	SERIAL_CHECK_TRUE(pulse(0, GUIDER_GUIDE_EAST_ITEM_NAME, 0, true));
	SERIAL_CHECK_TRUE(pulse(0, GUIDER_GUIDE_EAST_ITEM_NAME, 2000, false));
	SERIAL_CHECK_TRUE(pulse(0, GUIDER_GUIDE_WEST_ITEM_NAME, 500, true));
	double dec_start = wire_now();
	double before_ra, before_dec, after_ra, after_dec;
	snapshot_coordinates(&before_ra, &before_dec, NULL);
	SERIAL_CHECK_TRUE(pulse(1, GUIDER_GUIDE_NORTH_ITEM_NAME, 3000, false));
	SERIAL_CHECK_TRUE(pulse(0, GUIDER_GUIDE_WEST_ITEM_NAME, 200, true));
	SERIAL_CHECK_TRUE(wait_for_property_not_busy(GUIDER_GUIDE_DEC_PROPERTY_NAME));
	int frame_count = nexstar_read_frames(frames, 32768);
	double on = 0, off = 0;
	SERIAL_CHECK_TRUE(frame_count >= 0 && nexstar_guide_edges(frames, frame_count, dec_start, 17, 0x24, &on, &off));
	SERIAL_CHECK_TRUE(off - on > 2.5);
	SERIAL_CHECK_TRUE(fresh_coordinates());
	snapshot_coordinates(&after_ra, &after_dec, NULL);
	SERIAL_CHECK_TRUE(after_dec - before_dec > 0.004);
	SERIAL_CHECK_TRUE(wait_for_number_item_value(GUIDER_GUIDE_DEC_PROPERTY_NAME, GUIDER_GUIDE_NORTH_ITEM_NAME, 0, 0));
cleanup:
	free(frames);
	stop_mount_fixture();
}

static void nexstar_guider_first_and_sibling_survival(void) {
	external_serial_simulator session = { 0 };
	SERIAL_CHECK_TRUE(mountsim_attach(&session));
	fixture_started = bring_up_serial_driver(&nexstar_mount);
	SERIAL_CHECK_TRUE(fixture_started);
	reset_simulator_context(&nexstar_mount);
	enumerate_simulator_device();
	SERIAL_CHECK_EQ_INT(INDIGO_OK, indigo_change_text_property_1_raw(&simulator_test_client, nexstar_mount.device_name, DEVICE_PORT_PROPERTY_NAME, DEVICE_PORT_ITEM_NAME, session.port));
	SERIAL_CHECK_TRUE(fixture_connect(&nexstar_guider, NULL));
	if (!strcmp(model->selection, "AVX") || !strcmp(model->selection, "CGX")) {
		reset_simulator_context(&nexstar_guider);
		enumerate_simulator_device();
		indigo_item *rate1 = find_cached_item("COMMAND_GUIDE_RATE", "GUIDE_50");
		indigo_item *rate2 = find_cached_item("COMMAND_GUIDE_RATE", "GUIDE_100");
		SERIAL_CHECK_TRUE(rate1 != NULL && rate2 != NULL);
		SERIAL_CHECK_TRUE(strstr(rate1->label, "2x sidereal") != NULL && strstr(rate2->label, "4x sidereal") != NULL);
	}
	SERIAL_CHECK_TRUE(pulse(0, GUIDER_GUIDE_WEST_ITEM_NAME, 100, true));
	SERIAL_CHECK_TRUE(fixture_connect(&nexstar_mount, NULL));
	SERIAL_CHECK_TRUE(fresh_coordinates());
	SERIAL_CHECK_TRUE(fixture_disconnect(&nexstar_mount));
	SERIAL_CHECK_TRUE(pulse(1, GUIDER_GUIDE_NORTH_ITEM_NAME, 100, true));
	SERIAL_CHECK_TRUE(pulse(1, GUIDER_GUIDE_NORTH_ITEM_NAME, 2000, false));
	SERIAL_CHECK_TRUE(fixture_disconnect(&nexstar_guider));
	SERIAL_CHECK_TRUE(fixture_connect(&nexstar_guider, NULL));
	SERIAL_CHECK_TRUE(pulse(0, GUIDER_GUIDE_WEST_ITEM_NAME, 100, true));
cleanup:
	stop_mount_fixture();
}

static void run_loss_case(bool active) {
	external_serial_simulator session = { 0 };
	SERIAL_CHECK_TRUE(start_case(&session));
	SERIAL_CHECK_TRUE(fresh_coordinates());
	if (active) {
		SERIAL_CHECK_TRUE(change_switch(MOUNT_MOTION_DEC_PROPERTY_NAME, MOUNT_MOTION_NORTH_ITEM_NAME, true, INDIGO_BUSY_STATE));
	}
	unsigned int revision = property_revision(MOUNT_EQUATORIAL_COORDINATES_PROPERTY_NAME);
	SERIAL_CHECK_TRUE(mountsim_transport(&session, false));
	SERIAL_CHECK_TRUE(wait_for_property_state_seen_after(MOUNT_EQUATORIAL_COORDINATES_PROPERTY_NAME, INDIGO_ALERT_STATE, revision));
	SERIAL_CHECK_TRUE(fixture_disconnect(&nexstar_mount));
	SERIAL_CHECK_TRUE(mountsim_transport(&session, true));
	SERIAL_CHECK_TRUE(fixture_connect(&nexstar_mount, session.port));
	SERIAL_CHECK_TRUE(change_switch(MOUNT_ABORT_MOTION_PROPERTY_NAME, MOUNT_ABORT_MOTION_ITEM_NAME, true, INDIGO_OK_STATE));
	SERIAL_CHECK_TRUE(fresh_coordinates());
	SERIAL_CHECK_TRUE(reachable_goto(-1, 35));
cleanup:
	stop_mount_fixture();
}

static void nexstar_idle_transport_loss_recovers(void) {
	run_loss_case(false);
}

static void nexstar_active_transport_loss_recovers(void) {
	run_loss_case(true);
}

static void nexstar_park_abort_allows_new_motion(void) {
	external_serial_simulator session = { 0 };
	SERIAL_CHECK_TRUE(start_case(&session));
	SERIAL_CHECK_TRUE(reachable_goto(-1, 30));
	SERIAL_CHECK_TRUE(change_numbers(MOUNT_PARK_POSITION_PROPERTY_NAME, MOUNT_PARK_POSITION_HA_ITEM_NAME, 4, MOUNT_PARK_POSITION_DEC_ITEM_NAME, 70));
	SERIAL_CHECK_TRUE(change_switch(MOUNT_PARK_PROPERTY_NAME, MOUNT_PARK_PARKED_ITEM_NAME, true, INDIGO_BUSY_STATE));
	SERIAL_CHECK_TRUE(coordinates_change(1, 0.02, 3000));
	unsigned int revision = property_revision(MOUNT_PARK_PROPERTY_NAME);
	SERIAL_CHECK_TRUE(change_switch(MOUNT_ABORT_MOTION_PROPERTY_NAME, MOUNT_ABORT_MOTION_ITEM_NAME, true, INDIGO_OK_STATE));
	SERIAL_CHECK_TRUE(wait_for_property_state_seen_after(MOUNT_PARK_PROPERTY_NAME, INDIGO_ALERT_STATE, revision));
	SERIAL_CHECK_TRUE(find_cached_item(MOUNT_PARK_PROPERTY_NAME, MOUNT_PARK_UNPARKED_ITEM_NAME)->sw.value);
	SERIAL_CHECK_TRUE(fresh_coordinates());
	SERIAL_CHECK_TRUE(coordinates_stable(1, 0.02, 1500));
	SERIAL_CHECK_TRUE(reachable_goto(-0.8, 31));
cleanup:
	stop_mount_fixture();
}

static void run_pending_loss_case(bool parking) {
	external_serial_simulator session = { 0 };
	SERIAL_CHECK_TRUE(start_case(&session));
	SERIAL_CHECK_TRUE(reachable_goto(-1, 30));
	SERIAL_CHECK_TRUE(fresh_coordinates());
	unsigned int revision, ra_revision = 0, dec_revision = 0;
	if (parking) {
		SERIAL_CHECK_TRUE(change_numbers(MOUNT_PARK_POSITION_PROPERTY_NAME, MOUNT_PARK_POSITION_HA_ITEM_NAME, 4, MOUNT_PARK_POSITION_DEC_ITEM_NAME, 70));
		SERIAL_CHECK_TRUE(change_switch(MOUNT_PARK_PROPERTY_NAME, MOUNT_PARK_PARKED_ITEM_NAME, true, INDIGO_BUSY_STATE));
		SERIAL_CHECK_TRUE(coordinates_change(1, 0.02, 3000));
		revision = property_revision(MOUNT_PARK_PROPERTY_NAME);
	} else {
		SERIAL_CHECK_TRUE(fixture_connect(&nexstar_guider, NULL));
		SERIAL_CHECK_TRUE(pulse(0, GUIDER_GUIDE_WEST_ITEM_NAME, 2000, false));
		SERIAL_CHECK_TRUE(pulse(1, GUIDER_GUIDE_NORTH_ITEM_NAME, 2500, false));
		ra_revision = atomic_load(guide_updates);
		dec_revision = atomic_load(guide_updates + 1);
	}
	SERIAL_CHECK_TRUE(mountsim_transport(&session, false));
	if (parking) {
		SERIAL_CHECK_TRUE(wait_for_property_state_seen_after(MOUNT_PARK_PROPERTY_NAME, INDIGO_ALERT_STATE, revision));
	} else {
		SERIAL_CHECK_TRUE(await_guiding_state(0, INDIGO_ALERT_STATE, ra_revision));
		SERIAL_CHECK_TRUE(await_guiding_state(1, INDIGO_ALERT_STATE, dec_revision));
		SERIAL_CHECK_TRUE(fixture_disconnect(&nexstar_guider));
	}
	SERIAL_CHECK_TRUE(fixture_disconnect(&nexstar_mount));
	SERIAL_CHECK_TRUE(mountsim_transport(&session, true));
	SERIAL_CHECK_TRUE(fixture_connect(&nexstar_mount, session.port));
	SERIAL_CHECK_TRUE(change_switch(MOUNT_ABORT_MOTION_PROPERTY_NAME, MOUNT_ABORT_MOTION_ITEM_NAME, true, INDIGO_OK_STATE));
	SERIAL_CHECK_TRUE(fresh_coordinates());
	SERIAL_CHECK_TRUE(reachable_goto(-0.8, 31));
	if (!parking) {
		SERIAL_CHECK_TRUE(fixture_connect(&nexstar_guider, NULL));
		SERIAL_CHECK_TRUE(pulse(0, GUIDER_GUIDE_WEST_ITEM_NAME, 100, true));
		SERIAL_CHECK_TRUE(pulse(1, GUIDER_GUIDE_NORTH_ITEM_NAME, 100, true));
	}
cleanup:
	stop_mount_fixture();
}

static void nexstar_pending_park_loss_recovers(void) {
	run_pending_loss_case(true);
}

static void nexstar_pending_guide_loss_recovers(void) {
	run_pending_loss_case(false);
}

static int compare_sample(const void *left, const void *right) {
	double a = *(const double *)left, b = *(const double *)right;
	return (a > b) - (a < b);
}

static void timing_report(const char *workload, const char *direction, double requested, double *errors, int count) {
	double sum = 0, squared = 0, maximum_absolute = 0;
	for (int i = 0; i < count; i++) {
		sum += errors[i];
		squared += errors[i] * errors[i];
		maximum_absolute = fmax(maximum_absolute, fabs(errors[i]));
	}
	qsort(errors, count, sizeof(*errors), compare_sample);
	double mean = sum / count, median = (errors[(count - 1) / 2] + errors[count / 2]) / 2;
	printf("GUIDE_TIMING workload=%s direction=%s requested_ms=%g n=%d signed_ms min=%g mean=%g median=%g p95=%g p99=%g max=%g sd=%g max_abs_ms=%g mean_percent=%g mean_actual_ms=%g\n", workload, direction, requested, count, errors[0], mean, median, errors[(int)ceil(count * .95) - 1], errors[(int)ceil(count * .99) - 1], errors[count - 1], sqrt(fmax(0, squared / count - mean * mean)), maximum_absolute, 100 * mean / requested, requested + mean);
}

static void nexstar_guider_transport_edge_timing(void) {
	external_serial_simulator session = { 0 };
	nexstar_frame *frames = calloc(32768, sizeof(*frames));
	SERIAL_CHECK_TRUE(frames != NULL);
	SERIAL_CHECK_TRUE(start_case(&session));
	SERIAL_CHECK_TRUE(fixture_connect(&nexstar_guider, NULL));
	static const char *directions[] = { GUIDER_GUIDE_EAST_ITEM_NAME, GUIDER_GUIDE_WEST_ITEM_NAME, GUIDER_GUIDE_NORTH_ITEM_NAME, GUIDER_GUIDE_SOUTH_ITEM_NAME };
	static const int durations[] = { 20, 100, 500 };
	// Mapping is production baseline only, not a claim that sky direction is correct.
	static const int baseline_commands[] = { 0x24, 0x25, 0x24, 0x25 };
	for (int workload = 0; workload < 2; workload++) {
		reset_simulator_context(&nexstar_mount);
		enumerate_simulator_device();
		SERIAL_CHECK_TRUE(change_switch(MOUNT_TRACKING_PROPERTY_NAME, workload ? MOUNT_TRACKING_ON_ITEM_NAME : MOUNT_TRACKING_OFF_ITEM_NAME, true, INDIGO_OK_STATE));
		SERIAL_CHECK_TRUE(fresh_coordinates());
		indigo_item *tracking = find_cached_item(MOUNT_TRACKING_PROPERTY_NAME, workload ? MOUNT_TRACKING_ON_ITEM_NAME : MOUNT_TRACKING_OFF_ITEM_NAME);
		SERIAL_CHECK_TRUE(tracking != NULL && tracking->sw.value);
		reset_simulator_context(&nexstar_guider);
		enumerate_simulator_device();
		for (int direction = 0; direction < ARRAY_SIZE(directions); direction++) {
			for (int duration = 0; duration < ARRAY_SIZE(durations); duration++) {
				double errors[4];
				for (int repeat = -1; repeat < 4; repeat++) {
					double after = wire_now();
					SERIAL_CHECK_TRUE(pulse(direction / 2, directions[direction], durations[duration], true));
					double on = 0, off = 0;
					bool edges = false;
					for (int attempt = 0; attempt < 50 && !edges; attempt++) {
						int count = nexstar_read_frames(frames, 32768);
						SERIAL_CHECK_TRUE(count >= 0);
						edges = nexstar_guide_edges(frames, count, after, direction / 2 ? 17 : 16, baseline_commands[direction], &on, &off);
						if (!edges) {
							indigo_usleep(10000);
						}
					}
					SERIAL_CHECK_TRUE(edges);
					SERIAL_CHECK_TRUE(isfinite(on) && isfinite(off));
					if (repeat >= 0) {
						errors[repeat] = 1000 * (off - on) - durations[duration];
					}
				}
				timing_report(workload ? "tracking-and-coordinate-polling" : "tracking-off-and-coordinate-polling", directions[direction], durations[duration], errors, ARRAY_SIZE(errors));
			}
		}
	}
cleanup:
	free(frames);
	stop_mount_fixture();
}

int main(int argc, char **argv) {
	indigo_test_use_private_home();
	const char *selection = getenv("MOUNTSIM_MODEL");
	for (int i = 0; selection != NULL && i < ARRAY_SIZE(models); i++) {
		if (!strcmp(selection, models[i].selection)) {
			model = models + i;
			break;
		}
	}
	if (model == NULL || argc != 2) {
		fprintf(stderr, "Use shared launcher with a supported MOUNTSIM_MODEL and one named case\n");
		indigo_test_remove_private_home();
		return 2;
	}
	const indigo_test_case cases[] = {
		{ "nexstar_mechanical_axis_index_and_timed_motion", nexstar_mechanical_axis_index_and_timed_motion },
		{ "nexstar_cgem_documented_higher_manual_rates", nexstar_cgem_documented_higher_manual_rates },
		{ "nexstar_avx_cgx_documented_manual_rates", nexstar_avx_cgx_documented_manual_rates },
		{ "nexstar_se_axis_index_and_timed_motion", nexstar_se_axis_index_and_timed_motion },
		{ "nexstar_model_identity_and_reconnect", nexstar_model_identity_and_reconnect },
		{ "nexstar_sync_has_fresh_device_readback", nexstar_sync_has_fresh_device_readback },
		{ "nexstar_goto_arrives_and_handles_already_target", nexstar_goto_arrives_and_handles_already_target },
		{ "nexstar_abort_and_busy_conflict_recover", nexstar_abort_and_busy_conflict_recover },
		{ "nexstar_manual_directions_rates_and_axis_stop", nexstar_manual_directions_rates_and_axis_stop },
		{ "nexstar_se_documented_manual_rates", nexstar_se_documented_manual_rates },
		{ "nexstar_tracking_and_site_roundtrip", nexstar_tracking_and_site_roundtrip },
		{ "nexstar_clock_write_advances_and_reconnects", nexstar_clock_write_advances_and_reconnects },
		{ "nexstar_st4_rates_read_back", nexstar_st4_rates_read_back },
		{ "nexstar_park_completes_before_tracking_off", nexstar_park_completes_before_tracking_off },
		{ "nexstar_southern_default_park_keeps_signed_pole", nexstar_southern_default_park_keeps_signed_pole },
		{ "nexstar_gps_fix_and_shared_lifetime", nexstar_gps_fix_and_shared_lifetime },
		{ "nexstar_guider_directions_replacement_and_independent_axes", nexstar_guider_directions_replacement_and_independent_axes },
		{ "nexstar_guider_first_and_sibling_survival", nexstar_guider_first_and_sibling_survival },
		{ "nexstar_idle_transport_loss_recovers", nexstar_idle_transport_loss_recovers },
		{ "nexstar_active_transport_loss_recovers", nexstar_active_transport_loss_recovers },
		{ "nexstar_park_abort_allows_new_motion", nexstar_park_abort_allows_new_motion },
		{ "nexstar_pending_park_loss_recovers", nexstar_pending_park_loss_recovers },
		{ "nexstar_pending_guide_loss_recovers", nexstar_pending_guide_loss_recovers },
		{ "nexstar_guider_transport_edge_timing", nexstar_guider_transport_edge_timing }
	};
	int result = 2;
	if (!strcmp(argv[1], "--list")) {
		for (int i = 0; i < ARRAY_SIZE(cases); i++) {
			bool equatorial_axis = !strcmp(cases[i].name, "nexstar_mechanical_axis_index_and_timed_motion") || !strcmp(cases[i].name, "nexstar_st4_rates_read_back");
			bool cgem_only = !strcmp(cases[i].name, "nexstar_cgem_documented_higher_manual_rates");
			bool avx_cgx_only = !strcmp(cases[i].name, "nexstar_avx_cgx_documented_manual_rates");
			bool se_only = !strcmp(cases[i].name, "nexstar_se_documented_manual_rates") || !strcmp(cases[i].name, "nexstar_se_axis_index_and_timed_motion");
			if ((!equatorial_axis || !strcmp(model->selection, "CGE") || !strcmp(model->selection, "CGEM") || !strcmp(model->selection, "AVX") || !strcmp(model->selection, "CGX")) && (!cgem_only || !strcmp(model->selection, "CGEM")) && (!avx_cgx_only || !strcmp(model->selection, "AVX") || !strcmp(model->selection, "CGX")) && (!se_only || !strcmp(model->selection, "SE")) && (model->gps || strcmp(cases[i].name, "nexstar_gps_fix_and_shared_lifetime"))) {
				puts(cases[i].name);
			}
		}
		result = 0;
	} else {
		fprintf(stderr, "MountSim %s (%s) NexStar acceptance\n", getenv("MOUNTSIM_VERSION") ? getenv("MOUNTSIM_VERSION") : "unknown", model->selection);
		for (int i = 0; i < ARRAY_SIZE(cases); i++) {
			if (!strcmp(argv[1], cases[i].name)) {
				previous_update = simulator_test_client.update_property;
				simulator_test_client.update_property = observe_update;
				result = indigo_run_tests("NexStar MountSim acceptance", cases + i, 1);
				simulator_test_client.update_property = previous_update;
				break;
			}
		}
	}
	indigo_test_remove_private_home();
	return result;
}
