// Copyright (c) 2026 INDIGO initiative
// All rights reserved.
//
// You may use this software under the terms of 'INDIGO Astronomy
// open-source license' (see LICENSE.md).
//
// THIS SOFTWARE IS PROVIDED BY THE AUTHORS 'AS IS' AND ANY EXPRESS
// OR IMPLIED WARRANTIES, INCLUDING, BUT NOT LIMITED TO, THE IMPLIED
// WARRANTIES OF MERCHANTABILITY AND FITNESS FOR A PARTICULAR PURPOSE
// ARE DISCLAIMED. IN NO EVENT SHALL THE AUTHOR BE LIABLE FOR ANY
// DIRECT, INDIRECT, INCIDENTAL, SPECIAL, EXEMPLARY, OR CONSEQUENTIAL
// DAMAGES (INCLUDING, BUT NOT LIMITED TO, PROCUREMENT OF SUBSTITUTE
// GOODS OR SERVICES; LOSS OF USE, DATA, OR PROFITS; OR BUSINESS
// INTERRUPTION) HOWEVER CAUSED AND ON ANY THEORY OF LIABILITY,
// WHETHER IN CONTRACT, STRICT LIABILITY, OR TORT (INCLUDING
// NEGLIGENCE OR OTHERWISE) ARISING IN ANY WAY OUT OF THE USE OF THIS
// SOFTWARE, EVEN IF ADVISED OF THE POSSIBILITY OF SUCH DAMAGE.

// Code is generated by AI

#include <indigo_drivers/mount_ioptron/indigo_mount_ioptron.h>
#include <indigo/indigo_align.h>
#include "mountsim_test_common.h"
static const simulator_driver_case ioptron_mount = {
	"iOptron Mount",
	"indigo_mount_ioptron",
	"iOptron Mount",
	indigo_mount_ioptron,
	false,
	NULL, 0, NULL, 0, NULL, 0, NULL, 0
};

static const simulator_driver_case ioptron_guider = {
	"iOptron Mount (guider)",
	"indigo_mount_ioptron",
	"iOptron Mount (guider)",
	indigo_mount_ioptron,
	false,
	NULL, 0, NULL, 0, NULL, 0, NULL, 0
};

static bool io_switch(const simulator_driver_case *device, const char *property, const char *item, bool value, indigo_property_state state) {
	unsigned int revision = property_revision(property);
	return indigo_change_switch_property_1(&simulator_test_client, device->device_name, property, item, value) == INDIGO_OK && wait_for_property_state_seen_after(property, state, revision);
}

static bool io_number(const simulator_driver_case *device, const char *property, const char *item, double value, indigo_property_state state) {
	unsigned int revision = property_revision(property);
	return indigo_change_number_property_1(&simulator_test_client, device->device_name, property, item, value) == INDIGO_OK && wait_for_property_state_seen_after(property, state, revision);
}

static bool io_numbers(const simulator_driver_case *device, const char *property, const char *item1, double value1, const char *item2, double value2, indigo_property_state state) {
	unsigned int revision = property_revision(property);
	const char *items[] = { item1, item2 };
	double values[] = { value1, value2 };
	return indigo_change_number_property(&simulator_test_client, device->device_name, property, 2, items, values) == INDIGO_OK && wait_for_property_state_seen_after(property, state, revision);
}

static bool io_coordinates(double ra, double dec, indigo_property_state state) {
	return io_numbers(&ioptron_mount, MOUNT_EQUATORIAL_COORDINATES_PROPERTY_NAME, MOUNT_EQUATORIAL_COORDINATES_RA_ITEM_NAME, ra, MOUNT_EQUATORIAL_COORDINATES_DEC_ITEM_NAME, dec, state);
}

static bool io_sync(double ra, double dec, indigo_property_state state) {
	return io_switch(&ioptron_mount, MOUNT_ON_COORDINATES_SET_PROPERTY_NAME, MOUNT_ON_COORDINATES_SET_SYNC_ITEM_NAME, true, INDIGO_OK_STATE) && io_coordinates(ra, dec, state);
}

static bool io_goto(double ra, double dec, indigo_property_state state) {
	return io_switch(&ioptron_mount, MOUNT_ON_COORDINATES_SET_PROPERTY_NAME, MOUNT_ON_COORDINATES_SET_TRACK_ITEM_NAME, true, INDIGO_OK_STATE) && io_coordinates(ra, dec, state);
}

static bool io_utc(const char *time, const char *offset, indigo_property_state state) {
	unsigned int revision = property_revision(UTC_TIME_PROPERTY_NAME);
	const char *items[] = { UTC_TIME_ITEM_NAME, UTC_OFFSET_ITEM_NAME };
	const char *values[] = { time, offset };
	return indigo_change_text_property(&simulator_test_client, ioptron_mount.device_name, UTC_TIME_PROPERTY_NAME, 2, items, values) == INDIGO_OK && wait_for_property_state_seen_after(UTC_TIME_PROPERTY_NAME, state, revision);
}

static bool io_site(double latitude, double longitude, indigo_property_state state) {
	unsigned int revision = property_revision(GEOGRAPHIC_COORDINATES_PROPERTY_NAME);
	const char *items[] = { GEOGRAPHIC_COORDINATES_LATITUDE_ITEM_NAME, GEOGRAPHIC_COORDINATES_LONGITUDE_ITEM_NAME };
	double values[] = { latitude, longitude };
	return indigo_change_number_property(&simulator_test_client, ioptron_mount.device_name, GEOGRAPHIC_COORDINATES_PROPERTY_NAME, 2, items, values) == INDIGO_OK && wait_for_property_state_seen_after(GEOGRAPHIC_COORDINATES_PROPERTY_NAME, state, revision);
}

static bool switch_value(const char *property, const char *item) {
	indigo_item *cached = find_cached_item(property, item);
	return cached != NULL && cached->sw.value;
}

static bool wait_switch(const char *property, const char *item, bool value) {
	for (int i = 0; i < 100; i++) {
		if (switch_value(property, item) == value) {
			return true;
		}
		indigo_usleep(100000);
	}
	return false;
}

static double number_value(const char *property, const char *item) {
	indigo_item *cached = find_cached_item(property, item);
	return cached != NULL ? cached->number.value : NAN;
}

// Waits until value - reference exceeds delta (or falls below -delta when delta < 0).
static bool wait_number_change(const char *property, const char *item, double reference, double delta) {
	for (int i = 0; i < 100; i++) {
		double change = number_value(property, item) - reference;
		if ((delta > 0 && change > delta) || (delta < 0 && change < delta)) {
			return true;
		}
		indigo_usleep(100000);
	}
	fprintf(stderr, "  %s.%s did not change by %g from %g (now %g)\n", property, item, delta, reference, number_value(property, item));
	return false;
}

// Samples a readback over milliseconds and requires it to stay within tolerance.
static bool number_stays(const char *property, const char *item, double tolerance, int milliseconds) {
	double reference = number_value(property, item);
	for (int elapsed = 0; elapsed < milliseconds; elapsed += 100) {
		indigo_usleep(100000);
		if (fabs(number_value(property, item) - reference) > tolerance) {
			fprintf(stderr, "  %s.%s moved from %g to %g\n", property, item, reference, number_value(property, item));
			return false;
		}
	}
	return true;
}

static uint64_t io_monotonic_ns(void) {
#if defined(__APPLE__)
	return clock_gettime_nsec_np(CLOCK_MONOTONIC);
#else
	struct timespec now;
	clock_gettime(CLOCK_MONOTONIC, &now);
	return (uint64_t)now.tv_sec * 1000000000 + now.tv_nsec;
#endif
}

static atomic_uint_fast64_t guide_completed[2];
static atomic_uint_fast64_t guide_alerted[2];
static atomic_uint_fast64_t coordinates_ok_after;

static indigo_result timed_client_update(indigo_client *client, indigo_device *device, indigo_property *property, const char *message) {
	if (!strcmp(property->device, ioptron_guider.device_name)) {
		int axis = !strcmp(property->name, GUIDER_GUIDE_RA_PROPERTY_NAME) ? 0 : !strcmp(property->name, GUIDER_GUIDE_DEC_PROPERTY_NAME) ? 1 : -1;
		if (axis >= 0 && property->state == INDIGO_OK_STATE) {
			atomic_store(guide_completed + axis, io_monotonic_ns());
		} else if (axis >= 0 && property->state == INDIGO_ALERT_STATE) {
			atomic_store(guide_alerted + axis, io_monotonic_ns());
		}
	} else if (!strcmp(property->device, ioptron_mount.device_name) && !strcmp(property->name, MOUNT_EQUATORIAL_COORDINATES_PROPERTY_NAME) && property->state == INDIGO_OK_STATE) {
		uint_fast64_t expected = 0;
		atomic_compare_exchange_strong(&coordinates_ok_after, &expected, io_monotonic_ns());
	}
	return simulator_client_update_property(client, device, property, message);
}

static bool wait_motion(const char *property) {
	for (int i = 0; i < 600; i++) {
		indigo_property *p = find_cached_property(property);
		if (p && p->state == INDIGO_OK_STATE) { return true; }
		if (p && p->state == INDIGO_ALERT_STATE) { return false; }
		indigo_usleep(100000);
	}
	return false;
}

static bool start_mount(external_serial_simulator *session) {
	simulator_test_client.update_property = timed_client_update;
	return mountsim_attach(session) && start_serial_driver(&ioptron_mount, session->port) && io_number(&ioptron_mount, MOUNT_EPOCH_PROPERTY_NAME, MOUNT_EPOCH_ITEM_NAME, 0, INDIGO_OK_STATE) && io_site(48, 17, INDIGO_OK_STATE);
}

static void ioptron_identity_reconnect(void) {
	external_serial_simulator session = { 0 };
	SERIAL_CHECK_TRUE(start_mount(&session));
	assert_device_interface(INDIGO_INTERFACE_MOUNT);
	SERIAL_CHECK_EQ_INT(0, context.update_without_define_count);
	SERIAL_CHECK_TRUE(wait_for_property_state(MOUNT_EQUATORIAL_COORDINATES_PROPERTY_NAME, INDIGO_OK_STATE));
	SERIAL_CHECK_TRUE(wait_for_property_state(MOUNT_TRACK_RATE_PROPERTY_NAME, INDIGO_OK_STATE));
	SERIAL_CHECK_TRUE(wait_for_property_state(MOUNT_GUIDE_RATE_PROPERTY_NAME, INDIGO_OK_STATE));
	fprintf(stdout, "IDENTITY %s %s\n", find_cached_item(MOUNT_INFO_PROPERTY_NAME, MOUNT_INFO_MODEL_ITEM_NAME)->text.value, find_cached_item(MOUNT_INFO_PROPERTY_NAME, MOUNT_INFO_FIRMWARE_ITEM_NAME)->text.value);
	disconnect_serial_device(&ioptron_mount);
	SERIAL_CHECK_TRUE(connect_serial_device(&ioptron_mount, session.port));
	SERIAL_CHECK_TRUE(wait_for_property_state(MOUNT_EQUATORIAL_COORDINATES_PROPERTY_NAME, INDIGO_OK_STATE));
cleanup:
	if (context.connected) { stop_serial_driver(&ioptron_mount); }
}

static void ioptron_sync_goto_abort(void) {
	external_serial_simulator session = { 0 };
	SERIAL_CHECK_TRUE(start_mount(&session));
	double ra = number_value(MOUNT_LST_TIME_PROPERTY_NAME, MOUNT_LST_TIME_ITEM_NAME) - 1;
	if (ra < 0) { ra += 24; }
	SERIAL_CHECK_TRUE(io_sync(ra, 35.25, INDIGO_OK_STATE));
	SERIAL_CHECK_TRUE(wait_for_number_item_value(MOUNT_EQUATORIAL_COORDINATES_PROPERTY_NAME, MOUNT_EQUATORIAL_COORDINATES_RA_ITEM_NAME, ra, 0.01));
	SERIAL_CHECK_TRUE(wait_for_number_item_value(MOUNT_EQUATORIAL_COORDINATES_PROPERTY_NAME, MOUNT_EQUATORIAL_COORDINATES_DEC_ITEM_NAME, 35.25, 0.01));
	SERIAL_CHECK_TRUE(io_goto(ra + 0.05, 36, INDIGO_BUSY_STATE));
	SERIAL_CHECK_TRUE(wait_for_property_state(MOUNT_EQUATORIAL_COORDINATES_PROPERTY_NAME, INDIGO_OK_STATE));
	SERIAL_CHECK_TRUE(wait_for_number_item_value(MOUNT_EQUATORIAL_COORDINATES_PROPERTY_NAME, MOUNT_EQUATORIAL_COORDINATES_RA_ITEM_NAME, ra + 0.05, 0.01));
	SERIAL_CHECK_TRUE(wait_for_number_item_value(MOUNT_EQUATORIAL_COORDINATES_PROPERTY_NAME, MOUNT_EQUATORIAL_COORDINATES_DEC_ITEM_NAME, 36, 0.02));
	SERIAL_CHECK_TRUE(io_goto(ra + 1, 50, INDIGO_BUSY_STATE));
	SERIAL_CHECK_TRUE(io_switch(&ioptron_mount, MOUNT_ABORT_MOTION_PROPERTY_NAME, MOUNT_ABORT_MOTION_ITEM_NAME, true, INDIGO_OK_STATE));
	SERIAL_CHECK_TRUE(io_sync(ra, -0.5, INDIGO_OK_STATE));
	SERIAL_CHECK_TRUE(wait_for_number_item_value(MOUNT_EQUATORIAL_COORDINATES_PROPERTY_NAME, MOUNT_EQUATORIAL_COORDINATES_DEC_ITEM_NAME, -0.5, 0.01));
cleanup:
	if (context.connected) { stop_serial_driver(&ioptron_mount); }
}

static void ioptron_tracking_site_rates(void) {
	external_serial_simulator session = { 0 };
	SERIAL_CHECK_TRUE(start_mount(&session));
	SERIAL_CHECK_TRUE(io_site(48.25, 343.5, INDIGO_OK_STATE));
	SERIAL_CHECK_TRUE(io_utc("2026-09-23T12:34:56", "2", INDIGO_OK_STATE));
	const char *rates[] = { MOUNT_TRACK_RATE_SIDEREAL_ITEM_NAME, MOUNT_TRACK_RATE_SOLAR_ITEM_NAME, MOUNT_TRACK_RATE_LUNAR_ITEM_NAME, MOUNT_TRACK_RATE_KING_ITEM_NAME, MOUNT_TRACK_RATE_CUSTOM_ITEM_NAME };
	for (int i = 0; i < 5; i++) {
		SERIAL_CHECK_TRUE(io_switch(&ioptron_mount, MOUNT_TRACK_RATE_PROPERTY_NAME, rates[i], true, INDIGO_OK_STATE));
	}
	SERIAL_CHECK_TRUE(io_switch(&ioptron_mount, MOUNT_TRACKING_PROPERTY_NAME, MOUNT_TRACKING_ON_ITEM_NAME, true, INDIGO_OK_STATE));
	SERIAL_CHECK_TRUE(wait_switch(MOUNT_TRACKING_PROPERTY_NAME, MOUNT_TRACKING_ON_ITEM_NAME, true));
	SERIAL_CHECK_TRUE(io_switch(&ioptron_mount, MOUNT_TRACKING_PROPERTY_NAME, MOUNT_TRACKING_OFF_ITEM_NAME, true, INDIGO_OK_STATE));
	SERIAL_CHECK_TRUE(io_number(&ioptron_mount, MOUNT_GUIDE_RATE_PROPERTY_NAME, MOUNT_GUIDE_RATE_RA_ITEM_NAME, 70, INDIGO_OK_STATE));
	disconnect_serial_device(&ioptron_mount);
	SERIAL_CHECK_TRUE(connect_serial_device(&ioptron_mount, session.port));
	SERIAL_CHECK_TRUE(wait_for_number_item_value(GEOGRAPHIC_COORDINATES_PROPERTY_NAME, GEOGRAPHIC_COORDINATES_LATITUDE_ITEM_NAME, 48.25, 0.001));
	SERIAL_CHECK_TRUE(wait_for_number_item_value(GEOGRAPHIC_COORDINATES_PROPERTY_NAME, GEOGRAPHIC_COORDINATES_LONGITUDE_ITEM_NAME, 343.5, 0.001));
	SERIAL_CHECK_TRUE(wait_for_number_item_value(MOUNT_GUIDE_RATE_PROPERTY_NAME, MOUNT_GUIDE_RATE_RA_ITEM_NAME, 70, 0.1));
cleanup:
	if (context.connected) { stop_serial_driver(&ioptron_mount); }
}

static double last_command(const char *wanted) {
	char path[PATH_MAX], line[2048];
	if (!mountsim_trace_path(path, sizeof(path))) { return 0; }
	FILE *file = fopen(path, "r");
	if (!file) { return 0; }
	double found = 0;
	while (fgets(line, sizeof(line), file)) {
		char *cursor, *end, command[256];
		double timestamp = strtod(line, &cursor);
		int n = 0;
		while (n < 255) {
			unsigned long byte = strtoul(cursor, &end, 16);
			if (end == cursor) { break; }
			command[n++] = byte;
			cursor = end;
		}
		command[n] = 0;
		if (!strcmp(command, wanted)) { found = timestamp; }
	}
	fclose(file);
	return found;
}

static bool wait_command_after(const char *command, double previous) {
	for (int i = 0; i < 500; i++) {
		if (last_command(command) > previous) { return true; }
		indigo_usleep(10000);
	}
	return false;
}

static void ioptron_manual_motion(void) {
	external_serial_simulator session = { 0 };
	SERIAL_CHECK_TRUE(start_mount(&session));
	double ra = number_value(MOUNT_LST_TIME_PROPERTY_NAME, MOUNT_LST_TIME_ITEM_NAME);
	SERIAL_CHECK_TRUE(io_sync(ra, 35, INDIGO_OK_STATE));
	const char *rates[] = { MOUNT_SLEW_RATE_GUIDE_ITEM_NAME, MOUNT_SLEW_RATE_CENTERING_ITEM_NAME, MOUNT_SLEW_RATE_FIND_ITEM_NAME, MOUNT_SLEW_RATE_MAX_ITEM_NAME };
	const char *props[] = { MOUNT_MOTION_DEC_PROPERTY_NAME, MOUNT_MOTION_DEC_PROPERTY_NAME, MOUNT_MOTION_RA_PROPERTY_NAME, MOUNT_MOTION_RA_PROPERTY_NAME };
	const char *items[] = { MOUNT_MOTION_NORTH_ITEM_NAME, MOUNT_MOTION_SOUTH_ITEM_NAME, MOUNT_MOTION_EAST_ITEM_NAME, MOUNT_MOTION_WEST_ITEM_NAME };
	for (int rate = 0; rate < 4; rate++) {
		SERIAL_CHECK_TRUE(io_switch(&ioptron_mount, MOUNT_SLEW_RATE_PROPERTY_NAME, rates[rate], true, INDIGO_OK_STATE));
		for (int direction = 0; direction < 4; direction++) {
			const char *commands[] = { ":mn", ":ms", ":me", ":mw" };
			double previous = last_command(commands[direction]);
			SERIAL_CHECK_TRUE(io_switch(&ioptron_mount, props[direction], items[direction], true, INDIGO_BUSY_STATE));
			SERIAL_CHECK_TRUE(wait_command_after(commands[direction], previous));
			if (rate == 3) {
				const char *axis = direction < 2 ? MOUNT_EQUATORIAL_COORDINATES_DEC_ITEM_NAME : MOUNT_EQUATORIAL_COORDINATES_RA_ITEM_NAME;
				double before = number_value(MOUNT_EQUATORIAL_COORDINATES_PROPERTY_NAME, axis);
				SERIAL_CHECK_TRUE(wait_number_change(MOUNT_EQUATORIAL_COORDINATES_PROPERTY_NAME, axis, before, direction == 0 || direction == 2 ? .01 : -.01));
			}
			SERIAL_CHECK_TRUE(io_switch(&ioptron_mount, props[direction], items[direction], false, INDIGO_OK_STATE));
		}
	}
	SERIAL_CHECK_TRUE(io_sync(ra, 35, INDIGO_OK_STATE));
	SERIAL_CHECK_TRUE(io_switch(&ioptron_mount, MOUNT_SLEW_RATE_PROPERTY_NAME, MOUNT_SLEW_RATE_FIND_ITEM_NAME, true, INDIGO_OK_STATE));
	SERIAL_CHECK_TRUE(io_switch(&ioptron_mount, MOUNT_MOTION_DEC_PROPERTY_NAME, MOUNT_MOTION_NORTH_ITEM_NAME, true, INDIGO_BUSY_STATE));
	SERIAL_CHECK_TRUE(io_switch(&ioptron_mount, MOUNT_MOTION_RA_PROPERTY_NAME, MOUNT_MOTION_WEST_ITEM_NAME, true, INDIGO_BUSY_STATE));
	SERIAL_CHECK_TRUE(io_switch(&ioptron_mount, MOUNT_MOTION_RA_PROPERTY_NAME, MOUNT_MOTION_WEST_ITEM_NAME, false, INDIGO_OK_STATE));
	double dec = number_value(MOUNT_EQUATORIAL_COORDINATES_PROPERTY_NAME, MOUNT_EQUATORIAL_COORDINATES_DEC_ITEM_NAME);
	SERIAL_CHECK_TRUE(wait_number_change(MOUNT_EQUATORIAL_COORDINATES_PROPERTY_NAME, MOUNT_EQUATORIAL_COORDINATES_DEC_ITEM_NAME, dec, .01));
	SERIAL_CHECK_TRUE(io_switch(&ioptron_mount, MOUNT_ABORT_MOTION_PROPERTY_NAME, MOUNT_ABORT_MOTION_ITEM_NAME, true, INDIGO_OK_STATE));
	SERIAL_CHECK_TRUE(wait_for_property_not_busy(MOUNT_MOTION_DEC_PROPERTY_NAME));
cleanup:
	if (context.connected) { stop_serial_driver(&ioptron_mount); }
}

static void ioptron_park_home_options(void) {
	external_serial_simulator session = { 0 };
	SERIAL_CHECK_TRUE(start_mount(&session));
	double ra = number_value(MOUNT_LST_TIME_PROPERTY_NAME, MOUNT_LST_TIME_ITEM_NAME);
	SERIAL_CHECK_TRUE(io_sync(ra, 70, INDIGO_OK_STATE));
	if (has_defined_property(MOUNT_PARK_SET_PROPERTY_NAME)) {
		SERIAL_CHECK_TRUE(io_switch(&ioptron_mount, MOUNT_PARK_SET_PROPERTY_NAME, MOUNT_PARK_SET_CURRENT_ITEM_NAME, true, INDIGO_OK_STATE));
		SERIAL_CHECK_TRUE(io_sync(ra, 65, INDIGO_OK_STATE));
	}
	if (has_defined_property(MOUNT_PARK_PROPERTY_NAME)) {
		SERIAL_CHECK_TRUE(io_switch(&ioptron_mount, MOUNT_PARK_PROPERTY_NAME, MOUNT_PARK_PARKED_ITEM_NAME, true, INDIGO_BUSY_STATE));
		SERIAL_CHECK_TRUE(wait_motion(MOUNT_PARK_PROPERTY_NAME));
		if (has_defined_property(MOUNT_PARK_SET_PROPERTY_NAME)) {
			SERIAL_CHECK_TRUE(wait_for_number_item_value(MOUNT_EQUATORIAL_COORDINATES_PROPERTY_NAME, MOUNT_EQUATORIAL_COORDINATES_DEC_ITEM_NAME, 70, .2));
		}
		SERIAL_CHECK_TRUE(wait_switch(MOUNT_TRACKING_PROPERTY_NAME, MOUNT_TRACKING_OFF_ITEM_NAME, true));
		SERIAL_CHECK_TRUE(io_switch(&ioptron_mount, MOUNT_TRACKING_PROPERTY_NAME, MOUNT_TRACKING_ON_ITEM_NAME, true, INDIGO_ALERT_STATE));
		SERIAL_CHECK_TRUE(io_switch(&ioptron_mount, MOUNT_PARK_PROPERTY_NAME, MOUNT_PARK_UNPARKED_ITEM_NAME, true, INDIGO_OK_STATE));
	}
	if (has_defined_property(MOUNT_HOME_PROPERTY_NAME)) {
		SERIAL_CHECK_TRUE(io_switch(&ioptron_mount, MOUNT_HOME_PROPERTY_NAME, MOUNT_HOME_ITEM_NAME, true, INDIGO_BUSY_STATE));
		SERIAL_CHECK_TRUE(wait_motion(MOUNT_HOME_PROPERTY_NAME));
		SERIAL_CHECK_TRUE(wait_for_number_item_value(MOUNT_EQUATORIAL_COORDINATES_PROPERTY_NAME, MOUNT_EQUATORIAL_COORDINATES_DEC_ITEM_NAME, 90, .2));
	}
	if (has_defined_property(MOUNT_CUSTOM_TRACKING_RATE_PROPERTY_NAME)) {
		SERIAL_CHECK_TRUE(io_number(&ioptron_mount, MOUNT_CUSTOM_TRACKING_RATE_PROPERTY_NAME, MOUNT_CUSTOM_TRACKING_RATE_ITEM_NAME, 1.001, INDIGO_OK_STATE));
		SERIAL_CHECK_TRUE(io_switch(&ioptron_mount, MOUNT_TRACK_RATE_PROPERTY_NAME, MOUNT_TRACK_RATE_CUSTOM_ITEM_NAME, true, INDIGO_OK_STATE));
	}
	if (has_defined_property("MOUNT_MERIDIAN_HANDLING")) {
		SERIAL_CHECK_TRUE(io_switch(&ioptron_mount, "MOUNT_MERIDIAN_HANDLING", "FLIP", true, INDIGO_OK_STATE));
		SERIAL_CHECK_TRUE(io_number(&ioptron_mount, "MOUNT_MERIDIAN_LIMIT", "LIMIT", 5, INDIGO_OK_STATE));
		SERIAL_CHECK_TRUE(last_command(":SMT105") > 0);
	}
	if (has_defined_property(MOUNT_PEC_PROPERTY_NAME)) {
		SERIAL_CHECK_TRUE(io_switch(&ioptron_mount, MOUNT_PEC_PROPERTY_NAME, MOUNT_PEC_ENABLED_ITEM_NAME, true, INDIGO_OK_STATE));
		SERIAL_CHECK_TRUE(io_switch(&ioptron_mount, MOUNT_PEC_PROPERTY_NAME, MOUNT_PEC_DISABLED_ITEM_NAME, true, INDIGO_OK_STATE));
	}
cleanup:
	if (context.connected) { stop_serial_driver(&ioptron_mount); }
}

static void transport_loss(bool active) {
	external_serial_simulator session = { 0 };
	SERIAL_CHECK_TRUE(start_mount(&session));
	unsigned int revision = property_revision(MOUNT_EQUATORIAL_COORDINATES_PROPERTY_NAME);
	SERIAL_CHECK_TRUE(wait_for_property_state_after(MOUNT_EQUATORIAL_COORDINATES_PROPERTY_NAME, INDIGO_OK_STATE, revision));
	if (active) {
		SERIAL_CHECK_TRUE(io_switch(&ioptron_mount, MOUNT_MOTION_DEC_PROPERTY_NAME, MOUNT_MOTION_NORTH_ITEM_NAME, true, INDIGO_BUSY_STATE));
	}
	SERIAL_CHECK_TRUE(mountsim_transport(&session, false));
	SERIAL_CHECK_TRUE(wait_for_property_state(MOUNT_EQUATORIAL_COORDINATES_PROPERTY_NAME, INDIGO_ALERT_STATE) || !context.connected);
	disconnect_serial_device(&ioptron_mount);
	SERIAL_CHECK_TRUE(mountsim_transport(&session, true));
	SERIAL_CHECK_TRUE(connect_serial_device(&ioptron_mount, session.port));
	SERIAL_CHECK_TRUE(io_switch(&ioptron_mount, MOUNT_ABORT_MOTION_PROPERTY_NAME, MOUNT_ABORT_MOTION_ITEM_NAME, true, INDIGO_OK_STATE));
	SERIAL_CHECK_TRUE(io_switch(&ioptron_mount, MOUNT_TRACKING_PROPERTY_NAME, MOUNT_TRACKING_ON_ITEM_NAME, true, INDIGO_OK_STATE));
cleanup:
	if (context.connected) { stop_serial_driver(&ioptron_mount); }
}
static void ioptron_idle_transport_loss(void) { transport_loss(false); }
static void ioptron_active_transport_loss(void) { transport_loss(true); }

static void ioptron_guider_timing_and_shared_lifecycle(void) {
	external_serial_simulator session = { 0 };
	bool mount_connected = false;
	double errors[72], percentages[72];
	int samples = 0;
	SERIAL_CHECK_TRUE(mountsim_attach(&session));
	simulator_test_client.update_property = timed_client_update;
	SERIAL_CHECK_TRUE(start_shared_serial_device(&ioptron_guider, ioptron_mount.device_name, session.port));
	assert_device_interface(INDIGO_INTERFACE_GUIDER);
	const char *props[] = { GUIDER_GUIDE_DEC_PROPERTY_NAME, GUIDER_GUIDE_DEC_PROPERTY_NAME, GUIDER_GUIDE_RA_PROPERTY_NAME, GUIDER_GUIDE_RA_PROPERTY_NAME };
	const char *items[] = { GUIDER_GUIDE_NORTH_ITEM_NAME, GUIDER_GUIDE_SOUTH_ITEM_NAME, GUIDER_GUIDE_EAST_ITEM_NAME, GUIDER_GUIDE_WEST_ITEM_NAME };
	const char letters[] = "nsew";
	const int durations[] = { 20, 100, 500 };
	for (int workload = 0; workload < 2; workload++) {
		if (workload) {
			mount_connected = connect_serial_device(&ioptron_mount, NULL);
			SERIAL_CHECK_TRUE(mount_connected);
			SERIAL_CHECK_TRUE(io_switch(&ioptron_mount, MOUNT_TRACKING_PROPERTY_NAME, MOUNT_TRACKING_ON_ITEM_NAME, true, INDIGO_OK_STATE));
			reset_simulator_context(&ioptron_guider);
			enumerate_simulator_device();
		}
		for (int direction = 0; direction < 4; direction++) {
			for (int sample = -1; sample < 9; sample++) {
				int duration = sample < 0 ? 20 : durations[sample % 3];
				char command[32];
				snprintf(command, sizeof(command), ":M%c%05d", letters[direction], duration);
				int axis = direction < 2 ? 1 : 0;
				atomic_store(guide_completed + axis, 0);
				unsigned revision = property_revision(props[direction]);
				SERIAL_CHECK_TRUE(io_number(&ioptron_guider, props[direction], items[direction], duration, INDIGO_BUSY_STATE));
				SERIAL_CHECK_TRUE(wait_for_property_state_seen_after(props[direction], INDIGO_OK_STATE, revision));
				double entered = last_command(command), completed = atomic_load(guide_completed + axis) / 1e9;
				SERIAL_CHECK_TRUE(entered > 0 && completed >= entered && completed - entered < 5);
				SERIAL_CHECK_TRUE(number_value(props[direction], items[direction]) == 0);
				if (sample >= 0) {
					double error = (completed - entered) * 1000 - duration;
					errors[samples] = error;
					percentages[samples++] = error * 100 / duration;
					printf("PULSE %s %c requested=%d actual=%.3f error=%.3f ms\n", workload ? "tracking/polling" : "idle", letters[direction], duration, (completed - entered) * 1000, error);
				}
			}
		}
	}
	SERIAL_CHECK_TRUE(io_number(&ioptron_guider, GUIDER_GUIDE_DEC_PROPERTY_NAME, GUIDER_GUIDE_NORTH_ITEM_NAME, 1000, INDIGO_BUSY_STATE));
	SERIAL_CHECK_TRUE(io_number(&ioptron_guider, GUIDER_GUIDE_DEC_PROPERTY_NAME, GUIDER_GUIDE_SOUTH_ITEM_NAME, 100, INDIGO_OK_STATE));
	SERIAL_CHECK_TRUE(io_number(&ioptron_guider, GUIDER_GUIDE_RA_PROPERTY_NAME, GUIDER_GUIDE_EAST_ITEM_NAME, 200, INDIGO_BUSY_STATE));
	SERIAL_CHECK_TRUE(io_number(&ioptron_guider, GUIDER_GUIDE_DEC_PROPERTY_NAME, GUIDER_GUIDE_NORTH_ITEM_NAME, 100, INDIGO_OK_STATE));
	SERIAL_CHECK_TRUE(wait_for_property_state(GUIDER_GUIDE_RA_PROPERTY_NAME, INDIGO_OK_STATE));
	disconnect_serial_device(&ioptron_guider);
	reset_simulator_context(&ioptron_mount);
	enumerate_simulator_device();
	SERIAL_CHECK_TRUE(io_switch(&ioptron_mount, MOUNT_TRACKING_PROPERTY_NAME, MOUNT_TRACKING_OFF_ITEM_NAME, true, INDIGO_OK_STATE));
	SERIAL_CHECK_TRUE(connect_serial_device(&ioptron_guider, NULL));
	disconnect_serial_device(&ioptron_mount);
	mount_connected = false;
	reset_simulator_context(&ioptron_guider);
	enumerate_simulator_device();
	SERIAL_CHECK_TRUE(io_number(&ioptron_guider, GUIDER_GUIDE_RA_PROPERTY_NAME, GUIDER_GUIDE_WEST_ITEM_NAME, 20, INDIGO_OK_STATE));
	SERIAL_CHECK_TRUE(io_number(&ioptron_guider, GUIDER_GUIDE_RA_PROPERTY_NAME, GUIDER_GUIDE_WEST_ITEM_NAME, 2000, INDIGO_BUSY_STATE));
	disconnect_serial_device(&ioptron_guider);
	SERIAL_CHECK_TRUE(connect_serial_device(&ioptron_guider, NULL));
	SERIAL_CHECK_TRUE(io_number(&ioptron_guider, GUIDER_GUIDE_RA_PROPERTY_NAME, GUIDER_GUIDE_EAST_ITEM_NAME, 20, INDIGO_OK_STATE));
	for (int i = 0; i < samples; i++) {
		for (int j = i + 1; j < samples; j++) {
			if (errors[j] < errors[i]) { double swap = errors[i]; errors[i] = errors[j]; errors[j] = swap; }
		}
	}
	double sum = 0, square = 0, absolute = 0, percent_sum = 0, percent_max = 0;
	for (int i = 0; i < samples; i++) {
		sum += errors[i]; square += errors[i] * errors[i]; absolute = fmax(absolute, fabs(errors[i])); percent_sum += percentages[i]; percent_max = fmax(percent_max, fabs(percentages[i]));
	}
	printf("TIMING n=%d min=%.3f mean=%.3f median=%.3f p95=%.3f p99=%.3f max=%.3f stddev=%.3f max_abs=%.3f ms signed_mean_percent=%.3f max_abs_percent=%.3f\n", samples, errors[0], sum / samples, (errors[35] + errors[36]) / 2, errors[68], errors[71], errors[71], sqrt(fmax(0, square / samples - sum * sum / samples / samples)), absolute, percent_sum / samples, percent_max);
cleanup:
	if (mount_connected) { disconnect_serial_device(&ioptron_mount); }
	reset_simulator_context(&ioptron_guider);
	enumerate_simulator_device();
	stop_serial_driver(&ioptron_guider);
}

int main(int argc, char **argv) {
	if (!indigo_test_use_private_home()) {
		return 2;
	}
	setvbuf(stdout, NULL, _IONBF, 0);
	if (getenv("MOUNTSIM_DEBUG") != NULL) {
		indigo_set_log_level(INDIGO_LOG_DEBUG);
	}
	const indigo_test_case tests[] = {
		{ "ioptron_guider_timing_and_shared_lifecycle", ioptron_guider_timing_and_shared_lifecycle },
		{ "ioptron_active_transport_loss", ioptron_active_transport_loss },
		{ "ioptron_idle_transport_loss", ioptron_idle_transport_loss },
		{ "ioptron_park_home_options", ioptron_park_home_options },
		{ "ioptron_manual_motion", ioptron_manual_motion },
		{ "ioptron_identity_reconnect", ioptron_identity_reconnect },
		{ "ioptron_sync_goto_abort", ioptron_sync_goto_abort },
		{ "ioptron_tracking_site_rates", ioptron_tracking_site_rates },
	};
	int result = 2;
	if (argc == 2 && !strcmp(argv[1], "--list")) {
		for (int i = 0; i < ARRAY_SIZE(tests); i++) {
			puts(tests[i].name);
		}
		result = 0;
	} else if (argc == 2) {
		for (int i = 0; i < ARRAY_SIZE(tests); i++) {
			if (!strcmp(argv[1], tests[i].name)) {
				result = indigo_run_tests("MountSim 2.3 (iOptron)", tests + i, 1);
				break;
			}
		}
	}
	indigo_test_remove_private_home();
	return result;
}
