// Copyright (c) 2026 INDIGO initiative
// All rights reserved.
//
// You may use this software under the terms of 'INDIGO Astronomy
// open-source license' (see LICENSE.md).
//
// THIS SOFTWARE IS PROVIDED BY THE AUTHORS 'AS IS' AND ANY EXPRESS
// OR IMPLIED WARRANTIES, INCLUDING, BUT NOT LIMITED TO, THE IMPLIED
// WARRANTIES OF MERCHANTABILITY AND FITNESS FOR A PARTICULAR PURPOSE
// ARE DISCLAIMED. IN NO EVENT SHALL THE AUTHOR BE LIABLE FOR ANY
// DIRECT, INDIRECT, INCIDENTAL, SPECIAL, EXEMPLARY, OR CONSEQUENTIAL
// DAMAGES (INCLUDING, BUT NOT LIMITED TO, PROCUREMENT OF SUBSTITUTE
// GOODS OR SERVICES; LOSS OF USE, DATA, OR PROFITS; OR BUSINESS
// INTERRUPTION) HOWEVER CAUSED AND ON ANY THEORY OF LIABILITY,
// WHETHER IN CONTRACT, STRICT LIABILITY, OR TORT (INCLUDING
// NEGLIGENCE OR OTHERWISE) ARISING IN ANY WAY OUT OF THE USE OF THIS
// SOFTWARE, EVEN IF ADVISED OF THE POSSIBILITY OF SUCH DAMAGE.

// Code is generated by AI

#include <indigo_drivers/mount_rainbow/indigo_mount_rainbow.h>

#include "mountsim_test_common.h"
#include <indigo/indigo_align.h>

static const simulator_driver_case rainbow_mount = {
	"RainbowAstro Mount", "indigo_mount_rainbow", "RainbowAstro Mount", indigo_mount_rainbow, false,
	NULL, 0, NULL, 0, NULL, 0, NULL, 0
};

static int count_event_prefixes(const external_serial_simulator *simulator, const char *kind, const char *value) {
	(void)simulator;
	(void)kind;
	char path[PATH_MAX], line[1024];
	if (!mountsim_trace_path(path, sizeof(path))) {
		return 0;
	}
	FILE *file = fopen(path, "r");
	if (file == NULL) {
		return 0;
	}
	int count = 0;
	while (fgets(line, sizeof(line), file)) {
		char *cursor, *end;
		strtod(line, &cursor);
		char command[256];
		size_t n = 0;
		while (n < sizeof(command) - 1) {
			unsigned long byte = strtoul(cursor, &end, 16);
			if (end == cursor) {
				break;
			}
			command[n++] = byte;
			cursor = end;
		}
		command[n] = 0;
		count += command[0] == ':' && !strncmp(command + 1, value, strlen(value));
	}
	fclose(file);
	return count;
}

static int count_events(const external_serial_simulator *simulator, const char *kind, const char *value) {
	// Include the terminating NUL to distinguish a command from its argument prefix.
	(void)simulator;
	(void)kind;
	char path[PATH_MAX], line[1024];
	if (!mountsim_trace_path(path, sizeof(path))) {
		return 0;
	}
	FILE *file = fopen(path, "r");
	if (file == NULL) {
		return 0;
	}
	int count = 0;
	while (fgets(line, sizeof(line), file)) {
		char *cursor, *end;
		strtod(line, &cursor);
		char command[256];
		size_t n = 0;
		while (n < sizeof(command) - 1) {
			unsigned long byte = strtoul(cursor, &end, 16);
			if (end == cursor) {
				break;
			}
			command[n++] = byte;
			cursor = end;
		}
		command[n] = 0;
		count += command[0] == ':' && !strcmp(command + 1, value);
	}
	fclose(file);
	return count;
}

static bool wait_for_event_count(const external_serial_simulator *simulator, const char *kind, const char *value, int expected) {
	for (int i = 0; i < 100; i++) {
		if (count_events(simulator, kind, value) >= expected) {
			return true;
		}
		indigo_usleep(50000);
	}
	return false;
}

static bool start_rainbow(external_serial_simulator *simulator, const char *firmware) {
	(void)firmware;
	return mountsim_attach(simulator) && start_serial_driver(&rainbow_mount, simulator->port);
}

static bool change_switch_and_wait(const char *property, const char *item, bool value, indigo_property_state state) {
	unsigned int revision = property_revision(property);
	return indigo_change_switch_property_1(&simulator_test_client, rainbow_mount.device_name, property, item, value) == INDIGO_OK && wait_for_property_state_seen_after(property, state, revision);
}

static bool change_number_and_wait(const char *property, const char *item, double value, indigo_property_state state) {
	unsigned int revision = property_revision(property);
	return indigo_change_number_property_1(&simulator_test_client, rainbow_mount.device_name, property, item, value) == INDIGO_OK && wait_for_property_state_seen_after(property, state, revision);
}

static bool change_coordinates(double ra, double dec, indigo_property_state state) {
	const char *items[] = { MOUNT_EQUATORIAL_COORDINATES_RA_ITEM_NAME, MOUNT_EQUATORIAL_COORDINATES_DEC_ITEM_NAME };
	double values[] = { ra, dec };
	unsigned int revision = property_revision(MOUNT_EQUATORIAL_COORDINATES_PROPERTY_NAME);
	return indigo_change_number_property(&simulator_test_client, rainbow_mount.device_name, MOUNT_EQUATORIAL_COORDINATES_PROPERTY_NAME, ARRAY_SIZE(items), items, values) == INDIGO_OK && wait_for_property_state_seen_after(MOUNT_EQUATORIAL_COORDINATES_PROPERTY_NAME, state, revision);
}

static void rainbow_driver_info_and_property_inventory(void) {
	external_serial_simulator simulator = { 0 };
	static const char *required[] = { MOUNT_INFO_PROPERTY_NAME, MOUNT_LST_TIME_PROPERTY_NAME, MOUNT_SET_HOST_TIME_PROPERTY_NAME, MOUNT_PARK_PROPERTY_NAME, MOUNT_ON_COORDINATES_SET_PROPERTY_NAME, MOUNT_SLEW_RATE_PROPERTY_NAME, MOUNT_MOTION_DEC_PROPERTY_NAME, MOUNT_MOTION_RA_PROPERTY_NAME, MOUNT_TRACK_RATE_PROPERTY_NAME, MOUNT_TRACKING_PROPERTY_NAME, MOUNT_GUIDE_RATE_PROPERTY_NAME, GEOGRAPHIC_COORDINATES_PROPERTY_NAME, MOUNT_EQUATORIAL_COORDINATES_PROPERTY_NAME, MOUNT_HORIZONTAL_COORDINATES_PROPERTY_NAME, MOUNT_ABORT_MOTION_PROPERTY_NAME, MOUNT_EPOCH_PROPERTY_NAME, UTC_TIME_PROPERTY_NAME };
	static const char *hidden[] = { MOUNT_PARK_SET_PROPERTY_NAME, MOUNT_PARK_POSITION_PROPERTY_NAME, MOUNT_HOME_PROPERTY_NAME, MOUNT_HOME_SET_PROPERTY_NAME, MOUNT_HOME_POSITION_PROPERTY_NAME, MOUNT_CUSTOM_TRACKING_RATE_PROPERTY_NAME, MOUNT_RAW_COORDINATES_PROPERTY_NAME, MOUNT_SIDE_OF_PIER_PROPERTY_NAME, MOUNT_PEC_PROPERTY_NAME, MOUNT_PEC_TRAINING_PROPERTY_NAME };
	assert_simulator_driver_info(&rainbow_mount);
	SERIAL_CHECK_TRUE(start_rainbow(&simulator, "190402"));
	assert_device_interface(INDIGO_INTERFACE_MOUNT);
	SERIAL_CHECK_EQ_INT(0, context.update_without_define_count);
	assert_defined_properties(required, ARRAY_SIZE(required));
	assert_not_defined_properties(hidden, ARRAY_SIZE(hidden));
	SERIAL_CHECK_EQ_INT(1, find_cached_property(MOUNT_GUIDE_RATE_PROPERTY_NAME)->count);
	SERIAL_CHECK_EQ_INT(1, find_cached_property(MOUNT_PARK_PROPERTY_NAME)->count);
	SERIAL_CHECK_EQ_INT(2, find_cached_property(MOUNT_ON_COORDINATES_SET_PROPERTY_NAME)->count);
	SERIAL_CHECK_TRUE(!strcmp(find_cached_item(MOUNT_INFO_PROPERTY_NAME, MOUNT_INFO_VENDOR_ITEM_NAME)->text.value, "RainbowAstro"));
	SERIAL_CHECK_TRUE(!strcmp(find_cached_item(MOUNT_INFO_PROPERTY_NAME, MOUNT_INFO_FIRMWARE_ITEM_NAME)->text.value, "190402"));
	SERIAL_CHECK_TRUE(wait_for_number_item_value(MOUNT_GUIDE_RATE_PROPERTY_NAME, MOUNT_GUIDE_RATE_RA_ITEM_NAME, 50, 0.01));
	SERIAL_CHECK_TRUE(wait_for_number_item_value(MOUNT_EPOCH_PROPERTY_NAME, MOUNT_EPOCH_ITEM_NAME, 2000, 0));
	SERIAL_CHECK_EQ_INT(INDIGO_RO_PERM, find_cached_property(MOUNT_EPOCH_PROPERTY_NAME)->perm);
cleanup:
	if (context.connected) {
		stop_serial_driver(&rainbow_mount);
	}
}

static void rainbow_uses_legacy_firmware_protocol(void) {
	external_serial_simulator simulator = { 0 };
	SERIAL_CHECK_TRUE(start_rainbow(&simulator, "190402"));
	SERIAL_CHECK_TRUE(!strcmp(find_cached_item(MOUNT_INFO_PROPERTY_NAME, MOUNT_INFO_FIRMWARE_ITEM_NAME)->text.value, "190402"));
	SERIAL_CHECK_EQ_INT(0, count_events(&simulator, "CMD", "GC"));
	SERIAL_CHECK_EQ_INT(0, count_events(&simulator, "CMD", "GG"));
	SERIAL_CHECK_TRUE(change_switch_and_wait(MOUNT_MOTION_RA_PROPERTY_NAME, MOUNT_MOTION_EAST_ITEM_NAME, true, INDIGO_OK_STATE));
	SERIAL_CHECK_TRUE(change_switch_and_wait(MOUNT_MOTION_RA_PROPERTY_NAME, MOUNT_MOTION_EAST_ITEM_NAME, false, INDIGO_OK_STATE));
	SERIAL_CHECK_TRUE(wait_for_event_count(&simulator, "CMD", "Q", 1));
	SERIAL_CHECK_TRUE(change_switch_and_wait(MOUNT_MOTION_DEC_PROPERTY_NAME, MOUNT_MOTION_NORTH_ITEM_NAME, true, INDIGO_OK_STATE));
	SERIAL_CHECK_TRUE(change_switch_and_wait(MOUNT_MOTION_DEC_PROPERTY_NAME, MOUNT_MOTION_NORTH_ITEM_NAME, false, INDIGO_OK_STATE));
	SERIAL_CHECK_TRUE(wait_for_event_count(&simulator, "CMD", "Q", 2));
cleanup:
	if (context.connected) {
		stop_serial_driver(&rainbow_mount);
	}
}

static void rainbow_tracks_and_selects_every_rate(void) {
	external_serial_simulator simulator = { 0 };
	static const char *items[] = { MOUNT_TRACK_RATE_SIDEREAL_ITEM_NAME, MOUNT_TRACK_RATE_SOLAR_ITEM_NAME, MOUNT_TRACK_RATE_LUNAR_ITEM_NAME };
	static const char *commands[] = { "CtR", "CtS", "CtM" };
	SERIAL_CHECK_TRUE(start_rainbow(&simulator, "190402"));
	SERIAL_CHECK_TRUE(change_switch_and_wait(MOUNT_TRACKING_PROPERTY_NAME, MOUNT_TRACKING_ON_ITEM_NAME, true, INDIGO_OK_STATE));
	SERIAL_CHECK_TRUE(wait_for_event_count(&simulator, "CMD", "CtA", 1));
	SERIAL_CHECK_TRUE(change_switch_and_wait(MOUNT_TRACKING_PROPERTY_NAME, MOUNT_TRACKING_OFF_ITEM_NAME, true, INDIGO_OK_STATE));
	SERIAL_CHECK_TRUE(wait_for_event_count(&simulator, "CMD", "CtL", 1));
	for (int i = 0; i < ARRAY_SIZE(items); i++) {
		int command_count = count_events(&simulator, "CMD", commands[i]);
		SERIAL_CHECK_TRUE(change_switch_and_wait(MOUNT_TRACK_RATE_PROPERTY_NAME, items[i], true, INDIGO_OK_STATE));
		SERIAL_CHECK_TRUE(wait_for_event_count(&simulator, "CMD", commands[i], command_count + 1));
		unsigned int revision = property_revision(MOUNT_TRACK_RATE_PROPERTY_NAME);
		SERIAL_CHECK_TRUE(wait_for_property_state_after(MOUNT_TRACK_RATE_PROPERTY_NAME, INDIGO_OK_STATE, revision));
		assert_switch_item_value(MOUNT_TRACK_RATE_PROPERTY_NAME, items[i], true);
	}
	SERIAL_CHECK_TRUE(change_number_and_wait(MOUNT_GUIDE_RATE_PROPERTY_NAME, MOUNT_GUIDE_RATE_RA_ITEM_NAME, 70, INDIGO_OK_STATE));
	SERIAL_CHECK_TRUE(wait_for_event_count(&simulator, "CMD", "Cu0=0.7", 1));
	disconnect_serial_device(&rainbow_mount);
	SERIAL_CHECK_TRUE(connect_serial_device(&rainbow_mount, simulator.port));
	SERIAL_CHECK_TRUE(wait_for_number_item_value(MOUNT_GUIDE_RATE_PROPERTY_NAME, MOUNT_GUIDE_RATE_RA_ITEM_NAME, 70, 0.1));
cleanup:
	if (context.connected) {
		stop_serial_driver(&rainbow_mount);
	}
}

static void rainbow_manual_motion_covers_all_rates_axes_and_stops(void) {
	external_serial_simulator simulator = { 0 };
	static const char *rate_items[] = { MOUNT_SLEW_RATE_GUIDE_ITEM_NAME, MOUNT_SLEW_RATE_CENTERING_ITEM_NAME, MOUNT_SLEW_RATE_FIND_ITEM_NAME, MOUNT_SLEW_RATE_MAX_ITEM_NAME };
	static const char *rate_commands[] = { "RG", "RC", "RM", "RS" };
	static const char *properties[] = { MOUNT_MOTION_DEC_PROPERTY_NAME, MOUNT_MOTION_DEC_PROPERTY_NAME, MOUNT_MOTION_RA_PROPERTY_NAME, MOUNT_MOTION_RA_PROPERTY_NAME };
	static const char *items[] = { MOUNT_MOTION_NORTH_ITEM_NAME, MOUNT_MOTION_SOUTH_ITEM_NAME, MOUNT_MOTION_WEST_ITEM_NAME, MOUNT_MOTION_EAST_ITEM_NAME };
	static const char *commands[] = { "Mn", "Ms", "Mw", "Me" };
	SERIAL_CHECK_TRUE(start_rainbow(&simulator, "190402"));
	for (int rate = 0; rate < ARRAY_SIZE(rate_items); rate++) {
		SERIAL_CHECK_TRUE(change_switch_and_wait(MOUNT_SLEW_RATE_PROPERTY_NAME, rate_items[rate], true, INDIGO_OK_STATE));
		for (int motion = 0; motion < ARRAY_SIZE(items); motion++) {
			int rate_count = count_events(&simulator, "CMD", rate_commands[rate]);
			int motion_count = count_events(&simulator, "CMD", commands[motion]);
			SERIAL_CHECK_TRUE(change_switch_and_wait(properties[motion], items[motion], true, INDIGO_OK_STATE));
			SERIAL_CHECK_TRUE(wait_for_event_count(&simulator, "CMD", rate_commands[rate], rate_count + 1));
			SERIAL_CHECK_TRUE(wait_for_event_count(&simulator, "CMD", commands[motion], motion_count + 1));
			SERIAL_CHECK_TRUE(change_switch_and_wait(properties[motion], items[motion], false, INDIGO_OK_STATE));
		}
	}
	SERIAL_CHECK_TRUE(wait_for_event_count(&simulator, "CMD", "Q", 16));
	SERIAL_CHECK_TRUE(wait_for_event_count(&simulator, "CMD", "Q", 16));
	SERIAL_CHECK_TRUE(wait_for_event_count(&simulator, "CMD", "Q", 16));
	SERIAL_CHECK_TRUE(wait_for_event_count(&simulator, "CMD", "Q", 16));
cleanup:
	if (context.connected) {
		stop_serial_driver(&rainbow_mount);
	}
}

static bool prepare_position(double *ra);

static void rainbow_park_completes_and_rejects_motion(void) {
	external_serial_simulator simulator = { 0 };
	SERIAL_CHECK_TRUE(start_rainbow(&simulator, "190402"));
	double ra;
	SERIAL_CHECK_TRUE(prepare_position(&ra));
	unsigned int revision = property_revision(MOUNT_PARK_PROPERTY_NAME);
	SERIAL_CHECK_EQ_INT(INDIGO_OK, indigo_change_switch_property_1(&simulator_test_client, rainbow_mount.device_name, MOUNT_PARK_PROPERTY_NAME, MOUNT_PARK_PARKED_ITEM_NAME, true));
	SERIAL_CHECK_TRUE(wait_for_property_state_seen_after(MOUNT_PARK_PROPERTY_NAME, INDIGO_BUSY_STATE, revision));
	for (int i = 0; i < 225 && find_cached_property(MOUNT_PARK_PROPERTY_NAME)->state == INDIGO_BUSY_STATE; i++) {
		indigo_usleep(200000);
	}
	SERIAL_CHECK_TRUE(wait_for_property_state_seen_after(MOUNT_PARK_PROPERTY_NAME, INDIGO_OK_STATE, revision));
	SERIAL_CHECK_TRUE(wait_for_number_item_value(MOUNT_EQUATORIAL_COORDINATES_PROPERTY_NAME, MOUNT_EQUATORIAL_COORDINATES_DEC_ITEM_NAME, 0, .01));
	indigo_usleep(1200000);
	assert_switch_item_value(MOUNT_TRACKING_PROPERTY_NAME, MOUNT_TRACKING_OFF_ITEM_NAME, true);
	time_t now = time(NULL);
	double ha = fmod(indigo_lst(&now, 17) - cached_number_value(MOUNT_EQUATORIAL_COORDINATES_PROPERTY_NAME, MOUNT_EQUATORIAL_COORDINATES_RA_ITEM_NAME) + 24, 24);
	SERIAL_CHECK_TRUE(fabs(ha - 6) < .01);
	assert_switch_item_value(MOUNT_PARK_PROPERTY_NAME, MOUNT_PARK_PARKED_ITEM_NAME, true);
	int north_count = count_events(&simulator, "CMD", "Mn");
	SERIAL_CHECK_TRUE(change_switch_and_wait(MOUNT_MOTION_DEC_PROPERTY_NAME, MOUNT_MOTION_NORTH_ITEM_NAME, true, INDIGO_ALERT_STATE));
	SERIAL_CHECK_EQ_INT(north_count, count_events(&simulator, "CMD", "Mn"));
cleanup:
	if (context.connected) {
		stop_serial_driver(&rainbow_mount);
	}
}

static void rainbow_reconnects_after_clean_disconnect(void) {
	external_serial_simulator simulator = { 0 };
	bool driver_up = false;
	SERIAL_CHECK_TRUE(mountsim_attach(&simulator));
	SERIAL_CHECK_TRUE(bring_up_serial_driver(&rainbow_mount));
	driver_up = true;
	SERIAL_CHECK_TRUE(connect_serial_device(&rainbow_mount, simulator.port));
	disconnect_serial_device(&rainbow_mount);
	indigo_usleep(500000);
	bool reconnected = indigo_change_switch_property_1(&simulator_test_client, rainbow_mount.device_name, CONNECTION_PROPERTY_NAME, CONNECTION_CONNECTED_ITEM_NAME, true) == INDIGO_OK && wait_for_simulator_connection_state(true);

	SERIAL_CHECK_TRUE(reconnected);
	SERIAL_CHECK_TRUE(wait_for_event_count(&simulator, "CMD", "AV", 4));
cleanup:
	if (context.connected) {
		disconnect_serial_device(&rainbow_mount);
	}
	if (driver_up) {
		tear_down_serial_driver(&rainbow_mount);
	}
}

static void rainbow_idle_transport_loss_and_recovery(void) {
	external_serial_simulator simulator = { 0 };
	SERIAL_CHECK_TRUE(start_rainbow(&simulator, "190402"));
	SERIAL_CHECK_TRUE(mountsim_transport(&simulator, false));
	unsigned int revision = property_revision(MOUNT_TRACKING_PROPERTY_NAME);
	SERIAL_CHECK_EQ_INT(INDIGO_OK, indigo_change_switch_property_1(&simulator_test_client, rainbow_mount.device_name, MOUNT_TRACKING_PROPERTY_NAME, MOUNT_TRACKING_ON_ITEM_NAME, true));
	SERIAL_CHECK_TRUE(wait_for_property_state_seen_after(MOUNT_TRACKING_PROPERTY_NAME, INDIGO_ALERT_STATE, revision));
	disconnect_serial_device(&rainbow_mount);
	SERIAL_CHECK_TRUE(mountsim_transport(&simulator, true));
	SERIAL_CHECK_TRUE(connect_serial_device(&rainbow_mount, simulator.port));
	SERIAL_CHECK_TRUE(change_switch_and_wait(MOUNT_TRACKING_PROPERTY_NAME, MOUNT_TRACKING_OFF_ITEM_NAME, true, INDIGO_OK_STATE));
	SERIAL_CHECK_TRUE(wait_for_event_count(&simulator, "CMD", "CtL", 1));
cleanup:
	if (context.connected) {
		stop_serial_driver(&rainbow_mount);
	}
}

static bool prepare_position(double *ra) {
	const char *items[] = { GEOGRAPHIC_COORDINATES_LATITUDE_ITEM_NAME, GEOGRAPHIC_COORDINATES_LONGITUDE_ITEM_NAME };
	double values[] = { 48, 17 };
	unsigned int revision = property_revision(GEOGRAPHIC_COORDINATES_PROPERTY_NAME);
	if (indigo_change_number_property(&simulator_test_client, rainbow_mount.device_name, GEOGRAPHIC_COORDINATES_PROPERTY_NAME, 2, items, values) != INDIGO_OK || !wait_for_property_state_seen_after(GEOGRAPHIC_COORDINATES_PROPERTY_NAME, INDIGO_OK_STATE, revision)) {
		return false;
	}
	time_t now = time(NULL);
	*ra = fmod(indigo_lst(&now, 17) + 23.8, 24);
	return change_switch_and_wait(MOUNT_ON_COORDINATES_SET_PROPERTY_NAME, MOUNT_ON_COORDINATES_SET_SYNC_ITEM_NAME, true, INDIGO_OK_STATE) && change_coordinates(*ra, 40.125, INDIGO_OK_STATE) && wait_for_number_item_value(MOUNT_EQUATORIAL_COORDINATES_PROPERTY_NAME, MOUNT_EQUATORIAL_COORDINATES_DEC_ITEM_NAME, 40.125, .002) && change_switch_and_wait(MOUNT_TRACKING_PROPERTY_NAME, MOUNT_TRACKING_ON_ITEM_NAME, true, INDIGO_OK_STATE);
}

static void rainbow_sync_fractional_readback(void) {
	external_serial_simulator simulator = { 0 };
	SERIAL_CHECK_TRUE(start_rainbow(&simulator, "190402"));
	SERIAL_CHECK_TRUE(change_switch_and_wait(MOUNT_ON_COORDINATES_SET_PROPERTY_NAME, MOUNT_ON_COORDINATES_SET_SYNC_ITEM_NAME, true, INDIGO_OK_STATE));
	SERIAL_CHECK_TRUE(change_coordinates(8.125, -20.375, INDIGO_OK_STATE));
	SERIAL_CHECK_TRUE(wait_for_number_item_value(MOUNT_EQUATORIAL_COORDINATES_PROPERTY_NAME, MOUNT_EQUATORIAL_COORDINATES_RA_ITEM_NAME, 8.125, .002));
	SERIAL_CHECK_TRUE(wait_for_number_item_value(MOUNT_EQUATORIAL_COORDINATES_PROPERTY_NAME, MOUNT_EQUATORIAL_COORDINATES_DEC_ITEM_NAME, -20.375, .002));
	SERIAL_CHECK_TRUE(change_coordinates(8.125, -5.375, INDIGO_OK_STATE));
	SERIAL_CHECK_TRUE(wait_for_event_count(&simulator, "CMD", "Ck121.875-05.375", 1));
	SERIAL_CHECK_TRUE(wait_for_number_item_value(MOUNT_EQUATORIAL_COORDINATES_PROPERTY_NAME, MOUNT_EQUATORIAL_COORDINATES_DEC_ITEM_NAME, -5.375, .002));
	SERIAL_CHECK_EQ_INT(0, count_events(&simulator, "CMD", "MS"));
cleanup:
	if (context.connected) {
		stop_serial_driver(&rainbow_mount);
	}
}

static void rainbow_reachable_goto_completion_and_abort(void) {
	external_serial_simulator simulator = { 0 };
	double ra;
	SERIAL_CHECK_TRUE(start_rainbow(&simulator, "190402"));
	SERIAL_CHECK_TRUE(prepare_position(&ra));
	SERIAL_CHECK_TRUE(change_switch_and_wait(MOUNT_ON_COORDINATES_SET_PROPERTY_NAME, MOUNT_ON_COORDINATES_SET_TRACK_ITEM_NAME, true, INDIGO_OK_STATE));
	SERIAL_CHECK_TRUE(change_coordinates(ra, 60.125, INDIGO_BUSY_STATE));
	SERIAL_CHECK_TRUE(wait_for_event_count(&simulator, "CMD", "MS", 1));
	indigo_usleep(250000);
	SERIAL_CHECK_EQ_INT(INDIGO_BUSY_STATE, find_cached_property(MOUNT_EQUATORIAL_COORDINATES_PROPERTY_NAME)->state);
	SERIAL_CHECK_TRUE(wait_for_property_state(MOUNT_EQUATORIAL_COORDINATES_PROPERTY_NAME, INDIGO_OK_STATE));
	SERIAL_CHECK_TRUE(wait_for_number_item_value(MOUNT_EQUATORIAL_COORDINATES_PROPERTY_NAME, MOUNT_EQUATORIAL_COORDINATES_DEC_ITEM_NAME, 60.125, .01));
	SERIAL_CHECK_TRUE(wait_for_number_item_value(MOUNT_EQUATORIAL_COORDINATES_PROPERTY_NAME, MOUNT_EQUATORIAL_COORDINATES_RA_ITEM_NAME, ra, .002));
	SERIAL_CHECK_TRUE(change_coordinates(ra, 60.125, INDIGO_BUSY_STATE));
	SERIAL_CHECK_TRUE(wait_for_event_count(&simulator, "CMD", "MS", 2));
	SERIAL_CHECK_TRUE(wait_for_property_state(MOUNT_EQUATORIAL_COORDINATES_PROPERTY_NAME, INDIGO_OK_STATE));
	SERIAL_CHECK_TRUE(change_coordinates(ra, 20, INDIGO_BUSY_STATE));
	SERIAL_CHECK_TRUE(wait_for_event_count(&simulator, "CMD", "MS", 3));
	SERIAL_CHECK_EQ_INT(INDIGO_OK, indigo_change_number_property_1(&simulator_test_client, rainbow_mount.device_name, MOUNT_EQUATORIAL_COORDINATES_PROPERTY_NAME, MOUNT_EQUATORIAL_COORDINATES_DEC_ITEM_NAME, 30));
	indigo_usleep(200000);
	SERIAL_CHECK_EQ_INT(3, count_events(&simulator, "CMD", "MS"));
	SERIAL_CHECK_TRUE(change_switch_and_wait(MOUNT_ABORT_MOTION_PROPERTY_NAME, MOUNT_ABORT_MOTION_ITEM_NAME, true, INDIGO_OK_STATE));
	SERIAL_CHECK_TRUE(wait_for_event_count(&simulator, "CMD", "Q", 1));
	SERIAL_CHECK_TRUE(change_coordinates(ra, 45, INDIGO_BUSY_STATE));
	SERIAL_CHECK_TRUE(wait_for_event_count(&simulator, "CMD", "MS", 4));
	SERIAL_CHECK_TRUE(wait_for_property_state(MOUNT_EQUATORIAL_COORDINATES_PROPERTY_NAME, INDIGO_OK_STATE));
	SERIAL_CHECK_TRUE(wait_for_number_item_value(MOUNT_EQUATORIAL_COORDINATES_PROPERTY_NAME, MOUNT_EQUATORIAL_COORDINATES_DEC_ITEM_NAME, 45, .01));
cleanup:
	if (context.connected) {
		stop_serial_driver(&rainbow_mount);
	}
}

static void rainbow_location_roundtrip_and_legacy_time(void) {
	external_serial_simulator simulator = { 0 };
	SERIAL_CHECK_TRUE(start_rainbow(&simulator, "190402"));
	SERIAL_CHECK_TRUE(change_number_and_wait(GEOGRAPHIC_COORDINATES_PROPERTY_NAME, GEOGRAPHIC_COORDINATES_LATITUDE_ITEM_NAME, -33.5, INDIGO_OK_STATE));
	SERIAL_CHECK_TRUE(change_number_and_wait(GEOGRAPHIC_COORDINATES_PROPERTY_NAME, GEOGRAPHIC_COORDINATES_LONGITUDE_ITEM_NAME, 289.75, INDIGO_OK_STATE));
	disconnect_serial_device(&rainbow_mount);
	SERIAL_CHECK_TRUE(connect_serial_device(&rainbow_mount, simulator.port));
	SERIAL_CHECK_TRUE(wait_for_number_item_value(GEOGRAPHIC_COORDINATES_PROPERTY_NAME, GEOGRAPHIC_COORDINATES_LATITUDE_ITEM_NAME, -33.5, .001));
	SERIAL_CHECK_TRUE(wait_for_number_item_value(GEOGRAPHIC_COORDINATES_PROPERTY_NAME, GEOGRAPHIC_COORDINATES_LONGITUDE_ITEM_NAME, 289.75, .001));
	SERIAL_CHECK_TRUE(change_switch_and_wait(MOUNT_SET_HOST_TIME_PROPERTY_NAME, MOUNT_SET_HOST_TIME_ITEM_NAME, true, INDIGO_ALERT_STATE));
	unsigned int revision = property_revision(UTC_TIME_PROPERTY_NAME);
	SERIAL_CHECK_EQ_INT(INDIGO_OK, indigo_change_text_property_1_raw(&simulator_test_client, rainbow_mount.device_name, UTC_TIME_PROPERTY_NAME, UTC_TIME_ITEM_NAME, "2026-09-23T12:00:00"));
	SERIAL_CHECK_TRUE(wait_for_property_state_seen_after(UTC_TIME_PROPERTY_NAME, INDIGO_ALERT_STATE, revision));
	SERIAL_CHECK_EQ_INT(0, count_event_prefixes(&simulator, "CMD", "SC"));
	SERIAL_CHECK_TRUE(wait_for_property_state(UTC_TIME_PROPERTY_NAME, INDIGO_OK_STATE));
cleanup:
	if (context.connected) {
		stop_serial_driver(&rainbow_mount);
	}
}

static void rainbow_park_abort_and_disconnect(void) {
	external_serial_simulator simulator = { 0 };
	double ra;
	SERIAL_CHECK_TRUE(start_rainbow(&simulator, "190402"));
	SERIAL_CHECK_TRUE(prepare_position(&ra));
	SERIAL_CHECK_TRUE(change_switch_and_wait(MOUNT_PARK_PROPERTY_NAME, MOUNT_PARK_PARKED_ITEM_NAME, true, INDIGO_BUSY_STATE));
	SERIAL_CHECK_TRUE(wait_for_event_count(&simulator, "CMD", "Ch", 1));
	SERIAL_CHECK_TRUE(change_switch_and_wait(MOUNT_ABORT_MOTION_PROPERTY_NAME, MOUNT_ABORT_MOTION_ITEM_NAME, true, INDIGO_OK_STATE));
	SERIAL_CHECK_TRUE(find_cached_property(MOUNT_PARK_PROPERTY_NAME)->state != INDIGO_BUSY_STATE);
	assert_switch_item_value(MOUNT_PARK_PROPERTY_NAME, MOUNT_PARK_PARKED_ITEM_NAME, false);
	disconnect_serial_device(&rainbow_mount);
	SERIAL_CHECK_TRUE(connect_serial_device(&rainbow_mount, simulator.port));
	SERIAL_CHECK_TRUE(change_switch_and_wait(MOUNT_PARK_PROPERTY_NAME, MOUNT_PARK_PARKED_ITEM_NAME, true, INDIGO_BUSY_STATE));
	SERIAL_CHECK_TRUE(wait_for_event_count(&simulator, "CMD", "Ch", 2));
	disconnect_serial_device(&rainbow_mount);
	SERIAL_CHECK_TRUE(connect_serial_device(&rainbow_mount, simulator.port));
	SERIAL_CHECK_TRUE(change_switch_and_wait(MOUNT_ABORT_MOTION_PROPERTY_NAME, MOUNT_ABORT_MOTION_ITEM_NAME, true, INDIGO_OK_STATE));
cleanup:
	if (context.connected) {
		stop_serial_driver(&rainbow_mount);
	}
}

static void rainbow_rejected_goto_recovers(void) {
	external_serial_simulator simulator = { 0 };
	double ra;
	SERIAL_CHECK_TRUE(start_rainbow(&simulator, "190402"));
	SERIAL_CHECK_TRUE(prepare_position(&ra));
	SERIAL_CHECK_TRUE(change_switch_and_wait(MOUNT_ON_COORDINATES_SET_PROPERTY_NAME, MOUNT_ON_COORDINATES_SET_TRACK_ITEM_NAME, true, INDIGO_OK_STATE));
	SERIAL_CHECK_TRUE(change_coordinates(fmod(ra + 12, 24), -60, INDIGO_ALERT_STATE));
	SERIAL_CHECK_TRUE(change_coordinates(ra, 45, INDIGO_BUSY_STATE));
	SERIAL_CHECK_TRUE(wait_for_event_count(&simulator, "CMD", "MS", 2));
	SERIAL_CHECK_TRUE(wait_for_property_state(MOUNT_EQUATORIAL_COORDINATES_PROPERTY_NAME, INDIGO_OK_STATE));
	SERIAL_CHECK_TRUE(wait_for_number_item_value(MOUNT_EQUATORIAL_COORDINATES_PROPERTY_NAME, MOUNT_EQUATORIAL_COORDINATES_DEC_ITEM_NAME, 45, .01));
cleanup:
	if (context.connected) {
		stop_serial_driver(&rainbow_mount);
	}
}

static void rainbow_manual_motion_readback_and_active_loss(void) {
	external_serial_simulator simulator = { 0 };
	double ra;
	SERIAL_CHECK_TRUE(start_rainbow(&simulator, "190402"));
	SERIAL_CHECK_TRUE(prepare_position(&ra));
	SERIAL_CHECK_TRUE(change_switch_and_wait(MOUNT_SLEW_RATE_PROPERTY_NAME, MOUNT_SLEW_RATE_MAX_ITEM_NAME, true, INDIGO_OK_STATE));
	SERIAL_CHECK_TRUE(change_switch_and_wait(MOUNT_MOTION_RA_PROPERTY_NAME, MOUNT_MOTION_EAST_ITEM_NAME, true, INDIGO_OK_STATE));
	SERIAL_CHECK_TRUE(change_switch_and_wait(MOUNT_MOTION_DEC_PROPERTY_NAME, MOUNT_MOTION_NORTH_ITEM_NAME, true, INDIGO_OK_STATE));
	indigo_usleep(1200000);
	double moved_ra = cached_number_value(MOUNT_EQUATORIAL_COORDINATES_PROPERTY_NAME, MOUNT_EQUATORIAL_COORDINATES_RA_ITEM_NAME);
	double moved_dec = cached_number_value(MOUNT_EQUATORIAL_COORDINATES_PROPERTY_NAME, MOUNT_EQUATORIAL_COORDINATES_DEC_ITEM_NAME);
	SERIAL_CHECK_TRUE(fabs(moved_ra - ra) > .01 && fabs(moved_dec - 40.125) > .1);
	SERIAL_CHECK_TRUE(change_switch_and_wait(MOUNT_MOTION_RA_PROPERTY_NAME, MOUNT_MOTION_WEST_ITEM_NAME, true, INDIGO_OK_STATE));
	SERIAL_CHECK_TRUE(change_switch_and_wait(MOUNT_MOTION_DEC_PROPERTY_NAME, MOUNT_MOTION_SOUTH_ITEM_NAME, true, INDIGO_OK_STATE));
	indigo_usleep(1200000);
	SERIAL_CHECK_TRUE(fabs(cached_number_value(MOUNT_EQUATORIAL_COORDINATES_PROPERTY_NAME, MOUNT_EQUATORIAL_COORDINATES_RA_ITEM_NAME) - moved_ra) > .01);
	SERIAL_CHECK_TRUE(fabs(cached_number_value(MOUNT_EQUATORIAL_COORDINATES_PROPERTY_NAME, MOUNT_EQUATORIAL_COORDINATES_DEC_ITEM_NAME) - moved_dec) > .1);
	SERIAL_CHECK_TRUE(change_switch_and_wait(MOUNT_ABORT_MOTION_PROPERTY_NAME, MOUNT_ABORT_MOTION_ITEM_NAME, true, INDIGO_OK_STATE));
	assert_switch_item_value(MOUNT_MOTION_RA_PROPERTY_NAME, MOUNT_MOTION_WEST_ITEM_NAME, false);
	assert_switch_item_value(MOUNT_MOTION_DEC_PROPERTY_NAME, MOUNT_MOTION_SOUTH_ITEM_NAME, false);
	indigo_usleep(1200000);
	double stopped_dec = cached_number_value(MOUNT_EQUATORIAL_COORDINATES_PROPERTY_NAME, MOUNT_EQUATORIAL_COORDINATES_DEC_ITEM_NAME);
	indigo_usleep(1200000);
	SERIAL_CHECK_TRUE(fabs(cached_number_value(MOUNT_EQUATORIAL_COORDINATES_PROPERTY_NAME, MOUNT_EQUATORIAL_COORDINATES_DEC_ITEM_NAME) - stopped_dec) < .01);
	SERIAL_CHECK_TRUE(change_switch_and_wait(MOUNT_ON_COORDINATES_SET_PROPERTY_NAME, MOUNT_ON_COORDINATES_SET_TRACK_ITEM_NAME, true, INDIGO_OK_STATE));
	SERIAL_CHECK_TRUE(change_coordinates(ra, 70, INDIGO_BUSY_STATE));
	SERIAL_CHECK_TRUE(wait_for_event_count(&simulator, "CMD", "MS", 1));
	SERIAL_CHECK_TRUE(mountsim_transport(&simulator, false));
	SERIAL_CHECK_TRUE(change_switch_and_wait(MOUNT_ABORT_MOTION_PROPERTY_NAME, MOUNT_ABORT_MOTION_ITEM_NAME, true, INDIGO_ALERT_STATE));
	disconnect_serial_device(&rainbow_mount);
	SERIAL_CHECK_TRUE(mountsim_transport(&simulator, true));
	// The mount may still be moving when its transport returns.
	SERIAL_CHECK_TRUE(connect_serial_device(&rainbow_mount, simulator.port));
	SERIAL_CHECK_TRUE(change_switch_and_wait(MOUNT_ABORT_MOTION_PROPERTY_NAME, MOUNT_ABORT_MOTION_ITEM_NAME, true, INDIGO_OK_STATE));
	SERIAL_CHECK_TRUE(change_switch_and_wait(MOUNT_TRACKING_PROPERTY_NAME, MOUNT_TRACKING_OFF_ITEM_NAME, true, INDIGO_OK_STATE));
cleanup:
	if (context.connected) {
		stop_serial_driver(&rainbow_mount);
	}
}

int main(int argc, char **argv) {
	if (!indigo_test_use_private_home()) {
		return 2;
	}
	setvbuf(stdout, NULL, _IONBF, 0);
	if (getenv("MOUNTSIM_DEBUG") != NULL) {
		indigo_set_log_level(INDIGO_LOG_DEBUG);
	}
	const indigo_test_case tests[] = {
		{ "rainbow_rejected_goto_recovers", rainbow_rejected_goto_recovers },
		{ "rainbow_manual_motion_readback_and_active_loss", rainbow_manual_motion_readback_and_active_loss },
		{ "rainbow_sync_fractional_readback", rainbow_sync_fractional_readback },
		{ "rainbow_reachable_goto_completion_and_abort", rainbow_reachable_goto_completion_and_abort },
		{ "rainbow_location_roundtrip_and_legacy_time", rainbow_location_roundtrip_and_legacy_time },
		{ "rainbow_park_abort_and_disconnect", rainbow_park_abort_and_disconnect },
		{ "rainbow_driver_info_and_property_inventory", rainbow_driver_info_and_property_inventory },
		{ "rainbow_uses_legacy_firmware_protocol", rainbow_uses_legacy_firmware_protocol },
		{ "rainbow_tracks_and_selects_every_rate", rainbow_tracks_and_selects_every_rate },
		{ "rainbow_manual_motion_covers_all_rates_axes_and_stops", rainbow_manual_motion_covers_all_rates_axes_and_stops },
		{ "rainbow_park_completes_and_rejects_motion", rainbow_park_completes_and_rejects_motion },
		{ "rainbow_reconnects_after_clean_disconnect", rainbow_reconnects_after_clean_disconnect },
		{ "rainbow_idle_transport_loss_and_recovery", rainbow_idle_transport_loss_and_recovery },
	};
	int result = 2;
	if (argc == 2 && !strcmp(argv[1], "--list")) {
		for (int i = 0; i < ARRAY_SIZE(tests); i++) {
			puts(tests[i].name);
		}
		result = 0;
	} else if (argc == 2) {
		for (int i = 0; i < ARRAY_SIZE(tests); i++) {
			if (!strcmp(argv[1], tests[i].name)) {
				result = indigo_run_tests("MountSim 2.3 (RainbowAstro RST135)", tests + i, 1);
				break;
			}
		}
	}
	indigo_test_remove_private_home();
	return result;
}
