// Copyright (c) 2026 INDIGO initiative
// All rights reserved.
//
// You may use this software under the terms of 'INDIGO Astronomy
// open-source license' (see LICENSE.md).
//
// THIS SOFTWARE IS PROVIDED BY THE AUTHORS 'AS IS' AND ANY EXPRESS
// OR IMPLIED WARRANTIES, INCLUDING, BUT NOT LIMITED TO, THE IMPLIED
// WARRANTIES OF MERCHANTABILITY AND FITNESS FOR A PARTICULAR PURPOSE
// ARE DISCLAIMED. IN NO EVENT SHALL THE AUTHOR BE LIABLE FOR ANY
// DIRECT, INDIRECT, INCIDENTAL, SPECIAL, EXEMPLARY, OR CONSEQUENTIAL
// DAMAGES (INCLUDING, BUT NOT LIMITED TO, PROCUREMENT OF SUBSTITUTE
// GOODS OR SERVICES; LOSS OF USE, DATA, OR PROFITS; OR BUSINESS
// INTERRUPTION) HOWEVER CAUSED AND ON ANY THEORY OF LIABILITY,
// WHETHER IN CONTRACT, STRICT LIABILITY, OR TORT (INCLUDING
// NEGLIGENCE OR OTHERWISE) ARISING IN ANY WAY OUT OF THE USE OF THIS
// SOFTWARE, EVEN IF ADVISED OF THE POSSIBILITY OF SUCH DAMAGE.

// Code is generated by AI

// Compiles the current RPI management entry block and helper functions with inert I/O.
#include <assert.h>
#include <pthread.h>
#include <indigo/indigo_bus.h>
#include "../test_runner.h"

static indigo_property *install_property;
static pthread_mutex_t install_property_mutex = PTHREAD_MUTEX_INITIALIZER;
#define SERVER_INSTALL_PROPERTY install_property
static char invoked_command[1024];
static char published_message[1024];
static char published_format[1024];
static const char *helper_reply;
static int invocation_count;
static bool invocation_failure;

static FILE *stub_popen(const char *command, const char *mode) {
	(void)mode;
	invocation_count++;
	snprintf(invoked_command, sizeof(invoked_command), "%s", command);
	if (invocation_failure) {
		errno = ENOENT;
		return NULL;
	}
	FILE *output = tmpfile();
	assert(output != NULL);
	fputs(helper_reply, output);
	rewind(output);
	return output;
}

static int stub_pclose(FILE *output) {
	return fclose(output);
}

indigo_result indigo_update_property(indigo_device *device, indigo_property *property, const char *format, ...) {
	(void)device;
	(void)property;
	snprintf(published_format, sizeof(published_format), "%s", format ? format : "");
	if (format && !strcmp(format, "%s")) {
		va_list args;
		va_start(args, format);
		vsnprintf(published_message, sizeof(published_message), format, args);
		va_end(args);
	} else {
		// Capture unsafe formats without invoking undefined variadic reads in the pre-fix baseline.
		snprintf(published_message, sizeof(published_message), "%s", format ? format : "");
	}
	return INDIGO_OK;
}

bool indigo_property_match(indigo_property *canonical, indigo_property *incoming) {
	return canonical && canonical->type == incoming->type && !strcmp(canonical->device, incoming->device) && !strcmp(canonical->name, incoming->name);
}

void indigo_property_copy_values(indigo_property *canonical, indigo_property *incoming, bool with_state) {
	(void)with_state;
	assert(canonical->type == INDIGO_SWITCH_VECTOR);
	for (int j = 0; j < canonical->count; j++) {
		canonical->items[j].sw.value = false;
		for (int i = 0; i < incoming->count; i++) {
			if (!strcmp(canonical->items[j].name, incoming->items[i].name)) {
				canonical->items[j].sw.value = incoming->items[i].sw.value;
			}
		}
	}
}

#define popen stub_popen
#define pclose stub_pclose
#include "server_management_source.inc"
#undef popen
#undef pclose

static indigo_device server;
static indigo_property *request;

static void prepare_request(const char *canonical_name, const char *incoming_name) {
	memset(install_property, 0, sizeof(indigo_property) + 2 * sizeof(indigo_item));
	memset(request, 0, sizeof(indigo_property) + 2 * sizeof(indigo_item));
	install_property->type = request->type = INDIGO_SWITCH_VECTOR;
	install_property->count = request->count = 1;
	snprintf(install_property->items[0].name, INDIGO_NAME_SIZE, "%s", canonical_name);
	snprintf(request->items[0].name, INDIGO_NAME_SIZE, "%s", incoming_name);
	request->items[0].sw.value = true;
	helper_reply = "OK\n";
	invocation_count = 0;
	invocation_failure = false;
	invoked_command[0] = published_message[0] = published_format[0] = 0;
}

static void valid_choice_is_one_argument(void) {
	prepare_request("3.0-7", "3.0-7");
	ASSERT_EQ_INT(INDIGO_OK, change_property(&server, NULL, request));
	ASSERT_EQ_INT(1, invocation_count);
	ASSERT_STREQ("s_rpi_ctrl.sh --install-version '3.0-7'", invoked_command);
	ASSERT_EQ_INT(INDIGO_OK_STATE, install_property->state);
}

static void valid_choice_uses_canonical_index(void) {
	prepare_request("3.0-6", "3.0-7");
	install_property->count = 2;
	strcpy(install_property->items[1].name, "3.0-7");
	ASSERT_EQ_INT(INDIGO_OK, change_property(&server, NULL, request));
	ASSERT_EQ_INT(1, invocation_count);
	ASSERT_STREQ("s_rpi_ctrl.sh --install-version '3.0-7'", invoked_command);
	ASSERT_TRUE(install_property->items[1].sw.value);
}

static void unselected_unknown_name_is_not_executed(void) {
	prepare_request("3.0-7", "unavailable; printf synthetic");
	request->items[0].sw.value = false;
	ASSERT_EQ_INT(INDIGO_OK, change_property(&server, NULL, request));
	ASSERT_EQ_INT(0, invocation_count);
}

static void unknown_selected_name_is_rejected(void) {
	prepare_request("3.0-7", "3.0-7; printf synthetic");
	install_property->items[0].sw.value = true;
	ASSERT_EQ_INT(INDIGO_OK, change_property(&server, NULL, request));
	ASSERT_EQ_INT(0, invocation_count);
	ASSERT_EQ_INT(INDIGO_ALERT_STATE, install_property->state);
	ASSERT_TRUE(install_property->items[0].sw.value);
}

static void mixed_valid_and_unknown_selection_is_rejected(void) {
	prepare_request("3.0-7", "3.0-7");
	request->count = 2;
	strcpy(request->items[1].name, "$(printf synthetic)");
	request->items[1].sw.value = true;
	ASSERT_EQ_INT(INDIGO_OK, change_property(&server, NULL, request));
	ASSERT_EQ_INT(0, invocation_count);
	ASSERT_EQ_INT(INDIGO_ALERT_STATE, install_property->state);
}

static void canonical_shell_characters_are_quoted(void) {
	const char *version = "3.0';$(printf synthetic) `printf marker` * \" \\%s";
	prepare_request(version, version);
	ASSERT_EQ_INT(INDIGO_OK, change_property(&server, NULL, request));
	ASSERT_EQ_INT(1, invocation_count);
	ASSERT_STREQ("s_rpi_ctrl.sh --install-version '3.0'\\'';$(printf synthetic) `printf marker` * \" \\%s'", invoked_command);
}

static void maximum_apostrophe_choice_is_complete(void) {
	char version[INDIGO_NAME_SIZE];
	memset(version, '\'', sizeof(version) - 1);
	version[sizeof(version) - 1] = 0;
	prepare_request(version, version);
	ASSERT_EQ_INT(INDIGO_OK, change_property(&server, NULL, request));
	ASSERT_EQ_INT(1, invocation_count);
	const char *token = invoked_command + strlen("s_rpi_ctrl.sh --install-version ");
	ASSERT_EQ_INT(4 * (INDIGO_NAME_SIZE - 1) + 2, strlen(token));
	ASSERT_EQ_INT('\'', token[0]);
	for (int i = 0; i < INDIGO_NAME_SIZE - 1; i++) {
		ASSERT_TRUE(!memcmp(token + 1 + 4 * i, "'\\''", 4));
	}
	ASSERT_EQ_INT('\'', token[strlen(token) - 1]);
}

static void unselected_request_does_not_install(void) {
	prepare_request("3.0-7", "3.0-7");
	request->items[0].sw.value = false;
	install_property->items[0].sw.value = true;
	ASSERT_EQ_INT(INDIGO_OK, change_property(&server, NULL, request));
	ASSERT_EQ_INT(0, invocation_count);
}

static void helper_percent_diagnostics_are_literal(void) {
	prepare_request("3.0-7", "3.0-7");
	helper_reply = "ALERT:cannot set date %s %n %08x %%\n";
	ASSERT_EQ_INT(INDIGO_OK, change_property(&server, NULL, request));
	ASSERT_EQ_INT(INDIGO_ALERT_STATE, install_property->state);
	ASSERT_STREQ("%s", published_format);
	ASSERT_STREQ("cannot set date %s %n %08x %%", published_message);
}

static void helper_missing_colon_has_diagnostic(void) {
	prepare_request("3.0-7", "3.0-7");
	helper_reply = "ALERT\n";
	ASSERT_EQ_INT(INDIGO_OK, change_property(&server, NULL, request));
	ASSERT_EQ_INT(INDIGO_ALERT_STATE, install_property->state);
	ASSERT_STREQ("ALERT", published_message);
}

static void empty_helper_reply_is_alert(void) {
	prepare_request("3.0-7", "3.0-7");
	helper_reply = "";
	ASSERT_EQ_INT(INDIGO_OK, change_property(&server, NULL, request));
	ASSERT_EQ_INT(INDIGO_ALERT_STATE, install_property->state);
	ASSERT_STREQ("No reply from rpi_ctrl.sh", published_message);
}

static void helper_open_failure_is_alert(void) {
	prepare_request("3.0-7", "3.0-7");
	invocation_failure = true;
	ASSERT_EQ_INT(INDIGO_OK, change_property(&server, NULL, request));
	ASSERT_EQ_INT(INDIGO_ALERT_STATE, install_property->state);
	ASSERT_STREQ(strerror(ENOENT), published_message);
}

int main(void) {
	install_property = calloc(1, sizeof(indigo_property) + 2 * sizeof(indigo_item));
	request = calloc(1, sizeof(indigo_property) + 2 * sizeof(indigo_item));
	assert(install_property && request);
	const indigo_test_case tests[] = {
		{ "valid_choice_is_one_argument", valid_choice_is_one_argument },
		{ "valid_choice_uses_canonical_index", valid_choice_uses_canonical_index },
		{ "unselected_unknown_name_is_not_executed", unselected_unknown_name_is_not_executed },
		{ "unknown_selected_name_is_rejected", unknown_selected_name_is_rejected },
		{ "mixed_valid_and_unknown_selection_is_rejected", mixed_valid_and_unknown_selection_is_rejected },
		{ "canonical_shell_characters_are_quoted", canonical_shell_characters_are_quoted },
		{ "maximum_apostrophe_choice_is_complete", maximum_apostrophe_choice_is_complete },
		{ "unselected_request_does_not_install", unselected_request_does_not_install },
		{ "helper_percent_diagnostics_are_literal", helper_percent_diagnostics_are_literal },
		{ "helper_missing_colon_has_diagnostic", helper_missing_colon_has_diagnostic },
		{ "empty_helper_reply_is_alert", empty_helper_reply_is_alert },
		{ "helper_open_failure_is_alert", helper_open_failure_is_alert }
	};
	int result = indigo_run_tests("Server management security", tests, sizeof(tests) / sizeof(tests[0]));
	free(request);
	free(install_property);
	return result;
}
