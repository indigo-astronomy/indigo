// Copyright (c) 2026 INDIGO initiative
// All rights reserved.
//
// You may use this software under the terms of 'INDIGO Astronomy
// open-source license' (see LICENSE.md).
//
// THIS SOFTWARE IS PROVIDED BY THE AUTHORS 'AS IS' AND ANY EXPRESS
// OR IMPLIED WARRANTIES, INCLUDING, BUT NOT LIMITED TO, THE IMPLIED
// WARRANTIES OF MERCHANTABILITY AND FITNESS FOR A PARTICULAR PURPOSE
// ARE DISCLAIMED. IN NO EVENT SHALL THE AUTHOR BE LIABLE FOR ANY
// DIRECT, INDIRECT, INCIDENTAL, SPECIAL, EXEMPLARY, OR CONSEQUENTIAL
// DAMAGES (INCLUDING, BUT NOT LIMITED TO, PROCUREMENT OF SUBSTITUTE
// GOODS OR SERVICES; LOSS OF USE, DATA, OR PROFITS; OR BUSINESS
// INTERRUPTION) HOWEVER CAUSED AND ON ANY THEORY OF LIABILITY,
// WHETHER IN CONTRACT, STRICT LIABILITY, OR TORT (INCLUDING
// NEGLIGENCE OR OTHERWISE) ARISING IN ANY WAY OUT OF THE USE OF THIS
// SOFTWARE, EVEN IF ADVISED OF THE POSSIBILITY OF SUCH DAMAGE.

// Code is generated by AI

/** Test of the indigo_solver command line tool: the built executable is run on a synthetic Tycho-2 style index and
 synthetic RAW and FITS frames of the indexed field in a private directory; its output, messages and exit codes are
 checked for every hint switch, and the WCS header of the wcs format is checked against the catalog positions of the rendered
 stars. The index management modes download from file:// URLs of the test directories with curl. No network, no real
 index files.
 */

#include <stdio.h>
#include <stdlib.h>
#include <string.h>
#include <math.h>
#include <unistd.h>
#include <limits.h>
#include <fcntl.h>
#include <signal.h>
#include <sys/stat.h>
#include <sys/wait.h>

#include <indigo/indigo_bus.h>
#include <indigo/indigo_fits.h>
#include <indigo/indigo_align.h>
#include <indigo_drivers/agent_platesolver/indigo_solver.h>

#include "../test_runner.h"

#ifndef INDIGO_SOLVER_EXECUTABLE
#define INDIGO_SOLVER_EXECUTABLE "../build/bin/indigo_solver"
#endif

#define SUITE										"indigo_solver tool"
#define REQUIRE(c) do { if (!(c)) { fprintf(stderr, "%s:%d: %s\n", __FILE__, __LINE__, #c); indigo_test_failures++; return false; } } while (0)

#define CATALOG_STAR_COUNT			28
#define IMAGE_WIDTH							1600
#define IMAGE_HEIGHT						1200
#define IMAGE_SCALE							(8 * ARCSEC_TO_RAD)
#define IMAGE_ANGLE							(20 * DEG_TO_RAD)
#define CATALOG_SCALE						(16 * ARCSEC_TO_RAD)
#define OUTPUT_SIZE							16384

typedef struct {
	int exit_code;
	char output[OUTPUT_SIZE];
} tool_run;

typedef struct {
	double ra;
	double dec;
	double angle;
	double scale;
	double width;
	double height;
	int parity;
} tool_solution;

static char work_dir[PATH_MAX], index_dir[PATH_MAX], two_index_dir[PATH_MAX], three_index_dir[PATH_MAX], empty_dir[PATH_MAX], raw_path[PATH_MAX], fits_path[PATH_MAX], text_path[PATH_MAX], mirrored_path[PATH_MAX], wcs_path[PATH_MAX];
static float ra0, dec0, image_ra, image_dec;
static indigo_solver_index_star frame_stars[CATALOG_STAR_COUNT];
static uint32_t rng_state = 20261028;

static float frand(void) {
	rng_state = rng_state * 1664525u + 1013904223u;
	return (rng_state >> 8) / (float)(1u << 24);
}

// -------------------------------------------------------------------------------- synthetic index and frames

// A patch of random catalog stars around (97.9°, 5.1°), indexed like indigo_solver_indexer does: all quads with
// their code variants, stored as the 5° Tycho-2 index
static bool write_synthetic_index(const char *path) {
	indigo_solver_star catalog[CATALOG_STAR_COUNT];
	ra0 = 97.9 * DEG_TO_RAD;
	dec0 = 5.1 * DEG_TO_RAD;
	for (int i = 0; i < CATALOG_STAR_COUNT; i++) {
		memset(catalog + i, 0, sizeof(indigo_solver_star));
		catalog[i].id = i;
		catalog[i].ra = ra0 + (frand() - 0.5) * 3.2 * DEG_TO_RAD;
		catalog[i].dec = dec0 + (frand() - 0.5) * 2.4 * DEG_TO_RAD;
		REQUIRE(indigo_radec_to_xy(ra0, dec0 + 0.4 * DEG_TO_RAD, 0, CATALOG_SCALE, 1000, 1000, -1, catalog[i].ra, catalog[i].dec, &catalog[i].x, &catalog[i].y));
	}
	int capacity = 40000, count = 0;
	indigo_solver_quad *quads = malloc(capacity * sizeof(indigo_solver_quad));
	for (int i = 0; i < CATALOG_STAR_COUNT; i++) {
		for (int j = i + 1; j < CATALOG_STAR_COUNT; j++) {
			for (int k = j + 1; k < CATALOG_STAR_COUNT; k++) {
				for (int l = k + 1; l < CATALOG_STAR_COUNT; l++) {
					if (count + INDIGO_SOLVER_MAX_QUAD_VARIANTS > capacity) {
						capacity *= 2;
						quads = realloc(quads, capacity * sizeof(indigo_solver_quad));
					}
					count += indigo_solver_make_quad_variants(quads + count, INDIGO_SOLVER_MAX_QUAD_VARIANTS, catalog + i, catalog + j, catalog + k, catalog + l);
				}
			}
		}
	}
	indigo_solver_catalog index;
	bool ok = indigo_solver_catalog_build(catalog, CATALOG_STAR_COUNT, quads, count, 5, &index) && indigo_solver_write_index(path, &index);
	indigo_solver_free_catalog(&index);
	free(quads);
	REQUIRE(ok);
	return true;
}

// A 16 bit mono RAW frame of the catalog patch: flat background with noise and gaussian stars
static indigo_raw_header *render_image(const char *index_path, long *size) {
	*size = sizeof(indigo_raw_header) + IMAGE_WIDTH * IMAGE_HEIGHT * 2;
	indigo_raw_header *image = calloc(1, *size);
	image->signature = INDIGO_RAW_MONO16;
	image->width = IMAGE_WIDTH;
	image->height = IMAGE_HEIGHT;
	uint16_t *pixels = (uint16_t *)(image + 1);
	for (long i = 0; i < IMAGE_WIDTH * IMAGE_HEIGHT; i++) {
		pixels[i] = 1000 + (int)(frand() * 40);
	}
	image_ra = ra0 + 0.1 * DEG_TO_RAD;
	image_dec = dec0 - 0.05 * DEG_TO_RAD;
	indigo_solver_catalog index;
	if (!indigo_solver_load_index(index_path, &index) || index.star_count != CATALOG_STAR_COUNT) {
		indigo_solver_free_catalog(&index);
		free(image);
		return NULL;
	}
	indigo_solver_index_star stars[CATALOG_STAR_COUNT];
	memcpy(stars, index.stars, sizeof(stars));
	memcpy(frame_stars, index.stars, sizeof(frame_stars));
	indigo_solver_free_catalog(&index);
	for (int i = 0; i < CATALOG_STAR_COUNT; i++) {
		float x, y;
		if (indigo_radec_to_xy(image_ra, image_dec, IMAGE_ANGLE, IMAGE_SCALE, IMAGE_WIDTH, IMAGE_HEIGHT, -1, stars[i].ra, stars[i].dec, &x, &y)) {
			for (int dy = -6; dy <= 6; dy++) {
				for (int dx = -6; dx <= 6; dx++) {
					int px = (int)rint(x) + dx, py = (int)rint(y) + dy;
					if (px >= 0 && px < IMAGE_WIDTH && py >= 0 && py < IMAGE_HEIGHT) {
						float r2 = (px - x) * (px - x) + (py - y) * (py - y);
						int value = pixels[py * IMAGE_WIDTH + px] + (int)(30000 * exp(-r2 / (2 * 1.5 * 1.5)));
						pixels[py * IMAGE_WIDTH + px] = value > 65535 ? 65535 : value;
					}
				}
			}
		}
	}
	return image;
}

static bool write_file(const char *path, const void *data, long size) {
	FILE *file = fopen(path, "wb");
	REQUIRE(file != NULL);
	bool ok = fwrite(data, 1, size, file) == (size_t)size;
	fclose(file);
	REQUIRE(ok);
	return true;
}

static bool copy_file(const char *from, const char *to) {
	FILE *file = fopen(from, "rb");
	REQUIRE(file != NULL);
	fseek(file, 0, SEEK_END);
	long size = ftell(file);
	fseek(file, 0, SEEK_SET);
	char *data = malloc(size);
	bool ok = fread(data, 1, size, file) == (size_t)size;
	fclose(file);
	ok = ok && write_file(to, data, size);
	free(data);
	REQUIRE(ok);
	return true;
}

// -------------------------------------------------------------------------------- running the tool

// Runs the tool with the arguments, stdout and stderr captured together, or stdout alone with stderr discarded;
// INDIGO_CACHE_BASE always points into the private directory, so the default index directory never reaches the
// user's own cache
static bool run_tool_with(tool_run *run, const char *cache_base, const char *redirect, const char *format, va_list args) {
	char arguments[2048], command[4096];
	vsnprintf(arguments, sizeof(arguments), format, args);
	snprintf(command, sizeof(command), "INDIGO_CACHE_BASE='%s' '%s' %s %s", cache_base, INDIGO_SOLVER_EXECUTABLE, arguments, redirect);
	FILE *pipe = popen(command, "r");
	REQUIRE(pipe != NULL);
	size_t length = fread(run->output, 1, sizeof(run->output) - 1, pipe);
	run->output[length] = 0;
	int status = pclose(pipe);
	REQUIRE(WIFEXITED(status));
	run->exit_code = WEXITSTATUS(status);
	return true;
}

static bool run_tool(tool_run *run, const char *cache_base, const char *format, ...) {
	va_list args;
	va_start(args, format);
	bool ok = run_tool_with(run, cache_base, "2>&1", format, args);
	va_end(args);
	return ok;
}

static bool run_tool_stdout(tool_run *run, const char *cache_base, const char *format, ...) {
	va_list args;
	va_start(args, format);
	bool ok = run_tool_with(run, cache_base, "2>/dev/null", format, args);
	va_end(args);
	return ok;
}

// Runs the tool with stdout redirected to the WCS file of the test, as a user saves the wcs format, and stderr
// captured
static bool run_tool_wcs(tool_run *run, const char *cache_base, const char *format, ...) {
	char redirect[PATH_MAX + 16];
	snprintf(redirect, sizeof(redirect), "2>&1 >'%s'", wcs_path);
	va_list args;
	va_start(args, format);
	bool ok = run_tool_with(run, cache_base, redirect, format, args);
	va_end(args);
	return ok;
}

static long file_size(const char *path) {
	struct stat status;
	return stat(path, &status) == 0 ? (long)status.st_size : -1;
}

static bool output_contains(tool_run *run, const char *text) {
	if (strstr(run->output, text) == NULL) {
		fprintf(stderr, "Expected '%s' in the output:\n%s\n", text, run->output);
		return false;
	}
	return true;
}

// The value following a label at the start of an output line
static bool output_value(tool_run *run, const char *label, double *value) {
	for (const char *line = run->output; line != NULL && *line; line = strchr(line, '\n') ? strchr(line, '\n') + 1 : NULL) {
		size_t length = strlen(label);
		if (!strncmp(line, label, length) && sscanf(line + length, "%lf", value) == 1) {
			return true;
		}
	}
	fprintf(stderr, "No '%s' value in the output:\n%s\n", label, run->output);
	return false;
}

// The output contains the texts in this order, each after the previous one
static bool output_in_order(tool_run *run, const char **texts, int count) {
	const char *position = run->output;
	for (int i = 0; i < count && position != NULL; i++) {
		position = strstr(position, texts[i]);
		if (position != NULL) {
			position += strlen(texts[i]);
		}
	}
	return position != NULL;
}

static bool parse_solution(tool_run *run, tool_solution *solution) {
	double parity;
	REQUIRE(output_value(run, "RA:", &solution->ra));
	REQUIRE(output_value(run, "Dec:", &solution->dec));
	REQUIRE(output_value(run, "Angle:", &solution->angle));
	REQUIRE(output_value(run, "Scale:", &solution->scale));
	REQUIRE(output_value(run, "Field:", &solution->width));
	REQUIRE(sscanf(strstr(run->output, "Field:") + 6, "%*f° x %lf", &solution->height) == 1);
	REQUIRE(output_value(run, "Parity:", &parity));
	solution->parity = (int)parity;
	return true;
}

// The solved frame: centre within tolerance (arcseconds) of the rendered one, scale, size, angle and parity
static bool solution_matches_frame(tool_run *run, double tolerance, double scale_tolerance) {
	tool_solution solution;
	REQUIRE(run->exit_code == 0);
	REQUIRE(output_contains(run, "Solved in "));
	REQUIRE(output_contains(run, " stars matched, rms "));
	REQUIRE(output_contains(run, "Epoch:    J2000"));
	REQUIRE(output_contains(run, "Index:    5° Tycho-2 (FOV 4.5° - 10°)"));
	REQUIRE(parse_solution(run, &solution));
	double distance = indigo_angular_distance(solution.ra * 15 * DEG_TO_RAD, solution.dec * DEG_TO_RAD, image_ra, image_dec) / ARCSEC_TO_RAD;
	if (distance >= tolerance) {
		fprintf(stderr, "Solved centre %.1f\" from the frame centre\n", distance);
	}
	REQUIRE(distance < tolerance);
	REQUIRE(fabs(solution.scale / (IMAGE_SCALE * RAD_TO_DEG) - 1) < scale_tolerance);
	REQUIRE(fabs(solution.width - IMAGE_WIDTH * solution.scale) < 1e-3);
	REQUIRE(fabs(solution.height - IMAGE_HEIGHT * solution.scale) < 1e-3);
	REQUIRE(fabs(solution.angle - IMAGE_ANGLE * RAD_TO_DEG) < 0.3);
	REQUIRE(solution.parity == -1);
	return true;
}

// The number following the JSON key ("key": value) or inside the XML element (<key>value</key>)
static bool document_value(tool_run *run, bool json, const char *key, double *value) {
	char pattern[64];
	snprintf(pattern, sizeof(pattern), json ? "\"%s\": " : "<%s>", key);
	const char *found = strstr(run->output, pattern);
	if (found == NULL || sscanf(found + strlen(pattern), "%lf", value) != 1) {
		fprintf(stderr, "No '%s' value in the output:\n%s\n", key, run->output);
		return false;
	}
	return true;
}

// A JSON or XML document of the solved frame: the whole stdout is the document, with the same values the text
// output has, checked against the rendered frame like solution_matches_frame()
static bool document_matches_frame(tool_run *run, bool json) {
	tool_solution solution;
	double parity, image_width, image_height, matched, star_matches, rms, time;
	REQUIRE(run->exit_code == 0);
	if (json) {
		REQUIRE(!strncmp(run->output, "{\n", 2));
		REQUIRE(strlen(run->output) > 2 && !strcmp(run->output + strlen(run->output) - 2, "}\n"));
		REQUIRE(output_contains(run, "\"solved\": true,"));
		REQUIRE(output_contains(run, "\"epoch\": \"J2000\","));
		REQUIRE(output_contains(run, "\"index\": \"5° Tycho-2 (FOV 4.5° - 10°)\"\n}\n"));
		REQUIRE(output_contains(run, "\"ra_hms\": \""));
		REQUIRE(output_contains(run, "\"dec_dms\": \"+5:"));
		REQUIRE(strstr(run->output, "\"message\"") == NULL);
	} else {
		static const char *prolog = "<?xml version=\"1.0\" encoding=\"UTF-8\"?>\n<solution>\n";
		REQUIRE(!strncmp(run->output, prolog, strlen(prolog)));
		REQUIRE(strlen(run->output) > 12 && !strcmp(run->output + strlen(run->output) - 12, "</solution>\n"));
		REQUIRE(output_contains(run, "<solved>true</solved>"));
		REQUIRE(output_contains(run, "<epoch>J2000</epoch>"));
		REQUIRE(output_contains(run, "<index>5° Tycho-2 (FOV 4.5° - 10°)</index>"));
		REQUIRE(output_contains(run, "<ra_hms>"));
		REQUIRE(output_contains(run, "<dec_dms>+5:"));
		REQUIRE(strstr(run->output, "<message>") == NULL);
	}
	REQUIRE(document_value(run, json, "ra", &solution.ra));
	REQUIRE(document_value(run, json, "dec", &solution.dec));
	REQUIRE(document_value(run, json, "angle", &solution.angle));
	REQUIRE(document_value(run, json, "scale", &solution.scale));
	REQUIRE(document_value(run, json, "field_width", &solution.width));
	REQUIRE(document_value(run, json, "field_height", &solution.height));
	REQUIRE(document_value(run, json, "parity", &parity));
	REQUIRE(document_value(run, json, "image_width", &image_width));
	REQUIRE(document_value(run, json, "image_height", &image_height));
	REQUIRE(document_value(run, json, "matched_stars", &matched));
	REQUIRE(document_value(run, json, "star_matches", &star_matches));
	REQUIRE(document_value(run, json, "rms", &rms));
	REQUIRE(document_value(run, json, "time", &time));
	double distance = indigo_angular_distance(solution.ra * 15 * DEG_TO_RAD, solution.dec * DEG_TO_RAD, image_ra, image_dec) / ARCSEC_TO_RAD;
	REQUIRE(distance < 10);
	REQUIRE(fabs(solution.scale / (IMAGE_SCALE * RAD_TO_DEG) - 1) < 0.003);
	REQUIRE(fabs(solution.width - IMAGE_WIDTH * solution.scale) < 1e-5);
	REQUIRE(fabs(solution.height - IMAGE_HEIGHT * solution.scale) < 1e-5);
	REQUIRE(fabs(solution.angle - IMAGE_ANGLE * RAD_TO_DEG) < 0.3);
	REQUIRE(parity == -1);
	REQUIRE(image_width == IMAGE_WIDTH && image_height == IMAGE_HEIGHT);
	REQUIRE(matched >= 4 && matched <= star_matches);
	REQUIRE(rms >= 0 && rms < 10);
	REQUIRE(time >= 0);
	return true;
}

// -------------------------------------------------------------------------------- WCS files

typedef struct {
	char data[4 * 2880];
	long size;
	double crval1, crval2, crpix1, crpix2, cd1_1, cd1_2, cd2_1, cd2_2;
} wcs_file;

// The value of the header card with this keyword, NULL without one; the cards before END only
static const char *wcs_card_value(wcs_file *wcs, const char *key) {
	char keyword[9];
	snprintf(keyword, sizeof(keyword), "%-8s", key);
	for (long offset = 0; offset + 80 <= wcs->size; offset += 80) {
		const char *card = wcs->data + offset;
		if (!strncmp(card, "END     ", 8)) {
			return NULL;
		}
		if (!strncmp(card, keyword, 8) && card[8] == '=' && card[9] == ' ') {
			return card + 10;
		}
	}
	return NULL;
}

static bool wcs_card_number(wcs_file *wcs, const char *key, double *value) {
	const char *card = wcs_card_value(wcs, key);
	if (card == NULL || sscanf(card, "%lf", value) != 1) {
		fprintf(stderr, "No number for '%s' in the WCS file\n", key);
		return false;
	}
	return true;
}

static bool wcs_card_is(wcs_file *wcs, const char *key, const char *value) {
	const char *card = wcs_card_value(wcs, key);
	if (card == NULL || strncmp(card, value, strlen(value))) {
		fprintf(stderr, "'%s' is not '%s' in the WCS file\n", key, value);
		return false;
	}
	return true;
}

// A .wcs file as Astrometry.net and ASTAP write it: a FITS header without data, printable ASCII cards of 80
// characters up to END, padded with spaces to whole 2880 byte records, with a TAN projection in J2000
static bool read_wcs_file(const char *path, wcs_file *wcs) {
	FILE *file = fopen(path, "rb");
	REQUIRE(file != NULL);
	wcs->size = (long)fread(wcs->data, 1, sizeof(wcs->data), file);
	fclose(file);
	REQUIRE(wcs->size == 2880);
	for (long i = 0; i < wcs->size; i++) {
		REQUIRE(wcs->data[i] >= 0x20 && wcs->data[i] <= 0x7E);
	}
	long end = -1;
	for (long offset = 0; offset < wcs->size && end < 0; offset += 80) {
		if (!strncmp(wcs->data + offset, "END     ", 8)) {
			end = offset;
		}
	}
	REQUIRE(end > 0);
	for (long i = end + 3; i < wcs->size; i++) {
		REQUIRE(wcs->data[i] == ' ');
	}
	REQUIRE(!strncmp(wcs->data, "SIMPLE  =                    T", 30));
	REQUIRE(wcs_card_is(wcs, "NAXIS", "                   0"));
	REQUIRE(wcs_card_is(wcs, "CTYPE1", "'RA---TAN'"));
	REQUIRE(wcs_card_is(wcs, "CTYPE2", "'DEC--TAN'"));
	REQUIRE(wcs_card_is(wcs, "RADESYS", "'ICRS'"));
	REQUIRE(wcs_card_is(wcs, "CREATOR", "'indigo_solver'"));
	double equinox, width, height;
	REQUIRE(wcs_card_number(wcs, "EQUINOX", &equinox) && equinox == 2000);
	REQUIRE(wcs_card_number(wcs, "IMAGEW", &width) && width == IMAGE_WIDTH);
	REQUIRE(wcs_card_number(wcs, "IMAGEH", &height) && height == IMAGE_HEIGHT);
	REQUIRE(wcs_card_number(wcs, "CRVAL1", &wcs->crval1));
	REQUIRE(wcs_card_number(wcs, "CRVAL2", &wcs->crval2));
	REQUIRE(wcs_card_number(wcs, "CRPIX1", &wcs->crpix1));
	REQUIRE(wcs_card_number(wcs, "CRPIX2", &wcs->crpix2));
	REQUIRE(wcs_card_number(wcs, "CD1_1", &wcs->cd1_1));
	REQUIRE(wcs_card_number(wcs, "CD1_2", &wcs->cd1_2));
	REQUIRE(wcs_card_number(wcs, "CD2_1", &wcs->cd2_1));
	REQUIRE(wcs_card_number(wcs, "CD2_2", &wcs->cd2_2));
	return true;
}

// The sky position of the FITS pixel (x, y), 1 based, by the TAN projection of the file, in radians
static void wcs_pixel_to_sky(wcs_file *wcs, double x, double y, double *ra, double *dec) {
	double xi = (wcs->cd1_1 * (x - wcs->crpix1) + wcs->cd1_2 * (y - wcs->crpix2)) * DEG_TO_RAD;
	double eta = (wcs->cd2_1 * (x - wcs->crpix1) + wcs->cd2_2 * (y - wcs->crpix2)) * DEG_TO_RAD;
	double crval_ra = wcs->crval1 * DEG_TO_RAD, crval_dec = wcs->crval2 * DEG_TO_RAD;
	double denominator = cos(crval_dec) - eta * sin(crval_dec);
	*dec = atan2(sin(crval_dec) + eta * cos(crval_dec), hypot(xi, denominator));
	*ra = crval_ra + atan2(xi, denominator);
}

// Every catalog star rendered into the frame is where the WCS file puts its pixel, within the tolerance (arcseconds);
// a mirrored frame has its columns in the reverse order
static bool wcs_file_matches_frame(const char *path, bool mirrored, double tolerance) {
	wcs_file wcs;
	REQUIRE(read_wcs_file(path, &wcs));
	int checked = 0;
	for (int i = 0; i < CATALOG_STAR_COUNT; i++) {
		float x, y;
		if (indigo_radec_to_xy(image_ra, image_dec, IMAGE_ANGLE, IMAGE_SCALE, IMAGE_WIDTH, IMAGE_HEIGHT, -1, frame_stars[i].ra, frame_stars[i].dec, &x, &y)) {
			if (mirrored) {
				x = IMAGE_WIDTH - 1 - x;
			}
			double ra, dec;
			wcs_pixel_to_sky(&wcs, x + 1, y + 1, &ra, &dec);
			double distance = indigo_angular_distance(ra, dec, frame_stars[i].ra, frame_stars[i].dec) / ARCSEC_TO_RAD;
			if (distance >= tolerance) {
				fprintf(stderr, "Star %d at pixel %.1f, %.1f is %.1f\" from its position by the WCS file\n", i, x + 1, y + 1, distance);
			}
			REQUIRE(distance < tolerance);
			checked++;
		}
	}
	REQUIRE(checked >= 10);
	return true;
}

// -------------------------------------------------------------------------------- lifecycle

static bool setup(void) {
	snprintf(work_dir, sizeof(work_dir), "/tmp/indigo-solver-tool.XXXXXX");
	REQUIRE(mkdtemp(work_dir) != NULL);
	snprintf(index_dir, sizeof(index_dir), "%s/solver", work_dir);
	snprintf(empty_dir, sizeof(empty_dir), "%s/empty", work_dir);
	REQUIRE(mkdir(index_dir, 0755) == 0);
	REQUIRE(mkdir(empty_dir, 0755) == 0);
	char index_path[PATH_MAX];
	indigo_solver_index_path(index_path, sizeof(index_path), index_dir, 5);
	REQUIRE(write_synthetic_index(index_path));
	long size;
	indigo_raw_header *image = render_image(index_path, &size);
	REQUIRE(image != NULL);
	snprintf(raw_path, sizeof(raw_path), "%s/frame.raw", work_dir);
	snprintf(fits_path, sizeof(fits_path), "%s/frame.fits", work_dir);
	snprintf(text_path, sizeof(text_path), "%s/frame.txt", work_dir);
	bool ok = write_file(raw_path, image, size);
	char *fits = NULL;
	int fits_size = 0;
	ok = ok && indigo_raw_to_fits((char *)image, (int)size, &fits, &fits_size, NULL) == INDIGO_OK && write_file(fits_path, fits, fits_size);
	free(fits);
	free(image);
	REQUIRE(ok);
	REQUIRE(write_file(text_path, "not an image\n", 13));
	// the frame with its columns in the reverse order has the other parity
	snprintf(mirrored_path, sizeof(mirrored_path), "%s/mirrored.raw", work_dir);
	snprintf(wcs_path, sizeof(wcs_path), "%s/frame.wcs", work_dir);
	image = render_image(index_path, &size);
	REQUIRE(image != NULL);
	uint16_t *pixels = (uint16_t *)(image + 1);
	for (int y = 0; y < IMAGE_HEIGHT; y++) {
		for (int x = 0; x < IMAGE_WIDTH / 2; x++) {
			uint16_t pixel = pixels[y * IMAGE_WIDTH + x];
			pixels[y * IMAGE_WIDTH + x] = pixels[y * IMAGE_WIDTH + IMAGE_WIDTH - 1 - x];
			pixels[y * IMAGE_WIDTH + IMAGE_WIDTH - 1 - x] = pixel;
		}
	}
	ok = write_file(mirrored_path, image, size);
	free(image);
	REQUIRE(ok);
	// the matching 5° index and, as the 0.5° index, another random patch around the same centre that matches nothing
	snprintf(two_index_dir, sizeof(two_index_dir), "%s/two", work_dir);
	REQUIRE(mkdir(two_index_dir, 0755) == 0);
	char path[PATH_MAX];
	char matching[PATH_MAX];
	indigo_solver_index_path(matching, sizeof(matching), index_dir, 5);
	indigo_solver_index_path(path, sizeof(path), two_index_dir, 5);
	REQUIRE(copy_file(matching, path));
	indigo_solver_index_path(path, sizeof(path), two_index_dir, 0.5);
	REQUIRE(write_synthetic_index(path));
	// the same and, as the 2° index, a third random patch that matches nothing
	snprintf(three_index_dir, sizeof(three_index_dir), "%s/three", work_dir);
	REQUIRE(mkdir(three_index_dir, 0755) == 0);
	char copy[PATH_MAX];
	indigo_solver_index_path(copy, sizeof(copy), three_index_dir, 5);
	REQUIRE(copy_file(matching, copy));
	indigo_solver_index_path(copy, sizeof(copy), three_index_dir, 0.5);
	REQUIRE(copy_file(path, copy));
	indigo_solver_index_path(copy, sizeof(copy), three_index_dir, 2);
	REQUIRE(write_synthetic_index(copy));
	return true;
}

static void cleanup(void) {
	if (*work_dir) {
		indigo_test_remove_tree(work_dir);
	}
}

// -------------------------------------------------------------------------------- tests

// -h lists every switch with its default, the index directory derived from INDIGO_CACHE_BASE like in the agent
static void help_lists_switches_and_defaults(void) {
	tool_run run;
	ASSERT_TRUE(run_tool(&run, work_dir, "-h"));
	ASSERT_EQ_INT(0, run.exit_code);
	const char *expected[] = { "Usage: indigo_solver [options] image_file", "--index-dir", "--index", "--scale", "--ra", "--dec", "--radius", "--epoch", "--parity", "--downsample", "--depth", "--cpu-limit", "--format", "text, json, xml or wcs", "(default: text)", "With wcs the solution is a WCS FITS header on the standard output", "always in J2000; nothing is written to the standard output when the image is not solved", "2 on wrong arguments.\n", "--verbose", "--help", "0.2,0.5,1,2,5,10,20", "(default: 2)", "(default: 180)", "(default: 2000)" };
	for (unsigned i = 0; i < sizeof(expected) / sizeof(expected[0]); i++) {
		ASSERT_TRUE(output_contains(&run, expected[i]));
	}
	char directory[PATH_MAX + 32];
	snprintf(directory, sizeof(directory), "(default: %s)", index_dir);
	ASSERT_TRUE(output_contains(&run, directory));
	// the version and the build as indigo_prop_tool shows them, then the build date
	char version[64];
	snprintf(version, sizeof(version), "INDIGO Solver v.%d.%d-%s built on ", (INDIGO_VERSION_CURRENT >> 8) & 0xFF, INDIGO_VERSION_CURRENT & 0xFF, INDIGO_BUILD);
	ASSERT_TRUE(strncmp(run.output, version, strlen(version)) == 0);
	ASSERT_TRUE(output_contains(&run, ".\nPart of the INDIGO project, https://www.indigo-astronomy.org\n\n"));
	ASSERT_TRUE(run_tool(&run, work_dir, "--help %s", raw_path));
	ASSERT_EQ_INT(0, run.exit_code);
	ASSERT_TRUE(output_contains(&run, "Usage: indigo_solver"));
	ASSERT_FALSE(strstr(run.output, "Solved") != NULL);
}

// Without arguments the help is shown and the exit code is the one of wrong arguments
static void no_arguments_show_help(void) {
	tool_run run;
	ASSERT_TRUE(run_tool(&run, work_dir, ""));
	ASSERT_EQ_INT(2, run.exit_code);
	ASSERT_TRUE(output_contains(&run, "Usage: indigo_solver"));
}

// The full resolution RAW frame keeps the full centroid precision
static void solves_raw_frame(void) {
	tool_run run;
	ASSERT_TRUE(run_tool(&run, empty_dir, "-i '%s' -D 1 '%s'", index_dir, raw_path));
	ASSERT_TRUE(solution_matches_frame(&run, 10, 0.003));
}

// The default 2 x 2 binning reports the solution in unbinned pixels
static void solves_with_default_downsampling(void) {
	tool_run run;
	ASSERT_TRUE(run_tool(&run, empty_dir, "--index-dir '%s' '%s'", index_dir, raw_path));
	ASSERT_TRUE(solution_matches_frame(&run, 30, 0.005));
}

static void solves_fits_frame(void) {
	tool_run run;
	ASSERT_TRUE(run_tool(&run, empty_dir, "-i '%s' -D 1 '%s'", index_dir, fits_path));
	ASSERT_TRUE(solution_matches_frame(&run, 10, 0.003));
}

// Without -i the indexes are taken from $INDIGO_CACHE_BASE/solver, where the agent keeps them
static void default_index_directory_follows_cache_base(void) {
	tool_run run;
	ASSERT_TRUE(run_tool(&run, work_dir, "-D 1 '%s'", raw_path));
	ASSERT_TRUE(solution_matches_frame(&run, 10, 0.003));
	ASSERT_TRUE(run_tool(&run, empty_dir, "-D 1 '%s'", raw_path));
	ASSERT_EQ_INT(1, run.exit_code);
	ASSERT_TRUE(output_contains(&run, "Not solved: No index files found"));
}

// The scale hint selects the index fitting the field first
static void solves_with_scale_hint(void) {
	tool_run run;
	ASSERT_TRUE(run_tool(&run, empty_dir, "-i '%s' -D 1 -s %.8f '%s'", index_dir, IMAGE_SCALE * RAD_TO_DEG, raw_path));
	ASSERT_TRUE(solution_matches_frame(&run, 10, 0.003));
}

// A position hint half a degree away, given in decimal and in sexagesimal form, with a 2° radius keeps the solution
static void solves_with_position_hint(void) {
	tool_run run;
	double ra = (ra0 + 0.5 * DEG_TO_RAD) * RAD_TO_DEG / 15, dec = dec0 * RAD_TO_DEG;
	ASSERT_TRUE(run_tool(&run, empty_dir, "-i '%s' -D 1 -r %.6f -d %.6f -R 2 '%s'", index_dir, ra, dec, raw_path));
	ASSERT_TRUE(solution_matches_frame(&run, 10, 0.003));
	char ra_string[32], dec_string[32];
	indigo_dtos_r(ra, "%d:%02d:%05.2f", ra_string, sizeof(ra_string));
	indigo_dtos_r(dec, "%d:%02d:%04.1f", dec_string, sizeof(dec_string));
	ASSERT_TRUE(run_tool(&run, empty_dir, "-i '%s' -D 1 --ra %s --dec %s --radius 2 '%s'", index_dir, ra_string, dec_string, raw_path));
	ASSERT_TRUE(solution_matches_frame(&run, 10, 0.003));
}

// A position hint 30° away leaves no catalog quads in the cone
static void wrong_position_hint_fails(void) {
	tool_run run;
	ASSERT_TRUE(run_tool(&run, empty_dir, "-i '%s' -D 1 -r %.6f -d %.6f -R 2 '%s'", index_dir, (ra0 + 30 * DEG_TO_RAD) * RAD_TO_DEG / 15, dec0 * RAD_TO_DEG, raw_path));
	ASSERT_EQ_INT(1, run.exit_code);
	ASSERT_TRUE(output_contains(&run, "Not solved: No solution found"));
	ASSERT_FALSE(strstr(run.output, "RA:") != NULL);
}

// The JNow epoch reads the position hint in JNow and reports the solution in JNow
static void jnow_epoch_hint_and_solution(void) {
	tool_run run;
	double ra = (ra0 + 0.5 * DEG_TO_RAD) * RAD_TO_DEG / 15, dec = dec0 * RAD_TO_DEG;
	indigo_j2k_to_jnow(&ra, &dec);
	ASSERT_TRUE(run_tool(&run, empty_dir, "-i '%s' -D 1 -e 0 -r %.6f -d %.6f -R 2 '%s'", index_dir, ra, dec, raw_path));
	ASSERT_EQ_INT(0, run.exit_code);
	ASSERT_TRUE(output_contains(&run, "Epoch:    JNow"));
	tool_solution solution;
	ASSERT_TRUE(parse_solution(&run, &solution));
	double solved_ra = solution.ra, solved_dec = solution.dec;
	indigo_jnow_to_j2k(&solved_ra, &solved_dec);
	ASSERT_TRUE(indigo_angular_distance(solved_ra * 15 * DEG_TO_RAD, solved_dec * DEG_TO_RAD, image_ra, image_dec) < 10 * ARCSEC_TO_RAD);
	// the JNow centre differs from the J2000 one by the precession since 2000
	ASSERT_TRUE(indigo_angular_distance(solution.ra * 15 * DEG_TO_RAD, solution.dec * DEG_TO_RAD, image_ra, image_dec) > 60 * ARCSEC_TO_RAD);
}

// The frame has parity -1: the parity hint 1 rejects it, -1 accepts it
static void parity_hint(void) {
	tool_run run;
	ASSERT_TRUE(run_tool(&run, empty_dir, "-i '%s' -D 1 -p 1 '%s'", index_dir, raw_path));
	ASSERT_EQ_INT(1, run.exit_code);
	ASSERT_TRUE(output_contains(&run, "Not solved: Solution has the wrong parity"));
	ASSERT_TRUE(run_tool(&run, empty_dir, "-i '%s' -D 1 --parity -1 '%s'", index_dir, raw_path));
	ASSERT_TRUE(solution_matches_frame(&run, 10, 0.003));
}

// The depth hint tries the brightest stars first, the verbose progress shows the stages
static void depth_hint_and_verbose_progress(void) {
	tool_run run;
	ASSERT_TRUE(run_tool(&run, empty_dir, "-v -i '%s' -D 1 -t 8 '%s'", index_dir, raw_path));
	ASSERT_TRUE(solution_matches_frame(&run, 10, 0.003));
	ASSERT_TRUE(output_contains(&run, "Image 1600 x 1200, binned 1 x 1"));
	ASSERT_TRUE(output_contains(&run, " stars detected"));
	ASSERT_TRUE(output_contains(&run, "Solving with index 5° Tycho-2 (FOV 4.5° - 10°)..."));
	ASSERT_TRUE(output_contains(&run, "Stage 1: 8 brightest stars"));
	ASSERT_TRUE(output_contains(&run, "is not installed"));
}

// -f json writes the solution as one JSON document on stdout, with the same values as the text output; the progress
// of -v goes to stderr, so stdout stays a valid document
static void json_output_of_a_solution(void) {
	tool_run run, text;
	ASSERT_TRUE(run_tool_stdout(&run, empty_dir, "-v -f json -i '%s' -D 1 '%s'", index_dir, raw_path));
	ASSERT_TRUE(document_matches_frame(&run, true));
	ASSERT_FALSE(strstr(run.output, "Solving with index") != NULL);
	ASSERT_TRUE(run_tool(&text, empty_dir, "-v --format json -i '%s' -D 1 '%s'", index_dir, raw_path));
	ASSERT_EQ_INT(0, text.exit_code);
	ASSERT_TRUE(output_contains(&text, "Solving with index 5° Tycho-2 (FOV 4.5° - 10°)..."));
	ASSERT_TRUE(run_tool(&text, empty_dir, "-i '%s' -D 1 '%s'", index_dir, raw_path));
	tool_solution solution;
	double ra, dec;
	ASSERT_TRUE(parse_solution(&text, &solution));
	ASSERT_TRUE(document_value(&run, true, "ra", &ra));
	ASSERT_TRUE(document_value(&run, true, "dec", &dec));
	ASSERT_TRUE(fabs(ra - solution.ra) < 1e-6 && fabs(dec - solution.dec) < 1e-6);
}

// -f xml writes the same values as one XML document on stdout
static void xml_output_of_a_solution(void) {
	tool_run run;
	ASSERT_TRUE(run_tool_stdout(&run, empty_dir, "-v -f xml -i '%s' -D 1 '%s'", index_dir, raw_path));
	ASSERT_TRUE(document_matches_frame(&run, false));
	ASSERT_FALSE(strstr(run.output, "Solving with index") != NULL);
	ASSERT_TRUE(run_tool_stdout(&run, empty_dir, "-f text -i '%s' -D 1 '%s'", index_dir, raw_path));
	ASSERT_TRUE(solution_matches_frame(&run, 10, 0.003));
}

// The epoch of a JNow solution is named in the document too
static void structured_output_names_the_epoch(void) {
	tool_run run;
	ASSERT_TRUE(run_tool_stdout(&run, empty_dir, "-f json -e 0 -i '%s' -D 1 '%s'", index_dir, raw_path));
	ASSERT_EQ_INT(0, run.exit_code);
	ASSERT_TRUE(output_contains(&run, "\"epoch\": \"JNow\","));
	ASSERT_TRUE(run_tool_stdout(&run, empty_dir, "-f xml -e 0 -i '%s' -D 1 '%s'", index_dir, raw_path));
	ASSERT_EQ_INT(0, run.exit_code);
	ASSERT_TRUE(output_contains(&run, "<epoch>JNow</epoch>"));
}

// An image that is not solved, and a file that can't be read, give a document with the reason and exit code 1
static void structured_output_when_not_solved(void) {
	tool_run run;
	ASSERT_TRUE(run_tool_stdout(&run, empty_dir, "-f json -i '%s' '%s'", empty_dir, raw_path));
	ASSERT_EQ_INT(1, run.exit_code);
	ASSERT_TRUE(output_contains(&run, "\"solved\": false,"));
	ASSERT_TRUE(output_contains(&run, "\"message\": \"No index files found, download them with --download or the Platesolver Agent, or select another index directory\"\n}\n"));
	ASSERT_FALSE(strstr(run.output, "\"ra\"") != NULL);
	ASSERT_TRUE(run_tool(&run, empty_dir, "-f json -i '%s' '%s'", empty_dir, raw_path));
	ASSERT_EQ_INT(1, run.exit_code);
	ASSERT_TRUE(output_contains(&run, "Not solved: No index files found"));
	ASSERT_TRUE(run_tool_stdout(&run, empty_dir, "-f xml -i '%s' '%s'", index_dir, text_path));
	ASSERT_EQ_INT(1, run.exit_code);
	ASSERT_TRUE(output_contains(&run, "<solved>false</solved>"));
	ASSERT_TRUE(output_contains(&run, "<message>Unsupported image format"));
	ASSERT_FALSE(strstr(run.output, "<ra>") != NULL);
	char missing[PATH_MAX + 16];
	snprintf(missing, sizeof(missing), "%s/missing.raw", work_dir);
	ASSERT_TRUE(run_tool_stdout(&run, empty_dir, "-f json -i '%s' '%s'", index_dir, missing));
	ASSERT_EQ_INT(1, run.exit_code);
	ASSERT_TRUE(output_contains(&run, "\"message\": \"Can't read the image file\""));
	ASSERT_TRUE(run_tool(&run, empty_dir, "-f xml -i '%s' '%s'", index_dir, missing));
	ASSERT_EQ_INT(1, run.exit_code);
	ASSERT_TRUE(output_contains(&run, "can't open"));
	ASSERT_TRUE(output_contains(&run, "<message>Can&apos;t read the image file</message>"));
	// the text output keeps its messages on stderr and prints nothing on stdout
	ASSERT_TRUE(run_tool_stdout(&run, empty_dir, "-i '%s' '%s'", empty_dir, raw_path));
	ASSERT_EQ_INT(1, run.exit_code);
	ASSERT_EQ_INT(0, (int)strlen(run.output));
}

// The file name is escaped for the document
static void structured_output_escapes_the_file_name(void) {
	char path[PATH_MAX + 32];
	snprintf(path, sizeof(path), "%s/frame \"a&b<c>\\.raw", work_dir);
	ASSERT_TRUE(copy_file(raw_path, path));
	tool_run run;
	ASSERT_TRUE(run_tool_stdout(&run, empty_dir, "-f json -i '%s' -D 1 '%s'", index_dir, path));
	ASSERT_EQ_INT(0, run.exit_code);
	ASSERT_TRUE(output_contains(&run, "/frame \\\"a&b<c>\\\\.raw\",\n"));
	ASSERT_TRUE(run_tool_stdout(&run, empty_dir, "-f xml -i '%s' -D 1 '%s'", index_dir, path));
	ASSERT_EQ_INT(0, run.exit_code);
	ASSERT_TRUE(output_contains(&run, "/frame &quot;a&amp;b&lt;c&gt;\\.raw</file>\n"));
	unlink(path);
	// control characters and bytes that are not UTF-8 would make the document invalid, they become '?'; UTF-8 stays
	snprintf(path, sizeof(path), "%s/frame\x01\x1b\xe9\xc3\xa9.raw", work_dir);
	ASSERT_TRUE(copy_file(raw_path, path));
	ASSERT_TRUE(run_tool_stdout(&run, empty_dir, "-f json -i '%s' -D 1 '%s'", index_dir, path));
	ASSERT_EQ_INT(0, run.exit_code);
	ASSERT_TRUE(output_contains(&run, "/frame???\xc3\xa9.raw\",\n"));
	ASSERT_TRUE(run_tool_stdout(&run, empty_dir, "-f xml -i '%s' -D 1 '%s'", index_dir, path));
	ASSERT_EQ_INT(0, run.exit_code);
	ASSERT_TRUE(output_contains(&run, "/frame???\xc3\xa9.raw</file>\n"));
	unlink(path);
}

// An argument error gives no document, only the message on stderr and exit code 2
static void structured_output_not_given_for_wrong_arguments(void) {
	tool_run run;
	ASSERT_TRUE(run_tool_stdout(&run, empty_dir, "-f json -x 3 -i '%s' '%s'", index_dir, raw_path));
	ASSERT_EQ_INT(2, run.exit_code);
	ASSERT_EQ_INT(0, (int)strlen(run.output));
	ASSERT_TRUE(run_tool_stdout(&run, empty_dir, "-f xml -R 2 -i '%s' '%s'", index_dir, raw_path));
	ASSERT_EQ_INT(2, run.exit_code);
	ASSERT_EQ_INT(0, (int)strlen(run.output));
	ASSERT_TRUE(run_tool_stdout(&run, empty_dir, "-f wcs -x 3 -i '%s' '%s'", index_dir, raw_path));
	ASSERT_EQ_INT(2, run.exit_code);
	ASSERT_EQ_INT(0, (int)strlen(run.output));
	ASSERT_TRUE(run_tool(&run, empty_dir, "-f json -x 3 -i '%s' '%s'", index_dir, raw_path));
	ASSERT_EQ_INT(2, run.exit_code);
	ASSERT_TRUE(output_contains(&run, "unknown index scale '3'"));
}

// Without the scale the largest index is searched first, stage by stage: the first stage on every index, then the
// next stage in the opposite order starting with the index loaded last. Only the 5° index matches the frame; the
// depth 4 leaves the first stage without quads, so the 0.5° index is searched in the second stage before the 5° one
static void blind_search_goes_stage_by_stage(void) {
	tool_run run;
	ASSERT_TRUE(run_tool(&run, empty_dir, "-v -i '%s' -D 1 '%s'", two_index_dir, raw_path));
	ASSERT_TRUE(solution_matches_frame(&run, 10, 0.003));
	const char *first[] = { "Solving with index 5° Tycho-2 (FOV 4.5° - 10°)...\nStage 1:", "Solved in " };
	ASSERT_TRUE(output_in_order(&run, first, 2));
	ASSERT_FALSE(strstr(run.output, "Solving with index 0.5° Gaia DR3 (FOV 0.45° - 1°)") != NULL);
	ASSERT_TRUE(run_tool(&run, empty_dir, "-v -i '%s' -D 1 -t 4 '%s'", two_index_dir, raw_path));
	ASSERT_TRUE(solution_matches_frame(&run, 10, 0.003));
	const char *order[] = { "Solving with index 5° Tycho-2 (FOV 4.5° - 10°)", "Solving with index 0.5° Gaia DR3 (FOV 0.45° - 1°)", "Solving with index 0.5° Gaia DR3 (FOV 0.45° - 1°)", "Solving with index 5° Tycho-2 (FOV 4.5° - 10°)", "Stage 2:", "Solved in " };
	if (!output_in_order(&run, order, 6)) {
		fprintf(stderr, "Unexpected search order:\n%s\n", run.output);
	}
	ASSERT_TRUE(output_in_order(&run, order, 6));
	const char *three_times[] = { "Solving with index 5° Tycho-2 (FOV 4.5° - 10°)", "Solving with index 5° Tycho-2 (FOV 4.5° - 10°)", "Solving with index 5° Tycho-2 (FOV 4.5° - 10°)" };
	ASSERT_FALSE(output_in_order(&run, three_times, 3));
}

// With the scale every stage starts with the index nearest to 0.7 x the 3.6° x 2.7° frame, then the next nearest: of
// 0.5°, 2° and 5° it is 2° (2.16), which matches nothing, then 5° (log distance 0.84 against 1.46 of 0.5°), then 0.5°.
// The depth 4 leaves the first stage without quads, so every index is tried in it, and the second stage solves the
// frame with the 5° index after the 2° one, before the 0.5° index is tried again
static void scaled_search_uses_fitting_index_first(void) {
	tool_run run;
	ASSERT_TRUE(run_tool(&run, empty_dir, "-v -i '%s' -D 1 -t 4 -s %.8f '%s'", three_index_dir, IMAGE_SCALE * RAD_TO_DEG, raw_path));
	ASSERT_TRUE(solution_matches_frame(&run, 10, 0.003));
	const char *order[] = { "Solving with index 2° Tycho-2 (FOV 2° - 4.5°)", "Solving with index 5° Tycho-2 (FOV 4.5° - 10°)", "Solving with index 0.5° Gaia DR3 (FOV 0.45° - 1°)", "Solving with index 2° Tycho-2 (FOV 2° - 4.5°)", "Stage 2:", "Solving with index 5° Tycho-2 (FOV 4.5° - 10°)", "Stage 2:", "Solved in " };
	if (!output_in_order(&run, order, 8)) {
		fprintf(stderr, "Unexpected search order:\n%s\n", run.output);
	}
	ASSERT_TRUE(output_in_order(&run, order, 8));
	const char *gaia_twice[] = { "Solving with index 0.5° Gaia DR3 (FOV 0.45° - 1°)", "Solving with index 0.5° Gaia DR3 (FOV 0.45° - 1°)" };
	ASSERT_FALSE(output_in_order(&run, gaia_twice, 2));
	const char *two_three_times[] = { "Solving with index 2° Tycho-2 (FOV 2° - 4.5°)", "Solving with index 2° Tycho-2 (FOV 2° - 4.5°)", "Solving with index 2° Tycho-2 (FOV 2° - 4.5°)" };
	ASSERT_FALSE(output_in_order(&run, two_three_times, 3));
}

// -x restricts the indexes, only uninstalled ones leave nothing to solve with; the CPU limit 0 means no limit
static void index_selection_and_cpu_limit(void) {
	tool_run run;
	ASSERT_TRUE(run_tool(&run, empty_dir, "-i '%s' -D 1 -x 5 -c 0 '%s'", index_dir, raw_path));
	ASSERT_TRUE(solution_matches_frame(&run, 10, 0.003));
	ASSERT_TRUE(run_tool(&run, empty_dir, "-i '%s' -x 10,20 '%s'", index_dir, raw_path));
	ASSERT_EQ_INT(1, run.exit_code);
	ASSERT_TRUE(output_contains(&run, "Not solved: No index files found"));
}

// Wrong switches and values are refused with exit code 2 before anything is read
static void invalid_arguments_are_refused(void) {
	static const struct {
		const char *arguments;
		const char *message;
	} cases[] = {
		{ "-p 2", "invalid value '2' for '-p'" },
		{ "-p 0.5", "invalid value '0.5' for '-p'" },
		{ "-D 0", "invalid value '0' for '-D'" },
		{ "-D 17", "invalid value '17' for '-D'" },
		{ "-t -1", "invalid value '-1' for '-t'" },
		{ "-s -0.1", "invalid value '-0.1' for '-s'" },
		{ "-s abc", "invalid value 'abc' for '-s'" },
		{ "-r 24", "invalid value '24' for '-r'" },
		{ "-r 1:x", "invalid value '1:x' for '-r'" },
		{ "-d 91", "invalid value '91' for '-d'" },
		{ "-R -1", "invalid value '-1' for '-R'" },
		{ "-e 1950", "invalid value '1950' for '-e'" },
		{ "-c -5", "invalid value '-5' for '-c'" },
		{ "-x 3", "unknown index scale '3'" },
		{ "-R 2", "the search radius needs both the RA and the Dec hint" },
		{ "-R 2 -r 6", "the search radius needs both the RA and the Dec hint" },
		{ "-f yaml", "invalid value 'yaml' for '-f'" },
		{ "--format JSON", "invalid value 'JSON' for '--format'" },
		{ "-q 1", "unknown option '-q'" },
		{ "--format WCS", "invalid value 'WCS' for '--format'" },
		{ "-w frame.wcs", "unknown option '-w'" },
	};
	tool_run run;
	for (unsigned i = 0; i < sizeof(cases) / sizeof(cases[0]); i++) {
		ASSERT_TRUE(run_tool(&run, empty_dir, "-i '%s' %s '%s'", index_dir, cases[i].arguments, raw_path));
		if (run.exit_code != 2) {
			fprintf(stderr, "Arguments '%s'\n", cases[i].arguments);
		}
		ASSERT_EQ_INT(2, run.exit_code);
		ASSERT_TRUE(output_contains(&run, cases[i].message));
	}
	ASSERT_TRUE(run_tool(&run, empty_dir, "-i '%s' '%s' '%s'", index_dir, raw_path, fits_path));
	ASSERT_EQ_INT(2, run.exit_code);
	ASSERT_TRUE(output_contains(&run, "only one image file can be solved"));
	ASSERT_TRUE(run_tool(&run, empty_dir, "-i '%s' '%s' -D", index_dir, raw_path));
	ASSERT_EQ_INT(2, run.exit_code);
	ASSERT_TRUE(output_contains(&run, "unknown option or missing value for '-D'"));
	ASSERT_TRUE(run_tool(&run, empty_dir, "-i '%s' -v", index_dir));
	ASSERT_EQ_INT(2, run.exit_code);
	ASSERT_TRUE(output_contains(&run, "no image file given"));
}

// A missing file and a file that is no image are not solved; the library log stays quiet without -v
static void unreadable_and_unsupported_files_fail(void) {
	tool_run run;
	char missing[PATH_MAX + 16];
	snprintf(missing, sizeof(missing), "%s/missing.raw", work_dir);
	ASSERT_TRUE(run_tool(&run, empty_dir, "-i '%s' '%s'", index_dir, missing));
	ASSERT_EQ_INT(1, run.exit_code);
	ASSERT_TRUE(output_contains(&run, "can't open"));
	ASSERT_TRUE(run_tool(&run, empty_dir, "-i '%s' '%s'", index_dir, text_path));
	ASSERT_EQ_INT(1, run.exit_code);
	ASSERT_TRUE(output_contains(&run, "Not solved: Unsupported image format"));
	ASSERT_FALSE(strstr(run.output, "libraw") != NULL);
	ASSERT_TRUE(run_tool(&run, empty_dir, "-v -i '%s' '%s'", index_dir, text_path));
	ASSERT_EQ_INT(1, run.exit_code);
	ASSERT_TRUE(output_contains(&run, "libraw"));
}

// -f wcs gives the solution as a WCS FITS header alone on stdout, which puts every rendered star on its catalog
// position; nothing else is printed without -v
static void wcs_output_of_a_solution(void) {
	tool_run run;
	remove(wcs_path);
	ASSERT_TRUE(run_tool_wcs(&run, empty_dir, "-f wcs -i '%s' -D 1 '%s'", index_dir, raw_path));
	ASSERT_EQ_INT(0, run.exit_code);
	ASSERT_EQ_INT(0, (int)strlen(run.output));
	ASSERT_TRUE(wcs_file_matches_frame(wcs_path, false, 10));
	wcs_file wcs;
	ASSERT_TRUE(read_wcs_file(wcs_path, &wcs));
	ASSERT_TRUE(wcs.crpix1 == (IMAGE_WIDTH + 1) / 2.0 && wcs.crpix2 == (IMAGE_HEIGHT + 1) / 2.0);
	ASSERT_TRUE(strstr(wcs.data, "COMMENT Solution of frame.raw ") != NULL);
	remove(wcs_path);
	ASSERT_TRUE(run_tool_wcs(&run, empty_dir, "-i '%s' --format wcs '%s'", index_dir, fits_path));
	ASSERT_EQ_INT(0, run.exit_code);
	ASSERT_TRUE(wcs_file_matches_frame(wcs_path, false, 30));
}

// The mirrored frame has parity 1, the WCS header has the columns the other way round
static void wcs_output_of_a_mirrored_frame(void) {
	tool_run run;
	remove(wcs_path);
	ASSERT_TRUE(run_tool_wcs(&run, empty_dir, "-f wcs -i '%s' -D 1 '%s'", index_dir, mirrored_path));
	ASSERT_EQ_INT(0, run.exit_code);
	ASSERT_TRUE(wcs_file_matches_frame(wcs_path, true, 10));
}

// The WCS header is in J2000 when the JNow epoch is selected
static void wcs_output_of_a_jnow_solution(void) {
	tool_run run;
	remove(wcs_path);
	ASSERT_TRUE(run_tool_wcs(&run, empty_dir, "-f wcs -e 0 -i '%s' -D 1 '%s'", index_dir, raw_path));
	ASSERT_EQ_INT(0, run.exit_code);
	ASSERT_TRUE(wcs_file_matches_frame(wcs_path, false, 10));
}

// The progress of -v goes to stderr, stdout holds the WCS header alone
static void wcs_output_with_verbose_progress(void) {
	tool_run run;
	remove(wcs_path);
	ASSERT_TRUE(run_tool_wcs(&run, empty_dir, "-v -f wcs -i '%s' -D 1 '%s'", index_dir, raw_path));
	ASSERT_EQ_INT(0, run.exit_code);
	ASSERT_TRUE(output_contains(&run, "Solving with index "));
	ASSERT_TRUE(output_contains(&run, "stars detected"));
	ASSERT_FALSE(strstr(run.output, "Solved in ") != NULL);
	ASSERT_TRUE(wcs_file_matches_frame(wcs_path, false, 10));
}

// An image that is not solved gives nothing on stdout, the reason on stderr and exit code 1
static void wcs_output_when_not_solved(void) {
	tool_run run;
	ASSERT_TRUE(run_tool_wcs(&run, empty_dir, "-f wcs -i '%s' -D 1 -r %.6f -d %.6f -R 2 '%s'", index_dir, (ra0 + 30 * DEG_TO_RAD) * RAD_TO_DEG / 15, dec0 * RAD_TO_DEG, raw_path));
	ASSERT_EQ_INT(1, run.exit_code);
	ASSERT_TRUE(output_contains(&run, "Not solved: No solution found"));
	ASSERT_EQ_INT(0, (int)file_size(wcs_path));
	ASSERT_TRUE(run_tool_wcs(&run, empty_dir, "-f wcs -i '%s' '%s'", index_dir, text_path));
	ASSERT_EQ_INT(1, run.exit_code);
	ASSERT_TRUE(output_contains(&run, "Not solved: Unsupported image format"));
	ASSERT_EQ_INT(0, (int)file_size(wcs_path));
	char missing[PATH_MAX + 16];
	snprintf(missing, sizeof(missing), "%s/missing.raw", work_dir);
	ASSERT_TRUE(run_tool_wcs(&run, empty_dir, "-f wcs -i '%s' '%s'", index_dir, missing));
	ASSERT_EQ_INT(1, run.exit_code);
	ASSERT_TRUE(output_contains(&run, "can't open"));
	ASSERT_EQ_INT(0, (int)file_size(wcs_path));
}

// -------------------------------------------------------------------------------- index management

static bool exists(const char *path) {
	struct stat status;
	return stat(path, &status) == 0;
}

static bool curl_available(void) {
	if (system("command -v curl >/dev/null 2>&1") != 0) {
		fprintf(stderr, "curl is not installed, the index download needs it\n");
		return false;
	}
	return true;
}

// The listed state of the index of the given scale, "-", "installed" or "invalid"
static bool listed_state(tool_run *run, float fov, const char *state) {
	char line[64];
	snprintf(line, sizeof(line), "\n  %-5g %-10s ", fov, state);
	return output_contains(run, line);
}

// The indexes are listed, downloaded into a new directory, used for solving and removed
static void index_management_lists_downloads_and_removes(void) {
	ASSERT_TRUE(curl_available());
	char managed[PATH_MAX + 16], path[PATH_MAX], part[PATH_MAX + 8], source[PATH_MAX];
	snprintf(managed, sizeof(managed), "%s/managed/indexes", work_dir);
	tool_run run;
	ASSERT_TRUE(run_tool(&run, empty_dir, "-i '%s' --list", managed));
	ASSERT_EQ_INT(0, run.exit_code);
	ASSERT_TRUE(output_contains(&run, "Index directory: "));
	ASSERT_TRUE(output_contains(&run, managed));
	for (int i = 0; i < INDIGO_SOLVER_INDEX_FOV_COUNT; i++) {
		char label[128], line[256];
		indigo_solver_index_label(indigo_solver_index_fovs[i], label, sizeof(label));
		snprintf(line, sizeof(line), "%s, %s\n", label, indigo_solver_index_sizes[i]);
		ASSERT_TRUE(listed_state(&run, indigo_solver_index_fovs[i], "-"));
		ASSERT_TRUE(output_contains(&run, line));
	}
	ASSERT_FALSE(exists(managed));
	// the directory is created, the index is downloaded and is the same file as the published one
	ASSERT_TRUE(run_tool(&run, empty_dir, "-i '%s' --download 5 --index-url 'file://%s'", managed, index_dir));
	ASSERT_EQ_INT(0, run.exit_code);
	ASSERT_TRUE(output_contains(&run, "Downloading 5° Tycho-2 (FOV 4.5° - 10°), 178 MB...\n"));
	indigo_solver_index_path(path, sizeof(path), managed, 5);
	indigo_solver_index_path(source, sizeof(source), index_dir, 5);
	char installed[PATH_MAX + 16];
	snprintf(installed, sizeof(installed), "Installed %s\n", path);
	ASSERT_TRUE(output_contains(&run, installed));
	ASSERT_EQ_INT((int)file_size(source), (int)file_size(path));
	snprintf(part, sizeof(part), "%s.part", path);
	ASSERT_FALSE(exists(part));
	ASSERT_TRUE(run_tool(&run, empty_dir, "-i '%s' -x 5 '%s'", managed, raw_path));
	ASSERT_TRUE(solution_matches_frame(&run, 30, 0.005));
	// an installed index is kept, a listed one is installed
	ASSERT_TRUE(run_tool(&run, empty_dir, "-i '%s' --download 5 --index-url 'file://%s'", managed, index_dir));
	ASSERT_EQ_INT(0, run.exit_code);
	ASSERT_TRUE(output_contains(&run, "5° Tycho-2 (FOV 4.5° - 10°) is already installed\n"));
	ASSERT_FALSE(strstr(run.output, "Downloading") != NULL);
	ASSERT_TRUE(run_tool(&run, empty_dir, "-i '%s' -l", managed));
	ASSERT_EQ_INT(0, run.exit_code);
	ASSERT_TRUE(listed_state(&run, 5, "installed"));
	ASSERT_TRUE(listed_state(&run, 2, "-"));
	// a damaged file is listed as invalid
	char damaged[PATH_MAX];
	indigo_solver_index_path(damaged, sizeof(damaged), managed, 2);
	ASSERT_TRUE(copy_file(text_path, damaged));
	ASSERT_TRUE(run_tool(&run, empty_dir, "-i '%s' -l", managed));
	ASSERT_EQ_INT(0, run.exit_code);
	ASSERT_TRUE(listed_state(&run, 2, "invalid"));
	// an invalid index is replaced by the download
	char invalid_five[PATH_MAX + 16];
	snprintf(invalid_five, sizeof(invalid_five), "%s/invalid", work_dir);
	ASSERT_EQ_INT(0, mkdir(invalid_five, 0755));
	char invalid_path[PATH_MAX];
	indigo_solver_index_path(invalid_path, sizeof(invalid_path), invalid_five, 5);
	ASSERT_TRUE(copy_file(text_path, invalid_path));
	ASSERT_TRUE(run_tool(&run, empty_dir, "-i '%s' --download 5 --index-url 'file://%s'", invalid_five, index_dir));
	ASSERT_EQ_INT(0, run.exit_code);
	ASSERT_TRUE(output_contains(&run, "5° Tycho-2 (FOV 4.5° - 10°) is invalid, it is replaced\n"));
	ASSERT_EQ_INT((int)file_size(source), (int)file_size(invalid_path));
	// removal of the installed indexes, a missing one is reported and is no error
	ASSERT_TRUE(run_tool(&run, empty_dir, "-i '%s' --remove 5,2,20", managed));
	ASSERT_EQ_INT(0, run.exit_code);
	char removed[PATH_MAX + 16];
	snprintf(removed, sizeof(removed), "Removed %s\n", path);
	ASSERT_TRUE(output_contains(&run, removed));
	ASSERT_TRUE(output_contains(&run, "20° Tycho-2 (FOV > 20°) is not installed\n"));
	ASSERT_FALSE(exists(path));
	ASSERT_FALSE(exists(damaged));
	ASSERT_TRUE(run_tool(&run, empty_dir, "-i '%s' --remove all", managed));
	ASSERT_EQ_INT(0, run.exit_code);
	ASSERT_TRUE(output_contains(&run, "5° Tycho-2 (FOV 4.5° - 10°) is not installed\n"));
	ASSERT_TRUE(output_contains(&run, "0.2° Gaia DR3 (FOV 0.2° - 0.45°) is not installed\n"));
	ASSERT_TRUE(exists(source));
}

// A failed download leaves neither the index nor the partial file, the other indexes are still downloaded
static void index_download_failures(void) {
	ASSERT_TRUE(curl_available());
	char managed[PATH_MAX + 16], path[PATH_MAX], part[PATH_MAX + 8];
	snprintf(managed, sizeof(managed), "%s/failures", work_dir);
	tool_run run;
	// 1° is not published there, the 0.5° index of the mirror has the header of a 5° index
	ASSERT_TRUE(run_tool(&run, empty_dir, "-i '%s' --download 1,0.5,5 --index-url 'file://%s'", managed, two_index_dir));
	ASSERT_EQ_INT(1, run.exit_code);
	ASSERT_TRUE(output_contains(&run, "1° Tycho-2 (FOV 1° - 2°) can't be downloaded: the download failed\n"));
	ASSERT_TRUE(output_contains(&run, "0.5° Gaia DR3 (FOV 0.45° - 1°) can't be downloaded: the downloaded file is not a valid index\n"));
	float failed[] = { 1, 0.5 };
	for (int i = 0; i < 2; i++) {
		indigo_solver_index_path(path, sizeof(path), managed, failed[i]);
		snprintf(part, sizeof(part), "%s.part", path);
		ASSERT_FALSE(exists(path));
		ASSERT_FALSE(exists(part));
	}
	indigo_solver_index_path(path, sizeof(path), managed, 5);
	ASSERT_TRUE(exists(path));
	// a URL that looks like a curl option is passed to curl as the URL
	ASSERT_TRUE(run_tool(&run, empty_dir, "-i '%s' --download 2 --index-url '-K%s'", managed, text_path));
	ASSERT_EQ_INT(1, run.exit_code);
	ASSERT_TRUE(output_contains(&run, "2° Tycho-2 (FOV 2° - 4.5°) can't be downloaded: the download failed\n"));
	// a directory that can't be created
	char blocked[PATH_MAX + 16];
	snprintf(blocked, sizeof(blocked), "%s/indexes", text_path);
	ASSERT_TRUE(run_tool(&run, empty_dir, "-i '%s' --download 5 --index-url 'file://%s'", blocked, index_dir));
	ASSERT_EQ_INT(1, run.exit_code);
	ASSERT_TRUE(output_contains(&run, "can't create the index directory"));
}

// The index management modes are exclusive and take no solving options
static void index_management_arguments_are_refused(void) {
	static const struct {
		const char *arguments;
		const char *message;
	} cases[] = {
		{ "--list frame.raw", "an image file can't be solved with --list" },
		{ "--download 5 frame.raw", "an image file can't be solved with --download" },
		{ "-l --remove 5", "only one of --list, --download and --remove can be given" },
		{ "--download 5 --remove 5", "only one of --list, --download and --remove can be given" },
		{ "--download 5 -x 5", "'-x' can't be used with --download" },
		{ "--remove 5 --format json", "'--format' can't be used with --remove" },
		{ "-s 0.001 --list", "'-s' can't be used with --list" },
		{ "--list --index-url file:///tmp", "--index-url can be used with --download only" },
		{ "--index-url file:///tmp frame.raw", "--index-url can be used with --download only" },
		{ "--download 3", "unknown index scale '3'" },
		{ "--remove 5,abc", "unknown index scale 'abc'" },
		{ "--download ''", "invalid value '' for '--download'" },
		{ "--download 5 --index-url ''", "invalid value '' for '--index-url'" },
		{ "--remove", "unknown option or missing value for '--remove'" },
	};
	tool_run run;
	for (unsigned i = 0; i < sizeof(cases) / sizeof(cases[0]); i++) {
		ASSERT_TRUE(run_tool(&run, empty_dir, "-i '%s' %s", empty_dir, cases[i].arguments));
		if (run.exit_code != 2) {
			fprintf(stderr, "Arguments '%s'\n", cases[i].arguments);
		}
		ASSERT_EQ_INT(2, run.exit_code);
		ASSERT_TRUE(output_contains(&run, cases[i].message));
	}
	ASSERT_TRUE(run_tool(&run, empty_dir, "-h"));
	const char *expected[] = { "Usage: indigo_solver [options] image_file\n       indigo_solver [-i <dir>] -l | --download <scales> | --remove <scales>", "-l, --list", "--download <scales>", "--remove <scales>", "--index-url <url>", INDIGO_SOLVER_INDEX_URL, "1 when an index can't be downloaded or removed" };
	for (unsigned i = 0; i < sizeof(expected) / sizeof(expected[0]); i++) {
		ASSERT_TRUE(output_contains(&run, expected[i]));
	}
}

// SIGINT, the terminal interrupt, stops the transfer of a source that never ends and removes the partial file
static void interrupted_download_removes_partial_file(void) {
	ASSERT_TRUE(curl_available());
	char mirror[PATH_MAX + 16], managed[PATH_MAX + 16], source[PATH_MAX], path[PATH_MAX], part[PATH_MAX + 8], errors[PATH_MAX + 16];
	snprintf(mirror, sizeof(mirror), "%s/endless", work_dir);
	snprintf(managed, sizeof(managed), "%s/interrupted", work_dir);
	snprintf(errors, sizeof(errors), "%s/interrupted.txt", work_dir);
	ASSERT_EQ_INT(0, mkdir(mirror, 0755));
	indigo_solver_index_path(source, sizeof(source), mirror, 1);
	ASSERT_EQ_INT(0, mkfifo(source, 0600));
	int fifo = open(source, O_RDWR | O_CLOEXEC);
	ASSERT_TRUE(fifo >= 0);
	ASSERT_EQ_INT(16, (int)write(fifo, "partial content\n", 16));
	indigo_solver_index_path(path, sizeof(path), managed, 1);
	snprintf(part, sizeof(part), "%s.part", path);
	char command[4 * PATH_MAX];
	snprintf(command, sizeof(command), "exec '%s' -i '%s' --download 1,5 --index-url 'file://%s' >'%s' 2>&1", INDIGO_SOLVER_EXECUTABLE, managed, mirror, errors);
	pid_t pid = fork();
	ASSERT_TRUE(pid >= 0);
	if (pid == 0) {
		// a group of its own, so the interrupt reaches the whole group like a terminal interrupt does
		setpgid(0, 0);
		execl("/bin/sh", "sh", "-c", command, (char *)NULL);
		_exit(127);
	}
	bool started = false;
	for (int i = 0; i < 500 && !started; i++) {
		started = exists(part);
		indigo_usleep(10000);
	}
	setpgid(pid, pid);
	kill(-pid, SIGINT);
	// when curl is not stopped the source is closed after 3 s, so that the test fails instead of blocking
	int status = 0;
	pid_t waited = 0;
	for (int i = 0; i < 300 && waited == 0; i++) {
		waited = waitpid(pid, &status, WNOHANG);
		indigo_usleep(10000);
	}
	close(fifo);
	if (waited == 0) {
		waitpid(pid, &status, 0);
	}
	ASSERT_TRUE(started);
	ASSERT_TRUE(waited == pid);
	ASSERT_TRUE(WIFEXITED(status));
	ASSERT_EQ_INT(1, WEXITSTATUS(status));
	ASSERT_FALSE(exists(part));
	ASSERT_FALSE(exists(path));
	// the interrupt stops the whole run, the next index is not downloaded
	indigo_solver_index_path(path, sizeof(path), managed, 5);
	ASSERT_FALSE(exists(path));
	tool_run run = { 0 };
	FILE *file = fopen(errors, "r");
	ASSERT_TRUE(file != NULL);
	size_t length = fread(run.output, 1, sizeof(run.output) - 1, file);
	run.output[length] = 0;
	fclose(file);
	ASSERT_TRUE(output_contains(&run, "the download was interrupted\n"));
	ASSERT_FALSE(strstr(run.output, "can't be downloaded") != NULL);
	// curl ran in the process group of its own and has ended with the tool
	char check[2 * PATH_MAX];
	snprintf(check, sizeof(check), "ps -A -o args= | awk -v part='%s' 'index($0, \"curl \") == 1 && index($0, part) { found = 1 } END { exit !found }'", part);
	ASSERT_TRUE(system(check) != 0);
}

static const indigo_test_case tests[] = {
	{ "help_lists_switches_and_defaults", help_lists_switches_and_defaults },
	{ "no_arguments_show_help", no_arguments_show_help },
	{ "solves_raw_frame", solves_raw_frame },
	{ "solves_with_default_downsampling", solves_with_default_downsampling },
	{ "solves_fits_frame", solves_fits_frame },
	{ "default_index_directory_follows_cache_base", default_index_directory_follows_cache_base },
	{ "solves_with_scale_hint", solves_with_scale_hint },
	{ "solves_with_position_hint", solves_with_position_hint },
	{ "wrong_position_hint_fails", wrong_position_hint_fails },
	{ "jnow_epoch_hint_and_solution", jnow_epoch_hint_and_solution },
	{ "parity_hint", parity_hint },
	{ "depth_hint_and_verbose_progress", depth_hint_and_verbose_progress },
	{ "blind_search_goes_stage_by_stage", blind_search_goes_stage_by_stage },
	{ "scaled_search_uses_fitting_index_first", scaled_search_uses_fitting_index_first },
	{ "index_selection_and_cpu_limit", index_selection_and_cpu_limit },
	{ "invalid_arguments_are_refused", invalid_arguments_are_refused },
	{ "unreadable_and_unsupported_files_fail", unreadable_and_unsupported_files_fail },
	{ "json_output_of_a_solution", json_output_of_a_solution },
	{ "xml_output_of_a_solution", xml_output_of_a_solution },
	{ "structured_output_names_the_epoch", structured_output_names_the_epoch },
	{ "structured_output_when_not_solved", structured_output_when_not_solved },
	{ "structured_output_escapes_the_file_name", structured_output_escapes_the_file_name },
	{ "structured_output_not_given_for_wrong_arguments", structured_output_not_given_for_wrong_arguments },
	{ "wcs_output_of_a_solution", wcs_output_of_a_solution },
	{ "wcs_output_of_a_mirrored_frame", wcs_output_of_a_mirrored_frame },
	{ "wcs_output_of_a_jnow_solution", wcs_output_of_a_jnow_solution },
	{ "wcs_output_with_verbose_progress", wcs_output_with_verbose_progress },
	{ "wcs_output_when_not_solved", wcs_output_when_not_solved },
	{ "index_management_lists_downloads_and_removes", index_management_lists_downloads_and_removes },
	{ "index_download_failures", index_download_failures },
	{ "index_management_arguments_are_refused", index_management_arguments_are_refused },
	{ "interrupted_download_removes_partial_file", interrupted_download_removes_partial_file },
};

int main(void) {
	indigo_set_log_level(INDIGO_LOG_ERROR);
	if (access(INDIGO_SOLVER_EXECUTABLE, X_OK) != 0) {
		fprintf(stderr, "Missing %s. Run 'make all' from the repository root first.\n", INDIGO_SOLVER_EXECUTABLE);
		return 1;
	}
	int result = 1;
	if (setup()) {
		result = indigo_run_tests(SUITE, tests, sizeof(tests) / sizeof(tests[0]));
	}
	cleanup();
	return result;
}
