// Copyright (c) 2026 INDIGO initiative
// All rights reserved.
//
// You may use this software under the terms of 'INDIGO Astronomy
// open-source license' (see LICENSE.md).
//
// THIS SOFTWARE IS PROVIDED BY THE AUTHORS 'AS IS' AND ANY EXPRESS
// OR IMPLIED WARRANTIES, INCLUDING, BUT NOT LIMITED TO, THE IMPLIED
// WARRANTIES OF MERCHANTABILITY AND FITNESS FOR A PARTICULAR PURPOSE
// ARE DISCLAIMED. IN NO EVENT SHALL THE AUTHOR BE LIABLE FOR ANY
// DIRECT, INDIRECT, INCIDENTAL, SPECIAL, EXEMPLARY, OR CONSEQUENTIAL
// DAMAGES (INCLUDING, BUT NOT LIMITED TO, PROCUREMENT OF SUBSTITUTE
// GOODS OR SERVICES; LOSS OF USE, DATA, OR PROFITS; OR BUSINESS
// INTERRUPTION) HOWEVER CAUSED AND ON ANY THEORY OF LIABILITY,
// WHETHER IN CONTRACT, STRICT LIABILITY, OR TORT (INCLUDING
// NEGLIGENCE OR OTHERWISE) ARISING IN ANY WAY OUT OF THE USE OF THIS
// SOFTWARE, EVEN IF ADVISED OF THE POSSIBILITY OF SUCH DAMAGE.

// Code is generated by AI

// Integration tests of the system_alpaca driver (ASCOM Alpaca client) against system_alpaca_simulator.
//
// The driver runs in this process, the simulators are child processes on loopback ports of their own. Every case
// runs in a forked child with a private HOME, so the cases are independent and run several at a time
// (INDIGO_TEST_JOBS, see parallel_case_runner.h); INDIGO_TEST_CASE_FILTER selects cases by a part of their name.
// SYSTEM_ALPACA_TEST_NO_FORK=1 runs the selected cases one after another in this process instead, which is what a debugger
// or a leak checker needs (the configuration folder is emptied before every case); SYSTEM_ALPACA_TEST_DEBUG=1 turns the debug
// log of the driver on.
//
// The cases live in system_alpaca/: core_cases.h for the driver core, interface_cases.h for the interface the class modules
// are written against, and one <class>_cases.h for every device class.
// A new case is added to the macro at the end of its file, this file does not change.

#include "system_alpaca/system_alpaca_test_common.h"
#include "parallel_case_runner.h"

#include "system_alpaca/core_cases.h"
#include "system_alpaca/interface_cases.h"
#include "system_alpaca/focuser_cases.h"
#include "system_alpaca/wheel_cases.h"
#include "system_alpaca/rotator_cases.h"
#include "system_alpaca/mount_cases.h"
#include "system_alpaca/ccd_cases.h"
#include "system_alpaca/guider_cases.h"
#include "system_alpaca/dome_cases.h"
#include "system_alpaca/lightbox_cases.h"
#include "system_alpaca/switch_cases.h"
#include "system_alpaca/weather_cases.h"
#include "system_alpaca/safety_cases.h"

#define SUITE_NAME "system_alpaca simulator integration tests"
#define CASE_TIMEOUT 180

static const indigo_test_case cases[] = {
	SYSTEM_ALPACA_CORE_CASES
	SYSTEM_ALPACA_INTERFACE_CASES
	SYSTEM_ALPACA_FOCUSER_CASES
	SYSTEM_ALPACA_WHEEL_CASES
	SYSTEM_ALPACA_ROTATOR_CASES
	SYSTEM_ALPACA_MOUNT_CASES
	SYSTEM_ALPACA_CCD_CASES
	SYSTEM_ALPACA_GUIDER_CASES
	SYSTEM_ALPACA_DOME_CASES
	SYSTEM_ALPACA_LIGHTBOX_CASES
	SYSTEM_ALPACA_SWITCH_CASES
	SYSTEM_ALPACA_WEATHER_CASES
	SYSTEM_ALPACA_SAFETY_CASES
};

static const char *case_filter = NULL;

static const char *case_name(int index) {
	return cases[index].name;
}

static bool case_selected(int index) {
	return case_filter == NULL || strstr(cases[index].name, case_filter) != NULL;
}

static unsigned case_timeout(int index) {
	(void)index;
	return CASE_TIMEOUT;
}

// Runs in the forked child. The configuration of the driver goes to a HOME below the fixture directory of the case.
static int case_child(int index, const char *fixture) {
	char home[PATH_MAX];
	snprintf(home, sizeof(home), "%s/home", fixture);
	if (mkdir(home, 0700) != 0 || !indigo_test_set_private_home(home)) {
		perror(home);
		return 2;
	}
	int result = indigo_run_tests(SUITE_NAME, cases + index, 1);
	fflush(NULL);
	return result;
}

int main(void) {
	char fixture_root[PATH_MAX];
	int run = 0, passed = 0, failed = 0;
	setvbuf(stdout, NULL, _IOLBF, 0);
	if (!indigo_test_use_private_home()) {
		return 1;
	}
	snprintf(fixture_root, sizeof(fixture_root), "/tmp/indigo-system-alpaca.XXXXXX");
	if (mkdtemp(fixture_root) == NULL) {
		perror("mkdtemp");
		indigo_test_remove_private_home();
		return 1;
	}
	if (getenv("SYSTEM_ALPACA_TEST_DEBUG") != NULL) {
		indigo_set_log_level(INDIGO_LOG_DEBUG);
	}
	case_filter = getenv("INDIGO_TEST_CASE_FILTER");
	if (getenv("SYSTEM_ALPACA_TEST_NO_FORK") != NULL) {
		// All selected cases in this process. The framework keeps the configuration folder it found first ($HOME/.indigo), so a case can
		// not get a HOME of its own; the folder is emptied before every case instead, so that no case inherits the configuration of another.
		char config[PATH_MAX];
		int result = 0;
		snprintf(config, sizeof(config), "%s/.indigo", getenv("HOME"));
		for (int i = 0; i < (int)ARRAY_SIZE(cases); i++) {
			if (case_selected(i)) {
				indigo_test_remove_tree(config);
				result |= indigo_run_tests(SUITE_NAME, cases + i, 1);
			}
		}
		indigo_test_remove_tree(fixture_root);
		indigo_test_remove_private_home();
		return result;
	}
	if (case_filter != NULL) {
		indigo_test_record("filter\t%s", case_filter);
	}
	const parallel_case_runner runner = {
		SUITE_NAME, fixture_root, ARRAY_SIZE(cases), 0, case_name, case_selected, case_timeout, case_child, NULL
	};
	run_parallel_cases(&runner, &run, &passed, &failed);
	indigo_test_remove_tree(fixture_root);
	indigo_test_remove_private_home();
	printf("%s: %d run, %d passed, %d failed\n", SUITE_NAME, run, passed, failed);
	return failed != 0 || run == 0 ? 1 : 0;
}
