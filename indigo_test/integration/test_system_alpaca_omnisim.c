// Copyright (c) 2026 INDIGO initiative
// All rights reserved.
//
// You may use this software under the terms of 'INDIGO Astronomy
// open-source license' (see LICENSE.md).
//
// THIS SOFTWARE IS PROVIDED BY THE AUTHORS 'AS IS' AND ANY EXPRESS
// OR IMPLIED WARRANTIES, INCLUDING, BUT NOT LIMITED TO, THE IMPLIED
// WARRANTIES OF MERCHANTABILITY AND FITNESS FOR A PARTICULAR PURPOSE
// ARE DISCLAIMED. IN NO EVENT SHALL THE AUTHOR BE LIABLE FOR ANY
// DIRECT, INDIRECT, INCIDENTAL, SPECIAL, EXEMPLARY, OR CONSEQUENTIAL
// DAMAGES (INCLUDING, BUT NOT LIMITED TO, PROCUREMENT OF SUBSTITUTE
// GOODS OR SERVICES; LOSS OF USE, DATA, OR PROFITS; OR BUSINESS
// INTERRUPTION) HOWEVER CAUSED AND ON ANY THEORY OF LIABILITY,
// WHETHER IN CONTRACT, STRICT LIABILITY, OR TORT (INCLUDING
// NEGLIGENCE OR OTHERWISE) ARISING IN ANY WAY OUT OF THE USE OF THIS
// SOFTWARE, EVEN IF ADVISED OF THE POSSIBILITY OF SUCH DAMAGE.

// Code is generated by AI

// OmniSim tier of the system_alpaca driver: every Alpaca device type of ASCOM OmniSim (ASCOM Alpaca Simulators), an Alpaca
// server written independently of this driver and of system_alpaca_simulator, driven through the in-process driver on real time.
// Opt-in (make -C indigo_test test-system-alpaca-omnisim); OmniSim is never downloaded, see REFACTOR.md 4.1 of the driver.
// Without an OmniSim executable the tier reports that it was not run and exits 0 without recording a plan.
//
// The facts about OmniSim 0.5.0 the cases rely on were read from the running instance on 2026-10-03; each case states them.

#include <indigo/indigo_ccd_driver.h>
#include <indigo/indigo_focuser_driver.h>
#include <indigo/indigo_mount_driver.h>
#include <indigo/indigo_raw_utils.h>
#include <indigo/indigo_align.h>

#include "system_alpaca/omnisim_test_common.h"
#include "parallel_case_runner.h"

#define SUITE_NAME "system_alpaca OmniSim integration tests"
#define CASE_TIMEOUT 300

#define FOCUSER_LABEL "Alpaca Focuser Simulator"
#define WHEEL_LABEL "Alpaca Filter Wheel Simulator"
#define ROTATOR_LABEL "Alpaca Rotator Simulator"
#define TELESCOPE_LABEL "Alpaca Telescope Simulator"
#define CAMERA_LABEL "Alpaca Camera Sim"
#define DOME_LABEL "Alpaca Dome Simulator"
#define COVER_LABEL "Alpaca CoverCalibrator Simulator"
#define SWITCH_LABEL "Alpaca Switch Simulator"
#define WEATHER_LABEL "Alpaca Observing Conditions Simulator"
#define SAFETY_LABEL "Alpaca Safety Monitor Simulator"

// ASCOM error numbers seen from OmniSim.
#define OMNI_NOT_IMPLEMENTED 0x400
#define OMNI_INVALID_OPERATION 0x40B
#define OMNI_UNSPECIFIED 0x4FF

// The devicestate of the device contains every one of the comma separated names.
static bool omni_state_has(const char *type, const char *expected) {
	char names[1024], wanted[256];
	snprintf(names, sizeof(names), ",%s,", omni_device_state_names(type));
	printf("    %s devicestate: %s\n", type, names);
	for (const char *start = expected; *start; ) {
		size_t length = strcspn(start, ",");
		snprintf(wanted, sizeof(wanted), ",%.*s,", (int)length, start);
		if (strstr(names, wanted) == NULL) {
			fprintf(stderr, "    %s devicestate has no %.*s\n", type, (int)length, start);
			return false;
		}
		start += length + (start[length] == ',');
	}
	return true;
}

// A member of a newer interface version answers HTTP 200 with the given ErrorNumber (OmniSim's answer to a lower version).
static bool omni_member_answers(const char *type, const char *member, int expected) {
	int error_number = -1;
	omni_get(type, member, NULL, &error_number);
	if (omni_status != 200 || error_number != expected) {
		fprintf(stderr, "    GET %s/%s answered HTTP %d ErrorNumber 0x%X instead of HTTP 200 0x%X\n", type, member, omni_status, error_number, expected);
		return false;
	}
	return true;
}

// ---------------------------------------------------------------------------- discovery and management

// OmniSim answers the Alpaca discovery on UDP 32227. The request goes to 127.0.0.1:32227 only, never as a broadcast; the instance
// of this case is told apart from any other responder on that port by its HTTP port.
static void omnisim_discovery(void) {
	char targets[64];
	omni_connect_control();
	snprintf(targets, sizeof(targets), "127.0.0.1:32227");
	SA_CHECK(omni_write_config(targets) && sa_driver_start() && omni_switch_off_all());
	SA_CHECK(SA_WAIT(sa_discover() && sa_has_item(SA_BRIDGE, "X_ALPACA_SERVER_STATUS", omni_url), 3 * SA_TIMEOUT));
	printf("    discovered %s: %s\n", omni_url, sa_text(SA_BRIDGE, "X_ALPACA_SERVER_STATUS", omni_url));
	SA_CHECK(!strncmp(sa_text(SA_BRIDGE, "X_ALPACA_SERVER_STATUS", omni_url), "ONLINE", 6));
	// all ten device types are listed and none is unsupported
	SA_CHECK(SA_WAIT(sa_status_count("AVAILABLE") >= 10, SA_TIMEOUT) && sa_status_count("UNSUPPORTED") == 0);
	static const char *labels[] = { FOCUSER_LABEL, WHEEL_LABEL, ROTATOR_LABEL, TELESCOPE_LABEL, CAMERA_LABEL, DOME_LABEL, COVER_LABEL, SWITCH_LABEL, WEATHER_LABEL, SAFETY_LABEL };
	for (int i = 0; i < 10; i++) {
		const char *key = sa_device_key(labels[i]);
		SA_CHECK(*key && sa_device_status_is(key, "AVAILABLE"));
	}
	// the device is proxied under "ALPACA <DeviceName>" without the "Alpaca" of OmniSim's device names (decision D17)
	SA_CHECK(sa_attach(FOCUSER_LABEL) && !strncmp(sa_device, "ALPACA ", 7) && strstr(sa_device + 7, "Alpaca") == NULL && strstr(sa_device + 7, "alpaca") == NULL);
	SA_CHECK(sa_text(sa_device, INFO_PROPERTY_NAME, INFO_DEVICE_SERIAL_NUM_ITEM_NAME)[0] != 0);
cleanup:
	omni_end();
}

// ---------------------------------------------------------------------------- focuser

// OmniSim focuser: IFocuserV4, absolute, MaxStep 50000, MaxIncrement 50000, Position 25000, StepSize 20, temperature
// compensation available. Interface version 3 through /simulator/v1/focuser/0/interfaceversion.
static bool omni_focuser_move(double position) {
	unsigned revision = sa_revision(sa_device, FOCUSER_POSITION_PROPERTY_NAME);
	int state = omni_set_number(sa_device, FOCUSER_POSITION_PROPERTY_NAME, FOCUSER_POSITION_ITEM_NAME, position, OMNI_TIMEOUT);
	if (state != INDIGO_OK_STATE || !omni_went_busy(sa_device, FOCUSER_POSITION_PROPERTY_NAME, revision)) {
		fprintf(stderr, "    move to %g ended in state %d\n", position, state);
		omni_print_messages();
		return false;
	}
	return sa_number(sa_device, FOCUSER_POSITION_PROPERTY_NAME, FOCUSER_POSITION_ITEM_NAME) == position && omni_int("focuser", "position") == (int)position && !omni_bool("focuser", "ismoving");
}

static void omni_focuser_round_trip(int interface_version) {
	SA_CHECK(omni_begin());
	SA_CHECK(omni_attach_connect(FOCUSER_LABEL));
	SA_CHECK(omni_interface_version(sa_device) == interface_version);
	SA_CHECK(omni_bool("focuser", "connected"));
	// what the device reports
	SA_CHECK(sa_number(sa_device, FOCUSER_POSITION_PROPERTY_NAME, FOCUSER_POSITION_ITEM_NAME) == 25000);
	SA_CHECK(sa_item_count(sa_device, FOCUSER_POSITION_PROPERTY_NAME) == 1);
	SA_CHECK(SA_WAIT(fabs(sa_number(sa_device, FOCUSER_TEMPERATURE_PROPERTY_NAME, FOCUSER_TEMPERATURE_ITEM_NAME) - omni_double("focuser", "temperature")) < 1, SA_TIMEOUT));
	SA_CHECK(sa_number(sa_device, "X_ALPACA_STEP_SIZE", "STEP_SIZE") == 20);
	SA_CHECK(sa_defined(sa_device, FOCUSER_MODE_PROPERTY_NAME));
	// absolute and relative moves on real time, completion by IsMoving
	SA_CHECK(omni_focuser_move(25600));
	SA_CHECK(omni_set_switch(sa_device, FOCUSER_DIRECTION_PROPERTY_NAME, FOCUSER_DIRECTION_MOVE_INWARD_ITEM_NAME, true, SA_TIMEOUT) == INDIGO_OK_STATE);
	SA_CHECK(omni_set_number(sa_device, FOCUSER_STEPS_PROPERTY_NAME, FOCUSER_STEPS_ITEM_NAME, 300, OMNI_TIMEOUT) == INDIGO_OK_STATE);
	SA_CHECK(SA_WAIT(sa_number(sa_device, FOCUSER_POSITION_PROPERTY_NAME, FOCUSER_POSITION_ITEM_NAME) == 25300 && sa_state(sa_device, FOCUSER_POSITION_PROPERTY_NAME) == INDIGO_OK_STATE, SA_TIMEOUT));
	SA_CHECK(omni_int("focuser", "position") == 25300);
	// Halt during a long move: the move ends where the device stopped
	SA_CHECK(indigo_change_number_property_1(&sa_client, sa_device, FOCUSER_POSITION_PROPERTY_NAME, FOCUSER_POSITION_ITEM_NAME, 50000) == INDIGO_OK);
	SA_CHECK(SA_WAIT(omni_bool("focuser", "ismoving"), SA_TIMEOUT));
	SA_CHECK(omni_set_switch(sa_device, FOCUSER_ABORT_MOTION_PROPERTY_NAME, FOCUSER_ABORT_MOTION_ITEM_NAME, true, SA_TIMEOUT) == INDIGO_OK_STATE);
	SA_CHECK(SA_WAIT(sa_state(sa_device, FOCUSER_POSITION_PROPERTY_NAME) != INDIGO_BUSY_STATE, OMNI_TIMEOUT));
	// OmniSim stops at once but reports IsMoving for about one more second (its settle time); the stopped move is not shown as
	// a new motion of the device afterwards
	unsigned stopped = sa_revision(sa_device, FOCUSER_POSITION_PROPERTY_NAME);
	printf("    after Halt: FOCUSER_POSITION state %d, OmniSim IsMoving %d\n", sa_state(sa_device, FOCUSER_POSITION_PROPERTY_NAME), omni_bool("focuser", "ismoving"));
	SA_CHECK(SA_WAIT(!omni_bool("focuser", "ismoving"), OMNI_TIMEOUT));
	SA_WAIT(false, 1);
	SA_CHECK(!sa_state_after(sa_device, FOCUSER_POSITION_PROPERTY_NAME, INDIGO_BUSY_STATE, stopped));
	SA_CHECK(sa_state(sa_device, FOCUSER_POSITION_PROPERTY_NAME) == INDIGO_ALERT_STATE);
	SA_CHECK(SA_WAIT(sa_number(sa_device, FOCUSER_POSITION_PROPERTY_NAME, FOCUSER_POSITION_ITEM_NAME) == omni_int("focuser", "position"), SA_TIMEOUT));
	printf("    halted at %g\n", sa_number(sa_device, FOCUSER_POSITION_PROPERTY_NAME, FOCUSER_POSITION_ITEM_NAME));
	SA_CHECK(sa_number(sa_device, FOCUSER_POSITION_PROPERTY_NAME, FOCUSER_POSITION_ITEM_NAME) < 50000);
	// temperature compensation is TempComp of the device
	SA_CHECK(omni_set_switch(sa_device, FOCUSER_MODE_PROPERTY_NAME, FOCUSER_MODE_AUTOMATIC_ITEM_NAME, true, SA_TIMEOUT) == INDIGO_OK_STATE && omni_bool("focuser", "tempcomp"));
	SA_CHECK(omni_set_switch(sa_device, FOCUSER_MODE_PROPERTY_NAME, FOCUSER_MODE_MANUAL_ITEM_NAME, true, SA_TIMEOUT) == INDIGO_OK_STATE && !omni_bool("focuser", "tempcomp"));
	SA_CHECK(omni_focuser_move(24000));
	// devicestate (Platform 7) or OmniSim's answer to it on the older interface
	if (interface_version >= 4) {
		SA_CHECK(omni_state_has("focuser", "IsMoving,Position"));
	} else {
		SA_CHECK(omni_member_answers("focuser", "devicestate", OMNI_UNSPECIFIED));
		SA_CHECK(omni_member_answers("focuser", "connecting", OMNI_UNSPECIFIED));
	}
	// D5: an INDIGO disconnect disconnects the Alpaca device
	SA_CHECK(omni_disconnect_detach(FOCUSER_LABEL));
	SA_CHECK(SA_WAIT(!omni_bool("focuser", "connected"), OMNI_TIMEOUT));
cleanup:
	omni_end();
}

static void omnisim_focuser(void) {
	omni_focuser_round_trip(4);
}

static void omnisim_focuser_legacy(void) {
	omni_connect_control();
	SA_CHECK(omni_setting("focuser", "interfaceversion", "InterfaceVersion=3"));
	omni_focuser_round_trip(3);
	return;
cleanup:
	omni_end();
}

// ---------------------------------------------------------------------------- filter wheel

// OmniSim filter wheel: IFilterWheelV3, six slots Red, Green, Blue, Clear, Ha, OIII, Position 0, one second per slot (Position is -1
// on the way). Interface version 2 through the settings API.
static void omni_wheel_round_trip(int interface_version) {
	char item[INDIGO_NAME_SIZE];
	SA_CHECK(omni_begin());
	SA_CHECK(omni_attach_connect(WHEEL_LABEL));
	SA_CHECK(omni_interface_version(sa_device) == interface_version);
	SA_CHECK(sa_number(sa_device, WHEEL_SLOT_PROPERTY_NAME, WHEEL_SLOT_ITEM_NAME) == 1);
	SA_CHECK(sa_item_count(sa_device, WHEEL_SLOT_NAME_PROPERTY_NAME) == 6 && sa_item_count(sa_device, WHEEL_SLOT_OFFSET_PROPERTY_NAME) == 6);
	static const char *names[] = { "Red", "Green", "Blue", "Clear", "Ha", "OIII" };
	for (int i = 0; i < 6; i++) {
		snprintf(item, sizeof(item), WHEEL_SLOT_NAME_ITEM_NAME, i + 1);
		SA_CHECK(!strcmp(sa_text(sa_device, WHEEL_SLOT_NAME_PROPERTY_NAME, item), names[i]));
	}
	// the focus offsets of the device are the offsets of the slots
	int error_number = -1;
	const alpaca_json_value *offsets = omni_get("filterwheel", "focusoffsets", NULL, &error_number);
	SA_CHECK(error_number == 0 && alpaca_json_size(offsets) == 6);
	for (int i = 0; i < 6; i++) {
		int64_t offset = 0;
		SA_CHECK(alpaca_json_get_int(alpaca_json_array_get(offsets, i), &offset));
		snprintf(item, sizeof(item), WHEEL_SLOT_OFFSET_ITEM_NAME, i + 1);
		SA_CHECK(sa_number(sa_device, WHEEL_SLOT_OFFSET_PROPERTY_NAME, item) == (double)offset);
	}
	// a move ends when Position is no longer -1
	unsigned revision = sa_revision(sa_device, WHEEL_SLOT_PROPERTY_NAME);
	SA_CHECK(omni_set_number(sa_device, WHEEL_SLOT_PROPERTY_NAME, WHEEL_SLOT_ITEM_NAME, 4, OMNI_TIMEOUT) == INDIGO_OK_STATE);
	SA_CHECK(omni_went_busy(sa_device, WHEEL_SLOT_PROPERTY_NAME, revision));
	SA_CHECK(sa_number(sa_device, WHEEL_SLOT_PROPERTY_NAME, WHEEL_SLOT_ITEM_NAME) == 4 && omni_int("filterwheel", "position") == 3);
	SA_CHECK(omni_set_number(sa_device, WHEEL_SLOT_PROPERTY_NAME, WHEEL_SLOT_ITEM_NAME, 6, OMNI_TIMEOUT) == INDIGO_OK_STATE);
	SA_CHECK(sa_number(sa_device, WHEEL_SLOT_PROPERTY_NAME, WHEEL_SLOT_ITEM_NAME) == 6 && omni_int("filterwheel", "position") == 5);
	SA_CHECK(omni_set_number(sa_device, WHEEL_SLOT_PROPERTY_NAME, WHEEL_SLOT_ITEM_NAME, 1, OMNI_TIMEOUT) == INDIGO_OK_STATE);
	SA_CHECK(sa_number(sa_device, WHEEL_SLOT_PROPERTY_NAME, WHEEL_SLOT_ITEM_NAME) == 1 && omni_int("filterwheel", "position") == 0);
	// a move of another client is followed
	SA_CHECK(omni_put("filterwheel", "position", "Position=2") == 0);
	SA_CHECK(SA_WAIT(sa_number(sa_device, WHEEL_SLOT_PROPERTY_NAME, WHEEL_SLOT_ITEM_NAME) == 3 && sa_state(sa_device, WHEEL_SLOT_PROPERTY_NAME) == INDIGO_OK_STATE, OMNI_TIMEOUT));
	if (interface_version >= 3) {
		SA_CHECK(omni_state_has("filterwheel", "Position"));
	} else {
		SA_CHECK(omni_member_answers("filterwheel", "devicestate", OMNI_UNSPECIFIED));
	}
	SA_CHECK(omni_disconnect_detach(WHEEL_LABEL));
	SA_CHECK(SA_WAIT(!omni_bool("filterwheel", "connected"), OMNI_TIMEOUT));
cleanup:
	omni_end();
}

static void omnisim_wheel(void) {
	omni_wheel_round_trip(3);
}

static void omnisim_wheel_legacy(void) {
	omni_connect_control();
	SA_CHECK(omni_setting("filterwheel", "interfaceversion", "InterfaceVersion=2"));
	omni_wheel_round_trip(2);
	return;
cleanup:
	omni_end();
}

// ---------------------------------------------------------------------------- rotator

// OmniSim rotator: IRotatorV4, Position 0, about 8 degrees per second, CanReverse, StepSize 0.75. Interface version 2 through
// the settings API (no MechanicalPosition, MoveMechanical and Sync then).
static bool omni_rotator_settled(const char *property, unsigned revision) {
	return sa_state_after(sa_device, property, INDIGO_OK_STATE, revision) && sa_state(sa_device, ROTATOR_POSITION_PROPERTY_NAME) == INDIGO_OK_STATE && sa_state(sa_device, property) == INDIGO_OK_STATE;
}

static bool omni_rotator_move_to(double position) {
	unsigned revision = sa_revision(sa_device, ROTATOR_POSITION_PROPERTY_NAME);
	if (indigo_change_number_property_1(&sa_client, sa_device, ROTATOR_POSITION_PROPERTY_NAME, ROTATOR_POSITION_ITEM_NAME, position) != INDIGO_OK || !SA_WAIT(omni_rotator_settled(ROTATOR_POSITION_PROPERTY_NAME, revision), OMNI_TIMEOUT)) {
		fprintf(stderr, "    rotator move to %g ended in state %d\n", position, sa_state(sa_device, ROTATOR_POSITION_PROPERTY_NAME));
		omni_print_messages();
		return false;
	}
	return fabs(sa_number(sa_device, ROTATOR_POSITION_PROPERTY_NAME, ROTATOR_POSITION_ITEM_NAME) - position) < 1e-6 && fabs(omni_double("rotator", "position") - position) < 1e-6;
}

static void omni_rotator_round_trip(int interface_version) {
	bool mechanical = interface_version >= 3;
	SA_CHECK(omni_begin());
	SA_CHECK(omni_attach_connect(ROTATOR_LABEL));
	SA_CHECK(omni_interface_version(sa_device) == interface_version);
	SA_CHECK(sa_number(sa_device, ROTATOR_POSITION_PROPERTY_NAME, ROTATOR_POSITION_ITEM_NAME) == 0);
	SA_CHECK(sa_defined(sa_device, ROTATOR_DIRECTION_PROPERTY_NAME) && sa_defined(sa_device, ROTATOR_STEPS_PER_REVOLUTION_PROPERTY_NAME));
	SA_CHECK(sa_number(sa_device, ROTATOR_STEPS_PER_REVOLUTION_PROPERTY_NAME, ROTATOR_STEPS_PER_REVOLUTION_ITEM_NAME) == 480);
	SA_CHECK(sa_defined(sa_device, ROTATOR_RAW_POSITION_PROPERTY_NAME) == mechanical && sa_defined(sa_device, "X_ALPACA_MECHANICAL_POSITION") == mechanical && sa_defined(sa_device, ROTATOR_ON_POSITION_SET_PROPERTY_NAME) == mechanical);
	// absolute and relative moves, completion by IsMoving
	SA_CHECK(omni_rotator_move_to(30));
	unsigned revision = sa_revision(sa_device, ROTATOR_RELATIVE_MOVE_PROPERTY_NAME);
	SA_CHECK(indigo_change_number_property_1(&sa_client, sa_device, ROTATOR_RELATIVE_MOVE_PROPERTY_NAME, ROTATOR_RELATIVE_MOVE_ITEM_NAME, 15) == INDIGO_OK);
	SA_CHECK(SA_WAIT(omni_rotator_settled(ROTATOR_RELATIVE_MOVE_PROPERTY_NAME, revision), OMNI_TIMEOUT));
	SA_CHECK(fabs(sa_number(sa_device, ROTATOR_POSITION_PROPERTY_NAME, ROTATOR_POSITION_ITEM_NAME) - 45) < 1e-6 && fabs(omni_double("rotator", "position") - 45) < 1e-6);
	// Reverse is the setting of the device
	SA_CHECK(omni_set_switch(sa_device, ROTATOR_DIRECTION_PROPERTY_NAME, ROTATOR_DIRECTION_REVERSED_ITEM_NAME, true, SA_TIMEOUT) == INDIGO_OK_STATE && omni_bool("rotator", "reverse"));
	SA_CHECK(omni_set_switch(sa_device, ROTATOR_DIRECTION_PROPERTY_NAME, ROTATOR_DIRECTION_NORMAL_ITEM_NAME, true, SA_TIMEOUT) == INDIGO_OK_STATE && !omni_bool("rotator", "reverse"));
	if (mechanical) {
		// Sync: Position becomes the requested angle, the mechanical position stays
		SA_CHECK(omni_set_switch(sa_device, ROTATOR_ON_POSITION_SET_PROPERTY_NAME, ROTATOR_ON_POSITION_SET_SYNC_ITEM_NAME, true, SA_TIMEOUT) == INDIGO_OK_STATE);
		SA_CHECK(omni_set_number(sa_device, ROTATOR_POSITION_PROPERTY_NAME, ROTATOR_POSITION_ITEM_NAME, 100, SA_TIMEOUT) == INDIGO_OK_STATE);
		SA_CHECK(fabs(omni_double("rotator", "position") - 100) < 1e-6 && fabs(omni_double("rotator", "mechanicalposition") - 45) < 1e-6);
		SA_CHECK(SA_WAIT(sa_number(sa_device, ROTATOR_POSITION_PROPERTY_NAME, ROTATOR_POSITION_ITEM_NAME) == 100 && sa_number(sa_device, ROTATOR_RAW_POSITION_PROPERTY_NAME, ROTATOR_RAW_POSITION_ITEM_NAME) == 45, SA_TIMEOUT));
		SA_CHECK(omni_set_switch(sa_device, ROTATOR_ON_POSITION_SET_PROPERTY_NAME, ROTATOR_ON_POSITION_SET_GOTO_ITEM_NAME, true, SA_TIMEOUT) == INDIGO_OK_STATE);
		// a move to a sky angle while synced: the target of ROTATOR_POSITION is the requested sky angle all the way
		revision = sa_revision(sa_device, ROTATOR_POSITION_PROPERTY_NAME);
		SA_CHECK(indigo_change_number_property_1(&sa_client, sa_device, ROTATOR_POSITION_PROPERTY_NAME, ROTATOR_POSITION_ITEM_NAME, 160) == INDIGO_OK);
		SA_CHECK(SA_WAIT(omni_bool("rotator", "ismoving"), SA_TIMEOUT));
		printf("    OmniSim TargetPosition during MoveAbsolute 160 with a sync offset of 55: %g\n", omni_double("rotator", "targetposition"));
		SA_CHECK(SA_WAIT(sa_state(sa_device, ROTATOR_POSITION_PROPERTY_NAME) == INDIGO_BUSY_STATE, SA_TIMEOUT) && sa_number_target(sa_device, ROTATOR_POSITION_PROPERTY_NAME, ROTATOR_POSITION_ITEM_NAME) == 160);
		SA_CHECK(SA_WAIT(omni_rotator_settled(ROTATOR_POSITION_PROPERTY_NAME, revision), OMNI_TIMEOUT));
		SA_CHECK(sa_number(sa_device, ROTATOR_POSITION_PROPERTY_NAME, ROTATOR_POSITION_ITEM_NAME) == 160 && fabs(omni_double("rotator", "mechanicalposition") - 105) < 1e-6);
		// MoveMechanical: the mechanical angle is the request, the sky angle follows with the sync offset
		revision = sa_revision(sa_device, "X_ALPACA_MECHANICAL_POSITION");
		SA_CHECK(indigo_change_number_property_1(&sa_client, sa_device, "X_ALPACA_MECHANICAL_POSITION", "POSITION", 65) == INDIGO_OK);
		SA_CHECK(SA_WAIT(omni_bool("rotator", "ismoving"), SA_TIMEOUT));
		printf("    OmniSim TargetPosition during MoveMechanical 65: %g\n", omni_double("rotator", "targetposition"));
		SA_CHECK(SA_WAIT(omni_rotator_settled("X_ALPACA_MECHANICAL_POSITION", revision), OMNI_TIMEOUT));
		SA_CHECK(fabs(omni_double("rotator", "mechanicalposition") - 65) < 1e-6 && fabs(omni_double("rotator", "position") - 120) < 1e-6);
		SA_CHECK(SA_WAIT(sa_number(sa_device, ROTATOR_RAW_POSITION_PROPERTY_NAME, ROTATOR_RAW_POSITION_ITEM_NAME) == 65 && sa_number(sa_device, ROTATOR_POSITION_PROPERTY_NAME, ROTATOR_POSITION_ITEM_NAME) == 120, SA_TIMEOUT));
		SA_CHECK(omni_state_has("rotator", "IsMoving,MechanicalPosition,Position"));
	} else {
		SA_CHECK(omni_member_answers("rotator", "mechanicalposition", OMNI_UNSPECIFIED));
		SA_CHECK(omni_member_answers("rotator", "devicestate", OMNI_UNSPECIFIED));
	}
	// Halt during a move
	SA_CHECK(indigo_change_number_property_1(&sa_client, sa_device, ROTATOR_POSITION_PROPERTY_NAME, ROTATOR_POSITION_ITEM_NAME, mechanical ? 300 : 225) == INDIGO_OK);
	SA_CHECK(SA_WAIT(omni_bool("rotator", "ismoving"), SA_TIMEOUT));
	SA_CHECK(omni_set_switch(sa_device, ROTATOR_ABORT_MOTION_PROPERTY_NAME, ROTATOR_ABORT_MOTION_ITEM_NAME, true, SA_TIMEOUT) == INDIGO_OK_STATE);
	SA_CHECK(SA_WAIT(sa_state(sa_device, ROTATOR_POSITION_PROPERTY_NAME) != INDIGO_BUSY_STATE, OMNI_TIMEOUT) && !omni_bool("rotator", "ismoving"));
	SA_CHECK(SA_WAIT(fabs(sa_number(sa_device, ROTATOR_POSITION_PROPERTY_NAME, ROTATOR_POSITION_ITEM_NAME) - omni_double("rotator", "position")) < 1e-6, SA_TIMEOUT));
	printf("    halted at %g, OmniSim TargetPosition after Halt: %g\n", sa_number(sa_device, ROTATOR_POSITION_PROPERTY_NAME, ROTATOR_POSITION_ITEM_NAME), omni_double("rotator", "targetposition"));
	SA_CHECK(omni_disconnect_detach(ROTATOR_LABEL));
	SA_CHECK(SA_WAIT(!omni_bool("rotator", "connected"), OMNI_TIMEOUT));
cleanup:
	omni_end();
}

static void omnisim_rotator(void) {
	omni_rotator_round_trip(4);
}

static void omnisim_rotator_legacy(void) {
	omni_connect_control();
	SA_CHECK(omni_setting("rotator", "interfaceversion", "InterfaceVersion=2"));
	omni_rotator_round_trip(2);
	return;
cleanup:
	omni_end();
}

// ---------------------------------------------------------------------------- telescope

// OmniSim telescope: ITelescopeV4, German equatorial (AlignmentMode 2), EquatorialSystem 1 (topocentric, so the driver converts
// J2000 on the bus to JNow), site 51.07861 N, 0.29444 W, starts unparked and not tracking at azimuth 180, altitude 38.9 (the
// celestial equator on the meridian), slews at up to 20 degrees per second, AxisRates [0, 6.67] and [10, 20] deg/s,
// TrackingRates sidereal, King, lunar, solar, guide rates 0.0041781 deg/s (one sidereal rate), CanPulseGuide.
#define MOUNT_CASE_TIMEOUT 90.0

static double omni_hours(double hours) {
	hours = fmod(hours, 24);
	return hours < 0 ? hours + 24 : hours;
}

// Difference of two right ascensions in hours, -12 ... 12.
static double omni_ra_difference(double a, double b) {
	double difference = omni_hours(a - b);
	return difference > 12 ? difference - 24 : difference;
}

// A goto of the mount device to J2000 coordinates; true when the driver published the arrival at them.
static bool omni_goto(double ra, double dec) {
	static const char *items[] = { MOUNT_EQUATORIAL_COORDINATES_RA_ITEM_NAME, MOUNT_EQUATORIAL_COORDINATES_DEC_ITEM_NAME };
	const double values[] = { ra, dec };
	unsigned revision = sa_revision(sa_device, MOUNT_EQUATORIAL_COORDINATES_PROPERTY_NAME);
	int state = omni_set_numbers(sa_device, MOUNT_EQUATORIAL_COORDINATES_PROPERTY_NAME, 2, items, values, MOUNT_CASE_TIMEOUT);
	double published_ra = sa_number(sa_device, MOUNT_EQUATORIAL_COORDINATES_PROPERTY_NAME, MOUNT_EQUATORIAL_COORDINATES_RA_ITEM_NAME);
	double published_dec = sa_number(sa_device, MOUNT_EQUATORIAL_COORDINATES_PROPERTY_NAME, MOUNT_EQUATORIAL_COORDINATES_DEC_ITEM_NAME);
	printf("    goto %.4f %.4f ended in state %d at %.4f %.4f\n", ra, dec, state, published_ra, published_dec);
	if (state != INDIGO_OK_STATE || !omni_went_busy(sa_device, MOUNT_EQUATORIAL_COORDINATES_PROPERTY_NAME, revision)) {
		omni_print_messages();
		return false;
	}
	return fabs(omni_ra_difference(published_ra, ra)) < 0.002 && fabs(published_dec - dec) < 0.03 && !omni_bool("telescope", "slewing");
}

// Local sidereal time as the driver publishes it.
static double omni_lst(void) {
	return sa_number(sa_device, MOUNT_LST_TIME_PROPERTY_NAME, MOUNT_LST_TIME_ITEM_NAME);
}

static void omnisim_mount_goto(void) {
	SA_CHECK(omni_begin());
	SA_CHECK(omni_attach_connect(TELESCOPE_LABEL));
	SA_CHECK(omni_interface_version(sa_device) == 4);
	SA_CHECK(omni_state_has("telescope", "Altitude,AtHome,AtPark,Azimuth,Declination,IsPulseGuiding,RightAscension,SideOfPier,SiderealTime,Slewing,Tracking,UTCDate"));
	// site and time of the telescope
	SA_CHECK(fabs(sa_number(sa_device, GEOGRAPHIC_COORDINATES_PROPERTY_NAME, GEOGRAPHIC_COORDINATES_LATITUDE_ITEM_NAME) - 51.07861) < 1e-6);
	SA_CHECK(fabs(sa_number(sa_device, GEOGRAPHIC_COORDINATES_PROPERTY_NAME, GEOGRAPHIC_COORDINATES_LONGITUDE_ITEM_NAME) - (360 - 0.29444)) < 1e-6);
	SA_CHECK(fabs(omni_ra_difference(omni_lst(), omni_double("telescope", "siderealtime"))) < 0.01);
	SA_CHECK(sa_number(sa_device, MOUNT_EPOCH_PROPERTY_NAME, MOUNT_EPOCH_ITEM_NAME) == 0);
	SA_CHECK(!sa_switch(sa_device, MOUNT_PARK_PROPERTY_NAME, MOUNT_PARK_PARKED_ITEM_NAME) && sa_switch(sa_device, MOUNT_TRACKING_PROPERTY_NAME, MOUNT_TRACKING_OFF_ITEM_NAME));
	// goto east of the meridian: tracking is switched on for it, the telescope ends on pierWest
	double ra = omni_hours(omni_lst() + 2), dec = 20;
	SA_CHECK(omni_goto(ra, dec));
	SA_CHECK(omni_bool("telescope", "tracking") && sa_switch(sa_device, MOUNT_TRACKING_PROPERTY_NAME, MOUNT_TRACKING_ON_ITEM_NAME));
	SA_CHECK(omni_int("telescope", "sideofpier") == 1 && SA_WAIT(sa_switch(sa_device, MOUNT_SIDE_OF_PIER_PROPERTY_NAME, MOUNT_SIDE_OF_PIER_WEST_ITEM_NAME), SA_TIMEOUT));
	// the telescope works in JNow: what it reports differs from the J2000 target by the precession since 2000
	double jnow_ra = omni_double("telescope", "rightascension"), jnow_dec = omni_double("telescope", "declination");
	double expected_ra = ra, expected_dec = dec;
	indigo_j2k_to_jnow(&expected_ra, &expected_dec);
	printf("    J2000 %.5f %.5f, telescope %.5f %.5f, expected JNow %.5f %.5f\n", ra, dec, jnow_ra, jnow_dec, expected_ra, expected_dec);
	SA_CHECK(fabs(omni_ra_difference(jnow_ra, expected_ra)) < 0.002 && fabs(jnow_dec - expected_dec) < 0.03);
	// sync to a nearby position
	SA_CHECK(omni_set_switch(sa_device, MOUNT_ON_COORDINATES_SET_PROPERTY_NAME, MOUNT_ON_COORDINATES_SET_SYNC_ITEM_NAME, true, SA_TIMEOUT) == INDIGO_OK_STATE);
	{
		static const char *items[] = { MOUNT_EQUATORIAL_COORDINATES_RA_ITEM_NAME, MOUNT_EQUATORIAL_COORDINATES_DEC_ITEM_NAME };
		const double values[] = { omni_hours(ra + 0.05), dec + 0.5 };
		SA_CHECK(omni_set_numbers(sa_device, MOUNT_EQUATORIAL_COORDINATES_PROPERTY_NAME, 2, items, values, MOUNT_CASE_TIMEOUT) == INDIGO_OK_STATE);
		SA_CHECK(SA_WAIT(fabs(omni_ra_difference(sa_number(sa_device, MOUNT_EQUATORIAL_COORDINATES_PROPERTY_NAME, MOUNT_EQUATORIAL_COORDINATES_RA_ITEM_NAME), values[0])) < 0.002 && fabs(sa_number(sa_device, MOUNT_EQUATORIAL_COORDINATES_PROPERTY_NAME, MOUNT_EQUATORIAL_COORDINATES_DEC_ITEM_NAME) - values[1]) < 0.03, SA_TIMEOUT));
	}
	SA_CHECK(omni_set_switch(sa_device, MOUNT_ON_COORDINATES_SET_PROPERTY_NAME, MOUNT_ON_COORDINATES_SET_TRACK_ITEM_NAME, true, SA_TIMEOUT) == INDIGO_OK_STATE);
	// goto west of the meridian: the telescope flips to pierEast
	ra = omni_hours(omni_lst() - 2);
	dec = 35;
	SA_CHECK(omni_goto(ra, dec));
	SA_CHECK(omni_int("telescope", "sideofpier") == 0 && SA_WAIT(sa_switch(sa_device, MOUNT_SIDE_OF_PIER_PROPERTY_NAME, MOUNT_SIDE_OF_PIER_EAST_ITEM_NAME), SA_TIMEOUT));
	// abort a long slew: AbortSlew stops it, the request ends in ALERT
	{
		static const char *items[] = { MOUNT_EQUATORIAL_COORDINATES_RA_ITEM_NAME, MOUNT_EQUATORIAL_COORDINATES_DEC_ITEM_NAME };
		const double values[] = { omni_hours(omni_lst() + 3), -10 };
		unsigned revision = sa_revision(sa_device, MOUNT_EQUATORIAL_COORDINATES_PROPERTY_NAME);
		SA_CHECK(indigo_change_number_property(&sa_client, sa_device, MOUNT_EQUATORIAL_COORDINATES_PROPERTY_NAME, 2, items, values) == INDIGO_OK);
		SA_CHECK(SA_WAIT(omni_bool("telescope", "slewing"), SA_TIMEOUT));
		SA_CHECK(omni_set_switch(sa_device, MOUNT_ABORT_MOTION_PROPERTY_NAME, MOUNT_ABORT_MOTION_ITEM_NAME, true, SA_TIMEOUT) == INDIGO_OK_STATE);
		SA_CHECK(SA_WAIT(sa_state(sa_device, MOUNT_EQUATORIAL_COORDINATES_PROPERTY_NAME) != INDIGO_BUSY_STATE, MOUNT_CASE_TIMEOUT));
		SA_CHECK(sa_state_after(sa_device, MOUNT_EQUATORIAL_COORDINATES_PROPERTY_NAME, INDIGO_ALERT_STATE, revision) && !omni_bool("telescope", "slewing"));
		SA_CHECK(fabs(sa_number(sa_device, MOUNT_EQUATORIAL_COORDINATES_PROPERTY_NAME, MOUNT_EQUATORIAL_COORDINATES_DEC_ITEM_NAME) + 10) > 0.5);
	}
	SA_CHECK(omni_disconnect_detach(TELESCOPE_LABEL));
	SA_CHECK(SA_WAIT(!omni_bool("telescope", "connected"), OMNI_TIMEOUT));
cleanup:
	omni_end();
}

static void omnisim_mount_park_home_tracking(void) {
	SA_CHECK(omni_begin());
	SA_CHECK(omni_attach_connect(TELESCOPE_LABEL));
	// tracking and the tracking rates of the telescope
	SA_CHECK(omni_set_switch(sa_device, MOUNT_TRACKING_PROPERTY_NAME, MOUNT_TRACKING_ON_ITEM_NAME, true, SA_TIMEOUT) == INDIGO_OK_STATE && omni_bool("telescope", "tracking"));
	SA_CHECK(sa_has_item(sa_device, MOUNT_TRACK_RATE_PROPERTY_NAME, MOUNT_TRACK_RATE_SIDEREAL_ITEM_NAME) && sa_has_item(sa_device, MOUNT_TRACK_RATE_PROPERTY_NAME, MOUNT_TRACK_RATE_SOLAR_ITEM_NAME) && sa_has_item(sa_device, MOUNT_TRACK_RATE_PROPERTY_NAME, MOUNT_TRACK_RATE_LUNAR_ITEM_NAME) && sa_has_item(sa_device, MOUNT_TRACK_RATE_PROPERTY_NAME, MOUNT_TRACK_RATE_KING_ITEM_NAME));
	SA_CHECK(sa_switch(sa_device, MOUNT_TRACK_RATE_PROPERTY_NAME, MOUNT_TRACK_RATE_SIDEREAL_ITEM_NAME));
	SA_CHECK(omni_set_switch(sa_device, MOUNT_TRACK_RATE_PROPERTY_NAME, MOUNT_TRACK_RATE_LUNAR_ITEM_NAME, true, SA_TIMEOUT) == INDIGO_OK_STATE && omni_int("telescope", "trackingrate") == 1);
	SA_CHECK(omni_set_switch(sa_device, MOUNT_TRACK_RATE_PROPERTY_NAME, MOUNT_TRACK_RATE_KING_ITEM_NAME, true, SA_TIMEOUT) == INDIGO_OK_STATE && omni_int("telescope", "trackingrate") == 3);
	SA_CHECK(omni_set_switch(sa_device, MOUNT_TRACK_RATE_PROPERTY_NAME, MOUNT_TRACK_RATE_SIDEREAL_ITEM_NAME, true, SA_TIMEOUT) == INDIGO_OK_STATE && omni_int("telescope", "trackingrate") == 0);
	// guide rates in percent of the sidereal rate
	SA_CHECK(fabs(sa_number(sa_device, MOUNT_GUIDE_RATE_PROPERTY_NAME, MOUNT_GUIDE_RATE_RA_ITEM_NAME) - 100) < 0.01);
	{
		static const char *items[] = { MOUNT_GUIDE_RATE_RA_ITEM_NAME, MOUNT_GUIDE_RATE_DEC_ITEM_NAME };
		const double values[] = { 50, 75 };
		SA_CHECK(omni_set_numbers(sa_device, MOUNT_GUIDE_RATE_PROPERTY_NAME, 2, items, values, SA_TIMEOUT) == INDIGO_OK_STATE);
		SA_CHECK(fabs(omni_double("telescope", "guideraterightascension") - 0.5 * 15.0410686 / 3600) < 1e-7 && fabs(omni_double("telescope", "guideratedeclination") - 0.75 * 15.0410686 / 3600) < 1e-7);
	}
	// UTC of the telescope
	SA_CHECK(sa_text(sa_device, UTC_TIME_PROPERTY_NAME, UTC_TIME_ITEM_NAME)[0] != 0);
	// park: the telescope goes to its park position and reports AtPark; a parked telescope does not track
	SA_CHECK(omni_set_switch(sa_device, MOUNT_PARK_PROPERTY_NAME, MOUNT_PARK_PARKED_ITEM_NAME, true, MOUNT_CASE_TIMEOUT) == INDIGO_OK_STATE);
	SA_CHECK(omni_bool("telescope", "atpark") && sa_switch(sa_device, MOUNT_PARK_PROPERTY_NAME, MOUNT_PARK_PARKED_ITEM_NAME));
	SA_CHECK(SA_WAIT(sa_switch(sa_device, MOUNT_TRACKING_PROPERTY_NAME, MOUNT_TRACKING_OFF_ITEM_NAME), SA_TIMEOUT) && !omni_bool("telescope", "tracking"));
	// a goto of a parked telescope is refused by the driver
	{
		static const char *items[] = { MOUNT_EQUATORIAL_COORDINATES_RA_ITEM_NAME, MOUNT_EQUATORIAL_COORDINATES_DEC_ITEM_NAME };
		const double values[] = { omni_hours(omni_lst() + 1), 10 };
		SA_CHECK(omni_set_numbers(sa_device, MOUNT_EQUATORIAL_COORDINATES_PROPERTY_NAME, 2, items, values, SA_TIMEOUT) == INDIGO_ALERT_STATE && omni_bool("telescope", "atpark"));
	}
	SA_CHECK(omni_set_switch(sa_device, MOUNT_PARK_PROPERTY_NAME, MOUNT_PARK_UNPARKED_ITEM_NAME, true, MOUNT_CASE_TIMEOUT) == INDIGO_OK_STATE && !omni_bool("telescope", "atpark"));
	// FindHome: the telescope reports AtHome at the end
	SA_CHECK(omni_set_switch(sa_device, MOUNT_HOME_PROPERTY_NAME, MOUNT_HOME_ITEM_NAME, true, MOUNT_CASE_TIMEOUT) == INDIGO_OK_STATE);
	SA_CHECK(omni_bool("telescope", "athome"));
	// Platform 7 disconnect is asynchronous in OmniSim (Connecting is true for about a second): CONNECTION stays BUSY until Connecting
	// is false (REFACTOR.md 2.4, 2.7), so when the device is reported disconnected the telescope is neither connected nor connecting,
	// and a connect right after it ends connected and working
	double started = indigo_monotonic_time();
	SA_CHECK(sa_disconnect(sa_device));
	printf("    disconnect completed after %.2f s: Connected %d, Connecting %d\n", indigo_monotonic_time() - started, omni_bool("telescope", "connected"), omni_bool("telescope", "connecting"));
	SA_CHECK(!omni_bool("telescope", "connected") && !omni_bool("telescope", "connecting"));
	SA_CHECK(sa_request_connection(sa_device, true) && SA_WAIT(sa_is_connected(sa_device), OMNI_TIMEOUT));
	SA_CHECK(omni_bool("telescope", "connected") && !omni_bool("telescope", "connecting"));
	SA_CHECK(omni_set_switch(sa_device, MOUNT_TRACKING_PROPERTY_NAME, MOUNT_TRACKING_ON_ITEM_NAME, true, SA_TIMEOUT) == INDIGO_OK_STATE && omni_bool("telescope", "tracking"));
	SA_CHECK(omni_disconnect_detach(TELESCOPE_LABEL));
cleanup:
	omni_end();
}

// MoveAxis through MOUNT_MOTION_DEC / _RA. Answers the open question of the sense: OmniSim moves the mechanical axes, so a positive
// rate of the secondary axis is north on pierEast and south on pierWest; a positive rate of the primary axis is west.
static bool omni_manual_motion(const char *property, const char *item, double seconds) {
	// the motion runs while the item is on; the telescope reports Slewing during MoveAxis
	if (indigo_change_switch_property_1(&sa_client, sa_device, property, item, true) != INDIGO_OK || !SA_WAIT(omni_bool("telescope", "slewing"), SA_TIMEOUT)) {
		fprintf(stderr, "    %s.%s did not start MoveAxis, state %d\n", property, item, sa_state(sa_device, property));
		omni_print_messages();
		return false;
	}
	SA_WAIT(false, seconds);
	return omni_set_switch(sa_device, property, item, false, SA_TIMEOUT) == INDIGO_OK_STATE;
}

// One manual motion of 1 s; the change of the declination or of the right ascension (hours, -12 ... 12) of the telescope is left in *change.
static bool omni_motion_change(const char *property, const char *item, const char *member, const char *where, double *change) {
	double before = omni_double("telescope", member);
	if (!omni_manual_motion(property, item, 1) || !SA_WAIT(!omni_bool("telescope", "slewing"), SA_TIMEOUT)) {
		return false;
	}
	double after = omni_double("telescope", member);
	*change = !strcmp(member, "rightascension") ? omni_ra_difference(after, before) : after - before;
	printf("    %s, %s.%s: %s %.5f -> %.5f\n", where, property, item, member, before, after);
	return true;
}

// MOUNT_MOTION_DEC.NORTH moves toward the north celestial pole on both sides of the pier and on a northern and a southern site; OmniSim turns
// the secondary axis the other way through the pole (pierWest), so the driver inverts the rate there (indigo_system_alpaca_mount.c, MANUAL
// MOTION). MOUNT_MOTION_RA.WEST makes the right ascension fall everywhere, the primary axis is never inverted.
static void omnisim_mount_manual_motion(void) {
	char where[64];
	double change = 0;
	SA_CHECK(omni_begin());
	SA_CHECK(omni_attach_connect(TELESCOPE_LABEL));
	// the rates of MOUNT_SLEW_RATE come from AxisRates [0, 6.67] and [10, 20]
	SA_CHECK(omni_set_switch(sa_device, MOUNT_SLEW_RATE_PROPERTY_NAME, MOUNT_SLEW_RATE_FIND_ITEM_NAME, true, SA_TIMEOUT) == INDIGO_OK_STATE);
	for (int site = 0; site < 2; site++) {
		// OmniSim's site is at 51.07861 N; the southern one is set on the telescope directly. OmniSim saves SiteLatitude in its profile, which
		// lives in the private home of this instance only (omnisim_test_common.h), so it is not put back
		if (site) {
			SA_CHECK(omni_put("telescope", "sitelatitude", "SiteLatitude=-30.2407") == 0 && fabs(omni_double("telescope", "sitelatitude") + 30.2407) < 1e-9);
		}
		for (int west = 0; west < 2; west++) {
			// 2 h east of the meridian the telescope points through the pole (pierWest), 2 h west of it it is on pierEast
			SA_CHECK(omni_goto(omni_hours(omni_lst() + (west ? 2 : -2)), 10));
			SA_CHECK(omni_int("telescope", "sideofpier") == west);
			snprintf(where, sizeof(where), "%s site, %s", site ? "southern" : "northern", west ? "pierWest" : "pierEast");
			SA_CHECK(omni_motion_change(MOUNT_MOTION_DEC_PROPERTY_NAME, MOUNT_MOTION_NORTH_ITEM_NAME, "declination", where, &change) && change > 0.1);
			SA_CHECK(omni_motion_change(MOUNT_MOTION_DEC_PROPERTY_NAME, MOUNT_MOTION_SOUTH_ITEM_NAME, "declination", where, &change) && change < -0.1);
			// west: the hour angle grows, the right ascension of the place the telescope points at falls
			SA_CHECK(omni_motion_change(MOUNT_MOTION_RA_PROPERTY_NAME, MOUNT_MOTION_WEST_ITEM_NAME, "rightascension", where, &change) && change < -0.01);
		}
	}
	SA_CHECK(omni_disconnect_detach(TELESCOPE_LABEL));
cleanup:
	omni_end();
}

// The guider of the telescope: PulseGuide on real time, completion by IsPulseGuiding.
static void omnisim_mount_guider(void) {
	char guider[INDIGO_NAME_SIZE];
	SA_CHECK(omni_begin());
	SA_CHECK(omni_attach_connect(TELESCOPE_LABEL));
	snprintf(guider, sizeof(guider), "%s (guider)", sa_device);
	SA_CHECK(SA_WAIT(sa_defined(guider, CONNECTION_PROPERTY_NAME), SA_TIMEOUT));
	SA_CHECK(sa_request_connection(guider, true) && SA_WAIT(sa_is_connected(guider), SA_TIMEOUT));
	SA_CHECK(omni_set_switch(sa_device, MOUNT_TRACKING_PROPERTY_NAME, MOUNT_TRACKING_ON_ITEM_NAME, true, SA_TIMEOUT) == INDIGO_OK_STATE);
	double before = omni_double("telescope", "declination");
	unsigned revision = sa_revision(guider, GUIDER_GUIDE_DEC_PROPERTY_NAME);
	SA_CHECK(indigo_change_number_property_1(&sa_client, guider, GUIDER_GUIDE_DEC_PROPERTY_NAME, GUIDER_GUIDE_NORTH_ITEM_NAME, 2000) == INDIGO_OK);
	SA_CHECK(SA_WAIT(omni_bool("telescope", "ispulseguiding"), SA_TIMEOUT));
	SA_CHECK(SA_WAIT(sa_state_after(guider, GUIDER_GUIDE_DEC_PROPERTY_NAME, INDIGO_OK_STATE, revision) && sa_state(guider, GUIDER_GUIDE_DEC_PROPERTY_NAME) == INDIGO_OK_STATE, SA_TIMEOUT));
	SA_CHECK(!omni_bool("telescope", "ispulseguiding"));
	double after = omni_double("telescope", "declination");
	printf("    2 s north pulse at the guide rate: declination %.6f -> %.6f\n", before, after);
	SA_CHECK(after - before > 0.004 && after - before < 0.0125);
	// a pulse ended early: both items zero send PulseGuide Duration 0, which ends the pulse in OmniSim
	revision = sa_revision(guider, GUIDER_GUIDE_RA_PROPERTY_NAME);
	SA_CHECK(indigo_change_number_property_1(&sa_client, guider, GUIDER_GUIDE_RA_PROPERTY_NAME, GUIDER_GUIDE_WEST_ITEM_NAME, 5000) == INDIGO_OK);
	SA_CHECK(SA_WAIT(omni_bool("telescope", "ispulseguiding"), SA_TIMEOUT));
	double started = indigo_monotonic_time();
	SA_CHECK(indigo_change_number_property_1(&sa_client, guider, GUIDER_GUIDE_RA_PROPERTY_NAME, GUIDER_GUIDE_WEST_ITEM_NAME, 0) == INDIGO_OK);
	SA_CHECK(SA_WAIT(!omni_bool("telescope", "ispulseguiding"), SA_TIMEOUT));
	SA_CHECK(SA_WAIT(sa_state(guider, GUIDER_GUIDE_RA_PROPERTY_NAME) == INDIGO_OK_STATE, SA_TIMEOUT));
	printf("    a 5 s pulse ended by Duration 0 after %.2f s\n", indigo_monotonic_time() - started);
	SA_CHECK(indigo_monotonic_time() - started < 4);
	SA_CHECK(sa_disconnect(guider));
	SA_CHECK(omni_disconnect_detach(TELESCOPE_LABEL));
cleanup:
	omni_end();
}

// ---------------------------------------------------------------------------- camera

// OmniSim camera: ICameraV3 (no devicestate: it answers 0x40B "not present in ICameraV3"), 800 x 600 mono, MaxADU 65535,
// binning up to 4 and asymmetric, one readout mode "Default" and no FastReadout, no cooler, no gain or offset, no pulse guiding.
// The image is the picture of M42 the release ships as m42-800x600.jpg; ImageBytes are Int32 sent as bytes.
// Brightness of the picture of M42 in 50 x 50 pixel blocks, 16 x 12 blocks, rows top down: the mean of R, G and B of
// m42-800x600.jpg from the OmniSim 0.5.0 release, decoded with sips. It tells which way the image is oriented.
static const double omni_m42[12][16] = {
	{ 88, 89, 86, 76, 69, 65, 66, 58, 53, 49, 45, 44, 41, 38, 37, 34 },
	{ 89, 86, 78, 69, 67, 83, 80, 67, 65, 60, 62, 60, 56, 53, 45, 40 },
	{ 88, 83, 75, 69, 71, 106, 123, 91, 86, 87, 86, 81, 73, 63, 55, 47 },
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	{ 54, 44, 55, 63, 64, 65, 66, 66, 60, 56, 49, 40, 34, 28, 21, 20 }
};

static pthread_mutex_t omni_ccd_mutex = PTHREAD_MUTEX_INITIALIZER;
static char omni_ccd_device[INDIGO_NAME_SIZE];
static unsigned char *omni_ccd_image = NULL;
static size_t omni_ccd_image_size = 0;
static unsigned omni_ccd_image_count = 0;
static bool omni_ccd_client_attached = false;

static indigo_result omni_ccd_update_property(indigo_client *client, indigo_device *device, indigo_property *property, const char *message) {
	(void)client;
	(void)device;
	(void)message;
	pthread_mutex_lock(&omni_ccd_mutex);
	if (!strcmp(property->device, omni_ccd_device) && !strcmp(property->name, CCD_IMAGE_PROPERTY_NAME) && property->state == INDIGO_OK_STATE && property->items[0].blob.value != NULL) {
		omni_ccd_image = indigo_safe_realloc(omni_ccd_image, property->items[0].blob.size);
		memcpy(omni_ccd_image, property->items[0].blob.value, property->items[0].blob.size);
		omni_ccd_image_size = property->items[0].blob.size;
		omni_ccd_image_count++;
	}
	pthread_mutex_unlock(&omni_ccd_mutex);
	return INDIGO_OK;
}

static indigo_client omni_ccd_client = {
	"system_alpaca OmniSim camera client", false, NULL, INDIGO_OK, INDIGO_VERSION_CURRENT, NULL, NULL, NULL, omni_ccd_update_property, NULL, NULL, NULL, false, false
};

static unsigned omni_ccd_images(void) {
	pthread_mutex_lock(&omni_ccd_mutex);
	unsigned result = omni_ccd_image_count;
	pthread_mutex_unlock(&omni_ccd_mutex);
	return result;
}

static void omni_ccd_end(void) {
	if (omni_ccd_client_attached) {
		indigo_detach_client(&omni_ccd_client);
		omni_ccd_client_attached = false;
	}
	omni_end();
	pthread_mutex_lock(&omni_ccd_mutex);
	indigo_safe_free(omni_ccd_image);
	omni_ccd_image = NULL;
	omni_ccd_image_size = 0;
	pthread_mutex_unlock(&omni_ccd_mutex);
}

// The image of the last exposure as OmniSim serves it, read directly with ImageBytes: elements in the order Value[x][y].
static uint32_t *omni_image = NULL;
static int omni_image_width = 0;
static int omni_image_height = 0;

static bool omni_read_imagebytes(void) {
	sa_simulator *simulator = sa_simulators + 0;
	alpaca_http_options options = { { 5000, 30000, 10000, 60000 }, "Accept: application/imagebytes\r\n", false };
	if (alpaca_http_get(simulator->control, "/api/v1/camera/0/imagearray", NULL, &options, &simulator->response) != ALPACA_HTTP_OK || simulator->response.status != 200 || !alpaca_http_response_is(&simulator->response, "application/imagebytes") || simulator->response.body.size < 44) {
		fprintf(stderr, "    imagearray as ImageBytes failed: HTTP %d %s\n", simulator->response.status, simulator->response.content_type);
		return false;
	}
	int32_t header[11];
	memcpy(header, simulator->response.body.data, sizeof(header));
	printf("    ImageBytes: version %d, error %d, data start %d, element type %d, transmission type %d, rank %d, %d x %d x %d\n", header[0], header[1], header[4], header[5], header[6], header[7], header[8], header[9], header[10]);
	if (header[0] != 1 || header[1] != 0 || header[7] != 2) {
		return false;
	}
	int sizes[] = { 0, 2, 4, 8, 0, 0, 1, 4, 2, 0 };
	int transmission = header[6];
	if (transmission < 1 || transmission > 9 || sizes[transmission] == 0) {
		fprintf(stderr, "    transmission type %d is not handled by the test\n", transmission);
		return false;
	}
	omni_image_width = header[8];
	omni_image_height = header[9];
	size_t count = (size_t)omni_image_width * (size_t)omni_image_height;
	if ((size_t)header[4] + count * (size_t)sizes[transmission] > simulator->response.body.size) {
		return false;
	}
	omni_image = indigo_safe_realloc(omni_image, count * sizeof(uint32_t));
	const unsigned char *data = (const unsigned char *)simulator->response.body.data + header[4];
	for (size_t i = 0; i < count; i++) {
		switch (transmission) {
			case 6:
				omni_image[i] = data[i];
				break;
			case 8:
				omni_image[i] = (uint32_t)(data[2 * i] | data[2 * i + 1] << 8);
				break;
			case 1: {
				int16_t value = (int16_t)(data[2 * i] | data[2 * i + 1] << 8);
				omni_image[i] = value < 0 ? 0 : (uint32_t)value;
				break;
			}
			default: {
				int32_t value = (int32_t)((uint32_t)data[4 * i] | (uint32_t)data[4 * i + 1] << 8 | (uint32_t)data[4 * i + 2] << 16 | (uint32_t)data[4 * i + 3] << 24);
				omni_image[i] = value < 0 ? 0 : (uint32_t)value;
				break;
			}
		}
	}
	return true;
}

// The same image through the JSON path: the reply without Accept: application/imagebytes, parsed by the driver's own
// alpaca_json_parse_image(), has to hold exactly the elements of ImageBytes.
static bool omni_json_matches_imagebytes(void) {
	sa_simulator *simulator = sa_simulators + 0;
	alpaca_http_options options = { { 5000, 30000, 10000, 60000 }, "Accept: application/json\r\n", false };
	if (alpaca_http_get(simulator->control, "/api/v1/camera/0/imagearray", NULL, &options, &simulator->response) != ALPACA_HTTP_OK || simulator->response.status != 200) {
		return false;
	}
	void *buffer = NULL;
	size_t capacity = 0;
	alpaca_json_image image;
	char error[256] = { 0 };
	bool result = alpaca_json_parse_image(simulator->response.body.data, simulator->response.body.size, ALPACA_JSON_IMAGE_INT32, &buffer, &capacity, true, &image, error, sizeof(error));
	printf("    JSON imagearray: %lu bytes, type %d, rank %d, %d x %d, error %d %s\n", (unsigned long)simulator->response.body.size, image.type, image.rank, image.dimensions[0], image.dimensions[1], (int)image.error_number, error);
	result = result && image.error_number == 0 && image.has_value && image.rank == 2 && image.dimensions[0] == omni_image_width && image.dimensions[1] == omni_image_height;
	for (size_t i = 0; result && i < image.count; i++) {
		int32_t value = ((int32_t *)buffer)[i];
		if ((uint32_t)(value < 0 ? 0 : value) != omni_image[i]) {
			fprintf(stderr, "    JSON element %lu is %d, ImageBytes %u\n", (unsigned long)i, value, omni_image[i]);
			result = false;
		}
	}
	indigo_safe_free(buffer);
	return result;
}

// The last image the driver published is a raw image of width x height with the elements OmniSim served at Value[x][y]
// in row y, column x (top-down rows).
static bool omni_ccd_image_matches(int width, int height) {
	bool result = false;
	pthread_mutex_lock(&omni_ccd_mutex);
	indigo_raw_header header = { 0 };
	if (omni_ccd_image == NULL || omni_ccd_image_size < sizeof(header)) {
		fprintf(stderr, "    no image\n");
	} else {
		memcpy(&header, omni_ccd_image, sizeof(header));
		int bytes = header.signature == INDIGO_RAW_MONO16 ? 2 : header.signature == INDIGO_RAW_MONO8 ? 1 : 0;
		const unsigned char *pixel = omni_ccd_image + sizeof(header);
		printf("    driver image %08x %u x %u, OmniSim %d x %d\n", header.signature, header.width, header.height, omni_image_width, omni_image_height);
		if (bytes == 0 || (int)header.width != width || (int)header.height != height || omni_image_width != width || omni_image_height != height || omni_ccd_image_size < sizeof(header) + (size_t)width * (size_t)height * (size_t)bytes) {
			fprintf(stderr, "    image does not have the expected size\n");
		} else {
			result = true;
			for (int y = 0; y < height && result; y++) {
				for (int x = 0; x < width && result; x++, pixel += bytes) {
					unsigned value = bytes == 2 ? (unsigned)(pixel[0] | pixel[1] << 8) : pixel[0];
					if (value != omni_image[(size_t)x * (size_t)height + (size_t)y]) {
						fprintf(stderr, "    pixel %d, %d is %u, OmniSim Value[%d][%d] is %u\n", x, y, value, x, y, omni_image[(size_t)x * (size_t)height + (size_t)y]);
						result = false;
					}
				}
			}
		}
	}
	pthread_mutex_unlock(&omni_ccd_mutex);
	return result;
}

// Correlation of the 16 x 12 block means of the published full frame with the picture of M42, for the frame as it is and flipped.
static double omni_m42_correlation(bool flip_vertical, bool flip_horizontal) {
	double blocks[12][16] = { { 0 } };
	double sum_a = 0, sum_b = 0, sum_ab = 0, sum_aa = 0, sum_bb = 0;
	pthread_mutex_lock(&omni_ccd_mutex);
	indigo_raw_header header = { 0 };
	memcpy(&header, omni_ccd_image, sizeof(header));
	int bytes = header.signature == INDIGO_RAW_MONO16 ? 2 : 1;
	const unsigned char *pixels = omni_ccd_image + sizeof(header);
	for (int y = 0; y < 600; y++) {
		for (int x = 0; x < 800; x++) {
			const unsigned char *pixel = pixels + ((size_t)y * 800 + (size_t)x) * (size_t)bytes;
			blocks[y / 50][x / 50] += bytes == 2 ? (pixel[0] | pixel[1] << 8) : pixel[0];
		}
	}
	pthread_mutex_unlock(&omni_ccd_mutex);
	for (int row = 0; row < 12; row++) {
		for (int column = 0; column < 16; column++) {
			double a = blocks[flip_vertical ? 11 - row : row][flip_horizontal ? 15 - column : column];
			double b = omni_m42[row][column];
			sum_a += a;
			sum_b += b;
			sum_ab += a * b;
			sum_aa += a * a;
			sum_bb += b * b;
		}
	}
	double n = 192;
	return (sum_ab - sum_a * sum_b / n) / sqrt((sum_aa - sum_a * sum_a / n) * (sum_bb - sum_b * sum_b / n));
}

// Expose and wait for the image; the exposure has to deliver exactly one image.
static bool omni_expose(double duration) {
	unsigned images = omni_ccd_images();
	unsigned revision = sa_revision(sa_device, CCD_EXPOSURE_PROPERTY_NAME);
	if (indigo_change_number_property_1(&sa_client, sa_device, CCD_EXPOSURE_PROPERTY_NAME, CCD_EXPOSURE_ITEM_NAME, duration) != INDIGO_OK) {
		return false;
	}
	if (!SA_WAIT(sa_state_after(sa_device, CCD_EXPOSURE_PROPERTY_NAME, INDIGO_OK_STATE, revision) && sa_state(sa_device, CCD_EXPOSURE_PROPERTY_NAME) == INDIGO_OK_STATE && omni_ccd_images() == images + 1, OMNI_TIMEOUT)) {
		fprintf(stderr, "    exposure of %g s ended with CCD_EXPOSURE in state %d, %u image(s)\n", duration, sa_state(sa_device, CCD_EXPOSURE_PROPERTY_NAME), omni_ccd_images() - images);
		omni_print_messages();
		return false;
	}
	return omni_went_busy(sa_device, CCD_EXPOSURE_PROPERTY_NAME, revision) && sa_state(sa_device, CCD_IMAGE_PROPERTY_NAME) == INDIGO_OK_STATE;
}

static bool omni_ccd_begin(void) {
	if (!omni_begin() || !omni_attach_connect(CAMERA_LABEL)) {
		return false;
	}
	pthread_mutex_lock(&omni_ccd_mutex);
	snprintf(omni_ccd_device, sizeof(omni_ccd_device), "%s", sa_device);
	omni_ccd_image_count = 0;
	pthread_mutex_unlock(&omni_ccd_mutex);
	omni_ccd_client_attached = indigo_attach_client(&omni_ccd_client) == INDIGO_OK;
	return omni_ccd_client_attached && omni_set_switch(sa_device, CCD_IMAGE_FORMAT_PROPERTY_NAME, CCD_IMAGE_FORMAT_RAW_ITEM_NAME, true, SA_TIMEOUT) == INDIGO_OK_STATE;
}

static void omnisim_camera_image(void) {
	SA_CHECK(omni_ccd_begin());
	SA_CHECK(omni_interface_version(sa_device) == 3);
	SA_CHECK(omni_member_answers("camera", "devicestate", OMNI_INVALID_OPERATION));
	// what the camera reports
	SA_CHECK(sa_number(sa_device, CCD_INFO_PROPERTY_NAME, CCD_INFO_WIDTH_ITEM_NAME) == 800 && sa_number(sa_device, CCD_INFO_PROPERTY_NAME, CCD_INFO_HEIGHT_ITEM_NAME) == 600);
	SA_CHECK(sa_number(sa_device, CCD_INFO_PROPERTY_NAME, CCD_INFO_MAX_HORIZONTAL_BIN_ITEM_NAME) == 4 && sa_number(sa_device, CCD_INFO_PROPERTY_NAME, CCD_INFO_MAX_VERTICAL_BIN_ITEM_NAME) == 4);
	SA_CHECK(sa_number(sa_device, CCD_INFO_PROPERTY_NAME, CCD_INFO_BITS_PER_PIXEL_ITEM_NAME) == 16);
	// SIM-1: a camera with one readout mode and without FastReadout: no CCD_READ_MODE, CCD_MODE holds the binning modes
	SA_CHECK(!omni_bool("camera", "canfastreadout") && !sa_defined(sa_device, CCD_READ_MODE_PROPERTY_NAME));
	// Gain and Offset are NotImplemented
	SA_CHECK(!sa_defined(sa_device, CCD_GAIN_PROPERTY_NAME) && !sa_defined(sa_device, CCD_OFFSET_PROPERTY_NAME) && !sa_defined(sa_device, "X_ALPACA_GAIN") && !sa_defined(sa_device, "X_ALPACA_OFFSET"));
	// CoolerOn and CCDTemperature are implemented, CanSetCCDTemperature and CanGetCoolerPower are false
	SA_CHECK(sa_defined(sa_device, CCD_COOLER_PROPERTY_NAME) && sa_perm(sa_device, CCD_TEMPERATURE_PROPERTY_NAME) == INDIGO_RO_PERM && !sa_defined(sa_device, CCD_COOLER_POWER_PROPERTY_NAME));
	SA_CHECK(fabs(sa_number(sa_device, CCD_TEMPERATURE_PROPERTY_NAME, CCD_TEMPERATURE_ITEM_NAME) - omni_double("camera", "ccdtemperature")) < 0.5);
	SA_CHECK(omni_set_switch(sa_device, CCD_COOLER_PROPERTY_NAME, CCD_COOLER_ON_ITEM_NAME, true, SA_TIMEOUT) == INDIGO_OK_STATE && omni_bool("camera", "cooleron"));
	SA_CHECK(omni_set_switch(sa_device, CCD_COOLER_PROPERTY_NAME, CCD_COOLER_OFF_ITEM_NAME, true, SA_TIMEOUT) == INDIGO_OK_STATE && !omni_bool("camera", "cooleron"));
	// a full frame light exposure: the published image is the image OmniSim serves, transposed onto top-down rows
	SA_CHECK(omni_expose(0.5));
	SA_CHECK(omni_read_imagebytes());
	SA_CHECK(omni_ccd_image_matches(800, 600));
	// orientation: the published frame is the picture of M42 the right way up
	double same = omni_m42_correlation(false, false), vertical = omni_m42_correlation(true, false), horizontal = omni_m42_correlation(false, true), both = omni_m42_correlation(true, true);
	printf("    correlation with M42: as published %.4f, flipped vertically %.4f, horizontally %.4f, both %.4f\n", same, vertical, horizontal, both);
	SA_CHECK(same > 0.98 && same > vertical + 0.05 && same > horizontal + 0.05 && same > both + 0.05);
	// the JSON path of the same image, parsed by the driver's parser, holds the same elements
	SA_CHECK(omni_json_matches_imagebytes());
	// a binned subframe: the camera is told StartX = 25, StartY = 10, NumX = 150, NumY = 100 at binning 4 x 2... in binned pixels
	{
		static const char *bin_items[] = { CCD_BIN_HORIZONTAL_ITEM_NAME, CCD_BIN_VERTICAL_ITEM_NAME };
		const double bin_values[] = { 4, 2 };
		static const char *frame_items[] = { CCD_FRAME_LEFT_ITEM_NAME, CCD_FRAME_TOP_ITEM_NAME, CCD_FRAME_WIDTH_ITEM_NAME, CCD_FRAME_HEIGHT_ITEM_NAME };
		const double frame_values[] = { 100, 20, 600, 200 };
		SA_CHECK(omni_set_numbers(sa_device, CCD_BIN_PROPERTY_NAME, 2, bin_items, bin_values, SA_TIMEOUT) == INDIGO_OK_STATE);
		SA_CHECK(omni_set_numbers(sa_device, CCD_FRAME_PROPERTY_NAME, 4, frame_items, frame_values, SA_TIMEOUT) == INDIGO_OK_STATE);
		SA_CHECK(omni_expose(0.5));
		SA_CHECK(omni_int("camera", "binx") == 4 && omni_int("camera", "biny") == 2 && omni_int("camera", "startx") == 25 && omni_int("camera", "starty") == 10 && omni_int("camera", "numx") == 150 && omni_int("camera", "numy") == 100);
		SA_CHECK(omni_read_imagebytes());
		SA_CHECK(omni_ccd_image_matches(150, 100));
	}
	// a dark frame (Light=False)
	SA_CHECK(omni_set_switch(sa_device, CCD_FRAME_TYPE_PROPERTY_NAME, CCD_FRAME_TYPE_DARK_ITEM_NAME, true, SA_TIMEOUT) == INDIGO_OK_STATE);
	SA_CHECK(omni_expose(0.2));
	SA_CHECK(omni_read_imagebytes());
	SA_CHECK(omni_ccd_image_matches(150, 100));
	SA_CHECK(omni_disconnect_detach(CAMERA_LABEL));
	SA_CHECK(SA_WAIT(!omni_bool("camera", "connected"), OMNI_TIMEOUT));
cleanup:
	indigo_safe_free(omni_image);
	omni_image = NULL;
	omni_ccd_end();
}

static void omnisim_camera_abort(void) {
	SA_CHECK(omni_ccd_begin());
	unsigned images = omni_ccd_images();
	unsigned revision = sa_revision(sa_device, CCD_EXPOSURE_PROPERTY_NAME);
	SA_CHECK(indigo_change_number_property_1(&sa_client, sa_device, CCD_EXPOSURE_PROPERTY_NAME, CCD_EXPOSURE_ITEM_NAME, 20) == INDIGO_OK);
	SA_CHECK(SA_WAIT(omni_int("camera", "camerastate") == 2, SA_TIMEOUT));
	SA_CHECK(omni_set_switch(sa_device, CCD_ABORT_EXPOSURE_PROPERTY_NAME, CCD_ABORT_EXPOSURE_ITEM_NAME, true, SA_TIMEOUT) == INDIGO_OK_STATE);
	SA_CHECK(SA_WAIT(sa_state(sa_device, CCD_EXPOSURE_PROPERTY_NAME) != INDIGO_BUSY_STATE, SA_TIMEOUT));
	SA_CHECK(sa_state_after(sa_device, CCD_EXPOSURE_PROPERTY_NAME, INDIGO_ALERT_STATE, revision));
	SA_CHECK(omni_int("camera", "camerastate") == 0 && !omni_bool("camera", "imageready") && omni_ccd_images() == images);
	// the camera takes the next exposure
	SA_CHECK(omni_expose(0.2));
	SA_CHECK(omni_disconnect_detach(CAMERA_LABEL));
cleanup:
	omni_ccd_end();
}

// ---------------------------------------------------------------------------- dome

// OmniSim dome: IDomeV3, starts parked at azimuth 180 with the shutter closed, turns 15 deg/s, the shutter takes 3 s, CanSetAzimuth,
// CanSetAltitude, CanSyncAzimuth, CanPark, CanSetPark, CanFindHome (home at azimuth 0), CanSetShutter, no CanSlave, Slewing false while
// only the shutter moves. Interface version 2 through the settings API.
static bool omni_dome_azimuth(double azimuth) {
	unsigned revision = sa_revision(sa_device, DOME_HORIZONTAL_COORDINATES_PROPERTY_NAME);
	int state = omni_set_number(sa_device, DOME_HORIZONTAL_COORDINATES_PROPERTY_NAME, DOME_HORIZONTAL_COORDINATES_AZ_ITEM_NAME, azimuth, OMNI_TIMEOUT);
	if (state != INDIGO_OK_STATE || !omni_went_busy(sa_device, DOME_HORIZONTAL_COORDINATES_PROPERTY_NAME, revision)) {
		fprintf(stderr, "    dome slew to %g ended in state %d\n", azimuth, state);
		omni_print_messages();
		return false;
	}
	return fabs(sa_number(sa_device, DOME_HORIZONTAL_COORDINATES_PROPERTY_NAME, DOME_HORIZONTAL_COORDINATES_AZ_ITEM_NAME) - azimuth) < 0.5 && fabs(omni_double("dome", "azimuth") - azimuth) < 0.5;
}

static void omni_dome_round_trip(int interface_version) {
	SA_CHECK(omni_begin());
	SA_CHECK(omni_attach_connect(DOME_LABEL));
	SA_CHECK(omni_interface_version(sa_device) == interface_version);
	SA_CHECK(sa_switch(sa_device, DOME_SHUTTER_PROPERTY_NAME, DOME_SHUTTER_CLOSED_ITEM_NAME) && sa_switch(sa_device, DOME_PARK_PROPERTY_NAME, DOME_PARK_PARKED_ITEM_NAME));
	SA_CHECK(sa_number(sa_device, DOME_HORIZONTAL_COORDINATES_PROPERTY_NAME, DOME_HORIZONTAL_COORDINATES_AZ_ITEM_NAME) == 180);
	SA_CHECK(sa_defined(sa_device, DOME_HOME_PROPERTY_NAME) && !sa_defined(sa_device, "X_ALPACA_DOME_SLAVED"));
	// shutter: completion when ShutterStatus leaves Opening / Closing
	SA_CHECK(omni_set_switch(sa_device, DOME_SHUTTER_PROPERTY_NAME, DOME_SHUTTER_OPENED_ITEM_NAME, true, OMNI_TIMEOUT) == INDIGO_OK_STATE && omni_int("dome", "shutterstatus") == 0);
	// unpark and turn, completion by Slewing
	SA_CHECK(omni_set_switch(sa_device, DOME_PARK_PROPERTY_NAME, DOME_PARK_UNPARKED_ITEM_NAME, true, SA_TIMEOUT) == INDIGO_OK_STATE);
	SA_CHECK(omni_dome_azimuth(120));
	SA_CHECK(!omni_bool("dome", "atpark"));
	// sync of the azimuth
	SA_CHECK(omni_set_switch(sa_device, DOME_ON_COORDINATES_SET_PROPERTY_NAME, DOME_ON_COORDINATES_SET_SYNC_ITEM_NAME, true, SA_TIMEOUT) == INDIGO_OK_STATE);
	SA_CHECK(omni_set_number(sa_device, DOME_HORIZONTAL_COORDINATES_PROPERTY_NAME, DOME_HORIZONTAL_COORDINATES_AZ_ITEM_NAME, 130, SA_TIMEOUT) == INDIGO_OK_STATE);
	SA_CHECK(fabs(omni_double("dome", "azimuth") - 130) < 0.5 && SA_WAIT(fabs(sa_number(sa_device, DOME_HORIZONTAL_COORDINATES_PROPERTY_NAME, DOME_HORIZONTAL_COORDINATES_AZ_ITEM_NAME) - 130) < 0.5, SA_TIMEOUT));
	SA_CHECK(omni_set_switch(sa_device, DOME_ON_COORDINATES_SET_PROPERTY_NAME, DOME_ON_COORDINATES_SET_GOTO_ITEM_NAME, true, SA_TIMEOUT) == INDIGO_OK_STATE);
	// the shutter altitude
	{
		static const char *items[] = { DOME_HORIZONTAL_COORDINATES_AZ_ITEM_NAME, DOME_HORIZONTAL_COORDINATES_ALT_ITEM_NAME };
		const double values[] = { 130, 45 };
		SA_CHECK(sa_has_item(sa_device, DOME_HORIZONTAL_COORDINATES_PROPERTY_NAME, DOME_HORIZONTAL_COORDINATES_ALT_ITEM_NAME));
		SA_CHECK(omni_set_numbers(sa_device, DOME_HORIZONTAL_COORDINATES_PROPERTY_NAME, 2, items, values, OMNI_TIMEOUT) == INDIGO_OK_STATE);
		SA_CHECK(fabs(omni_double("dome", "altitude") - 45) < 0.5);
	}
	// AbortSlew while the shutter closes: OmniSim stops it in Error (ShutterStatus 4), the request ends in ALERT
	unsigned revision = sa_revision(sa_device, DOME_SHUTTER_PROPERTY_NAME);
	SA_CHECK(indigo_change_switch_property_1(&sa_client, sa_device, DOME_SHUTTER_PROPERTY_NAME, DOME_SHUTTER_CLOSED_ITEM_NAME, true) == INDIGO_OK);
	SA_CHECK(SA_WAIT(omni_int("dome", "shutterstatus") == 3, SA_TIMEOUT));
	SA_CHECK(omni_set_switch(sa_device, DOME_ABORT_MOTION_PROPERTY_NAME, DOME_ABORT_MOTION_ITEM_NAME, true, SA_TIMEOUT) == INDIGO_OK_STATE);
	SA_CHECK(SA_WAIT(sa_state(sa_device, DOME_SHUTTER_PROPERTY_NAME) != INDIGO_BUSY_STATE, OMNI_TIMEOUT));
	printf("    AbortSlew while closing: ShutterStatus %d, DOME_SHUTTER state %d\n", omni_int("dome", "shutterstatus"), sa_state(sa_device, DOME_SHUTTER_PROPERTY_NAME));
	SA_CHECK(omni_int("dome", "shutterstatus") == 4 && sa_state_after(sa_device, DOME_SHUTTER_PROPERTY_NAME, INDIGO_ALERT_STATE, revision));
	// the shutter can be closed again from Error
	SA_CHECK(omni_set_switch(sa_device, DOME_SHUTTER_PROPERTY_NAME, DOME_SHUTTER_CLOSED_ITEM_NAME, true, OMNI_TIMEOUT) == INDIGO_OK_STATE && omni_int("dome", "shutterstatus") == 1);
	// FindHome and Park
	SA_CHECK(omni_set_switch(sa_device, DOME_HOME_PROPERTY_NAME, DOME_HOME_ITEM_NAME, true, OMNI_TIMEOUT) == INDIGO_OK_STATE && omni_bool("dome", "athome"));
	SA_CHECK(fabs(sa_number(sa_device, DOME_HORIZONTAL_COORDINATES_PROPERTY_NAME, DOME_HORIZONTAL_COORDINATES_AZ_ITEM_NAME)) < 0.5 || fabs(sa_number(sa_device, DOME_HORIZONTAL_COORDINATES_PROPERTY_NAME, DOME_HORIZONTAL_COORDINATES_AZ_ITEM_NAME) - 360) < 0.5);
	SA_CHECK(omni_set_switch(sa_device, DOME_PARK_PROPERTY_NAME, DOME_PARK_PARKED_ITEM_NAME, true, OMNI_TIMEOUT) == INDIGO_OK_STATE && omni_bool("dome", "atpark"));
	SA_CHECK(fabs(omni_double("dome", "azimuth") - 180) < 0.5);
	if (interface_version >= 3) {
		SA_CHECK(omni_state_has("dome", "Altitude,AtHome,AtPark,Azimuth,ShutterStatus,Slewing"));
	} else {
		SA_CHECK(omni_member_answers("dome", "devicestate", OMNI_UNSPECIFIED));
	}
	SA_CHECK(omni_disconnect_detach(DOME_LABEL));
	SA_CHECK(SA_WAIT(!omni_bool("dome", "connected"), OMNI_TIMEOUT));
cleanup:
	omni_end();
}

static void omnisim_dome(void) {
	omni_dome_round_trip(3);
}

static void omnisim_dome_legacy(void) {
	omni_connect_control();
	SA_CHECK(omni_setting("dome", "interfaceversion", "InterfaceVersion=2"));
	omni_dome_round_trip(2);
	return;
cleanup:
	omni_end();
}

// ---------------------------------------------------------------------------- cover calibrator

// OmniSim cover calibrator: ICoverCalibratorV2, cover Closed (5 s to move), calibrator Off (2 s to become Ready), MaxBrightness 100.
static void omnisim_lightbox(void) {
	SA_CHECK(omni_begin());
	SA_CHECK(omni_attach_connect(COVER_LABEL));
	SA_CHECK(omni_interface_version(sa_device) == 2);
	SA_CHECK(omni_state_has("covercalibrator", "Brightness,CalibratorState,CalibratorChanging,CoverState,CoverMoving"));
	SA_CHECK(sa_switch(sa_device, AUX_COVER_PROPERTY_NAME, AUX_COVER_CLOSE_ITEM_NAME) && sa_switch(sa_device, AUX_LIGHT_SWITCH_PROPERTY_NAME, AUX_LIGHT_SWITCH_OFF_ITEM_NAME));
	SA_CHECK(sa_defined(sa_device, AUX_LIGHT_INTENSITY_PROPERTY_NAME));
	// cover: completion by CoverMoving
	unsigned revision = sa_revision(sa_device, AUX_COVER_PROPERTY_NAME);
	SA_CHECK(omni_set_switch(sa_device, AUX_COVER_PROPERTY_NAME, AUX_COVER_OPEN_ITEM_NAME, true, OMNI_TIMEOUT) == INDIGO_OK_STATE);
	SA_CHECK(omni_went_busy(sa_device, AUX_COVER_PROPERTY_NAME, revision) && omni_int("covercalibrator", "coverstate") == 3);
	SA_CHECK(omni_set_switch(sa_device, AUX_COVER_PROPERTY_NAME, AUX_COVER_CLOSE_ITEM_NAME, true, OMNI_TIMEOUT) == INDIGO_OK_STATE && omni_int("covercalibrator", "coverstate") == 1);
	// HaltCover during a move: OmniSim leaves the cover Unknown (4); the request ends in ALERT with neither item on
	revision = sa_revision(sa_device, AUX_COVER_PROPERTY_NAME);
	SA_CHECK(indigo_change_switch_property_1(&sa_client, sa_device, AUX_COVER_PROPERTY_NAME, AUX_COVER_OPEN_ITEM_NAME, true) == INDIGO_OK);
	SA_CHECK(SA_WAIT(omni_bool("covercalibrator", "covermoving"), SA_TIMEOUT));
	SA_CHECK(omni_set_switch(sa_device, "X_ALPACA_COVER_ABORT_MOTION", "ABORT_MOTION", true, SA_TIMEOUT) == INDIGO_OK_STATE);
	SA_CHECK(SA_WAIT(sa_state(sa_device, AUX_COVER_PROPERTY_NAME) != INDIGO_BUSY_STATE, OMNI_TIMEOUT));
	printf("    HaltCover: CoverState %d, AUX_COVER state %d, OPEN %d CLOSE %d\n", omni_int("covercalibrator", "coverstate"), sa_state(sa_device, AUX_COVER_PROPERTY_NAME), sa_switch(sa_device, AUX_COVER_PROPERTY_NAME, AUX_COVER_OPEN_ITEM_NAME), sa_switch(sa_device, AUX_COVER_PROPERTY_NAME, AUX_COVER_CLOSE_ITEM_NAME));
	SA_CHECK(omni_int("covercalibrator", "coverstate") == 4 && !omni_bool("covercalibrator", "covermoving"));
	SA_CHECK(sa_state_after(sa_device, AUX_COVER_PROPERTY_NAME, INDIGO_ALERT_STATE, revision) && !sa_switch(sa_device, AUX_COVER_PROPERTY_NAME, AUX_COVER_OPEN_ITEM_NAME) && !sa_switch(sa_device, AUX_COVER_PROPERTY_NAME, AUX_COVER_CLOSE_ITEM_NAME));
	// from Unknown the cover can be closed again
	SA_CHECK(omni_set_switch(sa_device, AUX_COVER_PROPERTY_NAME, AUX_COVER_CLOSE_ITEM_NAME, true, OMNI_TIMEOUT) == INDIGO_OK_STATE && omni_int("covercalibrator", "coverstate") == 1);
	// calibrator: brightness first (only remembered while the light is off), then on; completion by CalibratorChanging
	SA_CHECK(omni_set_number(sa_device, AUX_LIGHT_INTENSITY_PROPERTY_NAME, AUX_LIGHT_INTENSITY_ITEM_NAME, 60, SA_TIMEOUT) == INDIGO_OK_STATE && omni_int("covercalibrator", "calibratorstate") == 1);
	SA_CHECK(omni_set_switch(sa_device, AUX_LIGHT_SWITCH_PROPERTY_NAME, AUX_LIGHT_SWITCH_ON_ITEM_NAME, true, OMNI_TIMEOUT) == INDIGO_OK_STATE);
	SA_CHECK(omni_int("covercalibrator", "calibratorstate") == 3 && omni_int("covercalibrator", "brightness") == 60);
	// a new brightness while the light is on goes to the device
	SA_CHECK(omni_set_number(sa_device, AUX_LIGHT_INTENSITY_PROPERTY_NAME, AUX_LIGHT_INTENSITY_ITEM_NAME, 25, OMNI_TIMEOUT) == INDIGO_OK_STATE);
	SA_CHECK(SA_WAIT(omni_int("covercalibrator", "brightness") == 25 && omni_int("covercalibrator", "calibratorstate") == 3, OMNI_TIMEOUT));
	SA_CHECK(omni_set_switch(sa_device, AUX_LIGHT_SWITCH_PROPERTY_NAME, AUX_LIGHT_SWITCH_OFF_ITEM_NAME, true, OMNI_TIMEOUT) == INDIGO_OK_STATE);
	SA_CHECK(omni_int("covercalibrator", "calibratorstate") == 1 && omni_int("covercalibrator", "brightness") == 0);
	SA_CHECK(omni_disconnect_detach(COVER_LABEL));
	SA_CHECK(SA_WAIT(!omni_bool("covercalibrator", "connected"), OMNI_TIMEOUT));
cleanup:
	omni_end();
}

// ---------------------------------------------------------------------------- switch

// OmniSim switch: ISwitchV3, ten switches: 0 Power1 (boolean, writable, CanAsync), 1 Power2 (boolean, writable), 2 Light Box
// (0 .. 100 step 10, writable), 3 Flat Panel (0 .. 255, writable), 4 - 9 read only: Cover State, Parked (boolean), Cloud Cover
// (0 .. 8), Temperature (-20 .. 30 step 0.1, 12), Humidity (0 .. 100, 50), Raining (boolean).
static bool omni_switch_value(int id, double *value) {
	char query[32];
	int error_number = -1;
	snprintf(query, sizeof(query), "Id=%d", id);
	const alpaca_json_value *json = omni_get("switch", "getswitchvalue", query, &error_number);
	return error_number == 0 && alpaca_json_get_double(json, value);
}

static void omnisim_switch(void) {
	double value = -1;
	SA_CHECK(omni_begin());
	SA_CHECK(omni_attach_connect(SWITCH_LABEL));
	SA_CHECK(omni_interface_version(sa_device) == 3);
	SA_CHECK(omni_state_has("switch", "GetSwitch0,GetSwitchValue0,StateChangeComplete0,GetSwitch9,GetSwitchValue9"));
	SA_CHECK(sa_item_count(sa_device, AUX_GPIO_OUTLETS_PROPERTY_NAME) == 2 && sa_item_count(sa_device, "X_ALPACA_SWITCH_VALUES") == 2 && sa_item_count(sa_device, AUX_GPIO_SENSORS_PROPERTY_NAME) == 6);
	SA_CHECK(!strcmp(sa_text(sa_device, AUX_OUTLET_NAMES_PROPERTY_NAME, "GPIO_OUTLET_NAME_1"), "Power1") && !strcmp(sa_text(sa_device, AUX_OUTLET_NAMES_PROPERTY_NAME, "GPIO_OUTLET_NAME_2"), "Power2"));
	SA_CHECK(!strcmp(sa_text(sa_device, AUX_OUTLET_NAMES_PROPERTY_NAME, "VALUE_NAME_1"), "Light Box") && !strcmp(sa_text(sa_device, AUX_OUTLET_NAMES_PROPERTY_NAME, "VALUE_NAME_2"), "Flat Panel"));
	SA_CHECK(!strcmp(sa_text(sa_device, AUX_SENSOR_NAMES_PROPERTY_NAME, "GPIO_SENSOR_NAME_4"), "Temperature"));
	SA_CHECK(sa_number(sa_device, AUX_GPIO_SENSORS_PROPERTY_NAME, "SENSOR_4") == 12 && sa_number(sa_device, AUX_GPIO_SENSORS_PROPERTY_NAME, "SENSOR_5") == 50);
	// switch 0 can be set asynchronously; completion by StateChangeComplete
	unsigned revision = sa_revision(sa_device, AUX_GPIO_OUTLETS_PROPERTY_NAME);
	SA_CHECK(omni_set_switch(sa_device, AUX_GPIO_OUTLETS_PROPERTY_NAME, "OUTLET_1", true, OMNI_TIMEOUT) == INDIGO_OK_STATE);
	SA_CHECK(omni_switch_value(0, &value) && value == 1);
	printf("    async switch 0: AUX_GPIO_OUTLETS %s BUSY on the way\n", omni_went_busy(sa_device, AUX_GPIO_OUTLETS_PROPERTY_NAME, revision) ? "was" : "was not");
	SA_CHECK(omni_set_switch(sa_device, AUX_GPIO_OUTLETS_PROPERTY_NAME, "OUTLET_2", true, OMNI_TIMEOUT) == INDIGO_OK_STATE);
	SA_CHECK(omni_switch_value(1, &value) && value == 1);
	SA_CHECK(omni_set_switch(sa_device, AUX_GPIO_OUTLETS_PROPERTY_NAME, "OUTLET_1", false, OMNI_TIMEOUT) == INDIGO_OK_STATE);
	SA_CHECK(omni_switch_value(0, &value) && value == 0 && sa_switch(sa_device, AUX_GPIO_OUTLETS_PROPERTY_NAME, "OUTLET_2"));
	// analog values
	SA_CHECK(omni_set_number(sa_device, "X_ALPACA_SWITCH_VALUES", "VALUE_1", 30, OMNI_TIMEOUT) == INDIGO_OK_STATE && omni_switch_value(2, &value) && value == 30);
	SA_CHECK(omni_set_number(sa_device, "X_ALPACA_SWITCH_VALUES", "VALUE_2", 200, OMNI_TIMEOUT) == INDIGO_OK_STATE && omni_switch_value(3, &value) && value == 200);
	// a change of another client is followed
	SA_CHECK(omni_put("switch", "setswitch", "Id=1&State=false") == 0);
	SA_CHECK(SA_WAIT(!sa_switch(sa_device, AUX_GPIO_OUTLETS_PROPERTY_NAME, "OUTLET_2"), SA_TIMEOUT));
	SA_CHECK(omni_disconnect_detach(SWITCH_LABEL));
	SA_CHECK(SA_WAIT(!omni_bool("switch", "connected"), OMNI_TIMEOUT));
cleanup:
	omni_end();
}

// ---------------------------------------------------------------------------- observing conditions

// OmniSim observing conditions: IObservingConditionsV2, all thirteen sensors, values that change slowly over time.
static void omnisim_weather(void) {
	SA_CHECK(omni_begin());
	SA_CHECK(omni_attach_connect(WEATHER_LABEL));
	SA_CHECK(omni_interface_version(sa_device) == 2);
	SA_CHECK(omni_state_has("observingconditions", "CloudCover,DewPoint,Humidity,Pressure,RainRate,SkyBrightness,SkyQuality,SkyTemperature,StarFWHM,Temperature,WindDirection,WindSpeed,WindGust"));
	static const char *items[] = { AUX_WEATHER_TEMPERATURE_ITEM_NAME, AUX_WEATHER_HUMIDITY_ITEM_NAME, AUX_WEATHER_DEWPOINT_ITEM_NAME, AUX_WEATHER_PRESSURE_ITEM_NAME, AUX_WEATHER_WIND_SPEED_ITEM_NAME, AUX_WEATHER_WIND_DIRECTION_ITEM_NAME, "X_WIND_GUST", "X_RAIN_RATE", "X_CLOUD_COVER", AUX_WEATHER_SKY_TEMPERATURE_ITEM_NAME, AUX_WEATHER_SKY_BRIGHTNESS_ITEM_NAME, "X_SKY_ILLUMINANCE", "X_STAR_FWHM" };
	static const char *members[] = { "temperature", "humidity", "dewpoint", "pressure", "windspeed", "winddirection", "windgust", "rainrate", "cloudcover", "skytemperature", "skyquality", "skybrightness", "starfwhm" };
	for (int i = 0; i < 13; i++) {
		SA_CHECK(sa_has_item(sa_device, AUX_WEATHER_PROPERTY_NAME, items[i]));
		double device = omni_double("observingconditions", members[i]);
		// the values drift slowly; the driver follows within a few poll ticks
		if (!SA_WAIT(fabs(sa_number(sa_device, AUX_WEATHER_PROPERTY_NAME, items[i]) - omni_double("observingconditions", members[i])) <= 0.05 * fabs(device) + 0.5, SA_TIMEOUT)) {
			fprintf(stderr, "    %s is %g, the device says %g\n", items[i], sa_number(sa_device, AUX_WEATHER_PROPERTY_NAME, items[i]), omni_double("observingconditions", members[i]));
			SA_CHECK(false);
		}
	}
	SA_CHECK(sa_state(sa_device, AUX_WEATHER_PROPERTY_NAME) == INDIGO_OK_STATE);
	// the sensor descriptions and the averaging period of the device
	SA_CHECK(sa_defined(sa_device, "X_ALPACA_WEATHER_SENSORS") && sa_defined(sa_device, "X_ALPACA_WEATHER_AVERAGE_PERIOD"));
	double period = omni_double("observingconditions", "averageperiod");
	printf("    AveragePeriod %g, sensor description of Temperature '%s'\n", period, sa_text(sa_device, "X_ALPACA_WEATHER_SENSORS", "TEMPERATURE"));
	SA_CHECK(omni_set_number(sa_device, "X_ALPACA_WEATHER_AVERAGE_PERIOD", "PERIOD", period == 0 ? 0.5 : 0, SA_TIMEOUT) == INDIGO_OK_STATE);
	SA_CHECK(omni_double("observingconditions", "averageperiod") == (period == 0 ? 0.5 : 0));
	// Refresh
	SA_CHECK(omni_set_switch(sa_device, "X_ALPACA_WEATHER_REFRESH", "REFRESH", true, SA_TIMEOUT) == INDIGO_OK_STATE);
	SA_CHECK(omni_disconnect_detach(WEATHER_LABEL));
	SA_CHECK(SA_WAIT(!omni_bool("observingconditions", "connected"), OMNI_TIMEOUT));
cleanup:
	omni_end();
}

// ---------------------------------------------------------------------------- safety monitor

// OmniSim safety monitor: ISafetyMonitorV3, IsSafe follows /simulator/v1/safetymonitor/0/issafesetting, IsSafe of a disconnected
// device is NotConnected ("As of 2025/02 Safety Monitors should throw when not connected"). Interface version 2 through the settings API.
static void omni_safety_round_trip(int interface_version) {
	SA_CHECK(omni_begin());
	SA_CHECK(omni_attach_connect(SAFETY_LABEL));
	SA_CHECK(omni_interface_version(sa_device) == interface_version);
	// the light is IsSafe, the state of the property says whether it could be read
	SA_CHECK(SA_WAIT(sa_state(sa_device, "X_ALPACA_SAFETY") == INDIGO_OK_STATE && sa_light(sa_device, "X_ALPACA_SAFETY", "SAFE") == INDIGO_OK_STATE, SA_TIMEOUT));
	SA_CHECK(omni_setting("safetymonitor", "issafesetting", "IsSafeSetting=false"));
	SA_CHECK(SA_WAIT(sa_light(sa_device, "X_ALPACA_SAFETY", "SAFE") == INDIGO_ALERT_STATE, SA_TIMEOUT) && sa_state(sa_device, "X_ALPACA_SAFETY") == INDIGO_OK_STATE);
	SA_CHECK(sa_message_seen("reports unsafe conditions"));
	// neither is taken back by the staleness timer while the device answers
	SA_WAIT(false, 3);
	SA_CHECK(sa_light(sa_device, "X_ALPACA_SAFETY", "SAFE") == INDIGO_ALERT_STATE && sa_state(sa_device, "X_ALPACA_SAFETY") == INDIGO_OK_STATE);
	SA_CHECK(omni_setting("safetymonitor", "issafesetting", "IsSafeSetting=true"));
	SA_CHECK(SA_WAIT(sa_state(sa_device, "X_ALPACA_SAFETY") == INDIGO_OK_STATE && sa_light(sa_device, "X_ALPACA_SAFETY", "SAFE") == INDIGO_OK_STATE, SA_TIMEOUT));
	SA_WAIT(false, 3);
	SA_CHECK(sa_state(sa_device, "X_ALPACA_SAFETY") == INDIGO_OK_STATE && sa_light(sa_device, "X_ALPACA_SAFETY", "SAFE") == INDIGO_OK_STATE);
	if (interface_version >= 3) {
		SA_CHECK(omni_state_has("safetymonitor", "IsSafe"));
	} else {
		SA_CHECK(omni_member_answers("safetymonitor", "devicestate", OMNI_UNSPECIFIED));
	}
	SA_CHECK(omni_disconnect_detach(SAFETY_LABEL));
	{
		int error_number = -1;
		omni_get("safetymonitor", "issafe", NULL, &error_number);
		printf("    IsSafe of the disconnected device: ErrorNumber 0x%X\n", error_number);
		SA_CHECK(error_number == 0x407);
	}
cleanup:
	omni_end();
}

static void omnisim_safety(void) {
	omni_safety_round_trip(3);
}

static void omnisim_safety_legacy(void) {
	omni_connect_control();
	SA_CHECK(omni_setting("safetymonitor", "interfaceversion", "InterfaceVersion=2"));
	omni_safety_round_trip(2);
	return;
cleanup:
	omni_end();
}

// ---------------------------------------------------------------------------- runner

static const indigo_test_case cases[] = {
	{ "omnisim_discovery", omnisim_discovery },
	{ "omnisim_focuser", omnisim_focuser },
	{ "omnisim_focuser_legacy", omnisim_focuser_legacy },
	{ "omnisim_wheel", omnisim_wheel },
	{ "omnisim_wheel_legacy", omnisim_wheel_legacy },
	{ "omnisim_rotator", omnisim_rotator },
	{ "omnisim_rotator_legacy", omnisim_rotator_legacy },
	{ "omnisim_mount_goto", omnisim_mount_goto },
	{ "omnisim_mount_park_home_tracking", omnisim_mount_park_home_tracking },
	{ "omnisim_mount_manual_motion", omnisim_mount_manual_motion },
	{ "omnisim_mount_guider", omnisim_mount_guider },
	{ "omnisim_camera_image", omnisim_camera_image },
	{ "omnisim_camera_abort", omnisim_camera_abort },
	{ "omnisim_dome", omnisim_dome },
	{ "omnisim_dome_legacy", omnisim_dome_legacy },
	{ "omnisim_lightbox", omnisim_lightbox },
	{ "omnisim_switch", omnisim_switch },
	{ "omnisim_weather", omnisim_weather },
	{ "omnisim_safety", omnisim_safety },
	{ "omnisim_safety_legacy", omnisim_safety_legacy }
};

static const char *case_filter = NULL;

static const char *case_name(int index) {
	return cases[index].name;
}

static bool case_selected(int index) {
	return case_filter == NULL || strstr(cases[index].name, case_filter) != NULL;
}

static unsigned case_timeout(int index) {
	(void)index;
	return CASE_TIMEOUT;
}

// One case in its forked child: a private HOME for the driver, a fresh OmniSim instance, the case, the instance stopped.
static int case_child(int index, const char *fixture) {
	char home[PATH_MAX], directory[PATH_MAX];
	snprintf(home, sizeof(home), "%s/home", fixture);
	snprintf(directory, sizeof(directory), "%s/omnisim", fixture);
	if (mkdir(home, 0700) != 0 || !indigo_test_set_private_home(home)) {
		perror(home);
		return 2;
	}
	if (getenv("SYSTEM_ALPACA_TEST_DEBUG") != NULL) {
		indigo_set_log_level(INDIGO_LOG_DEBUG);
	}
	if (!omni_start(directory)) {
		omni_stop();
		return 2;
	}
	int result = indigo_run_tests(SUITE_NAME, cases + index, 1);
	fflush(NULL);
	omni_stop();
	if (result != 0 || getenv("SYSTEM_ALPACA_OMNISIM_LOG") != NULL) {
		char log[PATH_MAX];
		snprintf(log, sizeof(log), "%s/omnisim.log", directory);
		printf("    OmniSim log of the case: %s (kept only with SYSTEM_ALPACA_OMNISIM_KEEP)\n", log);
	}
	return result;
}

static char fixture_root[PATH_MAX];

// Ctrl-C or a kill of the parent: the cases run in process groups of their own, so their reapers end OmniSim when they die;
// the parent stops the instance itself as well and leaves no directory behind.
static void omni_signal(int signal) {
	(void)signal;
	omni_kill_leftover();
	if (getenv("SYSTEM_ALPACA_OMNISIM_KEEP") == NULL) {
		indigo_test_remove_tree(fixture_root);
	}
	indigo_test_remove_private_home();
	_exit(130);
}

int main(void) {
	int run = 0, passed = 0, failed = 0;
	setvbuf(stdout, NULL, _IOLBF, 0);
	if (!omni_find()) {
		printf("%s: NOT RUN, no OmniSim executable (INDIGO_TEST_OMNISIM, or " SYSTEM_ALPACA_OMNISIM_DIR "/*/" OMNI_EXECUTABLE_NAME "; install it as REFACTOR.md 4.1 of system_alpaca says). No case was planned, nothing passed.\n", SUITE_NAME);
		return 0;
	}
	if (!indigo_test_use_private_home()) {
		return 1;
	}
	snprintf(fixture_root, sizeof(fixture_root), "/tmp/indigo-system-alpaca-omnisim.XXXXXX");
	if (mkdtemp(fixture_root) == NULL) {
		perror("mkdtemp");
		indigo_test_remove_private_home();
		return 1;
	}
	snprintf(omni_instance_lock, sizeof(omni_instance_lock), "%s/instance.lock", fixture_root);
	signal(SIGINT, omni_signal);
	signal(SIGTERM, omni_signal);
	signal(SIGHUP, omni_signal);
	int result = 1;
	char probe[PATH_MAX];
	snprintf(probe, sizeof(probe), "%s/probe", fixture_root);
	if (omni_lock_run()) {
		// one instance first, for the version and to fail early when OmniSim can not run here
		bool started = omni_start(probe);
		omni_stop();
		if (started) {
			printf("%s: OmniSim %s (%s), %s\n", SUITE_NAME, omni_version, omni_version_full, omni_executable);
			// what tools/run_driver_test.py records as the type of the run
			indigo_test_record("device\tindigo_system_alpaca\t0\tOmniSim\tOmniSim %s", omni_version);
			case_filter = getenv("INDIGO_TEST_CASE_FILTER");
			if (case_filter != NULL) {
				indigo_test_record("filter\t%s", case_filter);
			}
			const parallel_case_runner runner = {
				SUITE_NAME, fixture_root, ARRAY_SIZE(cases), 1, case_name, case_selected, case_timeout, case_child, NULL
			};
			run_parallel_cases(&runner, &run, &passed, &failed);
			printf("%s: %d run, %d passed, %d failed against OmniSim %s\n", SUITE_NAME, run, passed, failed, omni_version);
			result = failed != 0 || run == 0 ? 1 : 0;
		} else {
			fprintf(stderr, "%s: OmniSim could not be started, no case was run\n", SUITE_NAME);
		}
		omni_kill_leftover();
		omni_unlock_run();
	}
	if (getenv("SYSTEM_ALPACA_OMNISIM_KEEP") == NULL) {
		indigo_test_remove_tree(fixture_root);
	} else {
		printf("fixtures and OmniSim logs kept in %s\n", fixture_root);
	}
	indigo_test_remove_private_home();
	return result;
}
