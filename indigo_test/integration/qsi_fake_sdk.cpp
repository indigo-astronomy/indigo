// Copyright (c) 2026 INDIGO initiative
// All rights reserved.
//
// You may use this software under the terms of 'INDIGO Astronomy
// open-source license' (see LICENSE.md).
//
// THIS SOFTWARE IS PROVIDED BY THE AUTHORS 'AS IS' AND ANY EXPRESS
// OR IMPLIED WARRANTIES, INCLUDING, BUT NOT LIMITED TO, THE IMPLIED
// WARRANTIES OF MERCHANTABILITY AND FITNESS FOR A PARTICULAR PURPOSE
// ARE DISCLAIMED. IN NO EVENT SHALL THE AUTHOR BE LIABLE FOR ANY
// DIRECT, INDIRECT, INCIDENTAL, SPECIAL, EXEMPLARY, OR CONSEQUENTIAL
// DAMAGES (INCLUDING, BUT NOT LIMITED TO, PROCUREMENT OF SUBSTITUTE
// GOODS OR SERVICES; LOSS OF USE, DATA, OR PROFITS; OR BUSINESS
// INTERRUPTION) HOWEVER CAUSED AND ON ANY THEORY OF LIABILITY,
// WHETHER IN CONTRACT, STRICT LIABILITY, OR TORT (INCLUDING
// NEGLIGENCE OR OTHERWISE) ARISING IN ANY WAY OUT OF THE USE OF THIS
// SOFTWARE, EVEN IF ADVISED OF THE POSSIBILITY OF SUCH DAMAGE.

// Code is generated by AI

// Deterministic fake implementation of the QSI qsiapi SDK. It provides the
// QSICamera class declared by the real vendor header so the production driver
// links against this file instead of libqsiapi.a.

#include <pthread.h>
#include <stdarg.h>
#include <stdio.h>
#include <stdlib.h>
#include <string.h>

#include <stdexcept>
#include <string>

#include <QSIError.h>
#include <qsiapi.h>

#include "ccd_test_noise.h"
#include "qsi_fake_sdk.h"

#define TRACE_LINES 4096
#define TRACE_LINE_SIZE 160

static pthread_mutex_t state_mutex = PTHREAD_MUTEX_INITIALIZER;
static pthread_mutex_t gate_mutex = PTHREAD_MUTEX_INITIALIZER;
static pthread_cond_t gate_condition = PTHREAD_COND_INITIALIZER;

static qsi_fake_camera cameras[QSI_FAKE_MAX_CAMERAS];
static bool camera_defined[QSI_FAKE_MAX_CAMERAS];
static int connected_index = -1;
static char selected_serial[QSI_FAKE_NAME_SIZE];
static bool structured_exceptions = true;
static bool is_main_camera;
static int enumerate_calls;
static int calls_after_close;
static int concurrent_calls;
static int active_calls;
static qsi_fake_gate_point armed_gate;
static bool gate_reached;
static bool trace_enabled;
static char trace[TRACE_LINES][TRACE_LINE_SIZE];
static int trace_count;

// -------------------------------------------------------------------------------- helpers

static void lock(void) {
	pthread_mutex_lock(&state_mutex);
}

static void unlock(void) {
	pthread_mutex_unlock(&state_mutex);
}

static void enter_call(void) {
	lock();
	if (++active_calls > 1) {
		concurrent_calls++;
	}
	unlock();
}

static void leave_call(void) {
	lock();
	active_calls--;
	unlock();
}

static void record(const char *format, ...) __attribute__((format(printf, 1, 2)));

static void record(const char *format, ...) {
	lock();
	if (trace_enabled && trace_count < TRACE_LINES) {
		va_list args;
		va_start(args, format);
		vsnprintf(trace[trace_count++], TRACE_LINE_SIZE, format, args);
		va_end(args);
	}
	unlock();
}

static void wait_for_gate(qsi_fake_gate_point point) {
	pthread_mutex_lock(&gate_mutex);
	if (armed_gate == point) {
		gate_reached = true;
		while (armed_gate == point) {
			pthread_cond_wait(&gate_condition, &gate_mutex);
		}
	}
	pthread_mutex_unlock(&gate_mutex);
}

// Mirrors lib/wincompat.h: throw when structured exceptions are enabled,
// return the QSI error code otherwise.
static int fail(int code, const char *text) {
	record("!%s=0x%x", text, (unsigned)code);
	if (structured_exceptions) {
		char message[256];
		snprintf(message, sizeof(message), "0x%x:%s", (unsigned)code, text);
		throw std::runtime_error(std::string(message));
	}
	return code;
}

static bool consume(int *counter) {
	if (*counter == 0) {
		return false;
	}
	if (*counter > 0) {
		(*counter)--;
	}
	return true;
}

// Returns the connected camera, or NULL after recording a not-connected call.
static qsi_fake_camera *current(void) {
	if (connected_index < 0) {
		calls_after_close++;
		return NULL;
	}
	return cameras + connected_index;
}

// -------------------------------------------------------------------------------- control surface

extern "C" void qsi_fake_reset(void) {
	qsi_fake_gate_release();
	lock();
	memset(cameras, 0, sizeof(cameras));
	memset(camera_defined, 0, sizeof(camera_defined));
	memset(selected_serial, 0, sizeof(selected_serial));
	connected_index = -1;
	structured_exceptions = true;
	is_main_camera = false;
	enumerate_calls = 0;
	calls_after_close = 0;
	concurrent_calls = 0;
	active_calls = 0;
	armed_gate = QSI_FAKE_GATE_NONE;
	gate_reached = false;
	trace_enabled = false;
	trace_count = 0;
	unlock();
}

extern "C" qsi_fake_camera *qsi_fake_add_camera(int index, const char *serial, const char *description, const char *model) {
	if (index < 0 || index >= QSI_FAKE_MAX_CAMERAS) {
		return NULL;
	}
	lock();
	qsi_fake_camera *camera = cameras + index;
	memset(camera, 0, sizeof(*camera));
	snprintf(camera->serial, sizeof(camera->serial), "%s", serial);
	snprintf(camera->description, sizeof(camera->description), "%s", description);
	snprintf(camera->model, sizeof(camera->model), "%s", model);
	camera->present = true;
	// QSI 683ws-like default profile, scaled down so tests stay fast.
	camera->has_filter_wheel = true;
	camera->filter_count = 5;
	camera->can_set_temperature = true;
	camera->can_get_cooler_power = true;
	camera->can_set_gain = true;
	camera->can_abort_exposure = true;
	camera->has_shutter = true;
	camera->power_of_two_binning = false;
	camera->reported_fan_mode = QSICamera::fanQuiet;
	camera->reported_readout_speed = QSICamera::HighImageQuality;
	camera->reported_anti_bloom = QSICamera::AntiBloomNormal;
	camera->reported_pre_exposure_flush = QSICamera::FlushNormal;
	camera->width = 96;
	camera->height = 64;
	camera->pixel_width = 5.4;
	camera->pixel_height = 5.4;
	camera->max_bin_x = 4;
	camera->max_bin_y = 4;
	camera->min_exposure = 0.03;
	camera->max_exposure = 3600;
	camera->fan_mode = QSICamera::fanQuiet;
	camera->readout_speed = QSICamera::HighImageQuality;
	camera->anti_bloom = QSICamera::AntiBloomNormal;
	camera->pre_exposure_flush = QSICamera::FlushNormal;
	camera->gain = QSICamera::CameraGainHigh;
	camera->cooler_on = false;
	camera->temperature = 12.5;
	camera->target_temperature = 12.5;
	camera->cooler_power = 0;
	camera->temperature_settles = true;
	camera->position = 0;
	camera->target_position = 0;
	camera->num_x = camera->width;
	camera->num_y = camera->height;
	camera->bin_x = 1;
	camera->bin_y = 1;
	camera_defined[index] = true;
	unlock();
	return camera;
}

extern "C" qsi_fake_camera *qsi_fake_camera_at(int index) {
	if (index < 0 || index >= QSI_FAKE_MAX_CAMERAS) {
		return NULL;
	}
	return cameras + index;
}

extern "C" int qsi_fake_counter(int index, const int *field) {
	(void)index;
	lock();
	int value = *field;
	unlock();
	return value;
}

extern "C" void qsi_fake_set_int(int index, int *field, int value) {
	(void)index;
	lock();
	*field = value;
	unlock();
}

extern "C" void qsi_fake_set_bool(int index, bool *field, bool value) {
	(void)index;
	lock();
	*field = value;
	unlock();
}

extern "C" int qsi_fake_connected_index(void) {
	lock();
	int value = connected_index;
	unlock();
	return value;
}

extern "C" const char *qsi_fake_selected_serial(void) {
	return selected_serial;
}

extern "C" int qsi_fake_calls_after_close(void) {
	lock();
	int value = calls_after_close;
	unlock();
	return value;
}

extern "C" int qsi_fake_concurrent_calls(void) {
	lock();
	int value = concurrent_calls;
	unlock();
	return value;
}

extern "C" bool qsi_fake_structured_exceptions(void) {
	lock();
	bool value = structured_exceptions;
	unlock();
	return value;
}

extern "C" int qsi_fake_enumerate_calls(void) {
	lock();
	int value = enumerate_calls;
	unlock();
	return value;
}

extern "C" bool qsi_fake_is_main_camera(void) {
	lock();
	bool value = is_main_camera;
	unlock();
	return value;
}

extern "C" void qsi_fake_gate_arm(qsi_fake_gate_point point) {
	pthread_mutex_lock(&gate_mutex);
	armed_gate = point;
	gate_reached = false;
	pthread_mutex_unlock(&gate_mutex);
}

extern "C" bool qsi_fake_gate_entered(void) {
	pthread_mutex_lock(&gate_mutex);
	bool value = gate_reached;
	pthread_mutex_unlock(&gate_mutex);
	return value;
}

extern "C" void qsi_fake_gate_release(void) {
	pthread_mutex_lock(&gate_mutex);
	armed_gate = QSI_FAKE_GATE_NONE;
	pthread_cond_broadcast(&gate_condition);
	pthread_mutex_unlock(&gate_mutex);
}

extern "C" void qsi_fake_trace_enable(bool enabled) {
	lock();
	trace_enabled = enabled;
	unlock();
}

extern "C" void qsi_fake_trace_clear(void) {
	lock();
	trace_count = 0;
	unlock();
}

extern "C" void qsi_fake_trace_record(const char *line) {
	record("%s", line);
}

// Recurring temperature polling is timing dependent, so a run of consecutive
// polling reads collapses into one normalized line and the trace stays
// comparable across hosts and driver revisions.
// A polling run always starts with the temperature read; the cooler-power
// capability query and reading only belong to it while such a run is open, so
// the one-off capability query issued during connection is preserved.
static bool starts_poll_run(const char *line) {
	return !strncmp(line, "get_CCDTemperature", 18);
}

static bool continues_poll_run(const char *line) {
	return starts_poll_run(line) || !strncmp(line, "get_CanGetCoolerPower", 21) || !strncmp(line, "get_CoolerPower", 15);
}

extern "C" bool qsi_fake_trace_write(const char *path) {
	lock();
	FILE *file = fopen(path, "w");
	if (file != NULL) {
		bool in_poll = false;
		for (int i = 0; i < trace_count; i++) {
			if (in_poll ? continues_poll_run(trace[i]) : starts_poll_run(trace[i])) {
				if (!in_poll) {
					fprintf(file, "[periodic temperature poll]\n");
					in_poll = true;
				}
				continue;
			}
			in_poll = false;
			fprintf(file, "%s\n", trace[i]);
		}
		fclose(file);
	}
	bool ok = file != NULL;
	unlock();
	return ok;
}

// -------------------------------------------------------------------------------- QSICamera

QSICamera::QSICamera() {
	pCam = NULL;
}

QSICamera::~QSICamera() {
}

int QSICamera::put_UseStructuredExceptions(bool newVal) {
	enter_call();
	record("put_UseStructuredExceptions(%s)", newVal ? "true" : "false");
	lock();
	structured_exceptions = newVal;
	unlock();
	leave_call();
	return QSI_OK;
}

int QSICamera::get_DriverInfo(std::string &pVal) {
	enter_call();
	record("get_DriverInfo");
	pVal = "QSI fake SDK 7.6.0";
	leave_call();
	return QSI_OK;
}

int QSICamera::get_AvailableCameras(std::string cameraSerial[], std::string cameraDesc[], int &numFound) {
	enter_call();
	lock();
	enumerate_calls++;
	bool failed = false;
	for (int i = 0; i < QSI_FAKE_MAX_CAMERAS; i++) {
		if (camera_defined[i] && consume(&cameras[i].fail.enumerate)) {
			failed = true;
		}
	}
	int found = 0;
	if (!failed) {
		for (int i = 0; i < QSI_FAKE_MAX_CAMERAS; i++) {
			if (camera_defined[i] && cameras[i].present) {
				cameraSerial[found] = cameras[i].serial;
				cameraDesc[found] = cameras[i].description;
				found++;
			}
		}
	}
	unlock();
	if (failed) {
		record("get_AvailableCameras");
		leave_call();
		return fail(QSI_UNRECOVERABLE, "get_AvailableCameras");
	}
	numFound = found;
	record("get_AvailableCameras=%d", found);
	leave_call();
	return QSI_OK;
}

int QSICamera::put_SelectCamera(std::string serialNum) {
	enter_call();
	record("put_SelectCamera(%s)", serialNum.c_str());
	lock();
	int index = -1;
	for (int i = 0; i < QSI_FAKE_MAX_CAMERAS; i++) {
		if (camera_defined[i] && !strcmp(cameras[i].serial, serialNum.c_str())) {
			index = i;
			break;
		}
	}
	bool failed = index < 0 || consume(&cameras[index].fail.select);
	if (!failed) {
		cameras[index].select_calls++;
		snprintf(selected_serial, sizeof(selected_serial), "%s", serialNum.c_str());
	}
	unlock();
	leave_call();
	return failed ? fail(QSI_NOTCONNECTED, "put_SelectCamera") : QSI_OK;
}

int QSICamera::get_SelectCamera(std::string &serialNum) {
	enter_call();
	record("get_SelectCamera");
	lock();
	serialNum = selected_serial;
	unlock();
	leave_call();
	return QSI_OK;
}

int QSICamera::put_IsMainCamera(bool newVal) {
	enter_call();
	record("put_IsMainCamera(%s)", newVal ? "true" : "false");
	lock();
	is_main_camera = newVal;
	unlock();
	leave_call();
	return QSI_OK;
}

int QSICamera::get_Connected(bool *pVal) {
	enter_call();
	lock();
	*pVal = connected_index >= 0;
	unlock();
	record("get_Connected=%s", *pVal ? "true" : "false");
	leave_call();
	return QSI_OK;
}

int QSICamera::put_Connected(bool newVal) {
	enter_call();
	record("put_Connected(%s)", newVal ? "true" : "false");
	wait_for_gate(QSI_FAKE_GATE_CONNECT);
	lock();
	int index = -1;
	for (int i = 0; i < QSI_FAKE_MAX_CAMERAS; i++) {
		if (camera_defined[i] && !strcmp(cameras[i].serial, selected_serial)) {
			index = i;
			break;
		}
	}
	bool failed = false;
	if (newVal) {
		if (index < 0 || !cameras[index].present || connected_index >= 0 || consume(&cameras[index].fail.connect)) {
			failed = true;
		} else {
			cameras[index].connect_calls++;
			connected_index = index;
		}
	} else {
		if (connected_index < 0) {
			calls_after_close++;
			failed = true;
		} else if (consume(&cameras[connected_index].fail.disconnect)) {
			failed = true;
		} else {
			cameras[connected_index].disconnect_calls++;
			connected_index = -1;
		}
	}
	unlock();
	leave_call();
	return failed ? fail(newVal ? QSI_NOTCONNECTED : QSI_UNRECOVERABLE, newVal ? "put_Connected(true)" : "put_Connected(false)") : QSI_OK;
}

// Every accessor below operates on the single connected camera, exactly like
// the vendor SDK's global object.
#define WITH_CAMERA(operation) \
	enter_call(); \
	lock(); \
	qsi_fake_camera *camera = current(); \
	if (camera == NULL) { \
		unlock(); \
		leave_call(); \
		return fail(QSI_NOTCONNECTED, operation); \
	}

#define RELEASE_CAMERA() \
	unlock(); \
	leave_call()

#define FAIL_CAMERA(injection, code, operation) \
	if (consume(&camera->fail.injection)) { \
		unlock(); \
		leave_call(); \
		return fail(code, operation); \
	}

int QSICamera::get_ModelNumber(std::string &pVal) {
	WITH_CAMERA("get_ModelNumber")
	FAIL_CAMERA(model, QSI_UNRECOVERABLE, "get_ModelNumber")
	pVal = camera->model;
	RELEASE_CAMERA();
	record("get_ModelNumber=%s", camera->model);
	return QSI_OK;
}

int QSICamera::get_CameraXSize(long *pVal) {
	WITH_CAMERA("get_CameraXSize")
	FAIL_CAMERA(geometry, QSI_UNRECOVERABLE, "get_CameraXSize")
	*pVal = camera->width;
	RELEASE_CAMERA();
	record("get_CameraXSize=%ld", (long)*pVal);
	return QSI_OK;
}

int QSICamera::get_CameraYSize(long *pVal) {
	WITH_CAMERA("get_CameraYSize")
	FAIL_CAMERA(geometry, QSI_UNRECOVERABLE, "get_CameraYSize")
	*pVal = camera->height;
	RELEASE_CAMERA();
	record("get_CameraYSize=%ld", (long)*pVal);
	return QSI_OK;
}

int QSICamera::get_PixelSizeX(double *pVal) {
	WITH_CAMERA("get_PixelSizeX")
	*pVal = camera->pixel_width;
	RELEASE_CAMERA();
	record("get_PixelSizeX=%.2f", *pVal);
	return QSI_OK;
}

int QSICamera::get_PixelSizeY(double *pVal) {
	WITH_CAMERA("get_PixelSizeY")
	*pVal = camera->pixel_height;
	RELEASE_CAMERA();
	record("get_PixelSizeY=%.2f", *pVal);
	return QSI_OK;
}

int QSICamera::get_CanSetCCDTemperature(bool *pVal) {
	WITH_CAMERA("get_CanSetCCDTemperature")
	*pVal = camera->can_set_temperature;
	RELEASE_CAMERA();
	record("get_CanSetCCDTemperature=%s", *pVal ? "true" : "false");
	return QSI_OK;
}

int QSICamera::get_HasShutter(bool *pVal) {
	WITH_CAMERA("get_HasShutter")
	*pVal = camera->has_shutter;
	RELEASE_CAMERA();
	record("get_HasShutter=%s", *pVal ? "true" : "false");
	return QSI_OK;
}

int QSICamera::get_MinExposureTime(double *pVal) {
	WITH_CAMERA("get_MinExposureTime")
	FAIL_CAMERA(exposure_limits, QSI_UNRECOVERABLE, "get_MinExposureTime")
	*pVal = camera->min_exposure;
	RELEASE_CAMERA();
	record("get_MinExposureTime=%.3f", *pVal);
	return QSI_OK;
}

int QSICamera::get_MaxExposureTime(double *pVal) {
	WITH_CAMERA("get_MaxExposureTime")
	FAIL_CAMERA(exposure_limits, QSI_UNRECOVERABLE, "get_MaxExposureTime")
	*pVal = camera->max_exposure;
	RELEASE_CAMERA();
	record("get_MaxExposureTime=%.3f", *pVal);
	return QSI_OK;
}

int QSICamera::get_HasFilterWheel(bool *pVal) {
	WITH_CAMERA("get_HasFilterWheel")
	*pVal = camera->has_filter_wheel;
	RELEASE_CAMERA();
	record("get_HasFilterWheel=%s", *pVal ? "true" : "false");
	return QSI_OK;
}

int QSICamera::get_FilterCount(int &count) {
	WITH_CAMERA("get_FilterCount")
	FAIL_CAMERA(filter_count, QSI_NOFILTER, "get_FilterCount")
	count = camera->filter_count;
	RELEASE_CAMERA();
	record("get_FilterCount=%d", camera->filter_count);
	return QSI_OK;
}

int QSICamera::get_CanSetGain(bool *pVal) {
	WITH_CAMERA("get_CanSetGain")
	*pVal = camera->can_set_gain;
	RELEASE_CAMERA();
	record("get_CanSetGain=%s", *pVal ? "true" : "false");
	return QSI_OK;
}

int QSICamera::get_CameraGain(CameraGain *pVal) {
	WITH_CAMERA("get_CameraGain")
	*pVal = (CameraGain)camera->gain;
	RELEASE_CAMERA();
	record("get_CameraGain=%d", (int)*pVal);
	return QSI_OK;
}

int QSICamera::put_CameraGain(CameraGain newVal) {
	WITH_CAMERA("put_CameraGain")
	FAIL_CAMERA(gain_write, QSI_NOTSUPPORTED, "put_CameraGain")
	camera->gain = (int)newVal;
	camera->gain_writes++;
	RELEASE_CAMERA();
	record("put_CameraGain(%d)", (int)newVal);
	return QSI_OK;
}

int QSICamera::get_MaxBinX(short *pVal) {
	WITH_CAMERA("get_MaxBinX")
	*pVal = camera->max_bin_x;
	RELEASE_CAMERA();
	record("get_MaxBinX=%d", (int)*pVal);
	return QSI_OK;
}

int QSICamera::get_MaxBinY(short *pVal) {
	WITH_CAMERA("get_MaxBinY")
	*pVal = camera->max_bin_y;
	RELEASE_CAMERA();
	record("get_MaxBinY=%d", (int)*pVal);
	return QSI_OK;
}

int QSICamera::get_PowerOfTwoBinning(bool *pVal) {
	WITH_CAMERA("get_PowerOfTwoBinning")
	*pVal = camera->power_of_two_binning;
	RELEASE_CAMERA();
	record("get_PowerOfTwoBinning=%s", *pVal ? "true" : "false");
	return QSI_OK;
}

int QSICamera::get_FanMode(FanMode &pVal) {
	WITH_CAMERA("get_FanMode")
	pVal = (FanMode)camera->reported_fan_mode;
	RELEASE_CAMERA();
	record("get_FanMode=%d", (int)pVal);
	return QSI_OK;
}

int QSICamera::put_FanMode(FanMode newVal) {
	WITH_CAMERA("put_FanMode")
	FAIL_CAMERA(fan_mode, QSI_NOTSUPPORTED, "put_FanMode")
	camera->fan_mode = camera->reported_fan_mode = (int)newVal;
	camera->fan_writes++;
	RELEASE_CAMERA();
	record("put_FanMode(%d)", (int)newVal);
	return QSI_OK;
}

int QSICamera::get_ReadoutSpeed(ReadoutSpeed &pVal) {
	WITH_CAMERA("get_ReadoutSpeed")
	pVal = (ReadoutSpeed)camera->reported_readout_speed;
	RELEASE_CAMERA();
	record("get_ReadoutSpeed=%d", (int)pVal);
	return QSI_OK;
}

int QSICamera::put_ReadoutSpeed(ReadoutSpeed newVal) {
	WITH_CAMERA("put_ReadoutSpeed")
	FAIL_CAMERA(readout_speed, QSI_NOTSUPPORTED, "put_ReadoutSpeed")
	camera->readout_speed = camera->reported_readout_speed = (int)newVal;
	camera->readout_speed_writes++;
	RELEASE_CAMERA();
	record("put_ReadoutSpeed(%d)", (int)newVal);
	return QSI_OK;
}

int QSICamera::get_AntiBlooming(AntiBloom *pVal) {
	WITH_CAMERA("get_AntiBlooming")
	*pVal = (AntiBloom)camera->reported_anti_bloom;
	RELEASE_CAMERA();
	record("get_AntiBlooming=%d", (int)*pVal);
	return QSI_OK;
}

int QSICamera::put_AntiBlooming(AntiBloom newVal) {
	WITH_CAMERA("put_AntiBlooming")
	FAIL_CAMERA(anti_bloom, QSI_NOTSUPPORTED, "put_AntiBlooming")
	camera->anti_bloom = camera->reported_anti_bloom = (int)newVal;
	camera->anti_bloom_writes++;
	RELEASE_CAMERA();
	record("put_AntiBlooming(%d)", (int)newVal);
	return QSI_OK;
}

int QSICamera::get_PreExposureFlush(PreExposureFlush *pVal) {
	WITH_CAMERA("get_PreExposureFlush")
	*pVal = (PreExposureFlush)camera->reported_pre_exposure_flush;
	RELEASE_CAMERA();
	record("get_PreExposureFlush=%d", (int)*pVal);
	return QSI_OK;
}

int QSICamera::put_PreExposureFlush(PreExposureFlush newVal) {
	WITH_CAMERA("put_PreExposureFlush")
	FAIL_CAMERA(pre_exposure_flush, QSI_NOTSUPPORTED, "put_PreExposureFlush")
	camera->pre_exposure_flush = camera->reported_pre_exposure_flush = (int)newVal;
	camera->pre_exposure_flush_writes++;
	RELEASE_CAMERA();
	record("put_PreExposureFlush(%d)", (int)newVal);
	return QSI_OK;
}

int QSICamera::get_CoolerOn(bool *pVal) {
	WITH_CAMERA("get_CoolerOn")
	FAIL_CAMERA(cooler_read, QSI_UNRECOVERABLE, "get_CoolerOn")
	*pVal = camera->cooler_on;
	RELEASE_CAMERA();
	record("get_CoolerOn=%s", *pVal ? "true" : "false");
	return QSI_OK;
}

int QSICamera::put_CoolerOn(bool newVal) {
	WITH_CAMERA("put_CoolerOn")
	FAIL_CAMERA(cooler_write, QSI_NOTSUPPORTED, "put_CoolerOn")
	camera->cooler_on = newVal;
	camera->cooler_power = newVal ? 42 : 0;
	camera->cooler_writes++;
	RELEASE_CAMERA();
	record("put_CoolerOn(%s)", newVal ? "true" : "false");
	return QSI_OK;
}

int QSICamera::get_CanGetCoolerPower(bool *pVal) {
	WITH_CAMERA("get_CanGetCoolerPower")
	*pVal = camera->can_get_cooler_power;
	RELEASE_CAMERA();
	record("get_CanGetCoolerPower=%s", *pVal ? "true" : "false");
	return QSI_OK;
}

int QSICamera::get_CoolerPower(double *pVal) {
	WITH_CAMERA("get_CoolerPower")
	FAIL_CAMERA(cooler_power, QSI_UNRECOVERABLE, "get_CoolerPower")
	*pVal = camera->cooler_power;
	camera->cooler_power_reads++;
	RELEASE_CAMERA();
	record("get_CoolerPower=%.1f", *pVal);
	return QSI_OK;
}

int QSICamera::get_CCDTemperature(double *pVal) {
	WITH_CAMERA("get_CCDTemperature")
	FAIL_CAMERA(temperature_read, QSI_UNRECOVERABLE, "get_CCDTemperature")
	*pVal = camera->temperature;
	camera->temperature_reads++;
	RELEASE_CAMERA();
	record("get_CCDTemperature=%.2f", *pVal);
	return QSI_OK;
}

int QSICamera::put_SetCCDTemperature(double newVal) {
	WITH_CAMERA("put_SetCCDTemperature")
	FAIL_CAMERA(temperature_write, QSI_INVALIDTEMP, "put_SetCCDTemperature")
	camera->target_temperature = newVal;
	// Settling immediately keeps temperature polling deterministic; a test can
	// switch it off to keep cooling in progress.
	if (camera->temperature_settles) {
		camera->temperature = newVal;
	}
	camera->temperature_writes++;
	RELEASE_CAMERA();
	record("put_SetCCDTemperature(%.2f)", newVal);
	return QSI_OK;
}

int QSICamera::get_SetCCDTemperature(double *pVal) {
	WITH_CAMERA("get_SetCCDTemperature")
	*pVal = camera->target_temperature;
	RELEASE_CAMERA();
	return QSI_OK;
}

int QSICamera::put_StartX(long newVal) {
	WITH_CAMERA("put_StartX")
	camera->start_x = newVal;
	RELEASE_CAMERA();
	record("put_StartX(%ld)", newVal);
	return QSI_OK;
}

int QSICamera::put_StartY(long newVal) {
	WITH_CAMERA("put_StartY")
	camera->start_y = newVal;
	RELEASE_CAMERA();
	record("put_StartY(%ld)", newVal);
	return QSI_OK;
}

int QSICamera::put_NumX(long newVal) {
	WITH_CAMERA("put_NumX")
	camera->num_x = newVal;
	RELEASE_CAMERA();
	record("put_NumX(%ld)", newVal);
	return QSI_OK;
}

int QSICamera::put_NumY(long newVal) {
	WITH_CAMERA("put_NumY")
	camera->num_y = newVal;
	RELEASE_CAMERA();
	record("put_NumY(%ld)", newVal);
	return QSI_OK;
}

int QSICamera::put_BinX(short newVal) {
	WITH_CAMERA("put_BinX")
	camera->bin_x = newVal;
	RELEASE_CAMERA();
	record("put_BinX(%d)", (int)newVal);
	return QSI_OK;
}

int QSICamera::put_BinY(short newVal) {
	WITH_CAMERA("put_BinY")
	camera->bin_y = newVal;
	RELEASE_CAMERA();
	record("put_BinY(%d)", (int)newVal);
	return QSI_OK;
}

int QSICamera::StartExposure(double Duration, bool Light) {
	WITH_CAMERA("StartExposure")
	FAIL_CAMERA(start_exposure, QSI_BADEXPOSURE, "StartExposure")
	camera->exposure_duration = Duration;
	camera->exposure_light = Light;
	camera->start_exposure_calls++;
	RELEASE_CAMERA();
	record("StartExposure(%.3f,%s)", Duration, Light ? "light" : "dark");
	return QSI_OK;
}

int QSICamera::get_ImageReady(bool *pVal) {
	enter_call();
	wait_for_gate(QSI_FAKE_GATE_IMAGE_READY);
	lock();
	qsi_fake_camera *camera = current();
	if (camera == NULL) {
		unlock();
		leave_call();
		return fail(QSI_NOTCONNECTED, "get_ImageReady");
	}
	camera->image_ready_calls++;
	if (consume(&camera->fail.image_ready)) {
		unlock();
		leave_call();
		return fail(QSI_NOIMAGEAVAILABLE, "get_ImageReady");
	}
	bool ready = !camera->image_never_ready;
	if (ready && camera->not_ready_reads > 0) {
		camera->not_ready_reads--;
		ready = false;
	}
	*pVal = ready;
	unlock();
	leave_call();
	record("get_ImageReady=%s", ready ? "true" : "false");
	return QSI_OK;
}

int QSICamera::get_ImageArraySize(int &xSize, int &ySize, int &elementSize) {
	WITH_CAMERA("get_ImageArraySize")
	FAIL_CAMERA(image_size, QSI_INVALIDIMAGEPARAMETER, "get_ImageArraySize")
	xSize = (int)camera->num_x;
	ySize = (int)camera->num_y;
	elementSize = 2;
	RELEASE_CAMERA();
	record("get_ImageArraySize=%dx%d", xSize, ySize);
	return QSI_OK;
}

int QSICamera::get_ImageArray(unsigned short *pVal) {
	enter_call();
	wait_for_gate(QSI_FAKE_GATE_IMAGE_ARRAY);
	lock();
	qsi_fake_camera *camera = current();
	if (camera == NULL) {
		unlock();
		leave_call();
		return fail(QSI_NOTCONNECTED, "get_ImageArray");
	}
	if (consume(&camera->fail.image_array)) {
		unlock();
		leave_call();
		return fail(QSI_NOIMAGEAVAILABLE, "get_ImageArray");
	}
	// Deterministic, coordinate-addressable content so a test can verify the
	// ROI and binning mapping of every delivered pixel.
	long width = camera->width;
	short bin_x = camera->bin_x > 0 ? camera->bin_x : 1;
	short bin_y = camera->bin_y > 0 ? camera->bin_y : 1;
	for (long y = 0; y < camera->num_y; y++) {
		for (long x = 0; x < camera->num_x; x++) {
			long sensor_x = (camera->start_x + x) * bin_x;
			long sensor_y = (camera->start_y + y) * bin_y;
			pVal[y * camera->num_x + x] = ccd_test_noise((unsigned)(sensor_y * width + sensor_x), (unsigned)bin_x);
		}
	}
	camera->image_array_calls++;
	unlock();
	leave_call();
	record("get_ImageArray");
	return QSI_OK;
}

int QSICamera::get_CanAbortExposure(bool *pVal) {
	WITH_CAMERA("get_CanAbortExposure")
	FAIL_CAMERA(can_abort, QSI_UNRECOVERABLE, "get_CanAbortExposure")
	*pVal = camera->can_abort_exposure;
	RELEASE_CAMERA();
	record("get_CanAbortExposure=%s", *pVal ? "true" : "false");
	return QSI_OK;
}

int QSICamera::AbortExposure(void) {
	WITH_CAMERA("AbortExposure")
	FAIL_CAMERA(abort, QSI_BADABORTRELAYS, "AbortExposure")
	camera->abort_calls++;
	camera->image_never_ready = false;
	camera->not_ready_reads = 0;
	RELEASE_CAMERA();
	record("AbortExposure");
	return QSI_OK;
}

int QSICamera::get_Position(short *pVal) {
	enter_call();
	wait_for_gate(QSI_FAKE_GATE_WHEEL_READ);
	lock();
	qsi_fake_camera *camera = current();
	if (camera == NULL) {
		unlock();
		leave_call();
		return fail(QSI_NOTCONNECTED, "get_Position");
	}
	camera->wheel_reads++;
	if (consume(&camera->fail.wheel_read)) {
		unlock();
		leave_call();
		return fail(QSI_INVALIDFILTERNUMBER, "get_Position");
	}
	short value;
	if (camera->wheel_never_settles) {
		value = -1;
	} else if (camera->wheel_busy_reads > 0) {
		camera->wheel_busy_reads--;
		value = -1;
	} else {
		camera->position = camera->target_position;
		value = camera->position;
	}
	*pVal = value;
	unlock();
	leave_call();
	record("get_Position=%d", (int)value);
	return QSI_OK;
}

int QSICamera::put_Position(short newVal) {
	WITH_CAMERA("put_Position")
	FAIL_CAMERA(wheel_write, QSI_INVALIDFILTERNUMBER, "put_Position")
	if (newVal < 0 || newVal >= camera->filter_count) {
		unlock();
		leave_call();
		return fail(QSI_INVALIDFILTERNUMBER, "put_Position");
	}
	camera->target_position = newVal;
	camera->wheel_writes++;
	RELEASE_CAMERA();
	record("put_Position(%d)", (int)newVal);
	return QSI_OK;
}
