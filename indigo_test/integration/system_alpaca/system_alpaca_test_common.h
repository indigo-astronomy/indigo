// Copyright (c) 2026 INDIGO initiative
// All rights reserved.
//
// You may use this software under the terms of 'INDIGO Astronomy
// open-source license' (see LICENSE.md).
//
// THIS SOFTWARE IS PROVIDED BY THE AUTHORS 'AS IS' AND ANY EXPRESS
// OR IMPLIED WARRANTIES, INCLUDING, BUT NOT LIMITED TO, THE IMPLIED
// WARRANTIES OF MERCHANTABILITY AND FITNESS FOR A PARTICULAR PURPOSE
// ARE DISCLAIMED. IN NO EVENT SHALL THE AUTHOR BE LIABLE FOR ANY
// DIRECT, INDIRECT, INCIDENTAL, SPECIAL, EXEMPLARY, OR CONSEQUENTIAL
// DAMAGES (INCLUDING, BUT NOT LIMITED TO, PROCUREMENT OF SUBSTITUTE
// GOODS OR SERVICES; LOSS OF USE, DATA, OR PROFITS; OR BUSINESS
// INTERRUPTION) HOWEVER CAUSED AND ON ANY THEORY OF LIABILITY,
// WHETHER IN CONTRACT, STRICT LIABILITY, OR TORT (INCLUDING
// NEGLIGENCE OR OTHERWISE) ARISING IN ANY WAY OUT OF THE USE OF THIS
// SOFTWARE, EVEN IF ADVISED OF THE POSSIBILITY OF SUCH DAMAGE.

// Code is generated by AI

// Shared harness of test_system_alpaca_simulator: the in-process system_alpaca driver against
// system_alpaca_simulator child processes.
//
// HOW A CASE IS WRITTEN
//
// Every case runs in a forked child with its own HOME, its own simulators and its own INDIGO bus, so cases are
// independent and may run in parallel. A case is a "static void name(void)" function of this shape:
//
//   static void focuser_moves(void) {
//     static const char *arguments[] = { "--device", "focuser:Position=1000", NULL };
//     SA_CHECK(sa_begin(arguments));                    // simulator 0 with discovery, driver, one discovery cycle
//     SA_CHECK(sa_attach("Focuser Simulator"));        // switch the device on, wait for its proxy; its name is sa_device
//     SA_CHECK(sa_connect(sa_device));
//     ... indigo_change_number_property_1(&sa_client, sa_device, ...), SA_WAIT(...), sa_request_count(...)
//   cleanup:
//     sa_end();                                         // disconnects everything, shuts the driver down, stops the simulators
//   }
//
// - SA_CHECK() records a failure and jumps to the cleanup label, so every case has one and always ends with sa_end().
// - The driver is observed through the property cache below (sa_state(), sa_switch(), sa_number(), sa_text()...),
//   which holds the properties of all devices. Waiting is done with SA_WAIT(condition, seconds), never with a sleep.
// - The simulator is controlled through its control API: sa_put() / sa_get() for /simulator/v1/..., and the
//   helpers sa_advance() (manual clock), sa_fault(), sa_request_count() and sa_last_request() on top of them.
//   Device time only moves when the test advances the clock.
// - The driver proxies every device it finds unless the device is switched off in X_ALPACA_DEVICES (decision D15). So that a case
//   decides which proxy devices exist, the configuration sa_write_config() writes (sa_begin() writes one) switches off every device
//   of the simulators that run at that time; sa_attach() switches one on. A case about the default sets sa_switch_off_devices to
//   false before the configuration is written and waits for the proxies with sa_wait_attached(). Devices that appear later
//   (a simulator started or a device added afterwards) are on, unless the case switches them off by their UniqueID first.
// - A case is registered by adding one line "{ "name", function }," to the SYSTEM_ALPACA_<CLASS>_CASES macro at the
//   end of its <class>_cases.h. Nothing else has to be edited.

#ifndef system_alpaca_test_common_h
#define system_alpaca_test_common_h

#include <pthread.h>
#include <stdatomic.h>
#include <sys/stat.h>

#include <indigo/indigo_bus.h>
#include <indigo/indigo_driver.h>
#include <indigo/indigo_names.h>
#include <indigo/indigo_timer.h>
#include <indigo_drivers/system_alpaca/indigo_system_alpaca.h>
#include <indigo_drivers/system_alpaca/indigo_system_alpaca_http.h>

#include "../serial_simulator_test_common.h"

#ifndef SYSTEM_ALPACA_SIMULATOR_EXECUTABLE
#define SYSTEM_ALPACA_SIMULATOR_EXECUTABLE "build/integration/system_alpaca_simulator"
#endif

#define SA_BRIDGE "Alpaca"
#define SA_SERVER_NAME "INDIGO Alpaca Simulator"
#define SA_MAX_PROPERTIES 4096
#define SA_MAX_SIMULATORS 4
#define SA_MAX_MESSAGES 64
#define SA_NAME_SIZE 256
#define SA_TEXT_SIZE 1024
#define SA_BODY_SIZE (4 * 1024 * 1024)

// Time a case waits for something the driver does at once (seconds). Generous, because a loaded machine runs many cases at a time.
#define SA_TIMEOUT 10.0

#define SA_CHECK(condition) do { \
	if (!(condition)) { \
		fprintf(stderr, "%s:%d: check failed: %s\n", __FILE__, __LINE__, #condition); \
		indigo_test_failures++; \
		goto cleanup; \
	} \
} while (0)

// Evaluate the condition every 10 ms until it holds or the time is over; the value is whether it held.
#define SA_WAIT(condition, seconds) ({ \
	bool sa_wait_result = false; \
	double sa_wait_deadline = indigo_monotonic_time() + (seconds); \
	while (true) { \
		if (condition) { \
			sa_wait_result = true; \
			break; \
		} \
		if (indigo_monotonic_time() >= sa_wait_deadline) { \
			break; \
		} \
		indigo_usleep(10000); \
	} \
	sa_wait_result; \
})

// ---------------------------------------------------------------------------- property cache

typedef struct {
	indigo_property *property;
	indigo_device *device;								// the device that defined the property
	unsigned revision;										// value of the global counter at the last define or update
	unsigned state_revision[4];						// value of the global counter when the state was last seen
	unsigned define_count;
} sa_cache_entry;

static sa_cache_entry sa_cache[SA_MAX_PROPERTIES];
static pthread_mutex_t sa_cache_mutex = PTHREAD_MUTEX_INITIALIZER;
static unsigned sa_revision_counter = 0;
static int sa_stray_update_count = 0;
static char sa_messages[SA_MAX_MESSAGES][SA_TEXT_SIZE];
static int sa_message_count = 0;

static sa_cache_entry *sa_cache_find(const char *device, const char *name) {
	for (int i = 0; i < SA_MAX_PROPERTIES; i++) {
		indigo_property *property = sa_cache[i].property;
		if (property != NULL && !strcmp(property->device, device) && !strcmp(property->name, name)) {
			return sa_cache + i;
		}
	}
	return NULL;
}

static indigo_item *sa_cache_item(const char *device, const char *name, const char *item_name) {
	sa_cache_entry *entry = sa_cache_find(device, name);
	for (int i = 0; entry != NULL && i < entry->property->count; i++) {
		if (!strcmp(entry->property->items[i].name, item_name)) {
			return entry->property->items + i;
		}
	}
	return NULL;
}

static void sa_cache_message(const char *device, const char *message) {
	if (message != NULL && *message) {
		snprintf(sa_messages[sa_message_count++ % SA_MAX_MESSAGES], SA_TEXT_SIZE, "%s: %s", device, message);
	}
}

static indigo_result sa_client_define_property(indigo_client *client, indigo_device *device, indigo_property *property, const char *message) {
	(void)client;
	pthread_mutex_lock(&sa_cache_mutex);
	sa_cache_entry *entry = sa_cache_find(property->device, property->name);
	unsigned define_count = 0;
	if (entry != NULL) {
		define_count = entry->define_count;
		indigo_release_property(entry->property);
		entry->property = NULL;
	} else {
		for (int i = 0; i < SA_MAX_PROPERTIES && entry == NULL; i++) {
			if (sa_cache[i].property == NULL) {
				entry = sa_cache + i;
			}
		}
	}
	if (entry != NULL) {
		memset(entry, 0, sizeof(sa_cache_entry));
		entry->property = indigo_copy_property(NULL, property);
		entry->device = device;
		entry->define_count = define_count + 1;
		entry->revision = ++sa_revision_counter;
		entry->state_revision[property->state] = entry->revision;
	} else {
		fprintf(stderr, "property cache is full, %s.%s dropped\n", property->device, property->name);
		indigo_test_failures++;
	}
	sa_cache_message(property->device, message);
	pthread_mutex_unlock(&sa_cache_mutex);
	return INDIGO_OK;
}

static indigo_result sa_client_update_property(indigo_client *client, indigo_device *device, indigo_property *property, const char *message) {
	(void)client;
	(void)device;
	pthread_mutex_lock(&sa_cache_mutex);
	sa_cache_entry *entry = sa_cache_find(property->device, property->name);
	if (entry == NULL) {
		// an update of a property that is not defined is a protocol violation no client can make sense of
		sa_stray_update_count++;
		fprintf(stderr, "    %s.%s was updated without being defined\n", property->device, property->name);
	} else {
		entry->property->state = property->state;
		for (int i = 0; i < property->count; i++) {
			indigo_item *item = property->items + i;
			for (int j = 0; j < entry->property->count; j++) {
				indigo_item *cached = entry->property->items + j;
				if (strcmp(cached->name, item->name)) {
					continue;
				}
				switch (property->type) {
					case INDIGO_TEXT_VECTOR:
						indigo_set_text_item_value(cached, indigo_get_text_item_value(item));
						break;
					case INDIGO_NUMBER_VECTOR:
						cached->number = item->number;
						break;
					case INDIGO_SWITCH_VECTOR:
						cached->sw = item->sw;
						break;
					case INDIGO_LIGHT_VECTOR:
						cached->light = item->light;
						break;
					default:
						break;
				}
			}
		}
		entry->revision = ++sa_revision_counter;
		entry->state_revision[property->state] = entry->revision;
	}
	sa_cache_message(property->device, message);
	pthread_mutex_unlock(&sa_cache_mutex);
	return INDIGO_OK;
}

static indigo_result sa_client_delete_property(indigo_client *client, indigo_device *device, indigo_property *property, const char *message) {
	(void)client;
	(void)device;
	pthread_mutex_lock(&sa_cache_mutex);
	for (int i = 0; i < SA_MAX_PROPERTIES; i++) {
		indigo_property *cached = sa_cache[i].property;
		// a delete without a property name removes every property of the device
		if (cached != NULL && !strcmp(cached->device, property->device) && (*property->name == 0 || !strcmp(cached->name, property->name))) {
			indigo_release_property(cached);
			sa_cache[i].property = NULL;
		}
	}
	sa_cache_message(property->device, message);
	pthread_mutex_unlock(&sa_cache_mutex);
	return INDIGO_OK;
}

static indigo_result sa_client_send_message(indigo_client *client, indigo_device *device, indigo_property *property, const char *message) {
	(void)client;
	(void)property;
	pthread_mutex_lock(&sa_cache_mutex);
	sa_cache_message(device != NULL ? device->name : "", message);
	pthread_mutex_unlock(&sa_cache_mutex);
	return INDIGO_OK;
}

static indigo_client sa_client = {
	"system_alpaca test client",
	false,
	NULL,
	INDIGO_OK,
	INDIGO_VERSION_CURRENT,
	NULL,
	NULL,
	sa_client_define_property,
	sa_client_update_property,
	sa_client_delete_property,
	sa_client_send_message,
	NULL,
	false,
	false
};

static void sa_cache_clear(void) {
	pthread_mutex_lock(&sa_cache_mutex);
	for (int i = 0; i < SA_MAX_PROPERTIES; i++) {
		if (sa_cache[i].property != NULL) {
			indigo_release_property(sa_cache[i].property);
		}
	}
	memset(sa_cache, 0, sizeof(sa_cache));
	sa_message_count = 0;
	pthread_mutex_unlock(&sa_cache_mutex);
}

// The property is defined.
static bool sa_defined(const char *device, const char *name) {
	pthread_mutex_lock(&sa_cache_mutex);
	bool result = sa_cache_find(device, name) != NULL;
	pthread_mutex_unlock(&sa_cache_mutex);
	return result;
}

// The device has at least one defined property, i.e. it is attached.
static bool sa_device_defined(const char *device) {
	bool result = false;
	pthread_mutex_lock(&sa_cache_mutex);
	for (int i = 0; i < SA_MAX_PROPERTIES && !result; i++) {
		result = sa_cache[i].property != NULL && !strcmp(sa_cache[i].property->device, device);
	}
	pthread_mutex_unlock(&sa_cache_mutex);
	return result;
}

// The device structure of an attached device of the driver under test, NULL if it is not attached. It is what the driver itself
// passes to its handlers, so a case can queue a handler of its own on the device with indigo_execute_handler().
static indigo_device *sa_device_pointer(const char *device) {
	indigo_device *result = NULL;
	pthread_mutex_lock(&sa_cache_mutex);
	for (int i = 0; i < SA_MAX_PROPERTIES && result == NULL; i++) {
		if (sa_cache[i].property != NULL && !strcmp(sa_cache[i].property->device, device)) {
			result = sa_cache[i].device;
		}
	}
	pthread_mutex_unlock(&sa_cache_mutex);
	return result;
}

// Number of attached devices whose name contains the text; with NULL all devices.
static int sa_device_count(const char *text) {
	char names[64][INDIGO_NAME_SIZE];
	int count = 0;
	pthread_mutex_lock(&sa_cache_mutex);
	for (int i = 0; i < SA_MAX_PROPERTIES; i++) {
		indigo_property *property = sa_cache[i].property;
		bool known = false;
		if (property == NULL || (text != NULL && strstr(property->device, text) == NULL)) {
			continue;
		}
		for (int j = 0; j < count && !known; j++) {
			known = !strcmp(names[j], property->device);
		}
		if (!known && count < 64) {
			strcpy(names[count++], property->device);
		}
	}
	pthread_mutex_unlock(&sa_cache_mutex);
	return count;
}

// State of the property, -1 if it is not defined.
static int sa_state(const char *device, const char *name) {
	pthread_mutex_lock(&sa_cache_mutex);
	sa_cache_entry *entry = sa_cache_find(device, name);
	int result = entry != NULL ? (int)entry->property->state : -1;
	pthread_mutex_unlock(&sa_cache_mutex);
	return result;
}

// Permission of the property, -1 if it is not defined.
static int sa_perm(const char *device, const char *name) {
	pthread_mutex_lock(&sa_cache_mutex);
	sa_cache_entry *entry = sa_cache_find(device, name);
	int result = entry != NULL ? (int)entry->property->perm : -1;
	pthread_mutex_unlock(&sa_cache_mutex);
	return result;
}

// Number of items of the property, -1 if it is not defined.
static int sa_item_count(const char *device, const char *name) {
	pthread_mutex_lock(&sa_cache_mutex);
	sa_cache_entry *entry = sa_cache_find(device, name);
	int result = entry != NULL ? entry->property->count : -1;
	pthread_mutex_unlock(&sa_cache_mutex);
	return result;
}

static bool sa_has_item(const char *device, const char *name, const char *item_name) {
	pthread_mutex_lock(&sa_cache_mutex);
	bool result = sa_cache_item(device, name, item_name) != NULL;
	pthread_mutex_unlock(&sa_cache_mutex);
	return result;
}

// Value of a switch item, false if it does not exist.
static bool sa_switch(const char *device, const char *name, const char *item_name) {
	pthread_mutex_lock(&sa_cache_mutex);
	indigo_item *item = sa_cache_item(device, name, item_name);
	bool result = item != NULL && item->sw.value;
	pthread_mutex_unlock(&sa_cache_mutex);
	return result;
}

// Value of a number item, NAN if it does not exist.
static double sa_number(const char *device, const char *name, const char *item_name) {
	pthread_mutex_lock(&sa_cache_mutex);
	indigo_item *item = sa_cache_item(device, name, item_name);
	double result = item != NULL ? item->number.value : NAN;
	pthread_mutex_unlock(&sa_cache_mutex);
	return result;
}

// Target of a number item, NAN if it does not exist.
static double sa_number_target(const char *device, const char *name, const char *item_name) {
	pthread_mutex_lock(&sa_cache_mutex);
	indigo_item *item = sa_cache_item(device, name, item_name);
	double result = item != NULL ? item->number.target : NAN;
	pthread_mutex_unlock(&sa_cache_mutex);
	return result;
}

// Copy of the value of a text item in a buffer that stays valid until the fourth following call; "" if the item does not exist.
static const char *sa_text(const char *device, const char *name, const char *item_name) {
	static char buffers[4][SA_TEXT_SIZE];
	static int next = 0;
	char *buffer = buffers[next++ % 4];
	pthread_mutex_lock(&sa_cache_mutex);
	indigo_item *item = sa_cache_item(device, name, item_name);
	snprintf(buffer, SA_TEXT_SIZE, "%s", item != NULL ? indigo_get_text_item_value(item) : "");
	pthread_mutex_unlock(&sa_cache_mutex);
	return buffer;
}

// State of a light item, -1 if it does not exist.
static int sa_light(const char *device, const char *name, const char *item_name) {
	pthread_mutex_lock(&sa_cache_mutex);
	indigo_item *item = sa_cache_item(device, name, item_name);
	int result = item != NULL ? (int)item->light.value : -1;
	pthread_mutex_unlock(&sa_cache_mutex);
	return result;
}

// Name of the first item whose label contains the text, "" if there is none. The buffer is static.
static const char *sa_item_by_label(const char *device, const char *name, const char *text) {
	static char buffer[INDIGO_NAME_SIZE];
	buffer[0] = 0;
	pthread_mutex_lock(&sa_cache_mutex);
	sa_cache_entry *entry = sa_cache_find(device, name);
	for (int i = 0; entry != NULL && i < entry->property->count; i++) {
		if (strstr(entry->property->items[i].label, text) != NULL) {
			strcpy(buffer, entry->property->items[i].name);
			break;
		}
	}
	pthread_mutex_unlock(&sa_cache_mutex);
	return buffer;
}

// Name of the item with the given index, "" if there is none. The buffer is static.
static const char *sa_item_name(const char *device, const char *name, int index) {
	static char buffer[INDIGO_NAME_SIZE];
	buffer[0] = 0;
	pthread_mutex_lock(&sa_cache_mutex);
	sa_cache_entry *entry = sa_cache_find(device, name);
	if (entry != NULL && index >= 0 && index < entry->property->count) {
		strcpy(buffer, entry->property->items[index].name);
	}
	pthread_mutex_unlock(&sa_cache_mutex);
	return buffer;
}

// Revision of the property: a number that grows with every define and update of any property. 0 if it is not defined.
// Take it before a request and pass it to sa_state_after() so that a state reached before the request can not pass for its result.
static unsigned sa_revision(const char *device, const char *name) {
	pthread_mutex_lock(&sa_cache_mutex);
	sa_cache_entry *entry = sa_cache_find(device, name);
	unsigned result = entry != NULL ? entry->revision : 0;
	pthread_mutex_unlock(&sa_cache_mutex);
	return result;
}

// The property was published in the given state after the given revision (it may have left the state since).
static bool sa_state_after(const char *device, const char *name, indigo_property_state state, unsigned revision) {
	pthread_mutex_lock(&sa_cache_mutex);
	sa_cache_entry *entry = sa_cache_find(device, name);
	bool result = entry != NULL && entry->state_revision[state] > revision;
	pthread_mutex_unlock(&sa_cache_mutex);
	return result;
}

// Revision at which the property was last published in the given state, 0 if never. The revisions of all properties come from one
// counter, so two of them tell which publication came first.
static unsigned sa_state_revision(const char *device, const char *name, indigo_property_state state) {
	pthread_mutex_lock(&sa_cache_mutex);
	sa_cache_entry *entry = sa_cache_find(device, name);
	unsigned result = entry != NULL ? entry->state_revision[state] : 0;
	pthread_mutex_unlock(&sa_cache_mutex);
	return result;
}

// How many times the property was defined since the device appeared.
static unsigned sa_define_count(const char *device, const char *name) {
	pthread_mutex_lock(&sa_cache_mutex);
	sa_cache_entry *entry = sa_cache_find(device, name);
	unsigned result = entry != NULL ? entry->define_count : 0;
	pthread_mutex_unlock(&sa_cache_mutex);
	return result;
}

// One of the last messages (of any device) contains the text. The ring is not cleared between the steps of a case: when the same text
// may have been published by an earlier step, take a mark before the step and use sa_message_seen_since().
static bool sa_message_seen(const char *text) {
	bool result = false;
	pthread_mutex_lock(&sa_cache_mutex);
	for (int i = 0; i < SA_MAX_MESSAGES && !result; i++) {
		result = strstr(sa_messages[i], text) != NULL;
	}
	pthread_mutex_unlock(&sa_cache_mutex);
	return result;
}

// Mark for sa_message_seen_since(): the number of messages published so far.
static int sa_message_mark(void) {
	pthread_mutex_lock(&sa_cache_mutex);
	int mark = sa_message_count;
	pthread_mutex_unlock(&sa_cache_mutex);
	return mark;
}

// A message published after the mark contains the text (as long as no more than SA_MAX_MESSAGES were published since).
static bool sa_message_seen_since(int mark, const char *text) {
	bool result = false;
	pthread_mutex_lock(&sa_cache_mutex);
	int first = sa_message_count - SA_MAX_MESSAGES > mark ? sa_message_count - SA_MAX_MESSAGES : mark;
	for (int i = first; i < sa_message_count && !result; i++) {
		result = strstr(sa_messages[i % SA_MAX_MESSAGES], text) != NULL;
	}
	pthread_mutex_unlock(&sa_cache_mutex);
	return result;
}

static int sa_stray_updates(void) {
	pthread_mutex_lock(&sa_cache_mutex);
	int result = sa_stray_update_count;
	pthread_mutex_unlock(&sa_cache_mutex);
	return result;
}

// ---------------------------------------------------------------------------- simulators

typedef struct {
	external_serial_simulator process;
	int http_port;
	int udp_port;																// 0 if the simulator was started without discovery
	alpaca_http_connection *control;
	alpaca_http_response response;
	alpaca_http_buffer form;
} sa_simulator;

static sa_simulator sa_simulators[SA_MAX_SIMULATORS];

// Start simulator number index. arguments is a NULL terminated list of extra command line arguments or NULL;
// --discovery-port 0 is added when discovery is true.
static bool sa_simulator_start(int index, const char * const *arguments, bool discovery) {
	sa_simulator *simulator = sa_simulators + index;
	const char *all[28];
	int count = 0;
	memset(simulator, 0, sizeof(sa_simulator));
	if (discovery) {
		all[count++] = "--discovery-port";
		all[count++] = "0";
	}
	while (arguments != NULL && *arguments != NULL && count < 27) {
		all[count++] = *arguments++;
	}
	all[count] = NULL;
	if (!start_external_serial_simulator_with_args(&simulator->process, SYSTEM_ALPACA_SIMULATOR_EXECUTABLE, all)) {
		return false;
	}
	const char *port = strrchr(simulator->process.tcp_url, ':');
	simulator->http_port = port != NULL ? atoi(port + 1) : 0;
	port = strrchr(simulator->process.udp_url, ':');
	simulator->udp_port = port != NULL ? atoi(port + 1) : 0;
	simulator->control = alpaca_http_connection_create("127.0.0.1", simulator->http_port);
	alpaca_http_response_init(&simulator->response, SA_BODY_SIZE);
	alpaca_http_buffer_init(&simulator->form, 65536);
	return simulator->http_port > 0 && simulator->control != NULL && (!discovery || simulator->udp_port > 0);
}

static void sa_simulator_stop(int index) {
	sa_simulator *simulator = sa_simulators + index;
	if (simulator->process.pid > 0) {
		stop_external_serial_simulator(&simulator->process);
	}
	if (simulator->control != NULL) {
		alpaca_http_connection_free(simulator->control);
		alpaca_http_response_free(&simulator->response);
		alpaca_http_buffer_free(&simulator->form);
	}
	memset(simulator, 0, sizeof(sa_simulator));
}

// PUT to the control API, e.g. sa_put(0, "/simulator/v1/clock", "Advance=1"). The form is sent as it is, so values with
// special characters have to be percent-encoded. Returns true for HTTP 200.
static bool sa_put(int index, const char *path, const char *form) {
	sa_simulator *simulator = sa_simulators + index;
	alpaca_http_result result = alpaca_http_put(simulator->control, path, NULL, form, NULL, &simulator->response);
	if (result != ALPACA_HTTP_OK || simulator->response.status != 200) {
		fprintf(stderr, "PUT %s %s -> %s, HTTP %d %s\n", path, form != NULL ? form : "", alpaca_http_result_text(result), simulator->response.status, simulator->response.body.data != NULL ? simulator->response.body.data : "");
		return false;
	}
	return true;
}

// GET from the control API. Returns the body, valid until the next request to the same simulator, or NULL on failure.
static const char *sa_get(int index, const char *path, const char *query) {
	sa_simulator *simulator = sa_simulators + index;
	alpaca_http_result result = alpaca_http_get(simulator->control, path, query, NULL, &simulator->response);
	if (result != ALPACA_HTTP_OK || simulator->response.status != 200) {
		fprintf(stderr, "GET %s -> %s, HTTP %d\n", path, alpaca_http_result_text(result), simulator->response.status);
		return NULL;
	}
	return simulator->response.body.data != NULL ? simulator->response.body.data : "";
}

// Decoded value of "key=value" in one line of a control API answer ('&' or the end of the line ends a value). "" if the key is missing.
// The buffer stays valid until the fourth following call.
static const char *sa_field(const char *line, const char *key) {
	static char buffers[4][SA_TEXT_SIZE];
	static int next = 0;
	char *buffer = buffers[next++ % 4];
	size_t key_length = strlen(key);
	size_t length = 0;
	buffer[0] = 0;
	while (line != NULL && *line && *line != '\n') {
		const char *end = line + strcspn(line, "&\n");
		if (!strncmp(line, key, key_length) && line[key_length] == '=') {
			for (const char *c = line + key_length + 1; c < end && length < SA_TEXT_SIZE - 1; c++) {
				if (*c == '%' && c + 2 < end) {
					char hex[3] = { c[1], c[2], 0 };
					buffer[length++] = (char)strtol(hex, NULL, 16);
					c += 2;
				} else {
					buffer[length++] = *c;
				}
			}
			buffer[length] = 0;
			return buffer;
		}
		line = *end == '&' ? end + 1 : end;
	}
	return buffer;
}

// Value of a key of a control API answer that has one key per line, e.g. sa_status(0, "/simulator/v1/focuser/0/state", "Position").
static const char *sa_status(int index, const char *path, const char *key) {
	const char *body = sa_get(index, path, NULL);
	size_t key_length = strlen(key);
	while (body != NULL && *body) {
		if (!strncmp(body, key, key_length) && body[key_length] == '=') {
			return sa_field(body, key);
		}
		body += strcspn(body, "\n");
		body += *body == '\n';
	}
	return "";
}

// Advance the manual clock of the simulator: every move, exposure and connect delay is measured on it.
static bool sa_advance(int index, double seconds) {
	char form[64];
	snprintf(form, sizeof(form), "Advance=%.6f", seconds);
	return sa_put(index, "/simulator/v1/clock", form);
}

// Set state of a simulated device, e.g. sa_device_state(0, "focuser", 0, "Position=1000&Temperature=5").
static bool sa_device_state(int index, const char *type, int number, const char *form) {
	char path[128];
	snprintf(path, sizeof(path), "/simulator/v1/%s/%d/state", type, number);
	return sa_put(index, path, form);
}

// Arm a fault, e.g. sa_fault(0, "GET", "*/focuser/0/position", "http-status", "Value=503&Count=2").
// method may be NULL for any method, extra NULL for one fault without parameters. See system_alpaca_simulator --help for the actions.
static bool sa_fault(int index, const char *method, const char *path, const char *action, const char *extra) {
	sa_simulator *simulator = sa_simulators + index;
	alpaca_http_buffer_clear(&simulator->form);
	alpaca_http_form_add_string(&simulator->form, "Path", path);
	alpaca_http_form_add_string(&simulator->form, "Action", action);
	if (method != NULL) {
		alpaca_http_form_add_string(&simulator->form, "Method", method);
	}
	if (extra != NULL && *extra) {
		alpaca_http_buffer_append(&simulator->form, "&", 1);
		alpaca_http_buffer_append(&simulator->form, extra, strlen(extra));
	}
	return sa_put(index, "/simulator/v1/faults", simulator->form.data);
}

static bool sa_clear_faults(int index) {
	return sa_put(index, "/simulator/v1/faults/clear", NULL);
}

// The recorded Alpaca requests that match the method (NULL for any) and the path glob, one per line in the order they arrived,
// or NULL on failure. Fields of a line are read with sa_field(line, "Body") etc.; see GET /simulator/v1/requests.
static const char *sa_requests(int index, const char *method, const char *path) {
	sa_simulator *simulator = sa_simulators + index;
	alpaca_http_buffer_clear(&simulator->form);
	alpaca_http_form_add_string(&simulator->form, "Path", path);
	if (method != NULL) {
		alpaca_http_form_add_string(&simulator->form, "Method", method);
	}
	return sa_get(index, "/simulator/v1/requests", simulator->form.data);
}

// Number of recorded requests that match, -1 on failure.
static int sa_request_count(int index, const char *method, const char *path) {
	const char *body = sa_requests(index, method, path);
	int count = 0;
	if (body == NULL) {
		return -1;
	}
	for (const char *c = body; *c; c++) {
		count += *c == '\n';
	}
	return count;
}

// The last recorded request that matches, as one line for sa_field(); NULL if there is none.
static const char *sa_last_request(int index, const char *method, const char *path) {
	const char *body = sa_requests(index, method, path);
	const char *last = NULL;
	while (body != NULL && *body) {
		last = body;
		body += strcspn(body, "\n");
		body += *body == '\n';
	}
	return last;
}

// Sequence number of the last recorded request that matches, 0 if there is none; it tells the order of two requests.
static int sa_sequence(int index, const char *method, const char *path) {
	const char *line = sa_last_request(index, method, path);
	return line != NULL ? atoi(sa_field(line, "Sequence")) : 0;
}

// Number of recorded requests that match and arrived before the request with the given sequence number, -1 on failure.
static int sa_count_before(int index, const char *method, const char *path, int sequence) {
	const char *body = sa_requests(index, method, path);
	int count = 0;
	if (body == NULL) {
		return -1;
	}
	while (*body) {
		count += atoi(sa_field(body, "Sequence")) < sequence;
		body += strcspn(body, "\n");
		body += *body == '\n';
	}
	return count;
}

// Number of recorded requests that match and were answered with the given fault ("http-status", "malformed-json"...), -1 on failure.
static int sa_faulted_count(int index, const char *method, const char *path, const char *fault) {
	const char *body = sa_requests(index, method, path);
	int count = 0;
	if (body == NULL) {
		return -1;
	}
	while (*body) {
		count += !strcmp(sa_field(body, "Fault"), fault);
		body += strcspn(body, "\n");
		body += *body == '\n';
	}
	return count;
}

// A device that does nothing publishes nothing: while the given number of further requests for poll_path arrive at the simulator
// (the request the driver makes once per poll tick: ".../devicestate" of a Platform 7 device, ".../connected" of an older one),
// no property of the device is defined, updated or deleted. The properties that were are printed.
// This is the way to assert that polling does not republish: never count the publications of a device that changes.
static bool sa_steady(int index, const char *device, const char *poll_path, int ticks) {
	static char names[256][INDIGO_NAME_SIZE];
	static unsigned revisions[256];
	int count = 0;
	bool steady = true;
	pthread_mutex_lock(&sa_cache_mutex);
	for (int i = 0; i < SA_MAX_PROPERTIES && count < 256; i++) {
		indigo_property *property = sa_cache[i].property;
		if (property != NULL && !strcmp(property->device, device)) {
			strcpy(names[count], property->name);
			revisions[count++] = sa_cache[i].revision;
		}
	}
	pthread_mutex_unlock(&sa_cache_mutex);
	int polls = sa_request_count(index, "GET", poll_path);
	if (count == 0 || polls < 0 || !SA_WAIT(sa_request_count(index, "GET", poll_path) >= polls + ticks, 3 * SA_TIMEOUT)) {
		fprintf(stderr, "    '%s' has %d properties and was not polled %d times with %s\n", device, count, ticks, poll_path);
		return false;
	}
	for (int i = 0; i < count; i++) {
		if (sa_revision(device, names[i]) != revisions[i]) {
			fprintf(stderr, "    %s.%s was published although nothing changed\n", device, names[i]);
			steady = false;
		}
	}
	return steady;
}

// ---------------------------------------------------------------------------- handler queue of a device
//
// A case orders what the driver does by conditions on the handler queue of the device instead of sleeps: whether a task is waiting,
// running or due. The queue is the one of the framework (indigo_timer.h); it is read under its own mutex. A device is passed by its
// structure (sa_device_pointer()); the queue is the one of its primary device.

static indigo_queue *sa_queue(indigo_device *device) {
	indigo_device *master = device != NULL && device->master_device != NULL ? device->master_device : device;
	return master != NULL && master->device_context != NULL ? ((indigo_device_context *)master->device_context)->queue : NULL;
}

// A task of the device with the callback waits in the queue (callback NULL: any task of the device).
static bool sa_queue_has(indigo_device *device, indigo_timer_callback callback) {
	indigo_queue *queue = sa_queue(device);
	bool found = false;
	if (queue != NULL) {
		pthread_mutex_lock(&queue->mutex);
		for (indigo_queue_task *task = queue->task; task != NULL && !found; task = task->next) {
			found = task->device == device && (callback == NULL || task->callback == callback);
		}
		pthread_mutex_unlock(&queue->mutex);
	}
	return found;
}

// Number of tasks of the device with the given priority that wait in the queue and whose time has come: poll ticks and finalizers
// (INDIGO_TASK_PRIORITY_TIME) that are due.
static int sa_queue_due(indigo_device *device, int priority) {
	indigo_queue *queue = sa_queue(device);
	int count = 0;
	if (queue != NULL) {
		// the time of the queue (indigo_delay_to_time(0) is 0, the time of a task that is due at once)
		struct timespec now = indigo_delay_to_time(1e-6);
		pthread_mutex_lock(&queue->mutex);
		for (indigo_queue_task *task = queue->task; task != NULL; task = task->next) {
			count += task->device == device && task->priority == priority && (task->at.tv_sec < now.tv_sec || (task->at.tv_sec == now.tv_sec && task->at.tv_nsec <= now.tv_nsec));
		}
		pthread_mutex_unlock(&queue->mutex);
	}
	return count;
}

// A gate on the handler queue of a device: while it is closed no handler, finalizer or poll tick of the device runs, so a case decides
// what is queued behind it (the queue then runs what is due by priority and time). Only one gate at a time.
static atomic_bool sa_gate_closed = false;
static atomic_bool sa_gate_entered = false;

static void sa_gate_handler(indigo_device *device) {
	(void)device;
	atomic_store(&sa_gate_entered, true);
	double deadline = indigo_monotonic_time() + 30;
	while (atomic_load(&sa_gate_closed) && indigo_monotonic_time() < deadline) {
		indigo_usleep(1000);
	}
}

static bool sa_gate_close(const char *device_name) {
	indigo_device *device = sa_device_pointer(device_name);
	if (device == NULL) {
		return false;
	}
	atomic_store(&sa_gate_closed, true);
	atomic_store(&sa_gate_entered, false);
	indigo_execute_priority_handler_in(device, INDIGO_TASK_PRIORITY_URGENT, 0, sa_gate_handler);
	return SA_WAIT(atomic_load(&sa_gate_entered), SA_TIMEOUT);
}

static void sa_gate_open(void) {
	atomic_store(&sa_gate_closed, false);
}

// ---------------------------------------------------------------------------- driver

static bool sa_driver_running = false;

// Name of the proxy device attached by the last sa_attach().
static char sa_device[INDIGO_NAME_SIZE];

// sa_write_config() switches off every device of the running simulators (see the top of this file). sa_end() sets it again.
static bool sa_switch_off_devices = true;

// Key of a device, the name of its item in X_ALPACA_DEVICES: its UniqueID in lower case with everything that is not safe in an item
// name replaced by '_', and a hash of the whole UniqueID if a character was replaced or it is too long (as the driver documents it in
// indigo_docs/PROPERTIES.md; REV-18). key has room for SA_KEY_SIZE bytes.
#define SA_KEY_SIZE 64

static void sa_key(const char *unique_id, char *key) {
	size_t length = strlen(unique_id);
	uint32_t hash = 2166136261u;
	bool replaced = false;
	for (size_t i = 0; i < length; i++) {
		char c = unique_id[i] >= 'A' && unique_id[i] <= 'Z' ? (char)(unique_id[i] - 'A' + 'a') : unique_id[i];
		bool safe = (c >= 'a' && c <= 'z') || (c >= '0' && c <= '9') || c == '-' || c == '.' || c == '_';
		hash = (hash ^ (unsigned char)c) * 16777619u;
		replaced = replaced || !safe;
		if (i < SA_KEY_SIZE - 1) {
			key[i] = safe ? c : '_';
		}
	}
	if (length >= SA_KEY_SIZE - 10 && (replaced || length >= SA_KEY_SIZE)) {
		snprintf(key + SA_KEY_SIZE - 10, 10, "_%08x", (unsigned)hash);
	} else if (replaced) {
		snprintf(key + length, 10, "_%08x", (unsigned)hash);
	} else {
		key[length] = 0;
	}
}

// Write X_ALPACA_DEVICES with every device of the running simulators switched off, as a saved configuration has it. The devices are
// read from the control API of the simulators, which records nothing, so the request counts of a case do not change.
static void sa_write_devices_off(FILE *file) {
	char key[SA_KEY_SIZE];
	int count = 0;
	for (int i = 0; i < SA_MAX_SIMULATORS; i++) {
		const char *line = sa_simulators[i].control != NULL ? sa_get(i, "/simulator/v1/devices", NULL) : NULL;
		while (line != NULL && *line) {
			sa_key(sa_field(line, "UniqueID"), key);
			fprintf(file, "%s<oneSwitch name='%s'>Off</oneSwitch>\n", count++ == 0 ? "<newSwitchVector device='" SA_BRIDGE "' name='X_ALPACA_DEVICES'>\n" : "", key);
			line += strcspn(line, "\n");
			line += *line == '\n';
		}
	}
	if (count > 0) {
		fprintf(file, "</newSwitchVector>\n");
	}
}

// Write the configuration of the bridge device the driver restores at INIT. Discovery is always directed at explicit loopback
// targets (a broadcast would reach real Alpaca servers of the network the test machine is in), and timeouts and poll intervals
// are short. With discovery_enabled the driver runs a cycle with discovery every second. Without it the only cycle the driver
// runs by itself is the one at INIT (the interval is an hour), so a case decides with sa_discover() when a cycle runs.
// With sa_switch_off_devices every device of the running simulators is switched off. extra is appended after that, it may be NULL.
static FILE *sa_open_config(void) {
	char path[PATH_MAX];
	snprintf(path, sizeof(path), "%s/.indigo", getenv("HOME"));
	mkdir(path, 0700);
	snprintf(path, sizeof(path), "%s/.indigo/" SA_BRIDGE ".config", getenv("HOME"));
	FILE *file = fopen(path, "w");
	if (file == NULL) {
		perror(path);
	}
	return file;
}

static bool sa_write_config(bool discovery_enabled, const char *targets, const char *extra) {
	FILE *file = sa_open_config();
	if (file == NULL) {
		return false;
	}
	fprintf(file, "<newSwitchVector device='" SA_BRIDGE "' name='X_ALPACA_DISCOVERY'>\n<oneSwitch name='ENABLED'>%s</oneSwitch>\n<oneSwitch name='DISABLED'>%s</oneSwitch>\n</newSwitchVector>\n", discovery_enabled ? "On" : "Off", discovery_enabled ? "Off" : "On");
	fprintf(file, "<newNumberVector device='" SA_BRIDGE "' name='X_ALPACA_DISCOVERY_SETTINGS'>\n<oneNumber name='INTERVAL'>%d</oneNumber>\n<oneNumber name='TIMEOUT'>150</oneNumber>\n<oneNumber name='POLLS'>1</oneNumber>\n<oneNumber name='RETENTION'>2</oneNumber>\n</newNumberVector>\n", discovery_enabled ? 1 : 3600);
	fprintf(file, "<newTextVector device='" SA_BRIDGE "' name='X_ALPACA_DISCOVERY_TARGETS'>\n<oneText name='TARGETS'>%s</oneText>\n</newTextVector>\n", targets);
	fprintf(file, "<newNumberVector device='" SA_BRIDGE "' name='X_ALPACA_TIMEOUTS'>\n<oneNumber name='ESTABLISH'>2</oneNumber>\n<oneNumber name='STANDARD'>2</oneNumber>\n<oneNumber name='LONG'>5</oneNumber>\n</newNumberVector>\n");
	fprintf(file, "<newNumberVector device='" SA_BRIDGE "' name='X_ALPACA_POLLING'>\n<oneNumber name='IDLE'>0.1</oneNumber>\n<oneNumber name='ACTIVE'>0.05</oneNumber>\n</newNumberVector>\n");
	if (sa_switch_off_devices) {
		sa_write_devices_off(file);
	}
	if (extra != NULL) {
		fputs(extra, file);
	}
	fclose(file);
	return true;
}

// Discovery targets for the running simulators that answer discovery: "127.0.0.1:<port>,...". When there is none, the target is
// a loopback port nobody listens on, so the test never broadcasts.
static const char *sa_targets(void) {
	static char targets[256];
	size_t used = 0;
	targets[0] = 0;
	for (int i = 0; i < SA_MAX_SIMULATORS; i++) {
		if (sa_simulators[i].udp_port > 0) {
			used += (size_t)snprintf(targets + used, sizeof(targets) - used, "%s127.0.0.1:%d", used > 0 ? "," : "", sa_simulators[i].udp_port);
		}
	}
	if (used == 0) {
		snprintf(targets, sizeof(targets), "127.0.0.1:9");
	}
	return targets;
}

// Start the bus, the test client and the driver, and wait until the bridge device restored its configuration.
// The restore has to succeed, and promptly: a property the driver does not answer costs the restore five seconds and ends it in ALERT.
static bool sa_driver_start(void) {
	double started = indigo_monotonic_time();
	if (indigo_start() != INDIGO_OK) {
		return false;
	}
	if (indigo_attach_client(&sa_client) != INDIGO_OK || indigo_system_alpaca(INDIGO_DRIVER_INIT, NULL) != INDIGO_OK) {
		indigo_detach_client(&sa_client);
		indigo_stop();
		return false;
	}
	sa_driver_running = true;
	if (!SA_WAIT(sa_defined(SA_BRIDGE, "X_ALPACA_DEVICES") && sa_state(SA_BRIDGE, CONFIG_PROPERTY_NAME) != INDIGO_BUSY_STATE, SA_TIMEOUT) || sa_state(SA_BRIDGE, CONFIG_PROPERTY_NAME) != INDIGO_OK_STATE || indigo_monotonic_time() - started > 4) {
		fprintf(stderr, "configuration restore of the bridge ended in state %d after %.1f s\n", sa_state(SA_BRIDGE, CONFIG_PROPERTY_NAME), indigo_monotonic_time() - started);
		return false;
	}
	return true;
}

// Shut the driver down and stop the bus. Returns the result of INDIGO_DRIVER_SHUTDOWN; the bus is stopped only if it succeeded.
static indigo_result sa_driver_stop(void) {
	if (!sa_driver_running) {
		return INDIGO_OK;
	}
	indigo_result result = indigo_system_alpaca(INDIGO_DRIVER_SHUTDOWN, NULL);
	if (result == INDIGO_OK) {
		indigo_detach_client(&sa_client);
		indigo_stop();
		sa_cache_clear();
		sa_driver_running = false;
	}
	return result;
}

// Run one discovery cycle (X_ALPACA_DISCOVER) and wait until it is finished.
static bool sa_discover(void) {
	unsigned revision = sa_revision(SA_BRIDGE, "X_ALPACA_DISCOVER");
	if (indigo_change_switch_property_1(&sa_client, SA_BRIDGE, "X_ALPACA_DISCOVER", "DISCOVER", true) != INDIGO_OK) {
		return false;
	}
	return SA_WAIT(sa_state_after(SA_BRIDGE, "X_ALPACA_DISCOVER", INDIGO_OK_STATE, revision) && sa_state(SA_BRIDGE, "X_ALPACA_DISCOVER") == INDIGO_OK_STATE, 3 * SA_TIMEOUT);
}

// Item name of a simulator in X_ALPACA_SERVER_STATUS ("127.0.0.1:<port>") and its status text, which starts with the state:
// ONLINE, SILENT, OFFLINE, IGNORED or UNSUPPORTED.
static const char *sa_server_item(int index) {
	static char names[SA_MAX_SIMULATORS][64];
	snprintf(names[index], sizeof(names[index]), "127.0.0.1:%d", sa_simulators[index].http_port);
	return names[index];
}

static const char *sa_server_status(int index) {
	return sa_text(SA_BRIDGE, "X_ALPACA_SERVER_STATUS", sa_server_item(index));
}

// Number of listed devices whose status starts with the given state.
static int sa_status_count(const char *state) {
	int count = 0;
	size_t length = strlen(state);
	pthread_mutex_lock(&sa_cache_mutex);
	sa_cache_entry *entry = sa_cache_find(SA_BRIDGE, "X_ALPACA_DEVICE_STATUS");
	for (int i = 0; entry != NULL && i < entry->property->count; i++) {
		const char *status = indigo_get_text_item_value(entry->property->items + i);
		count += !strncmp(status, state, length) && status[length] == ':';
	}
	pthread_mutex_unlock(&sa_cache_mutex);
	return count;
}

// Change one item of a property of the bridge and wait until the driver answered with a state that is not BUSY. Returns that state, -1 on failure.
static int sa_set_text(const char *name, const char *item, const char *value) {
	unsigned revision = sa_revision(SA_BRIDGE, name);
	if (indigo_change_text_property_1_raw(&sa_client, SA_BRIDGE, name, item, value) != INDIGO_OK || !SA_WAIT(sa_revision(SA_BRIDGE, name) > revision && sa_state(SA_BRIDGE, name) != INDIGO_BUSY_STATE, SA_TIMEOUT)) {
		return -1;
	}
	return sa_state(SA_BRIDGE, name);
}

static int sa_set_number(const char *name, const char *item, double value) {
	unsigned revision = sa_revision(SA_BRIDGE, name);
	if (indigo_change_number_property_1(&sa_client, SA_BRIDGE, name, item, value) != INDIGO_OK || !SA_WAIT(sa_revision(SA_BRIDGE, name) > revision && sa_state(SA_BRIDGE, name) != INDIGO_BUSY_STATE, SA_TIMEOUT)) {
		return -1;
	}
	return sa_state(SA_BRIDGE, name);
}

static int sa_set_switch(const char *name, const char *item, bool value) {
	unsigned revision = sa_revision(SA_BRIDGE, name);
	if (indigo_change_switch_property_1(&sa_client, SA_BRIDGE, name, item, value) != INDIGO_OK || !SA_WAIT(sa_revision(SA_BRIDGE, name) > revision && sa_state(SA_BRIDGE, name) != INDIGO_BUSY_STATE, SA_TIMEOUT)) {
		return -1;
	}
	return sa_state(SA_BRIDGE, name);
}

// Key (item name in X_ALPACA_DEVICES) of the first listed device whose label contains the text, "" if there is none.
static const char *sa_device_key(const char *label) {
	return sa_item_by_label(SA_BRIDGE, "X_ALPACA_DEVICES", label);
}

// Status text of a listed device (X_ALPACA_DEVICE_STATUS), "" if it is not listed. It starts with the state: AVAILABLE, ATTACHED, OFFLINE, FAILED or UNSUPPORTED.
static const char *sa_device_status(const char *key) {
	return sa_text(SA_BRIDGE, "X_ALPACA_DEVICE_STATUS", key);
}

static bool sa_device_status_is(const char *key, const char *state) {
	const char *status = sa_device_status(key);
	size_t length = strlen(state);
	return !strncmp(status, state, length) && status[length] == ':';
}

// Name of the proxy device of a listed device, taken from its status ("..., device '<name>'"); "" if it has none. The buffer is static.
static const char *sa_proxy_name(const char *key) {
	static char name[INDIGO_NAME_SIZE];
	const char *status = sa_device_status(key);
	const char *start = strstr(status, ", device '");
	name[0] = 0;
	if (start != NULL) {
		snprintf(name, sizeof(name), "%s", start + 10);
		char *end = strrchr(name, '\'');
		if (end != NULL) {
			*end = 0;
		}
	}
	return name;
}

// Select or deselect a listed device by its key.
static bool sa_select(const char *key, bool selected) {
	return *key != 0 && indigo_change_switch_property_1(&sa_client, SA_BRIDGE, "X_ALPACA_DEVICES", key, selected) == INDIGO_OK;
}

// Select the device whose label in X_ALPACA_DEVICES contains the text and wait for its proxy device.
// The name of the proxy is left in sa_device.
static bool sa_attach(const char *label) {
	char key[INDIGO_NAME_SIZE];
	snprintf(key, sizeof(key), "%s", sa_device_key(label));
	sa_device[0] = 0;
	if (!sa_select(key, true) || !SA_WAIT(sa_device_status_is(key, "ATTACHED"), SA_TIMEOUT)) {
		fprintf(stderr, "'%s' (key '%s') was not attached: %s\n", label, key, sa_device_status(key));
		return false;
	}
	snprintf(sa_device, sizeof(sa_device), "%s", sa_proxy_name(key));
	return SA_WAIT(sa_defined(sa_device, CONNECTION_PROPERTY_NAME), SA_TIMEOUT);
}

// Wait until the device whose label in X_ALPACA_DEVICES contains the text has its proxy device, without switching anything: what a
// device that is on by default gets. The name of the proxy is left in sa_device.
static bool sa_wait_attached(const char *label) {
	char key[INDIGO_NAME_SIZE];
	sa_device[0] = 0;
	bool attached = SA_WAIT(sa_device_status_is(sa_device_key(label), "ATTACHED"), SA_TIMEOUT);
	snprintf(key, sizeof(key), "%s", sa_device_key(label));
	if (!attached) {
		fprintf(stderr, "'%s' (key '%s') has no proxy device: %s\n", label, key, sa_device_status(key));
		return false;
	}
	snprintf(sa_device, sizeof(sa_device), "%s", sa_proxy_name(key));
	return SA_WAIT(sa_defined(sa_device, CONNECTION_PROPERTY_NAME), SA_TIMEOUT);
}

// Switch the devices with the given UniqueIDs off in one request, whether they are listed or not, and wait for the answer.
static bool sa_switch_off(const char * const *unique_ids, int count) {
	static char keys[128][SA_KEY_SIZE];
	const char *items[128];
	bool values[128];
	if (count < 1 || count > 128) {
		return false;
	}
	for (int i = 0; i < count; i++) {
		sa_key(unique_ids[i], keys[i]);
		items[i] = keys[i];
		values[i] = false;
	}
	unsigned revision = sa_revision(SA_BRIDGE, "X_ALPACA_DEVICES");
	return indigo_change_switch_property(&sa_client, SA_BRIDGE, "X_ALPACA_DEVICES", count, items, values) == INDIGO_OK && SA_WAIT(sa_revision(SA_BRIDGE, "X_ALPACA_DEVICES") > revision && sa_state(SA_BRIDGE, "X_ALPACA_DEVICES") == INDIGO_OK_STATE, SA_TIMEOUT);
}

static bool sa_is_connected(const char *device) {
	return sa_state(device, CONNECTION_PROPERTY_NAME) == INDIGO_OK_STATE && sa_switch(device, CONNECTION_PROPERTY_NAME, CONNECTION_CONNECTED_ITEM_NAME);
}

static bool sa_is_disconnected(const char *device) {
	return sa_state(device, CONNECTION_PROPERTY_NAME) != INDIGO_BUSY_STATE && sa_switch(device, CONNECTION_PROPERTY_NAME, CONNECTION_DISCONNECTED_ITEM_NAME);
}

// Request the connection without waiting for the result.
static bool sa_request_connection(const char *device, bool connected) {
	return indigo_change_switch_property_1(&sa_client, device, CONNECTION_PROPERTY_NAME, connected ? CONNECTION_CONNECTED_ITEM_NAME : CONNECTION_DISCONNECTED_ITEM_NAME, true) == INDIGO_OK;
}

// Connect a proxy device and wait until it is connected. The simulated devices connect at once unless ConnectDelay is set.
static bool sa_connect(const char *device) {
	if (!sa_request_connection(device, true) || !SA_WAIT(sa_is_connected(device), SA_TIMEOUT)) {
		fprintf(stderr, "'%s' did not connect, CONNECTION state %d\n", device, sa_state(device, CONNECTION_PROPERTY_NAME));
		return false;
	}
	return true;
}

static bool sa_disconnect(const char *device) {
	if (!sa_request_connection(device, false) || !SA_WAIT(sa_state(device, CONNECTION_PROPERTY_NAME) == INDIGO_OK_STATE && sa_switch(device, CONNECTION_PROPERTY_NAME, CONNECTION_DISCONNECTED_ITEM_NAME), SA_TIMEOUT)) {
		fprintf(stderr, "'%s' did not disconnect, CONNECTION state %d\n", device, sa_state(device, CONNECTION_PROPERTY_NAME));
		return false;
	}
	return true;
}

// Disconnect a Platform 7 device of simulator 0 whose disconnect takes device time (ConnectDelay): CONNECTION stays BUSY while the
// device reports Connecting (state_path is its control API state, e.g. "/simulator/v1/focuser/0/state"), the given device time passes,
// and then the device is disconnected.
static bool sa_disconnect_after(const char *device, const char *state_path, double seconds) {
	if (!sa_request_connection(device, false) || !SA_WAIT(!strcmp(sa_status(0, state_path, "Connecting"), "true"), SA_TIMEOUT) || sa_state(device, CONNECTION_PROPERTY_NAME) != INDIGO_BUSY_STATE) {
		fprintf(stderr, "'%s' is not disconnecting, CONNECTION state %d\n", device, sa_state(device, CONNECTION_PROPERTY_NAME));
		return false;
	}
	if (!sa_advance(0, seconds) || !SA_WAIT(sa_state(device, CONNECTION_PROPERTY_NAME) == INDIGO_OK_STATE && sa_switch(device, CONNECTION_PROPERTY_NAME, CONNECTION_DISCONNECTED_ITEM_NAME), SA_TIMEOUT)) {
		fprintf(stderr, "'%s' did not disconnect, CONNECTION state %d\n", device, sa_state(device, CONNECTION_PROPERTY_NAME));
		return false;
	}
	return true;
}

// The usual start of a case: simulator 0 with the given arguments (NULL for one device of every type) and discovery,
// the driver with periodic discovery disabled, and one discovery cycle, after which the devices of the simulator are listed,
// switched off unless the case cleared sa_switch_off_devices (then they are attached by default).
static bool sa_begin(const char * const *arguments) {
	return sa_simulator_start(0, arguments, true) && sa_write_config(false, sa_targets(), NULL) && sa_driver_start() && sa_discover();
}

// The end of every case: disconnect whatever is connected, shut the driver down and stop the simulators.
// A shutdown that is refused or a property updated without being defined fails the case.
static void sa_end(void) {
	if (sa_driver_running) {
		char names[64][INDIGO_NAME_SIZE];
		int count = 0;
		pthread_mutex_lock(&sa_cache_mutex);
		for (int i = 0; i < SA_MAX_PROPERTIES && count < 64; i++) {
			indigo_property *property = sa_cache[i].property;
			if (property != NULL && !strcmp(property->name, CONNECTION_PROPERTY_NAME) && property->count == 2 && (property->items[0].sw.value || property->state == INDIGO_BUSY_STATE)) {
				strcpy(names[count++], property->device);
			}
		}
		pthread_mutex_unlock(&sa_cache_mutex);
		for (int i = 0; i < count; i++) {
			SA_WAIT(sa_state(names[i], CONNECTION_PROPERTY_NAME) != INDIGO_BUSY_STATE, SA_TIMEOUT);
			if (sa_defined(names[i], CONNECTION_PROPERTY_NAME) && !sa_is_disconnected(names[i])) {
				sa_request_connection(names[i], false);
				SA_WAIT(!sa_defined(names[i], CONNECTION_PROPERTY_NAME) || sa_is_disconnected(names[i]), SA_TIMEOUT);
			}
		}
		if (sa_stray_updates() != 0) {
			fprintf(stderr, "%d update(s) of properties that were not defined\n", sa_stray_updates());
			indigo_test_failures++;
		}
		indigo_result result = INDIGO_FAILED;
		if (!SA_WAIT((result = sa_driver_stop()) == INDIGO_OK, SA_TIMEOUT)) {
			fprintf(stderr, "driver shutdown failed with %d\n", result);
			indigo_test_failures++;
		}
	}
	for (int i = 0; i < SA_MAX_SIMULATORS; i++) {
		sa_simulator_stop(i);
	}
	sa_switch_off_devices = true;
}

#endif /* system_alpaca_test_common_h */
