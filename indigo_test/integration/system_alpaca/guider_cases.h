// Copyright (c) 2026 INDIGO initiative
// All rights reserved.
//
// You may use this software under the terms of 'INDIGO Astronomy
// open-source license' (see LICENSE.md).
//
// THIS SOFTWARE IS PROVIDED BY THE AUTHORS 'AS IS' AND ANY EXPRESS
// OR IMPLIED WARRANTIES, INCLUDING, BUT NOT LIMITED TO, THE IMPLIED
// WARRANTIES OF MERCHANTABILITY AND FITNESS FOR A PARTICULAR PURPOSE
// ARE DISCLAIMED. IN NO EVENT SHALL THE AUTHOR BE LIABLE FOR ANY
// DIRECT, INDIRECT, INCIDENTAL, SPECIAL, EXEMPLARY, OR CONSEQUENTIAL
// DAMAGES (INCLUDING, BUT NOT LIMITED TO, PROCUREMENT OF SUBSTITUTE
// GOODS OR SERVICES; LOSS OF USE, DATA, OR PROFITS; OR BUSINESS
// INTERRUPTION) HOWEVER CAUSED AND ON ANY THEORY OF LIABILITY,
// WHETHER IN CONTRACT, STRICT LIABILITY, OR TORT (INCLUDING
// NEGLIGENCE OR OTHERWISE) ARISING IN ANY WAY OUT OF THE USE OF THIS
// SOFTWARE, EVEN IF ADVISED OF THE POSSIBILITY OF SUCH DAMAGE.

// Code is generated by AI

// Cases of the guider device class of the system_alpaca driver (indigo_system_alpaca_guider.c): the secondary guider device of a
// Telescope or a Camera that can pulse guide.
//
// PulseGuide of the simulated devices returns at once and IsPulseGuiding is true for Duration milliseconds of device time. The simulated
// telescope moves at its guide rates (0.00208903 degrees per second, half the sidereal rate) while a pulse lasts: north raises the
// declination, east raises the right ascension. The driver looks at IsPulseGuiding for the first time when Duration has passed in real
// time, so a case that wants to see a pulse in progress waits for these requests before it advances the clock of the device.
//
// guider_timing_* are measurements, not checks: without SYSTEM_ALPACA_TEST_TIMING=1 they only make sure that a pulse of every direction
// completes on a device whose time is real time. See "Guider timing measurements" in indigo_test/DRIVER_TESTING_RULES.md.

#ifndef system_alpaca_guider_cases_h
#define system_alpaca_guider_cases_h

#include <time.h>

#include "system_alpaca_test_common.h"
#include "mount_cases.h"

#define GUIDER_RATE (0.00208903)

static const char *guider_telescope[] = { "--device", "telescope:EquatorialSystem=2,Tracking=true,SiteLatitude=-30.2407,SiteLongitude=-70.7366", NULL };
static const char *guider_camera[] = { "--device", "camera", NULL };

// The primary device is sa_device; these are its guider and the device API of the Alpaca device both of them talk to.
static char guider_device[INDIGO_NAME_SIZE + 16];
static const char *guider_api = "/api/v1/telescope/0/";

// The telescope of a listed key selected again after a detach, connected, and its guider connected.
static bool guider_begin_attached(const char *key) {
	if (!sa_select(key, true) || !SA_WAIT(sa_device_status_is(key, "ATTACHED"), SA_TIMEOUT)) {
		return false;
	}
	snprintf(sa_device, sizeof(sa_device), "%s", sa_proxy_name(key));
	if (!SA_WAIT(sa_defined(sa_device, CONNECTION_PROPERTY_NAME), SA_TIMEOUT) || !sa_connect(sa_device)) {
		return false;
	}
	snprintf(guider_device, sizeof(guider_device), "%s (guider)", sa_device);
	return SA_WAIT(sa_defined(guider_device, CONNECTION_PROPERTY_NAME), SA_TIMEOUT) && sa_connect(guider_device);
}

// Simulator 0 with the given devices, the primary device connected, its guider connected.
static bool guider_begin(const char * const *arguments, bool camera) {
	guider_api = camera ? "/api/v1/camera/0/" : "/api/v1/telescope/0/";
	if (!sa_begin(arguments) || !sa_attach(camera ? "Camera Simulator" : MOUNT_LABEL) || !sa_connect(sa_device)) {
		return false;
	}
	snprintf(guider_device, sizeof(guider_device), "%s (guider)", sa_device);
	return SA_WAIT(sa_defined(guider_device, CONNECTION_PROPERTY_NAME), SA_TIMEOUT) && sa_connect(guider_device);
}

static int guider_count(const char *method, const char *member) {
	char path[128];
	snprintf(path, sizeof(path), "%s%s", guider_api, member);
	return sa_request_count(0, method, path);
}

// The parameters of the last PulseGuide start with the given text (the transaction IDs follow).
static bool guider_last(const char *parameters) {
	char path[128];
	snprintf(path, sizeof(path), "%spulseguide", guider_api);
	const char *line = sa_last_request(0, "PUT", path);
	if (line == NULL || strncmp(sa_field(line, "Body"), parameters, strlen(parameters))) {
		fprintf(stderr, "    last PUT pulseguide: %s\n", line != NULL ? sa_field(line, "Body") : "none");
		return false;
	}
	return true;
}

// Request a pulse without waiting for anything.
static bool guider_request(const char *property, const char *item, double duration) {
	return indigo_change_number_property_1(&sa_client, guider_device, property, item, duration) == INDIGO_OK;
}

// Request a pulse and wait until it is started: the property is BUSY and PulseGuide reached the device.
static bool guider_start(const char *property, const char *item, double duration) {
	int pulses = guider_count("PUT", "pulseguide");
	unsigned revision = sa_revision(guider_device, property);
	return guider_request(property, item, duration) && SA_WAIT(sa_state_after(guider_device, property, INDIGO_BUSY_STATE, revision) && guider_count("PUT", "pulseguide") == pulses + 1, SA_TIMEOUT) && sa_state(guider_device, property) == INDIGO_BUSY_STATE;
}

// Wait for the answer to a request made after the given revision: a state that is not BUSY. Returns it, -1 if there was none.
static int guider_answer(const char *property, unsigned revision) {
	if (!SA_WAIT(sa_revision(guider_device, property) > revision && sa_state(guider_device, property) != INDIGO_BUSY_STATE, 2 * SA_TIMEOUT)) {
		return -1;
	}
	return sa_state(guider_device, property);
}

// Request a pulse and wait for its end.
static int guider_pulse(const char *property, const char *item, double duration) {
	unsigned revision = sa_revision(guider_device, property);
	return guider_request(property, item, duration) ? guider_answer(property, revision) : -1;
}

// Both items of the property are zero.
static bool guider_zero(const char *property) {
	return sa_number(guider_device, property, sa_item_name(guider_device, property, 0)) == 0 && sa_number(guider_device, property, sa_item_name(guider_device, property, 1)) == 0;
}

// The driver looked at IsPulseGuiding at least the given number of times more than before.
static bool guider_watched(int before, int times) {
	return SA_WAIT(guider_count("GET", "ispulseguiding") >= before + times, SA_TIMEOUT);
}

// Nothing was asked of the device for 300 ms but the polls of the primary device.
static bool guider_quiet(void) {
	int pulses = guider_count("PUT", "pulseguide"), checks = guider_count("GET", "ispulseguiding");
	indigo_usleep(300000);
	return guider_count("PUT", "pulseguide") == pulses && guider_count("GET", "ispulseguiding") == checks;
}

// ---------------------------------------------------------------------------- properties

static void guider_properties(void) {
	static const char *no_guiding[] = { "--device", "telescope:CanPulseGuide=false", "--device", "camera:CanPulseGuide=false", NULL };
	for (int variant = 0; variant < 3; variant++) {
		bool camera = variant == 2;
		SA_CHECK(sa_begin(variant == 0 ? guider_telescope : variant == 1 ? mount_south_legacy : guider_camera) && sa_attach(camera ? "Camera Simulator" : MOUNT_LABEL));
		guider_api = camera ? "/api/v1/camera/0/" : "/api/v1/telescope/0/";
		snprintf(guider_device, sizeof(guider_device), "%s (guider)", sa_device);
		// the guider exists while its primary device is connected
		SA_CHECK(!sa_device_defined(guider_device) && sa_connect(sa_device) && SA_WAIT(sa_defined(guider_device, CONNECTION_PROPERTY_NAME), SA_TIMEOUT));
		SA_CHECK((core_interface(guider_device) & INDIGO_INTERFACE_GUIDER) == INDIGO_INTERFACE_GUIDER && sa_is_disconnected(guider_device) && guider_count("GET", "canpulseguide") == 1);
		SA_CHECK(!strcmp(sa_text(guider_device, INFO_PROPERTY_NAME, INFO_DEVICE_MODEL_ITEM_NAME), sa_text(sa_device, INFO_PROPERTY_NAME, INFO_DEVICE_MODEL_ITEM_NAME)));
		SA_CHECK(!sa_defined(guider_device, GUIDER_GUIDE_DEC_PROPERTY_NAME) && !sa_defined(guider_device, GUIDER_GUIDE_RA_PROPERTY_NAME));
		// it shares the connection of the primary device: connecting it sends nothing
		int puts = sa_request_count(0, "PUT", "/api/*");
		SA_CHECK(sa_connect(guider_device) && sa_request_count(0, "PUT", "/api/*") == puts);
		SA_CHECK(sa_item_count(guider_device, GUIDER_GUIDE_DEC_PROPERTY_NAME) == 2 && sa_has_item(guider_device, GUIDER_GUIDE_DEC_PROPERTY_NAME, GUIDER_GUIDE_NORTH_ITEM_NAME) && sa_has_item(guider_device, GUIDER_GUIDE_DEC_PROPERTY_NAME, GUIDER_GUIDE_SOUTH_ITEM_NAME));
		SA_CHECK(sa_item_count(guider_device, GUIDER_GUIDE_RA_PROPERTY_NAME) == 2 && sa_has_item(guider_device, GUIDER_GUIDE_RA_PROPERTY_NAME, GUIDER_GUIDE_EAST_ITEM_NAME) && sa_has_item(guider_device, GUIDER_GUIDE_RA_PROPERTY_NAME, GUIDER_GUIDE_WEST_ITEM_NAME));
		SA_CHECK(sa_state(guider_device, GUIDER_GUIDE_DEC_PROPERTY_NAME) == INDIGO_OK_STATE && sa_state(guider_device, GUIDER_GUIDE_RA_PROPERTY_NAME) == INDIGO_OK_STATE && sa_perm(guider_device, GUIDER_GUIDE_DEC_PROPERTY_NAME) == INDIGO_RW_PERM && sa_perm(guider_device, GUIDER_GUIDE_RA_PROPERTY_NAME) == INDIGO_RW_PERM);
		SA_CHECK(guider_zero(GUIDER_GUIDE_DEC_PROPERTY_NAME) && guider_zero(GUIDER_GUIDE_RA_PROPERTY_NAME));
		// a camera has no guide rate and the guide rates of a telescope are MOUNT_GUIDE_RATE of the mount: no GUIDER_RATE
		SA_CHECK(!sa_defined(guider_device, GUIDER_RATE_PROPERTY_NAME) && (camera || sa_defined(sa_device, MOUNT_GUIDE_RATE_PROPERTY_NAME)));
		// nothing is asked of the device for an idle guider
		SA_CHECK(guider_quiet() && guider_count("PUT", "pulseguide") == 0 && guider_count("GET", "ispulseguiding") == 0);
		// disconnected and connected again on its own
		SA_CHECK(sa_disconnect(guider_device) && !sa_defined(guider_device, GUIDER_GUIDE_DEC_PROPERTY_NAME) && sa_is_connected(sa_device) && sa_connect(guider_device) && sa_defined(guider_device, GUIDER_GUIDE_RA_PROPERTY_NAME) && sa_request_count(0, "PUT", "/api/*") == puts);
		SA_CHECK(sa_disconnect(sa_device) && SA_WAIT(!sa_device_defined(guider_device), SA_TIMEOUT));
		sa_end();
	}
	// devices that can not pulse guide have no guider, and PulseGuide and IsPulseGuiding are never asked for
	SA_CHECK(sa_begin(no_guiding) && sa_attach(MOUNT_LABEL) && sa_connect(sa_device));
	snprintf(guider_device, sizeof(guider_device), "%s (guider)", sa_device);
	SA_CHECK(mount_pause() && !sa_device_defined(guider_device) && mount_count("GET", "canpulseguide") == 1 && mount_count("GET", "ispulseguiding") == 0 && sa_disconnect(sa_device));
	SA_CHECK(sa_attach("Camera Simulator") && sa_connect(sa_device));
	snprintf(guider_device, sizeof(guider_device), "%s (guider)", sa_device);
	SA_CHECK(mount_pause() && !sa_device_defined(guider_device) && sa_request_count(0, "GET", "/api/v1/camera/0/canpulseguide") == 1 && sa_request_count(0, "GET", "/api/v1/camera/0/ispulseguiding") == 0 && sa_device_count("(guider)") == 0);
	SA_CHECK(sa_disconnect(sa_device));
cleanup:
	sa_end();
}

// ---------------------------------------------------------------------------- pulses

static void guider_directions_and_units(void) {
	const char *items[] = { GUIDER_GUIDE_NORTH_ITEM_NAME, GUIDER_GUIDE_SOUTH_ITEM_NAME };
	const double both[] = { 100, 200 };
	SA_CHECK(guider_begin(guider_telescope, false));
	double ra = mount_simulated("RightAscension"), dec = mount_simulated("Declination");
	// north: Direction 0, Duration in whole milliseconds; BUSY with the requested duration while the pulse lasts, OK with zeros afterwards
	unsigned revision = sa_revision(guider_device, GUIDER_GUIDE_DEC_PROPERTY_NAME);
	SA_CHECK(guider_start(GUIDER_GUIDE_DEC_PROPERTY_NAME, GUIDER_GUIDE_NORTH_ITEM_NAME, 400) && guider_last("Direction=0&Duration=400&ClientID=") && sa_number(guider_device, GUIDER_GUIDE_DEC_PROPERTY_NAME, GUIDER_GUIDE_NORTH_ITEM_NAME) == 400 && sa_number(guider_device, GUIDER_GUIDE_DEC_PROPERTY_NAME, GUIDER_GUIDE_SOUTH_ITEM_NAME) == 0);
	SA_CHECK(mount_simulated_is("IsPulseGuiding", "true") && sa_state(guider_device, GUIDER_GUIDE_RA_PROPERTY_NAME) == INDIGO_OK_STATE && sa_advance(0, 0.4) && guider_answer(GUIDER_GUIDE_DEC_PROPERTY_NAME, revision) == INDIGO_OK_STATE && guider_zero(GUIDER_GUIDE_DEC_PROPERTY_NAME));
	SA_CHECK(mount_near(mount_simulated("Declination"), dec + 0.4 * GUIDER_RATE, 1e-9) && mount_near(mount_simulated("RightAscension"), ra, 1e-12) && mount_simulated_is("IsPulseGuiding", "false"));
	// south: Direction 1
	SA_CHECK(guider_start(GUIDER_GUIDE_DEC_PROPERTY_NAME, GUIDER_GUIDE_SOUTH_ITEM_NAME, 250) && guider_last("Direction=1&Duration=250&ClientID=") && sa_number(guider_device, GUIDER_GUIDE_DEC_PROPERTY_NAME, GUIDER_GUIDE_SOUTH_ITEM_NAME) == 250 && sa_number(guider_device, GUIDER_GUIDE_DEC_PROPERTY_NAME, GUIDER_GUIDE_NORTH_ITEM_NAME) == 0);
	SA_CHECK(sa_advance(0, 0.25) && SA_WAIT(sa_state(guider_device, GUIDER_GUIDE_DEC_PROPERTY_NAME) == INDIGO_OK_STATE, SA_TIMEOUT) && guider_zero(GUIDER_GUIDE_DEC_PROPERTY_NAME) && mount_near(mount_simulated("Declination"), dec + 0.15 * GUIDER_RATE, 1e-9));
	// east: Direction 2, the right ascension grows
	SA_CHECK(guider_start(GUIDER_GUIDE_RA_PROPERTY_NAME, GUIDER_GUIDE_EAST_ITEM_NAME, 300) && guider_last("Direction=2&Duration=300&ClientID=") && sa_number(guider_device, GUIDER_GUIDE_RA_PROPERTY_NAME, GUIDER_GUIDE_EAST_ITEM_NAME) == 300 && sa_state(guider_device, GUIDER_GUIDE_DEC_PROPERTY_NAME) == INDIGO_OK_STATE);
	SA_CHECK(sa_advance(0, 0.3) && SA_WAIT(sa_state(guider_device, GUIDER_GUIDE_RA_PROPERTY_NAME) == INDIGO_OK_STATE, SA_TIMEOUT) && guider_zero(GUIDER_GUIDE_RA_PROPERTY_NAME) && mount_near(mount_simulated("RightAscension"), ra + 0.3 * GUIDER_RATE / 15, 1e-12));
	// west: Direction 3
	SA_CHECK(guider_start(GUIDER_GUIDE_RA_PROPERTY_NAME, GUIDER_GUIDE_WEST_ITEM_NAME, 150) && guider_last("Direction=3&Duration=150&ClientID=") && sa_number(guider_device, GUIDER_GUIDE_RA_PROPERTY_NAME, GUIDER_GUIDE_WEST_ITEM_NAME) == 150);
	SA_CHECK(sa_advance(0, 0.15) && SA_WAIT(sa_state(guider_device, GUIDER_GUIDE_RA_PROPERTY_NAME) == INDIGO_OK_STATE, SA_TIMEOUT) && guider_zero(GUIDER_GUIDE_RA_PROPERTY_NAME) && mount_near(mount_simulated("RightAscension"), ra + 0.15 * GUIDER_RATE / 15, 1e-12) && mount_near(mount_simulated("Declination"), dec + 0.15 * GUIDER_RATE, 1e-9));
	SA_CHECK(guider_count("PUT", "pulseguide") == 4 && mount_count("PUT", "*") == 5);
	// a fraction of a millisecond is rounded to the nearest whole one
	SA_CHECK(guider_start(GUIDER_GUIDE_DEC_PROPERTY_NAME, GUIDER_GUIDE_NORTH_ITEM_NAME, 123.6) && guider_last("Direction=0&Duration=124&ClientID=") && sa_advance(0, 0.124) && SA_WAIT(sa_state(guider_device, GUIDER_GUIDE_DEC_PROPERTY_NAME) == INDIGO_OK_STATE, SA_TIMEOUT));
	SA_CHECK(guider_start(GUIDER_GUIDE_RA_PROPERTY_NAME, GUIDER_GUIDE_WEST_ITEM_NAME, 20.4) && guider_last("Direction=3&Duration=20&ClientID=") && sa_advance(0, 0.02) && SA_WAIT(sa_state(guider_device, GUIDER_GUIDE_RA_PROPERTY_NAME) == INDIGO_OK_STATE, SA_TIMEOUT));
	// the longest pulse of the property
	SA_CHECK(guider_start(GUIDER_GUIDE_DEC_PROPERTY_NAME, GUIDER_GUIDE_SOUTH_ITEM_NAME, 10000) && guider_last("Direction=1&Duration=10000&ClientID=") && sa_advance(0, 10));
	// zero, and what rounds to zero, is a request to stop: without a pulse nothing is sent and the answer is OK
	int pulses = guider_count("PUT", "pulseguide");
	SA_CHECK(guider_pulse(GUIDER_GUIDE_RA_PROPERTY_NAME, GUIDER_GUIDE_EAST_ITEM_NAME, 0) == INDIGO_OK_STATE && guider_pulse(GUIDER_GUIDE_RA_PROPERTY_NAME, GUIDER_GUIDE_WEST_ITEM_NAME, 0.4) == INDIGO_OK_STATE && guider_zero(GUIDER_GUIDE_RA_PROPERTY_NAME) && guider_count("PUT", "pulseguide") == pulses);
	// the long pulse ends 10 s after it was started in real time at the earliest; then it is found over, because the device time is past it
	SA_CHECK(SA_WAIT(sa_state(guider_device, GUIDER_GUIDE_DEC_PROPERTY_NAME) == INDIGO_OK_STATE, 15) && guider_zero(GUIDER_GUIDE_DEC_PROPERTY_NAME));
	// both items of a property in one request: the first one wins, the telescope can not guide north and south at once
	revision = sa_revision(guider_device, GUIDER_GUIDE_DEC_PROPERTY_NAME);
	SA_CHECK(indigo_change_number_property(&sa_client, guider_device, GUIDER_GUIDE_DEC_PROPERTY_NAME, 2, items, both) == INDIGO_OK && SA_WAIT(guider_count("PUT", "pulseguide") == pulses + 1, SA_TIMEOUT) && guider_last("Direction=0&Duration=100&ClientID="));
	SA_CHECK(sa_advance(0, 0.1) && guider_answer(GUIDER_GUIDE_DEC_PROPERTY_NAME, revision) == INDIGO_OK_STATE && guider_zero(GUIDER_GUIDE_DEC_PROPERTY_NAME) && guider_count("PUT", "pulseguide") == pulses + 1);
	// the guide rates of the mount are the rates of the pulses: at 100 % of the sidereal rate a pulse moves twice as far
	dec = mount_simulated("Declination");
	SA_CHECK(mount_set_numbers(MOUNT_GUIDE_RATE_PROPERTY_NAME, MOUNT_GUIDE_RATE_RA_ITEM_NAME, 100, MOUNT_GUIDE_RATE_DEC_ITEM_NAME, 100) == INDIGO_OK_STATE && guider_start(GUIDER_GUIDE_DEC_PROPERTY_NAME, GUIDER_GUIDE_NORTH_ITEM_NAME, 500));
	SA_CHECK(sa_advance(0, 0.5) && SA_WAIT(sa_state(guider_device, GUIDER_GUIDE_DEC_PROPERTY_NAME) == INDIGO_OK_STATE, SA_TIMEOUT) && mount_near(mount_simulated("Declination"), dec + 0.5 * MOUNT_SIDEREAL, 1e-9));
	SA_CHECK(sa_disconnect(sa_device));
cleanup:
	sa_end();
}

static void guider_completion(void) {
	static const char *no_flag[] = { "--device", "telescope:interface=legacy,Tracking=true", NULL };
	SA_CHECK(guider_begin(guider_telescope, false));
	// IsPulseGuiding decides: not asked before the pulse can be over, then watched while it is true, and not asked any more when the pulse is over
	int checks = guider_count("GET", "ispulseguiding");
	unsigned revision = sa_revision(guider_device, GUIDER_GUIDE_DEC_PROPERTY_NAME);
	double started = indigo_monotonic_time();
	SA_CHECK(guider_start(GUIDER_GUIDE_DEC_PROPERTY_NAME, GUIDER_GUIDE_NORTH_ITEM_NAME, 400) && guider_count("GET", "ispulseguiding") == checks && guider_watched(checks, 1) && indigo_monotonic_time() - started >= 0.4);
	SA_CHECK(guider_watched(checks, 5) && sa_state(guider_device, GUIDER_GUIDE_DEC_PROPERTY_NAME) == INDIGO_BUSY_STATE && !sa_state_after(guider_device, GUIDER_GUIDE_DEC_PROPERTY_NAME, INDIGO_OK_STATE, revision) && sa_number(guider_device, GUIDER_GUIDE_DEC_PROPERTY_NAME, GUIDER_GUIDE_NORTH_ITEM_NAME) == 400);
	SA_CHECK(sa_advance(0, 0.4) && guider_answer(GUIDER_GUIDE_DEC_PROPERTY_NAME, revision) == INDIGO_OK_STATE);
	// the coordinates of the mount already show the pulse when it is reported over: the end of a pulse is followed by a poll tick,
	// the regular one may be a second away and a client that reads the coordinates at once would see where the pulse started
	SA_CHECK(mount_near(sa_number(sa_device, MOUNT_EQUATORIAL_COORDINATES_PROPERTY_NAME, MOUNT_EQUATORIAL_COORDINATES_DEC_ITEM_NAME), mount_simulated("Declination"), 1e-9));
	SA_CHECK(guider_zero(GUIDER_GUIDE_DEC_PROPERTY_NAME) && guider_quiet() && guider_count("PUT", "pulseguide") == 1);
	// the mount is not disturbed: its properties stay as they are
	SA_CHECK(sa_is_connected(sa_device) && sa_state(sa_device, MOUNT_EQUATORIAL_COORDINATES_PROPERTY_NAME) == INDIGO_OK_STATE && sa_switch(sa_device, MOUNT_TRACKING_PROPERTY_NAME, MOUNT_TRACKING_ON_ITEM_NAME));
	// a pulse that is over when its duration has passed (device time ran ahead) completes with the first look
	checks = guider_count("GET", "ispulseguiding");
	SA_CHECK(guider_start(GUIDER_GUIDE_RA_PROPERTY_NAME, GUIDER_GUIDE_EAST_ITEM_NAME, 300) && sa_advance(0, 0.3) && SA_WAIT(sa_state(guider_device, GUIDER_GUIDE_RA_PROPERTY_NAME) == INDIGO_OK_STATE, SA_TIMEOUT) && guider_count("GET", "ispulseguiding") == checks + 1);
	// the completion member fails: the pulse ends in ALERT with the reason, and is not watched any more
	checks = guider_count("GET", "ispulseguiding");
	revision = sa_revision(guider_device, GUIDER_GUIDE_DEC_PROPERTY_NAME);
	SA_CHECK(sa_fault(0, "GET", MOUNT_API "ispulseguiding", "ascom-error", "Value=1279&Message=Guide%20port%20fault") && guider_start(GUIDER_GUIDE_DEC_PROPERTY_NAME, GUIDER_GUIDE_SOUTH_ITEM_NAME, 200));
	SA_CHECK(guider_answer(GUIDER_GUIDE_DEC_PROPERTY_NAME, revision) == INDIGO_ALERT_STATE && mount_message("Guiding failed: device error (Guide port fault (0x4FF))") && guider_zero(GUIDER_GUIDE_DEC_PROPERTY_NAME) && guider_count("GET", "ispulseguiding") == checks + 1 && guider_quiet());
	SA_CHECK(sa_advance(0, 1) && sa_fault(0, "GET", MOUNT_API "ispulseguiding", "malformed-json", NULL));
	SA_CHECK(guider_start(GUIDER_GUIDE_RA_PROPERTY_NAME, GUIDER_GUIDE_WEST_ITEM_NAME, 200) && SA_WAIT(sa_state(guider_device, GUIDER_GUIDE_RA_PROPERTY_NAME) == INDIGO_ALERT_STATE, SA_TIMEOUT) && mount_message("Guiding failed: invalid reply") && guider_zero(GUIDER_GUIDE_RA_PROPERTY_NAME) && sa_advance(0, 1));
	// IsPulseGuiding does not become false: the pulse is given up 5 s after it should have ended
	revision = sa_revision(guider_device, GUIDER_GUIDE_DEC_PROPERTY_NAME);
	started = indigo_monotonic_time();
	SA_CHECK(guider_start(GUIDER_GUIDE_DEC_PROPERTY_NAME, GUIDER_GUIDE_NORTH_ITEM_NAME, 200) && guider_answer(GUIDER_GUIDE_DEC_PROPERTY_NAME, revision) == INDIGO_ALERT_STATE && mount_message("Guiding failed: timeout") && guider_zero(GUIDER_GUIDE_DEC_PROPERTY_NAME));
	SA_CHECK(indigo_monotonic_time() - started > 5 && indigo_monotonic_time() - started < 9 && guider_quiet() && sa_advance(0, 1) && sa_is_connected(guider_device));
	// a device whose PulseGuide returns only when the pulse is over (the reply comes 1.2 s after a pulse of 1 s was started): the pulse
	// is not waited for a second time, IsPulseGuiding is asked as soon as the reply is there
	SA_CHECK(sa_advance(0, 1) && sa_fault(0, "PUT", MOUNT_API "pulseguide", "stall-before", "Delay=1200"));
	revision = sa_revision(guider_device, GUIDER_GUIDE_RA_PROPERTY_NAME);
	checks = guider_count("PUT", "pulseguide");
	started = indigo_monotonic_time();
	SA_CHECK(guider_request(GUIDER_GUIDE_RA_PROPERTY_NAME, GUIDER_GUIDE_EAST_ITEM_NAME, 1000) && SA_WAIT(guider_count("PUT", "pulseguide") == checks + 1, SA_TIMEOUT) && sa_advance(0, 1) && guider_answer(GUIDER_GUIDE_RA_PROPERTY_NAME, revision) == INDIGO_OK_STATE);
	SA_CHECK(indigo_monotonic_time() - started > 1.1 && indigo_monotonic_time() - started < 1.9 && guider_zero(GUIDER_GUIDE_RA_PROPERTY_NAME));
	// and the next pulse is OK
	SA_CHECK(guider_start(GUIDER_GUIDE_DEC_PROPERTY_NAME, GUIDER_GUIDE_NORTH_ITEM_NAME, 100) && sa_advance(0, 0.1) && SA_WAIT(sa_state(guider_device, GUIDER_GUIDE_DEC_PROPERTY_NAME) == INDIGO_OK_STATE, SA_TIMEOUT) && guider_zero(GUIDER_GUIDE_DEC_PROPERTY_NAME));
	SA_CHECK(sa_disconnect(sa_device));
	sa_end();
	// a device without IsPulseGuiding: the member is asked once, and from then on a pulse is over when its duration has passed
	SA_CHECK(sa_begin(no_flag) && sa_attach(MOUNT_LABEL) && sa_put(0, MOUNT_ERROR, "Member=ispulseguiding&ErrorNumber=1024") && sa_connect(sa_device));
	snprintf(guider_device, sizeof(guider_device), "%s (guider)", sa_device);
	guider_api = MOUNT_API;
	SA_CHECK(SA_WAIT(sa_defined(guider_device, CONNECTION_PROPERTY_NAME), SA_TIMEOUT) && sa_connect(guider_device));
	for (int i = 0; i < 3; i++) {
		revision = sa_revision(guider_device, GUIDER_GUIDE_RA_PROPERTY_NAME);
		started = indigo_monotonic_time();
		SA_CHECK(guider_start(GUIDER_GUIDE_RA_PROPERTY_NAME, i == 1 ? GUIDER_GUIDE_WEST_ITEM_NAME : GUIDER_GUIDE_EAST_ITEM_NAME, 300) && guider_answer(GUIDER_GUIDE_RA_PROPERTY_NAME, revision) == INDIGO_OK_STATE && guider_zero(GUIDER_GUIDE_RA_PROPERTY_NAME));
		SA_CHECK(indigo_monotonic_time() - started >= 0.3 && indigo_monotonic_time() - started < 3 && guider_count("GET", "ispulseguiding") == 1 && guider_count("PUT", "pulseguide") == i + 1 && sa_advance(0, 0.3));
	}
	SA_CHECK(sa_disconnect(sa_device));
cleanup:
	sa_end();
}

static void guider_request_failures(void) {
	SA_CHECK(sa_begin(guider_telescope) && sa_set_number("X_ALPACA_TIMEOUTS", "LONG", 1) == INDIGO_OK_STATE && sa_attach(MOUNT_LABEL) && sa_connect(sa_device));
	snprintf(guider_device, sizeof(guider_device), "%s (guider)", sa_device);
	guider_api = MOUNT_API;
	SA_CHECK(SA_WAIT(sa_defined(guider_device, CONNECTION_PROPERTY_NAME), SA_TIMEOUT) && sa_connect(guider_device));
	// PulseGuide is refused: ALERT with the reason of the device, zeros, IsPulseGuiding is not asked for
	const char *faults[][3] = { { "ascom-error", "Value=1025&Message=Duration%20too%20long", "Guiding failed: invalid value (Duration too long (0x401))" }, { "ascom-error", "Value=1035&Message=Guide%20port%20disabled", "Guiding failed: invalid operation (Guide port disabled (0x40B))" }, { "ascom-error", "Value=1279&Message=Relay%20stuck", "Guiding failed: device error (Relay stuck (0x4FF))" }, { "http-status", "Value=500&Message=Driver%20crashed", "Guiding failed: server error (HTTP 500: Driver crashed)" } };
	for (int i = 0; i < 4; i++) {
		const char *property = i % 2 ? GUIDER_GUIDE_RA_PROPERTY_NAME : GUIDER_GUIDE_DEC_PROPERTY_NAME;
		unsigned revision = sa_revision(guider_device, property);
		SA_CHECK(sa_fault(0, "PUT", MOUNT_API "pulseguide", faults[i][0], faults[i][1]) && guider_pulse(property, i % 2 ? GUIDER_GUIDE_WEST_ITEM_NAME : GUIDER_GUIDE_SOUTH_ITEM_NAME, 300) == INDIGO_ALERT_STATE && mount_message(faults[i][2]));
		SA_CHECK(sa_state_after(guider_device, property, INDIGO_BUSY_STATE, revision) && guider_zero(property) && guider_count("PUT", "pulseguide") == i + 1 && guider_count("GET", "ispulseguiding") == 0 && mount_simulated_is("IsPulseGuiding", "false"));
	}
	// an answer that is no answer, and no answer in time: the device did get the pulse, which is never sent again; ALERT, because nobody knows what the device did
	SA_CHECK(sa_fault(0, "PUT", MOUNT_API "pulseguide", "malformed-json", NULL) && guider_pulse(GUIDER_GUIDE_DEC_PROPERTY_NAME, GUIDER_GUIDE_NORTH_ITEM_NAME, 300) == INDIGO_ALERT_STATE && mount_message("Guiding failed: invalid reply") && guider_count("PUT", "pulseguide") == 5);
	SA_CHECK(mount_simulated_is("IsPulseGuiding", "true") && sa_advance(0, 1) && guider_quiet() && guider_count("PUT", "pulseguide") == 5);
	SA_CHECK(sa_fault(0, "PUT", MOUNT_API "pulseguide", "stall-before", "Delay=1500"));
	double started = indigo_monotonic_time();
	SA_CHECK(guider_pulse(GUIDER_GUIDE_RA_PROPERTY_NAME, GUIDER_GUIDE_EAST_ITEM_NAME, 300) == INDIGO_ALERT_STATE && mount_message("Guiding failed: timeout") && indigo_monotonic_time() - started > 0.8 && indigo_monotonic_time() - started < 4 && guider_zero(GUIDER_GUIDE_RA_PROPERTY_NAME));
	SA_CHECK(sa_advance(0, 1) && guider_quiet() && guider_count("PUT", "pulseguide") == 6 && sa_is_connected(sa_device) && sa_is_connected(guider_device));
	// what the telescope itself refuses: a pulse while it slews, and a pulse while it is parked
	SA_CHECK(mount_request_coordinates(3.5, -52.25) && SA_WAIT(mount_simulated_is("Slewing", "true"), SA_TIMEOUT));
	SA_CHECK(guider_pulse(GUIDER_GUIDE_DEC_PROPERTY_NAME, GUIDER_GUIDE_NORTH_ITEM_NAME, 300) == INDIGO_ALERT_STATE && mount_message("Guiding failed: invalid operation (PulseGuide is not allowed while slewing (0x40B))") && sa_state(sa_device, MOUNT_EQUATORIAL_COORDINATES_PROPERTY_NAME) == INDIGO_BUSY_STATE);
	unsigned revision = sa_revision(sa_device, MOUNT_PARK_PROPERTY_NAME);
	SA_CHECK(sa_advance(0, 30) && SA_WAIT(sa_state(sa_device, MOUNT_EQUATORIAL_COORDINATES_PROPERTY_NAME) == INDIGO_OK_STATE, SA_TIMEOUT) && mount_start_switch(MOUNT_PARK_PROPERTY_NAME, MOUNT_PARK_PARKED_ITEM_NAME) && SA_WAIT(mount_simulated_is("Slewing", "true"), SA_TIMEOUT) && sa_advance(0, 60) && SA_WAIT(sa_state_after(sa_device, MOUNT_PARK_PROPERTY_NAME, INDIGO_OK_STATE, revision), SA_TIMEOUT));
	SA_CHECK(guider_pulse(GUIDER_GUIDE_RA_PROPERTY_NAME, GUIDER_GUIDE_WEST_ITEM_NAME, 300) == INDIGO_ALERT_STATE && mount_message("Guiding failed: invalid while parked (PulseGuide is not allowed while the telescope is parked (0x408))") && guider_zero(GUIDER_GUIDE_RA_PROPERTY_NAME));
	// after all of that a pulse works
	SA_CHECK(mount_set_switch(MOUNT_PARK_PROPERTY_NAME, MOUNT_PARK_UNPARKED_ITEM_NAME, true) == INDIGO_OK_STATE && guider_start(GUIDER_GUIDE_RA_PROPERTY_NAME, GUIDER_GUIDE_WEST_ITEM_NAME, 300) && sa_advance(0, 0.3) && SA_WAIT(sa_state(guider_device, GUIDER_GUIDE_RA_PROPERTY_NAME) == INDIGO_OK_STATE, SA_TIMEOUT));
	SA_CHECK(sa_disconnect(sa_device));
cleanup:
	sa_end();
}

static void guider_replacement_and_axes(void) {
	static const char *single_axis[] = { "--device", "telescope:EquatorialSystem=2,Tracking=true,DualAxisPulseGuide=false", NULL };
	SA_CHECK(guider_begin(guider_telescope, false));
	double ra = mount_simulated("RightAscension"), dec = mount_simulated("Declination");
	// both axes at once: two pulses, each completed on its own. IsPulseGuiding is one flag for both, so the shorter pulse is over when its
	// duration has passed (in real time) while the longer one still runs, and completing it sends nothing that would stop the other one
	unsigned ra_revision = sa_revision(guider_device, GUIDER_GUIDE_RA_PROPERTY_NAME), dec_revision = sa_revision(guider_device, GUIDER_GUIDE_DEC_PROPERTY_NAME);
	SA_CHECK(guider_start(GUIDER_GUIDE_DEC_PROPERTY_NAME, GUIDER_GUIDE_NORTH_ITEM_NAME, 1500) && guider_start(GUIDER_GUIDE_RA_PROPERTY_NAME, GUIDER_GUIDE_EAST_ITEM_NAME, 300) && guider_count("PUT", "pulseguide") == 2);
	SA_CHECK(guider_answer(GUIDER_GUIDE_RA_PROPERTY_NAME, ra_revision) == INDIGO_OK_STATE && guider_zero(GUIDER_GUIDE_RA_PROPERTY_NAME) && sa_state(guider_device, GUIDER_GUIDE_DEC_PROPERTY_NAME) == INDIGO_BUSY_STATE && sa_number(guider_device, GUIDER_GUIDE_DEC_PROPERTY_NAME, GUIDER_GUIDE_NORTH_ITEM_NAME) == 1500);
	SA_CHECK(guider_count("PUT", "pulseguide") == 2 && guider_count("GET", "ispulseguiding") == 0 && mount_simulated_is("IsPulseGuiding", "true") && !sa_state_after(guider_device, GUIDER_GUIDE_DEC_PROPERTY_NAME, INDIGO_OK_STATE, dec_revision));
	// the longer one is completed by IsPulseGuiding
	SA_CHECK(guider_watched(0, 3) && sa_state(guider_device, GUIDER_GUIDE_DEC_PROPERTY_NAME) == INDIGO_BUSY_STATE && sa_advance(0, 1.5) && guider_answer(GUIDER_GUIDE_DEC_PROPERTY_NAME, dec_revision) == INDIGO_OK_STATE && guider_zero(GUIDER_GUIDE_DEC_PROPERTY_NAME));
	SA_CHECK(mount_near(mount_simulated("Declination"), dec + 1.5 * GUIDER_RATE, 1e-9) && mount_near(mount_simulated("RightAscension"), ra + 0.3 * GUIDER_RATE / 15, 1e-12) && guider_count("PUT", "pulseguide") == 2 && guider_quiet());
	// a new request for an axis whose pulse runs replaces it: one more PulseGuide, the completion of the first pulse is forgotten
	dec = mount_simulated("Declination");
	dec_revision = sa_revision(guider_device, GUIDER_GUIDE_DEC_PROPERTY_NAME);
	SA_CHECK(guider_start(GUIDER_GUIDE_DEC_PROPERTY_NAME, GUIDER_GUIDE_NORTH_ITEM_NAME, 3000) && guider_start(GUIDER_GUIDE_DEC_PROPERTY_NAME, GUIDER_GUIDE_NORTH_ITEM_NAME, 300) && guider_last("Direction=0&Duration=300&ClientID=") && guider_count("PUT", "pulseguide") == 4);
	SA_CHECK(sa_number(guider_device, GUIDER_GUIDE_DEC_PROPERTY_NAME, GUIDER_GUIDE_NORTH_ITEM_NAME) == 300 && sa_advance(0, 0.3) && guider_answer(GUIDER_GUIDE_DEC_PROPERTY_NAME, dec_revision) == INDIGO_OK_STATE && guider_zero(GUIDER_GUIDE_DEC_PROPERTY_NAME) && mount_near(mount_simulated("Declination"), dec + 0.3 * GUIDER_RATE, 1e-9));
	// a reversal is a replacement, too; the old pulse does not complete the new one when its time comes (0.6 s after its start): the
	// queue runs its tasks in the order of their time, so once eight poll ticks of 0.1 s have run after the replacement, the finalizer of
	// the old pulse would have run as well
	dec_revision = sa_revision(guider_device, GUIDER_GUIDE_DEC_PROPERTY_NAME);
	SA_CHECK(guider_start(GUIDER_GUIDE_DEC_PROPERTY_NAME, GUIDER_GUIDE_NORTH_ITEM_NAME, 600) && guider_start(GUIDER_GUIDE_DEC_PROPERTY_NAME, GUIDER_GUIDE_SOUTH_ITEM_NAME, 5000) && guider_last("Direction=1&Duration=5000&ClientID=") && sa_number(guider_device, GUIDER_GUIDE_DEC_PROPERTY_NAME, GUIDER_GUIDE_NORTH_ITEM_NAME) == 0 && sa_number(guider_device, GUIDER_GUIDE_DEC_PROPERTY_NAME, GUIDER_GUIDE_SOUTH_ITEM_NAME) == 5000);
	int ticks = mount_count("GET", "devicestate");
	SA_CHECK(SA_WAIT(mount_count("GET", "devicestate") >= ticks + 8, SA_TIMEOUT));
	SA_CHECK(sa_state(guider_device, GUIDER_GUIDE_DEC_PROPERTY_NAME) == INDIGO_BUSY_STATE && !sa_state_after(guider_device, GUIDER_GUIDE_DEC_PROPERTY_NAME, INDIGO_OK_STATE, dec_revision) && sa_number(guider_device, GUIDER_GUIDE_DEC_PROPERTY_NAME, GUIDER_GUIDE_SOUTH_ITEM_NAME) == 5000 && guider_count("PUT", "pulseguide") == 6);
	// a zero request ends the running pulse: PulseGuide with Duration 0 for its direction, OK at once
	int checks = guider_count("GET", "ispulseguiding");
	SA_CHECK(guider_pulse(GUIDER_GUIDE_DEC_PROPERTY_NAME, GUIDER_GUIDE_SOUTH_ITEM_NAME, 0) == INDIGO_OK_STATE && guider_last("Direction=1&Duration=0&ClientID=") && guider_zero(GUIDER_GUIDE_DEC_PROPERTY_NAME) && mount_simulated_is("IsPulseGuiding", "false") && guider_count("PUT", "pulseguide") == 7);
	SA_CHECK(guider_quiet() && guider_count("GET", "ispulseguiding") == checks && guider_pulse(GUIDER_GUIDE_DEC_PROPERTY_NAME, GUIDER_GUIDE_SOUTH_ITEM_NAME, 0) == INDIGO_OK_STATE && guider_count("PUT", "pulseguide") == 7);
	// a device that refuses to end a pulse leaves the stop in ALERT
	SA_CHECK(guider_start(GUIDER_GUIDE_RA_PROPERTY_NAME, GUIDER_GUIDE_WEST_ITEM_NAME, 4000) && sa_fault(0, "PUT", MOUNT_API "pulseguide", "ascom-error", "Value=1025&Message=Duration%200%20is%20not%20allowed"));
	SA_CHECK(guider_pulse(GUIDER_GUIDE_RA_PROPERTY_NAME, GUIDER_GUIDE_WEST_ITEM_NAME, 0) == INDIGO_ALERT_STATE && mount_message("Guiding stop failed: invalid value (Duration 0 is not allowed (0x401))") && guider_zero(GUIDER_GUIDE_RA_PROPERTY_NAME) && sa_advance(0, 4) && guider_quiet());
	// requests that pile up for one axis while the queue of the device is busy are coalesced: only the last one is sent
	int pulses = guider_count("PUT", "pulseguide");
	ra_revision = sa_revision(guider_device, GUIDER_GUIDE_RA_PROPERTY_NAME);
	SA_CHECK(mount_close_gate() && guider_request(GUIDER_GUIDE_RA_PROPERTY_NAME, GUIDER_GUIDE_EAST_ITEM_NAME, 100) && guider_request(GUIDER_GUIDE_RA_PROPERTY_NAME, GUIDER_GUIDE_WEST_ITEM_NAME, 200) && guider_request(GUIDER_GUIDE_RA_PROPERTY_NAME, GUIDER_GUIDE_EAST_ITEM_NAME, 300));
	atomic_store(&mount_gate_open, true);
	SA_CHECK(SA_WAIT(guider_count("PUT", "pulseguide") == pulses + 1, SA_TIMEOUT) && guider_last("Direction=2&Duration=300&ClientID=") && sa_advance(0, 0.3) && guider_answer(GUIDER_GUIDE_RA_PROPERTY_NAME, ra_revision) == INDIGO_OK_STATE && guider_zero(GUIDER_GUIDE_RA_PROPERTY_NAME) && guider_count("PUT", "pulseguide") == pulses + 1);
	// the completion of a pulse and its replacement arrive in this order: the completion that finds a newer request waiting leaves the property to it,
	// so the new pulse is not reported as over by the old one
	dec_revision = sa_revision(guider_device, GUIDER_GUIDE_DEC_PROPERTY_NAME);
	SA_CHECK(guider_start(GUIDER_GUIDE_DEC_PROPERTY_NAME, GUIDER_GUIDE_NORTH_ITEM_NAME, 200) && mount_close_gate() && sa_advance(0, 0.2));
	indigo_usleep(400000);
	checks = guider_count("GET", "ispulseguiding");
	SA_CHECK(guider_request(GUIDER_GUIDE_DEC_PROPERTY_NAME, GUIDER_GUIDE_SOUTH_ITEM_NAME, 800));
	atomic_store(&mount_gate_open, true);
	SA_CHECK(SA_WAIT(guider_count("PUT", "pulseguide") == pulses + 3, SA_TIMEOUT) && guider_last("Direction=1&Duration=800&ClientID=") && guider_watched(checks, 3) && sa_state(guider_device, GUIDER_GUIDE_DEC_PROPERTY_NAME) == INDIGO_BUSY_STATE && !sa_state_after(guider_device, GUIDER_GUIDE_DEC_PROPERTY_NAME, INDIGO_OK_STATE, dec_revision));
	SA_CHECK(sa_number(guider_device, GUIDER_GUIDE_DEC_PROPERTY_NAME, GUIDER_GUIDE_SOUTH_ITEM_NAME) == 800 && sa_advance(0, 0.8) && guider_answer(GUIDER_GUIDE_DEC_PROPERTY_NAME, dec_revision) == INDIGO_OK_STATE && guider_zero(GUIDER_GUIDE_DEC_PROPERTY_NAME));
	SA_CHECK(sa_disconnect(sa_device));
	sa_end();
	// a telescope that guides one axis at a time refuses the second pulse; the first one is not disturbed
	SA_CHECK(guider_begin(single_axis, false));
	dec_revision = sa_revision(guider_device, GUIDER_GUIDE_DEC_PROPERTY_NAME);
	SA_CHECK(guider_start(GUIDER_GUIDE_DEC_PROPERTY_NAME, GUIDER_GUIDE_NORTH_ITEM_NAME, 1000) && guider_pulse(GUIDER_GUIDE_RA_PROPERTY_NAME, GUIDER_GUIDE_EAST_ITEM_NAME, 300) == INDIGO_ALERT_STATE && mount_message("Guiding failed: invalid operation (PulseGuide in both axes at the same time is not supported (0x40B))"));
	SA_CHECK(guider_zero(GUIDER_GUIDE_RA_PROPERTY_NAME) && sa_state(guider_device, GUIDER_GUIDE_DEC_PROPERTY_NAME) == INDIGO_BUSY_STATE && sa_advance(0, 1) && guider_answer(GUIDER_GUIDE_DEC_PROPERTY_NAME, dec_revision) == INDIGO_OK_STATE);
	SA_CHECK(guider_start(GUIDER_GUIDE_RA_PROPERTY_NAME, GUIDER_GUIDE_EAST_ITEM_NAME, 300) && sa_advance(0, 0.3) && SA_WAIT(sa_state(guider_device, GUIDER_GUIDE_RA_PROPERTY_NAME) == INDIGO_OK_STATE, SA_TIMEOUT));
	SA_CHECK(sa_disconnect(sa_device));
cleanup:
	atomic_store(&mount_gate_open, true);
	sa_end();
}

// REV-4: the durations of a request are the ones INDIGO accepted (the items allow 0 to 10000 ms), not the raw values of the request.
static void guider_duration_limits(void) {
	SA_CHECK(guider_begin(guider_telescope, false));
	unsigned revision = sa_revision(guider_device, GUIDER_GUIDE_DEC_PROPERTY_NAME);
	SA_CHECK(guider_start(GUIDER_GUIDE_DEC_PROPERTY_NAME, GUIDER_GUIDE_NORTH_ITEM_NAME, 60000) && guider_last("Direction=0&Duration=10000&ClientID=") && sa_number(guider_device, GUIDER_GUIDE_DEC_PROPERTY_NAME, GUIDER_GUIDE_NORTH_ITEM_NAME) == 10000);
	SA_CHECK(guider_pulse(GUIDER_GUIDE_DEC_PROPERTY_NAME, GUIDER_GUIDE_NORTH_ITEM_NAME, 0) == INDIGO_OK_STATE && guider_last("Direction=0&Duration=0&ClientID=") && guider_zero(GUIDER_GUIDE_DEC_PROPERTY_NAME) && sa_revision(guider_device, GUIDER_GUIDE_DEC_PROPERTY_NAME) > revision);
	// a value that is not finite is not taken: a request with nothing else is a stop, nothing is sent while no pulse runs
	int pulses = guider_count("PUT", "pulseguide");
	SA_CHECK(guider_pulse(GUIDER_GUIDE_RA_PROPERTY_NAME, GUIDER_GUIDE_EAST_ITEM_NAME, NAN) == INDIGO_OK_STATE && guider_count("PUT", "pulseguide") == pulses && guider_zero(GUIDER_GUIDE_RA_PROPERTY_NAME));
	SA_CHECK(sa_disconnect(sa_device));
cleanup:
	sa_end();
}

// ---------------------------------------------------------------------------- detach while a pulse is requested (REV-1)

static atomic_bool guider_detach_gate_open = true;
static atomic_bool guider_detach_gate_entered = false;

// Never runs: the detach removes it from the queue, which tells the case how far the detach is.
static void guider_detach_marker(indigo_device *device) {
	(void)device;
}

// A task of the guider that runs on the queue of the telescope without the lock of the device (an ordinary handler has it): while it
// runs, the detach of the telescope waits for it after the queue of the guider was emptied. When it is opened it sends a guide request
// from the queue, so the handler of that request is queued before the task ends.
static void guider_detach_gate(indigo_device *device) {
	atomic_store(&guider_detach_gate_entered, true);
	double deadline = indigo_monotonic_time() + 30;
	while (!atomic_load(&guider_detach_gate_open) && indigo_monotonic_time() < deadline) {
		indigo_usleep(1000);
	}
	indigo_change_number_property_1(&sa_client, device->name, GUIDER_GUIDE_RA_PROPERTY_NAME, GUIDER_GUIDE_EAST_ITEM_NAME, 100);
}

// The telescope is detached (deselected) while a guide request arrives. The detach empties the queue of the guider and then closes
// both sessions with the lock of the device of the framework held. A guider task that queued a finalizer after the queue was emptied
// let the guider finalizer become due while that lock was held: the queue took it and waited for the lock, and on_disconnect of the
// guider, which cancelled its finalizers, waited for that running finalizer for ever. The driver queue hung: no further discovery,
// attach, detach or shutdown. Ordered by conditions on the queue: the gate holds the queue while the detach waits for it, the marker
// shows that the queue of the guider was emptied, PulseGuide with Duration 0 of on_disconnect is held 3 s by the simulator so that the
// finalizer (0.1 s) is due while the lock is held.
static void guider_detach_with_pulse_requested(void) {
	char key[INDIGO_NAME_SIZE];
	indigo_device *guider = NULL;
	SA_CHECK(guider_begin(guider_telescope, false));
	snprintf(key, sizeof(key), "%s", sa_device_key(MOUNT_LABEL));
	SA_CHECK((guider = sa_device_pointer(guider_device)) != NULL && sa_queue(guider) != NULL);
	SA_CHECK(sa_fault(0, "PUT", MOUNT_API "pulseguide", "stall-before", "Delay=3000&Skip=1"));
	indigo_queue_add(sa_queue(guider), guider, INDIGO_TASK_PRIORITY_NORMAL, 3600, guider_detach_marker, NULL);
	atomic_store(&guider_detach_gate_open, false);
	atomic_store(&guider_detach_gate_entered, false);
	indigo_queue_add(sa_queue(guider), guider, INDIGO_TASK_PRIORITY_URGENT, 0, guider_detach_gate, NULL);
	SA_CHECK(SA_WAIT(atomic_load(&guider_detach_gate_entered), SA_TIMEOUT) && sa_queue_has(guider, guider_detach_marker));
	SA_CHECK(sa_select(key, false) && SA_WAIT(!sa_queue_has(guider, guider_detach_marker), SA_TIMEOUT));
	atomic_store(&guider_detach_gate_open, true);
	// the detach finishes, the device is available again, and the driver works: it is attached and connected again and can guide
	SA_CHECK(SA_WAIT(!sa_device_defined(sa_device) && !sa_device_defined(guider_device) && sa_device_status_is(key, "AVAILABLE"), 2 * SA_TIMEOUT));
	SA_CHECK(sa_discover() && guider_begin_attached(key));
	unsigned revision = sa_revision(guider_device, GUIDER_GUIDE_RA_PROPERTY_NAME);
	SA_CHECK(sa_clear_faults(0) && guider_start(GUIDER_GUIDE_RA_PROPERTY_NAME, GUIDER_GUIDE_EAST_ITEM_NAME, 100) && sa_advance(0, 0.1) && guider_answer(GUIDER_GUIDE_RA_PROPERTY_NAME, revision) == INDIGO_OK_STATE);
	SA_CHECK(sa_disconnect(sa_device));
cleanup:
	atomic_store(&guider_detach_gate_open, true);
	sa_end();
}

// ---------------------------------------------------------------------------- shared device and lifetime

static void guider_shared_lifetime(void) {
	char key[INDIGO_NAME_SIZE];
	SA_CHECK(sa_begin(guider_telescope));
	snprintf(key, sizeof(key), "%s", sa_device_key(MOUNT_LABEL));
	guider_api = MOUNT_API;
	SA_CHECK(sa_attach(MOUNT_LABEL) && sa_connect(sa_device));
	snprintf(guider_device, sizeof(guider_device), "%s (guider)", sa_device);
	SA_CHECK(SA_WAIT(sa_defined(guider_device, CONNECTION_PROPERTY_NAME), SA_TIMEOUT) && sa_connect(guider_device));
	// the mount works while a pulse runs: both devices share the Alpaca device and the queue, neither blocks the other
	unsigned revision = sa_revision(guider_device, GUIDER_GUIDE_DEC_PROPERTY_NAME);
	int polls = mount_count("GET", "devicestate");
	SA_CHECK(guider_start(GUIDER_GUIDE_DEC_PROPERTY_NAME, GUIDER_GUIDE_NORTH_ITEM_NAME, 1500) && mount_select(MOUNT_TRACK_RATE_PROPERTY_NAME, MOUNT_TRACK_RATE_SOLAR_ITEM_NAME) && mount_set_numbers(MOUNT_GUIDE_RATE_PROPERTY_NAME, MOUNT_GUIDE_RATE_RA_ITEM_NAME, 60, MOUNT_GUIDE_RATE_DEC_ITEM_NAME, 50) == INDIGO_OK_STATE);
	SA_CHECK(SA_WAIT(mount_count("GET", "devicestate") >= polls + 5, SA_TIMEOUT) && sa_state(guider_device, GUIDER_GUIDE_DEC_PROPERTY_NAME) == INDIGO_BUSY_STATE && mount_simulated_is("IsPulseGuiding", "true") && sa_state(sa_device, MOUNT_EQUATORIAL_COORDINATES_PROPERTY_NAME) == INDIGO_OK_STATE);
	SA_CHECK(sa_advance(0, 1.5) && guider_answer(GUIDER_GUIDE_DEC_PROPERTY_NAME, revision) == INDIGO_OK_STATE && mount_select(MOUNT_TRACK_RATE_PROPERTY_NAME, MOUNT_TRACK_RATE_SIDEREAL_ITEM_NAME));
	// the guider is disconnected with a pulse on each axis: both are ended with a Duration of 0, nothing is watched any more,
	// and the mount, which holds the connection, stays connected and works
	SA_CHECK(guider_start(GUIDER_GUIDE_DEC_PROPERTY_NAME, GUIDER_GUIDE_SOUTH_ITEM_NAME, 4000) && guider_start(GUIDER_GUIDE_RA_PROPERTY_NAME, GUIDER_GUIDE_WEST_ITEM_NAME, 5000));
	int pulses = guider_count("PUT", "pulseguide");
	SA_CHECK(sa_disconnect(guider_device) && guider_count("PUT", "pulseguide") == pulses + 2 && guider_last("Direction=3&Duration=0&ClientID=") && mount_simulated_is("IsPulseGuiding", "false") && !sa_defined(guider_device, GUIDER_GUIDE_DEC_PROPERTY_NAME));
	SA_CHECK(sa_is_connected(sa_device) && mount_simulated_is("Connected", "true") && mount_count("PUT", "disconnect") == 0 && guider_quiet() && mount_select(MOUNT_TRACKING_PROPERTY_NAME, MOUNT_TRACKING_OFF_ITEM_NAME) && mount_select(MOUNT_TRACKING_PROPERTY_NAME, MOUNT_TRACKING_ON_ITEM_NAME));
	// connected again it starts clean: nothing is BUSY, and a pulse works
	SA_CHECK(sa_connect(guider_device) && sa_state(guider_device, GUIDER_GUIDE_DEC_PROPERTY_NAME) == INDIGO_OK_STATE && sa_state(guider_device, GUIDER_GUIDE_RA_PROPERTY_NAME) == INDIGO_OK_STATE && guider_zero(GUIDER_GUIDE_DEC_PROPERTY_NAME) && guider_zero(GUIDER_GUIDE_RA_PROPERTY_NAME));
	SA_CHECK(guider_start(GUIDER_GUIDE_RA_PROPERTY_NAME, GUIDER_GUIDE_EAST_ITEM_NAME, 200) && sa_advance(0, 0.2) && SA_WAIT(sa_state(guider_device, GUIDER_GUIDE_RA_PROPERTY_NAME) == INDIGO_OK_STATE, SA_TIMEOUT));
	// the mount is disconnected with a pulse running: the pulse is ended before the Alpaca device is disconnected, the guider is gone with its mount, nothing is asked afterwards
	SA_CHECK(guider_start(GUIDER_GUIDE_DEC_PROPERTY_NAME, GUIDER_GUIDE_NORTH_ITEM_NAME, 5000));
	pulses = guider_count("PUT", "pulseguide");
	SA_CHECK(sa_disconnect(sa_device) && SA_WAIT(!sa_device_defined(guider_device), SA_TIMEOUT) && guider_count("PUT", "pulseguide") == pulses + 1 && guider_last("Direction=0&Duration=0&ClientID=") && mount_sequence("PUT", "pulseguide") < mount_sequence("PUT", "disconnect"));
	int requests = sa_request_count(0, NULL, "/api/*");
	indigo_usleep(300000);
	SA_CHECK(sa_request_count(0, NULL, "/api/*") == requests && mount_simulated_is("IsPulseGuiding", "false") && mount_simulated_is("Connected", "false"));
	// the next connection brings a new guider that works
	SA_CHECK(sa_connect(sa_device) && SA_WAIT(sa_defined(guider_device, CONNECTION_PROPERTY_NAME), SA_TIMEOUT) && sa_is_disconnected(guider_device) && sa_connect(guider_device) && sa_state(guider_device, GUIDER_GUIDE_DEC_PROPERTY_NAME) == INDIGO_OK_STATE && guider_zero(GUIDER_GUIDE_DEC_PROPERTY_NAME));
	SA_CHECK(guider_start(GUIDER_GUIDE_DEC_PROPERTY_NAME, GUIDER_GUIDE_SOUTH_ITEM_NAME, 200) && sa_advance(0, 0.2) && SA_WAIT(sa_state(guider_device, GUIDER_GUIDE_DEC_PROPERTY_NAME) == INDIGO_OK_STATE, SA_TIMEOUT));
	// the server goes away in the middle of a pulse on each axis: mount and guider leave the connected state, nothing hangs, nothing is asked any more
	SA_CHECK(guider_start(GUIDER_GUIDE_DEC_PROPERTY_NAME, GUIDER_GUIDE_NORTH_ITEM_NAME, 300) && guider_start(GUIDER_GUIDE_RA_PROPERTY_NAME, GUIDER_GUIDE_EAST_ITEM_NAME, 400) && sa_fault(0, NULL, MOUNT_API "*", "reset", "Count=-1"));
	double started = indigo_monotonic_time();
	SA_CHECK(SA_WAIT(core_alerted(sa_device) && !sa_device_defined(guider_device), SA_TIMEOUT) && indigo_monotonic_time() - started < 5);
	requests = sa_request_count(0, NULL, "/api/*");
	indigo_usleep(300000);
	SA_CHECK(sa_request_count(0, NULL, "/api/*") == requests && sa_clear_faults(0) && sa_advance(0, 1));
	SA_CHECK(sa_connect(sa_device) && SA_WAIT(sa_defined(guider_device, CONNECTION_PROPERTY_NAME), SA_TIMEOUT) && sa_connect(guider_device) && sa_state(guider_device, GUIDER_GUIDE_RA_PROPERTY_NAME) == INDIGO_OK_STATE && guider_zero(GUIDER_GUIDE_RA_PROPERTY_NAME));
	SA_CHECK(guider_start(GUIDER_GUIDE_RA_PROPERTY_NAME, GUIDER_GUIDE_WEST_ITEM_NAME, 200) && sa_advance(0, 0.2) && SA_WAIT(sa_state(guider_device, GUIDER_GUIDE_RA_PROPERTY_NAME) == INDIGO_OK_STATE, SA_TIMEOUT));
	// a request and a disconnect of the guider right behind it
	SA_CHECK(guider_request(GUIDER_GUIDE_DEC_PROPERTY_NAME, GUIDER_GUIDE_NORTH_ITEM_NAME, 3000) && sa_disconnect(guider_device) && guider_quiet() && sa_is_connected(sa_device) && sa_connect(guider_device) && sa_state(guider_device, GUIDER_GUIDE_DEC_PROPERTY_NAME) == INDIGO_OK_STATE);
	SA_CHECK(mount_simulated_is("IsPulseGuiding", "false") || (sa_advance(0, 3) && mount_simulated_is("IsPulseGuiding", "false")));
	// the mount is detached with its guider in the middle of a pulse: both go away without a hang and the Alpaca device is disconnected
	SA_CHECK(guider_start(GUIDER_GUIDE_RA_PROPERTY_NAME, GUIDER_GUIDE_EAST_ITEM_NAME, 5000));
	started = indigo_monotonic_time();
	SA_CHECK(sa_select(key, false) && SA_WAIT(!sa_device_defined(sa_device) && !sa_device_defined(guider_device), SA_TIMEOUT) && indigo_monotonic_time() - started < 3 && mount_simulated_is("Connected", "false") && mount_simulated_is("IsPulseGuiding", "false"));
	requests = sa_request_count(0, NULL, "/api/*");
	indigo_usleep(300000);
	SA_CHECK(sa_request_count(0, NULL, "/api/*") == requests);
	// and attached again both work
	SA_CHECK(sa_attach(MOUNT_LABEL) && sa_connect(sa_device) && SA_WAIT(sa_defined(guider_device, CONNECTION_PROPERTY_NAME), SA_TIMEOUT) && sa_connect(guider_device));
	SA_CHECK(guider_start(GUIDER_GUIDE_RA_PROPERTY_NAME, GUIDER_GUIDE_EAST_ITEM_NAME, 200) && sa_advance(0, 0.2) && SA_WAIT(sa_state(guider_device, GUIDER_GUIDE_RA_PROPERTY_NAME) == INDIGO_OK_STATE, SA_TIMEOUT) && guider_zero(GUIDER_GUIDE_RA_PROPERTY_NAME));
cleanup:
	sa_end();
}

// The guider of a camera: the same module on the Camera device type.
static void guider_camera_primary(void) {
	static const struct { const char *property; const char *item; double duration; const char *parameters; } pulses[] = { { GUIDER_GUIDE_DEC_PROPERTY_NAME, GUIDER_GUIDE_NORTH_ITEM_NAME, 350, "Direction=0&Duration=350&ClientID=" }, { GUIDER_GUIDE_DEC_PROPERTY_NAME, GUIDER_GUIDE_SOUTH_ITEM_NAME, 120, "Direction=1&Duration=120&ClientID=" }, { GUIDER_GUIDE_RA_PROPERTY_NAME, GUIDER_GUIDE_EAST_ITEM_NAME, 275, "Direction=2&Duration=275&ClientID=" }, { GUIDER_GUIDE_RA_PROPERTY_NAME, GUIDER_GUIDE_WEST_ITEM_NAME, 90.5, "Direction=3&Duration=91&ClientID=" } };
	SA_CHECK(guider_begin(guider_camera, true));
	for (int i = 0; i < 4; i++) {
		unsigned revision = sa_revision(guider_device, pulses[i].property);
		int checks = guider_count("GET", "ispulseguiding");
		SA_CHECK(guider_start(pulses[i].property, pulses[i].item, pulses[i].duration) && guider_last(pulses[i].parameters) && guider_count("PUT", "pulseguide") == i + 1 && sa_number(guider_device, pulses[i].property, pulses[i].item) == pulses[i].duration);
		SA_CHECK(!strcmp(sa_status(0, "/simulator/v1/camera/0/state", "IsPulseGuiding"), "true") && guider_watched(checks, 3) && sa_state(guider_device, pulses[i].property) == INDIGO_BUSY_STATE && !sa_state_after(guider_device, pulses[i].property, INDIGO_OK_STATE, revision));
		SA_CHECK(sa_advance(0, lround(pulses[i].duration) / 1000.0) && guider_answer(pulses[i].property, revision) == INDIGO_OK_STATE && guider_zero(pulses[i].property) && !strcmp(sa_status(0, "/simulator/v1/camera/0/state", "IsPulseGuiding"), "false") && guider_quiet());
	}
	// a refusal of the camera
	SA_CHECK(sa_fault(0, "PUT", "/api/v1/camera/0/pulseguide", "ascom-error", "Value=1035&Message=ST4%20port%20not%20connected") && guider_pulse(GUIDER_GUIDE_RA_PROPERTY_NAME, GUIDER_GUIDE_EAST_ITEM_NAME, 100) == INDIGO_ALERT_STATE && mount_message("Guiding failed: invalid operation (ST4 port not connected (0x40B))") && guider_zero(GUIDER_GUIDE_RA_PROPERTY_NAME));
	// guiding during an exposure: the pulse is started and completed while the camera exposes
	SA_CHECK(indigo_change_number_property_1(&sa_client, sa_device, CCD_EXPOSURE_PROPERTY_NAME, CCD_EXPOSURE_ITEM_NAME, 30) == INDIGO_OK && SA_WAIT(sa_request_count(0, "PUT", "/api/v1/camera/0/startexposure") == 1 && sa_state(sa_device, CCD_EXPOSURE_PROPERTY_NAME) == INDIGO_BUSY_STATE, SA_TIMEOUT));
	unsigned revision = sa_revision(guider_device, GUIDER_GUIDE_DEC_PROPERTY_NAME);
	SA_CHECK(guider_start(GUIDER_GUIDE_DEC_PROPERTY_NAME, GUIDER_GUIDE_NORTH_ITEM_NAME, 300) && sa_advance(0, 0.3) && guider_answer(GUIDER_GUIDE_DEC_PROPERTY_NAME, revision) == INDIGO_OK_STATE && guider_zero(GUIDER_GUIDE_DEC_PROPERTY_NAME) && sa_state(sa_device, CCD_EXPOSURE_PROPERTY_NAME) == INDIGO_BUSY_STATE);
	// the camera is disconnected with a pulse running (and the exposure with it): the pulse is ended first, the guider goes with its camera
	SA_CHECK(guider_start(GUIDER_GUIDE_RA_PROPERTY_NAME, GUIDER_GUIDE_WEST_ITEM_NAME, 5000));
	int count = guider_count("PUT", "pulseguide");
	SA_CHECK(sa_disconnect(sa_device) && SA_WAIT(!sa_device_defined(guider_device), SA_TIMEOUT) && guider_count("PUT", "pulseguide") == count + 1 && guider_last("Direction=3&Duration=0&ClientID="));
	int requests = sa_request_count(0, NULL, "/api/*");
	indigo_usleep(300000);
	SA_CHECK(sa_request_count(0, NULL, "/api/*") == requests && !strcmp(sa_status(0, "/simulator/v1/camera/0/state", "IsPulseGuiding"), "false") && !strcmp(sa_status(0, "/simulator/v1/camera/0/state", "Connected"), "false"));
	// connected again: a new guider, nothing BUSY, a pulse works
	SA_CHECK(sa_connect(sa_device) && SA_WAIT(sa_defined(guider_device, CONNECTION_PROPERTY_NAME), SA_TIMEOUT) && sa_connect(guider_device) && sa_state(guider_device, GUIDER_GUIDE_RA_PROPERTY_NAME) == INDIGO_OK_STATE && guider_zero(GUIDER_GUIDE_RA_PROPERTY_NAME));
	SA_CHECK(guider_start(GUIDER_GUIDE_RA_PROPERTY_NAME, GUIDER_GUIDE_EAST_ITEM_NAME, 200) && sa_advance(0, 0.2) && SA_WAIT(sa_state(guider_device, GUIDER_GUIDE_RA_PROPERTY_NAME) == INDIGO_OK_STATE, SA_TIMEOUT));
	SA_CHECK(sa_disconnect(sa_device));
cleanup:
	sa_end();
}

// ---------------------------------------------------------------------------- timing measurement

// PulseGuide takes a duration and the device ends the pulse itself, so what can be measured on the side of the driver is software
// completion timing: how long after PulseGuide reached the device the driver publishes the end of the pulse. The endpoints are the
// arrival of the PulseGuide request in the simulator (its monotonic clock, the same one as indigo_monotonic_time() on this host) and
// the update of GUIDER_GUIDE_DEC / GUIDER_GUIDE_RA with a state that is not BUSY, stamped in the callback of a client of the bus.
// The simulator runs on real time here (--clock real), so IsPulseGuiding becomes false exactly Duration after the arrival.
// This says nothing about a relay or a motor: there is none.

#define GUIDER_TIMING_SAMPLES 12
#define GUIDER_TIMING_WARMUPS 1

static pthread_mutex_t guider_timing_mutex = PTHREAD_MUTEX_INITIALIZER;
static double guider_timing_completed[2];
static int guider_timing_state[2];

// The clock of the measurement, read here and not through the library: CLOCK_MONOTONIC, which is what the simulator stamps its requests with.
// On macOS libindigo exports a clock_gettime() of its own that returns the wall clock for every clock id, and every process that links the
// library gets it; clock_gettime_nsec_np() is the way past it to the clock the simulator (which does not link the library) reads.
static double guider_timing_now(void) {
#if defined(__APPLE__)
	if (__builtin_available(macOS 10.12, *)) {
		return (double)clock_gettime_nsec_np(CLOCK_MONOTONIC) / 1e9;
	}
#endif
	struct timespec now;
	clock_gettime(CLOCK_MONOTONIC, &now);
	return (double)now.tv_sec + (double)now.tv_nsec / 1e9;
}

static indigo_result guider_timing_update(indigo_client *client, indigo_device *device, indigo_property *property, const char *message) {
	(void)client;
	(void)device;
	(void)message;
	if (property->state != INDIGO_BUSY_STATE && !strcmp(property->device, guider_device)) {
		int axis = !strcmp(property->name, GUIDER_GUIDE_DEC_PROPERTY_NAME) ? 0 : !strcmp(property->name, GUIDER_GUIDE_RA_PROPERTY_NAME) ? 1 : -1;
		if (axis >= 0) {
			double now = guider_timing_now();
			pthread_mutex_lock(&guider_timing_mutex);
			guider_timing_completed[axis] = now;
			guider_timing_state[axis] = property->state;
			pthread_mutex_unlock(&guider_timing_mutex);
		}
	}
	return INDIGO_OK;
}

static indigo_client guider_timing_client = { "system_alpaca guider timing", false, NULL, INDIGO_OK, INDIGO_VERSION_CURRENT, NULL, NULL, NULL, guider_timing_update, NULL, NULL, NULL, false, false };

static double guider_timing_completion(int axis) {
	pthread_mutex_lock(&guider_timing_mutex);
	double result = guider_timing_completed[axis];
	pthread_mutex_unlock(&guider_timing_mutex);
	return result;
}

static int guider_timing_compare(const void *a, const void *b) {
	double x = *(const double *)a, y = *(const double *)b;
	return x < y ? -1 : x > y;
}

// One pulse: the direction and the duration are checked at the entry of the device; *latency is the time from the request on the bus to
// that entry, *completion the time from the entry to the published end of the pulse and *check the time from the entry to the arrival of
// the request for IsPulseGuiding that found the pulse over, all in milliseconds.
static bool guider_timing_pulse(int direction, int duration, double *latency, double *completion, double *check) {
	static const char *items[] = { GUIDER_GUIDE_NORTH_ITEM_NAME, GUIDER_GUIDE_SOUTH_ITEM_NAME, GUIDER_GUIDE_EAST_ITEM_NAME, GUIDER_GUIDE_WEST_ITEM_NAME };
	const char *property = direction < 2 ? GUIDER_GUIDE_DEC_PROPERTY_NAME : GUIDER_GUIDE_RA_PROPERTY_NAME;
	int axis = direction < 2 ? 0 : 1;
	char path[128], expected[64];
	snprintf(path, sizeof(path), "%spulseguide", guider_api);
	snprintf(expected, sizeof(expected), "Direction=%d&Duration=%d&ClientID=", direction, duration);
	pthread_mutex_lock(&guider_timing_mutex);
	guider_timing_completed[axis] = 0;
	pthread_mutex_unlock(&guider_timing_mutex);
	int pulses = sa_request_count(0, "PUT", path);
	double requested = guider_timing_now();
	if (!guider_request(property, items[direction], duration) || !SA_WAIT(guider_timing_completion(axis) != 0, SA_TIMEOUT)) {
		fprintf(stderr, "    pulse %d of %d ms did not complete\n", direction, duration);
		return false;
	}
	const char *line = sa_last_request(0, "PUT", path);
	if (line == NULL || sa_request_count(0, "PUT", path) != pulses + 1 || strncmp(sa_field(line, "Body"), expected, strlen(expected)) || guider_timing_state[axis] != INDIGO_OK_STATE || !guider_zero(property)) {
		fprintf(stderr, "    pulse %d of %d ms: state %d, request %s\n", direction, duration, guider_timing_state[axis], line != NULL ? sa_field(line, "Body") : "none");
		return false;
	}
	line = sa_last_request(0, "PUT", path);
	double entry = atof(sa_field(line, "RealTime"));
	*latency = (entry - requested) * 1000;
	*completion = (guider_timing_completion(axis) - entry) * 1000;
	snprintf(path, sizeof(path), "%sispulseguiding", guider_api);
	line = sa_last_request(0, "GET", path);
	*check = line != NULL ? (atof(sa_field(line, "RealTime")) - entry) * 1000 : NAN;
	if (!isfinite(*completion) || *completion < 0 || *completion > duration + 5000 || *latency < -1 || *latency > 5000) {
		fprintf(stderr, "    pulse %d of %d ms: entry %.3f ms after the request, end %.3f ms after the entry\n", direction, duration, *latency, *completion);
		return false;
	}
	return true;
}

// All directions and durations for one workload. With full false one pulse of 20 ms per direction, which only shows that pulses complete on real time.
static bool guider_timing_series(const char *primary, const char *workload, bool full) {
	static const char *names[] = { "NORTH", "SOUTH", "EAST", "WEST" };
	static const int durations[] = { 20, 100, 500 };
	for (int direction = 0; direction < 4; direction++) {
		for (int d = 0; d < (full ? 3 : 1); d++) {
			double errors[GUIDER_TIMING_SAMPLES], latency = 0, completion = 0, check = 0, sum = 0, squares = 0, maximum_absolute = 0, latency_sum = 0, latency_maximum = 0, check_sum = 0, check_maximum = 0, publish_sum = 0, publish_maximum = 0;
			int count = full ? GUIDER_TIMING_SAMPLES : 1;
			for (int trial = 0; trial < (full ? GUIDER_TIMING_WARMUPS : 0) + count; trial++) {
				if (!guider_timing_pulse(direction, durations[d], &latency, &completion, &check)) {
					return false;
				}
				int sample = trial - (full ? GUIDER_TIMING_WARMUPS : 0);
				if (sample >= 0) {
					errors[sample] = completion - durations[d];
					sum += errors[sample];
					squares += errors[sample] * errors[sample];
					maximum_absolute = fmax(maximum_absolute, fabs(errors[sample]));
					latency_sum += latency;
					latency_maximum = fmax(latency_maximum, latency);
					check_sum += check - durations[d];
					check_maximum = fmax(check_maximum, check - durations[d]);
					publish_sum += completion - check;
					publish_maximum = fmax(publish_maximum, completion - check);
				}
			}
			if (full) {
				qsort(errors, (size_t)count, sizeof(double), guider_timing_compare);
				double mean = sum / count, median = (errors[(count - 1) / 2] + errors[count / 2]) / 2;
				int p95 = (int)ceil(0.95 * count) - 1, p99 = (int)ceil(0.99 * count) - 1;
				printf("TIMING %s %s %s requested_ms=%d n=%d warmup=%d actual_mean_ms=%.3f error_ms min=%.3f mean=%.3f median=%.3f p95=%.3f p99=%.3f max=%.3f sd=%.3f max_abs=%.3f error_mean_pct=%.2f request_to_entry_ms mean=%.3f max=%.3f check_after_end_ms mean=%.3f max=%.3f check_to_publish_ms mean=%.3f max=%.3f\n", primary, workload, names[direction], durations[d], count, GUIDER_TIMING_WARMUPS, durations[d] + mean, errors[0], mean, median, errors[p95], errors[p99], errors[count - 1], sqrt(fmax(0, squares / count - mean * mean)), maximum_absolute, 100 * mean / durations[d], latency_sum / count, latency_maximum, check_sum / count, check_maximum, publish_sum / count, publish_maximum);
			}
			sa_put(0, "/simulator/v1/requests/clear", NULL);
		}
	}
	return true;
}

static bool guider_timing_begin(const char * const *arguments, bool camera, double idle, double active) {
	guider_api = camera ? "/api/v1/camera/0/" : "/api/v1/telescope/0/";
	if (!sa_begin(arguments) || sa_set_number("X_ALPACA_POLLING", "IDLE", idle) != INDIGO_OK_STATE || sa_set_number("X_ALPACA_POLLING", "ACTIVE", active) != INDIGO_OK_STATE || !sa_attach(camera ? "Camera Simulator" : MOUNT_LABEL) || !sa_connect(sa_device)) {
		fprintf(stderr, "    the devices for the measurement did not start\n");
		return false;
	}
	snprintf(guider_device, sizeof(guider_device), "%s (guider)", sa_device);
	return SA_WAIT(sa_defined(guider_device, CONNECTION_PROPERTY_NAME), SA_TIMEOUT) && sa_connect(guider_device) && indigo_attach_client(&guider_timing_client) == INDIGO_OK;
}

static void guider_timing_end(void) {
	indigo_detach_client(&guider_timing_client);
	sa_end();
}

// Telescope: idle with the default polling of the driver (1 s), and with the queue and the connection kept busy by a telescope of
// interface version 3 that is polled every 50 ms with 12 requests (it has no DeviceState).
static void guider_timing_telescope(void) {
	static const char *idle[] = { "--clock", "real", "--device", "telescope:Tracking=true", NULL };
	static const char *busy[] = { "--clock", "real", "--device", "telescope:interface=legacy,Tracking=true", NULL };
	bool full = getenv("SYSTEM_ALPACA_TEST_TIMING") != NULL;
	SA_CHECK(guider_timing_begin(idle, false, 1, 0.2) && guider_timing_series("telescope", "idle", full));
	guider_timing_end();
	if (full) {
		SA_CHECK(guider_timing_begin(busy, false, 0.05, 0.05) && guider_timing_series("telescope", "polled-at-20Hz", full));
		guider_timing_end();
	}
	return;
cleanup:
	guider_timing_end();
}

// Camera: idle with the default polling, and during an exposure.
static void guider_timing_camera(void) {
	static const char *arguments[] = { "--clock", "real", "--device", "camera", NULL };
	bool full = getenv("SYSTEM_ALPACA_TEST_TIMING") != NULL;
	SA_CHECK(guider_timing_begin(arguments, true, 1, 0.2) && guider_timing_series("camera", "idle", full));
	if (full) {
		SA_CHECK(indigo_change_number_property_1(&sa_client, sa_device, CCD_EXPOSURE_PROPERTY_NAME, CCD_EXPOSURE_ITEM_NAME, 600) == INDIGO_OK && SA_WAIT(sa_request_count(0, "PUT", "/api/v1/camera/0/startexposure") == 1 && sa_state(sa_device, CCD_EXPOSURE_PROPERTY_NAME) == INDIGO_BUSY_STATE, SA_TIMEOUT));
		SA_CHECK(guider_timing_series("camera", "exposing", full) && sa_state(sa_device, CCD_EXPOSURE_PROPERTY_NAME) == INDIGO_BUSY_STATE);
		indigo_change_switch_property_1(&sa_client, sa_device, CCD_ABORT_EXPOSURE_PROPERTY_NAME, CCD_ABORT_EXPOSURE_ITEM_NAME, true);
		SA_WAIT(sa_state(sa_device, CCD_EXPOSURE_PROPERTY_NAME) != INDIGO_BUSY_STATE, SA_TIMEOUT);
	}
cleanup:
	guider_timing_end();
}

#define SYSTEM_ALPACA_GUIDER_CASES \
	{ "guider_properties", guider_properties }, \
	{ "guider_directions_and_units", guider_directions_and_units }, \
	{ "guider_completion", guider_completion }, \
	{ "guider_request_failures", guider_request_failures }, \
	{ "guider_replacement_and_axes", guider_replacement_and_axes }, \
	{ "guider_shared_lifetime", guider_shared_lifetime }, \
	{ "guider_duration_limits", guider_duration_limits }, \
	{ "guider_detach_with_pulse_requested", guider_detach_with_pulse_requested }, \
	{ "guider_camera_primary", guider_camera_primary }, \
	{ "guider_timing_telescope", guider_timing_telescope }, \
	{ "guider_timing_camera", guider_timing_camera },

#endif /* system_alpaca_guider_cases_h */
