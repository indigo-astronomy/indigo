// Copyright (c) 2026 INDIGO initiative
// All rights reserved.
//
// You may use this software under the terms of 'INDIGO Astronomy
// open-source license' (see LICENSE.md).
//
// THIS SOFTWARE IS PROVIDED BY THE AUTHORS 'AS IS' AND ANY EXPRESS
// OR IMPLIED WARRANTIES, INCLUDING, BUT NOT LIMITED TO, THE IMPLIED
// WARRANTIES OF MERCHANTABILITY AND FITNESS FOR A PARTICULAR PURPOSE
// ARE DISCLAIMED. IN NO EVENT SHALL THE AUTHOR BE LIABLE FOR ANY
// DIRECT, INDIRECT, INCIDENTAL, SPECIAL, EXEMPLARY, OR CONSEQUENTIAL
// DAMAGES (INCLUDING, BUT NOT LIMITED TO, PROCUREMENT OF SUBSTITUTE
// GOODS OR SERVICES; LOSS OF USE, DATA, OR PROFITS; OR BUSINESS
// INTERRUPTION) HOWEVER CAUSED AND ON ANY THEORY OF LIABILITY,
// WHETHER IN CONTRACT, STRICT LIABILITY, OR TORT (INCLUDING
// NEGLIGENCE OR OTHERWISE) ARISING IN ANY WAY OUT OF THE USE OF THIS
// SOFTWARE, EVEN IF ADVISED OF THE POSSIBILITY OF SUCH DAMAGE.

// Code is generated by AI

// Opt-in loopback-only HTTP upload regressions; synthetic BLOBs, no drivers.

#include <arpa/inet.h>
#include <errno.h>
#include <netinet/in.h>
#include <netinet/tcp.h>
#include <pthread.h>
#include <stdatomic.h>
#include <signal.h>
#include <stdio.h>
#include <string.h>
#include <sys/socket.h>
#include <sys/time.h>
#include <unistd.h>
#include <zlib.h>

#include <indigo/indigo_bus.h>
#include <indigo/indigo_server_tcp.h>
#include <indigo/indigo_timer.h>

#include "../test_runner.h"

#define WAIT_UNTIL(condition, timeout) ({ double deadline_ = indigo_monotonic_time() + (timeout); bool ready_ = (condition); while (!ready_ && indigo_monotonic_time() < deadline_) { indigo_usleep(5000); ready_ = (condition); } ready_; })

#ifdef INDIGO_HTTP_FAULT_INJECTION
static atomic_int file_handles;
static atomic_int file_opens;
static atomic_int file_fault;
static atomic_bool fail_worker;

indigo_uni_handle *http_test_open_file(const char *path, int level) {
	indigo_uni_handle *handle = indigo_uni_open_file(path, level);
	if (handle) {
		atomic_fetch_add(&file_handles, 1);
		atomic_fetch_add(&file_opens, 1);
	}
	return handle;
}

void http_test_close(indigo_uni_handle **handle) {
	if (*handle && (*handle)->type == INDIGO_FILE_HANDLE) {
		atomic_fetch_sub(&file_handles, 1);
	}
	indigo_uni_close(handle);
}

long http_test_read_available(indigo_uni_handle *handle, void *buffer, long length) {
	if (handle->type == INDIGO_FILE_HANDLE) {
		int fault = atomic_load(&file_fault);
		if (fault == 1 || fault == 2) {
			atomic_store(&file_fault, 0);
			return fault == 1 ? -1 : 0;
		}
	}
	return indigo_uni_read_available(handle, buffer, length);
}

long http_test_printf(indigo_uni_handle *handle, const char *format, ...) {
	if (atomic_load(&file_handles) > 0 && atomic_load(&file_fault) == 4) {
		atomic_store(&file_fault, 0);
		return 0;
	}
	va_list args;
	va_start(args, format);
	long result = indigo_uni_vprintf(handle, format, args);
	va_end(args);
	return result;
}

long http_test_write(indigo_uni_handle *handle, const char *buffer, long length) {
	if (atomic_load(&file_handles) > 0 && atomic_exchange(&file_fault, 0) == 3) {
		return -1;
	}
	return indigo_uni_write(handle, buffer, length);
}

static atomic_bool fail_compress;

void http_test_compress(char *name, char *in_buffer, unsigned in_size, unsigned char *out_buffer, unsigned *out_size) {
	if (atomic_exchange(&fail_compress, false)) {
		// what indigo_uni_compress() reports for a stream that did not reach Z_STREAM_END
		*out_size = 0;
		return;
	}
	indigo_uni_compress(name, in_buffer, in_size, out_buffer, out_size);
}

bool http_test_async(void *fun(void *), void *data) {
	if (atomic_exchange(&fail_worker, false)) {
		return false;
	}
	return indigo_async(fun, data);
}
#endif

static atomic_int server_client_count;
static atomic_bool server_listening;
static atomic_bool server_finished;
static pthread_t server_thread;
static bool server_started = false;

static void test_server_callback(int count) {
	atomic_store(&server_client_count, count);
	atomic_store(&server_listening, true);
}

static void *test_server_run(void *data) {
	indigo_server_start(test_server_callback);
	atomic_store(&server_finished, true);
	return NULL;
}

static bool start_test_server(void) {
	indigo_use_bonjour = false;
	indigo_server_tcp_port = 0;
	atomic_store(&server_client_count, 0);
	atomic_store(&server_listening, false);
	atomic_store(&server_finished, false);
	if (pthread_create(&server_thread, NULL, test_server_run, NULL) != 0) {
		return false;
	}
	server_started = true;
	if (!WAIT_UNTIL(atomic_load(&server_listening) && indigo_server_tcp_port != 0, 5)) {
		fprintf(stderr, "    TCP server did not start\n");
		return false;
	}
	return true;
}

static int connect_loopback(int port) {
	int fd = socket(AF_INET, SOCK_STREAM, 0);
	if (fd < 0) {
		return -1;
	}
	struct sockaddr_in address = { 0 };
	address.sin_family = AF_INET;
	address.sin_port = htons(port);
	address.sin_addr.s_addr = htonl(INADDR_LOOPBACK);
	if (connect(fd, (struct sockaddr *)&address, sizeof(address)) < 0) {
		close(fd);
		return -1;
	}
	struct timeval timeout = { 5, 0 };
	setsockopt(fd, SOL_SOCKET, SO_RCVTIMEO, &timeout, sizeof(timeout));
	int value = 1;
	setsockopt(fd, IPPROTO_TCP, TCP_NODELAY, &value, sizeof(value));
	return fd;
}

static void stop_test_server(void) {
	if (server_started) {
		WAIT_UNTIL(atomic_load(&server_client_count) == 0, 10);
		int port = indigo_server_tcp_port;
		indigo_server_shutdown();
		if (!WAIT_UNTIL(atomic_load(&server_finished), 1)) {
			// the listener may stay in accept() after its socket is shut down, a connection wakes it
			int fd = connect_loopback(port);
			if (fd >= 0) {
				close(fd);
			}
		}
		if (WAIT_UNTIL(atomic_load(&server_finished), 5)) {
			pthread_join(server_thread, NULL);
		} else {
			fprintf(stderr, "    TCP server thread did not finish\n");
			indigo_test_failures++;
			pthread_detach(server_thread);
		}
		server_started = false;
	}
}

static indigo_property *upload_property;
static indigo_device fixture_device = { .name = "Transport fixture" };

static bool read_reply(int fd, char *buffer, size_t capacity) {
	size_t length = 0;
	buffer[0] = 0;
	while (length + 1 < capacity) {
		ssize_t count = read(fd, buffer + length, capacity - length - 1);
		if (count < 0) {
			return false;
		}
		if (count == 0) {
			buffer[length] = 0;
			return true;
		}
		length += count;
		buffer[length] = 0;
		char *body = strstr(buffer, "\r\n\r\n");
		char *content_length = strstr(buffer, "Content-Length: ");
		if (body && content_length && length - (size_t)(body + 4 - buffer) == strtoul(content_length + 16, NULL, 10)) {
			return true;
		}
	}
	buffer[length] = 0;
	return false;
}

static int send_upload_headers(const char *headers, const char *body, size_t body_size) {
	int fd = connect_loopback(indigo_server_tcp_port);
	if (fd < 0) {
		return fd;
	}
	char request[2048];
	int length = snprintf(request, sizeof(request), "PUT /blob/%p.bin HTTP/1.1\r\n%s\r\n", upload_property->items, headers);
	if (length <= 0 || length >= sizeof(request) || write(fd, request, length) != length || (body_size && write(fd, body, body_size) != body_size)) {
		close(fd);
		return -1;
	}
	return fd;
}

static bool upload(const char *headers, const char *body, size_t body_size, int expected_status) {
	int fd = send_upload_headers(headers, body, body_size);
	if (fd < 0) {
		return false;
	}
	shutdown(fd, SHUT_WR);
	char response[4096];
	bool result = read_reply(fd, response, sizeof(response));
	close(fd);
	int status = 0;
	sscanf(response, "HTTP/1.1 %d", &status);
	if (!result || status != expected_status) {
		fprintf(stderr, "Expected HTTP %d, received %d (%s)\n", expected_status, status, response);
		return false;
	}
	return true;
}

static bool download_matches(const char *expected, size_t size) {
	int fd = connect_loopback(indigo_server_tcp_port);
	if (fd < 0) {
		return false;
	}
	char request[256];
	int length = snprintf(request, sizeof(request), "GET /blob/%p.bin HTTP/1.1\r\nConnection: close\r\n\r\n", upload_property->items);
	write(fd, request, length);
	char response[4096];
	bool result = read_reply(fd, response, sizeof(response));
	close(fd);
	char *body = strstr(response, "\r\n\r\n");
	return result && !strncmp(response, "HTTP/1.1 200 ", 13) && body && strlen(body + 4) == size && memcmp(body + 4, expected, size) == 0;
}

// Binary safe GET of the uploaded BLOB with gzip accepted; returns the body size or -1.
static long download_gzip(char *response, size_t capacity, char **body, bool *gzip) {
	int fd = connect_loopback(indigo_server_tcp_port);
	if (fd < 0) {
		return -1;
	}
	char request[256];
	int length = snprintf(request, sizeof(request), "GET /blob/%p.bin HTTP/1.1\r\nAccept-Encoding: gzip\r\nConnection: close\r\n\r\n", upload_property->items);
	if (write(fd, request, length) != length) {
		close(fd);
		return -1;
	}
	size_t received = 0;
	ssize_t count;
	while (received + 1 < capacity && (count = read(fd, response + received, capacity - received - 1)) > 0) {
		received += count;
	}
	close(fd);
	response[received] = 0;
	char *separator = strstr(response, "\r\n\r\n");
	// the line start matters, X-Uncompressed-Content-Length also ends with Content-Length
	char *content_length = strstr(response, "\r\nContent-Length: ");
	if (strncmp(response, "HTTP/1.1 200 ", 13) || separator == NULL || content_length == NULL || content_length > separator) {
		return -1;
	}
	*body = separator + 4;
	char *encoding = strstr(response, "\r\nContent-Encoding: gzip\r\n");
	*gzip = encoding != NULL && encoding < separator;
	long body_size = (long)(received - (size_t)(*body - response));
	return body_size == strtol(content_length + 18, NULL, 10) ? body_size : -1;
}

static void incompressible_gzip_download_is_complete(void) {
	char payload[INDIGO_BLOB_UPLOAD_LIMIT];
	unsigned state = 0x9e3779b9;
	for (int i = 0; i < (int)sizeof(payload); i++) {
		state = state * 1103515245 + 12345;
		payload[i] = (char)(state >> 24);
	}
	char headers[64];
	snprintf(headers, sizeof(headers), "Content-Length: %zu\r\n", sizeof(payload));
	ASSERT_TRUE(upload(headers, payload, sizeof(payload), 200));
	indigo_use_blob_compression = true;
	char response[4096];
	char *body = NULL;
	bool gzip = false;
	long size = download_gzip(response, sizeof(response), &body, &gzip);
	ASSERT_TRUE(size > (long)sizeof(payload));
	ASSERT_TRUE(gzip);
	unsigned char output[sizeof(payload) + 1];
	z_stream inflater = { 0 };
	ASSERT_EQ_INT(Z_OK, inflateInit2(&inflater, MAX_WBITS + 16));
	inflater.next_in = (Bytef *)body;
	inflater.avail_in = (uInt)size;
	inflater.next_out = output;
	inflater.avail_out = sizeof(output);
	int result = inflate(&inflater, Z_FINISH);
	unsigned long total = inflater.total_out;
	inflateEnd(&inflater);
	ASSERT_EQ_INT(Z_STREAM_END, result);
	ASSERT_EQ_INT(sizeof(payload), total);
	ASSERT_TRUE(memcmp(output, payload, sizeof(payload)) == 0);
#ifdef INDIGO_HTTP_FAULT_INJECTION
	atomic_store(&fail_compress, true);
	size = download_gzip(response, sizeof(response), &body, &gzip);
	ASSERT_EQ_INT(sizeof(payload), size);
	ASSERT_FALSE(gzip);
	ASSERT_TRUE(memcmp(body, payload, sizeof(payload)) == 0);
#endif
	indigo_use_blob_compression = false;
}

static void malformed_framing_preserves_cache(void) {
	ASSERT_TRUE(upload("Content-Length: 4\r\n", "good", 4, 200));
	const char *headers[] = {
		"", "Content-Length: -1\r\n", "Content-Length: +1\r\n", "Content-Length: 1x\r\n",
		"Content-Length: 99999999999999999999999999999999\r\n", "Content-Length: 1, 1\r\n",
		"Content-Length: 1\r\nContent-Length: 1\r\n", "Content-Length: 1\r\nContent-Length: 2\r\n",
		"Content-Length: 1\r\nTransfer-Encoding: chunked\r\n", "Content-Length : 1\r\n",
		"Content-Length: \r\n", "Transfer-Encoding: identity\r\n"
	};
	for (size_t i = 0; i < sizeof(headers) / sizeof(headers[0]); i++) {
		ASSERT_TRUE(upload(headers[i], "", 0, 400));
		ASSERT_TRUE(download_matches("good", 4));
	}
	char over_limit[80];
	snprintf(over_limit, sizeof(over_limit), "Content-Length: %zu\r\n", (size_t)INDIGO_BLOB_UPLOAD_LIMIT + 1);
	ASSERT_TRUE(upload(over_limit, "", 0, 400));
	ASSERT_TRUE(download_matches("good", 4));
}

static void short_eof_preserves_cache(void) {
	ASSERT_TRUE(upload("Content-Length: 4\r\n", "good", 4, 200));
	ASSERT_TRUE(upload("Content-Length: 8\r\n", "bad", 3, 400));
	ASSERT_TRUE(download_matches("good", 4));
	ASSERT_TRUE(upload("Content-Length: 8\r\n", "", 0, 400));
	ASSERT_TRUE(download_matches("good", 4));
}

static void valid_empty_and_ows_upload(void) {
	ASSERT_TRUE(upload("content-length:\t3 \t\r\n", "new", 3, 200));
	ASSERT_TRUE(download_matches("new", 3));
	ASSERT_TRUE(upload("Content-Length: 0\r\n", "", 0, 200));
	ASSERT_TRUE(download_matches("", 0));
}

static void private_receive_does_not_block_publication(void) {
	ASSERT_TRUE(upload("Content-Length: 4\r\n", "good", 4, 200));
	int fd = send_upload_headers("Content-Length: 8\r\n", "part", 4);
	ASSERT_TRUE(fd >= 0);
	ASSERT_TRUE(download_matches("good", 4));
	indigo_property *other = indigo_init_blob_property(NULL, "Transport fixture", "X_OUTPUT", "Test", "Output", INDIGO_OK_STATE, 1);
	indigo_init_blob_item(other->items, "ITEM", "Item");
	other->items[0].blob.value = "bus";
	other->items[0].blob.size = 3;
	double before = indigo_monotonic_time();
	indigo_update_property(&fixture_device, other, NULL);
	ASSERT_TRUE(indigo_monotonic_time() - before < 0.5);
	indigo_release_property(other);
	upload_property->perm = INDIGO_RO_PERM;
	upload_property->items[0].blob.value = "fresh";
	upload_property->items[0].blob.size = 5;
	before = indigo_monotonic_time();
	indigo_update_property(&fixture_device, upload_property, NULL);
	bool responsive = indigo_monotonic_time() - before < 0.5;
	upload_property->items[0].blob.value = NULL;
	upload_property->items[0].blob.size = 0;
	ASSERT_TRUE(responsive);
	ASSERT_TRUE(download_matches("fresh", 5));
	ASSERT_EQ_INT(4, write(fd, "done", 4));
	char response[1024];
	ASSERT_TRUE(read_reply(fd, response, sizeof(response)));
	close(fd);
	ASSERT_TRUE(!strncmp(response, "HTTP/1.1 404 ", 13));
	ASSERT_TRUE(download_matches("fresh", 5));
	ASSERT_TRUE(upload("Content-Length: 4\r\n", "bad!", 4, 403));
	ASSERT_TRUE(download_matches("fresh", 5));
	indigo_delete_property(&fixture_device, upload_property, NULL);
	upload_property->perm = INDIGO_WO_PERM;
	indigo_define_property(&fixture_device, upload_property, NULL);
}

static void stalled_body_times_out_without_publication(void) {
	ASSERT_TRUE(upload("Content-Length: 4\r\n", "good", 4, 200));
	int fd = send_upload_headers("Content-Length: 8\r\n", "part", 4);
	ASSERT_TRUE(fd >= 0);
	// Test builds use short deadlines; normal builds still finish within the read deadline.
	struct timeval timeout = { 10, 0 };
	setsockopt(fd, SOL_SOCKET, SO_RCVTIMEO, &timeout, sizeof(timeout));
	char response[1024];
	ASSERT_TRUE(read_reply(fd, response, sizeof(response)));
	close(fd);
	ASSERT_TRUE(!strncmp(response, "HTTP/1.1 408 ", 13));
	ASSERT_TRUE(download_matches("good", 4));
}

#ifdef INDIGO_BLOB_UPLOAD_TOTAL_TIMEOUT
static void *trickle_body(void *data) {
	int fd = *(int *)data;
	for (int i = 0; i < 30; i++) {
		if (write(fd, "x", 1) != 1) {
			break;
		}
		indigo_usleep(100000);
	}
	return NULL;
}

static void absolute_deadline_bounds_progressing_body(void) {
	ASSERT_TRUE(INDIGO_BLOB_UPLOAD_TOTAL_TIMEOUT <= 2.0);
	ASSERT_TRUE(upload("Content-Length: 4\r\n", "good", 4, 200));
	int fd = send_upload_headers("Content-Length: 40\r\n", "", 0);
	ASSERT_TRUE(fd >= 0);
	pthread_t thread;
	ASSERT_EQ_INT(0, pthread_create(&thread, NULL, trickle_body, &fd));
	double before = indigo_monotonic_time();
	char response[1024];
	bool received = read_reply(fd, response, sizeof(response));
	double elapsed = indigo_monotonic_time() - before;
	pthread_join(thread, NULL);
	close(fd);
	ASSERT_TRUE(received);
	ASSERT_TRUE(!strncmp(response, "HTTP/1.1 408 ", 13));
	ASSERT_TRUE(elapsed >= INDIGO_BLOB_UPLOAD_TOTAL_TIMEOUT * 0.8 && elapsed < INDIGO_BLOB_UPLOAD_TOTAL_TIMEOUT + 0.5);
	ASSERT_TRUE(download_matches("good", 4));
}
#endif

static void retirement_during_receive_rejects_publication(void) {
	int fd = send_upload_headers("Content-Length: 8\r\n", "part", 4);
	ASSERT_TRUE(fd >= 0);
	// A GET completes only once the pending request has been admitted; retirement stays bounded.
	ASSERT_TRUE(WAIT_UNTIL(atomic_load(&server_client_count) > 0, 1));
	indigo_usleep(20000);
	indigo_clear_property(upload_property);
	ASSERT_EQ_INT(4, write(fd, "done", 4));
	char response[1024];
	ASSERT_TRUE(read_reply(fd, response, sizeof(response)));
	close(fd);
	ASSERT_TRUE(!strncmp(response, "HTTP/1.1 404 ", 13));
}

#ifndef INDIGO_HTTP_HEADER_PROGRESS_TIMEOUT
#define INDIGO_HTTP_HEADER_PROGRESS_TIMEOUT 5.0
#endif
#ifndef INDIGO_HTTP_HEADER_TOTAL_TIMEOUT
#define INDIGO_HTTP_HEADER_TOTAL_TIMEOUT 30.0
#endif

static bool partial_http_expires(const char *prefix, bool drip_headers, bool drip_request) {
	int fd = connect_loopback(indigo_server_tcp_port);
	if (fd < 0) {
		return false;
	}
	bool sent = write(fd, prefix, strlen(prefix)) == (ssize_t)strlen(prefix);
	bool accepted = WAIT_UNTIL(atomic_load(&server_client_count) == 1, 1);
	double start = indigo_monotonic_time();
	double interval = INDIGO_HTTP_HEADER_PROGRESS_TIMEOUT / 3;
	double budget = drip_headers || drip_request ? INDIGO_HTTP_HEADER_TOTAL_TIMEOUT + 0.4 : INDIGO_HTTP_HEADER_PROGRESS_TIMEOUT + 0.4;
	while (indigo_monotonic_time() - start < budget && atomic_load(&server_client_count) != 0) {
		indigo_usleep((long)(interval * 1000000));
		if (drip_headers || drip_request) {
			const char *chunk = drip_headers ? "X: a\r\n" : "a";
			if (write(fd, chunk, strlen(chunk)) <= 0) {
				break;
			}
		}
	}
	bool expired = WAIT_UNTIL(atomic_load(&server_client_count) == 0, 0.2);
	bool total_used = !(drip_headers || drip_request) || indigo_monotonic_time() - start >= INDIGO_HTTP_HEADER_TOTAL_TIMEOUT - 0.15;
	close(fd);
	WAIT_UNTIL(atomic_load(&server_client_count) == 0, 1);
	return sent && accepted && expired && total_used;
}

static void partial_http_request_and_headers_expire(void) {
	ASSERT_TRUE(partial_http_expires("G", false, false));
	ASSERT_TRUE(partial_http_expires("GET /fixture-file HTTP/1.1\r\nHost:", false, false));
	ASSERT_TRUE(partial_http_expires("PUT /unregistered HTTP/1.1\r\nHost:", false, false));
}

static void progressing_http_framing_has_total_deadline(void) {
	ASSERT_TRUE(partial_http_expires("G", false, true));
	ASSERT_TRUE(partial_http_expires("GET /fixture-file HTTP/1.1\r\n", true, false));
}

static void http_header_size_and_peer_close_bounds(void) {
	for (size_t target = 4096; target <= 4097; target++) {
		char request[4098];
		size_t used = snprintf(request, sizeof(request), "GET /fixture-file HTTP/1.1\r\nConnection: close\r\n");
		while (target - used > 2) {
			size_t line = target - used - 2;
			if (line > 900) {
				line = 900;
			}
			ASSERT_TRUE(line >= 4);
			memcpy(request + used, "X:", 2);
			memset(request + used + 2, 'a', line - 4);
			memcpy(request + used + line - 2, "\r\n", 2);
			used += line;
		}
		memcpy(request + used, "\r\n", 2);
		int fd = connect_loopback(indigo_server_tcp_port);
		ASSERT_TRUE(fd >= 0);
		ASSERT_EQ_INT(1, write(fd, request, 1));
		ASSERT_TRUE(WAIT_UNTIL(atomic_load(&server_client_count) == 1, 1));
		bool sent = write(fd, request + 1, target - 1) == (ssize_t)target - 1;
		char response[4096];
		bool received = target == 4096 ? read_reply(fd, response, sizeof(response)) : WAIT_UNTIL(atomic_load(&server_client_count) == 0, 1);
		close(fd);
		ASSERT_TRUE(sent && received);
		if (target == 4096) {
			ASSERT_TRUE(!strncmp(response, "HTTP/1.1 200 ", 13));
		}
		ASSERT_TRUE(WAIT_UNTIL(atomic_load(&server_client_count) == 0, 1));
	}
	int fd = connect_loopback(indigo_server_tcp_port);
	ASSERT_TRUE(fd >= 0);
	ASSERT_EQ_INT(1, write(fd, "G", 1));
	ASSERT_TRUE(WAIT_UNTIL(atomic_load(&server_client_count) == 1, 1));
	shutdown(fd, SHUT_WR);
	bool released = WAIT_UNTIL(atomic_load(&server_client_count) == 0, INDIGO_HTTP_HEADER_PROGRESS_TIMEOUT + 0.5);
	close(fd);
	ASSERT_TRUE(released);
}

static bool http_block_is_rejected(const void *request, size_t size) {
	int fd = connect_loopback(indigo_server_tcp_port);
	if (fd < 0) {
		return false;
	}
	bool started = write(fd, request, 1) == 1 && WAIT_UNTIL(atomic_load(&server_client_count) == 1, 1);
	bool sent = started && write(fd, (const char *)request + 1, size - 1) == (ssize_t)size - 1;
	bool closed = WAIT_UNTIL(atomic_load(&server_client_count) == 0, 1);
	char response[256] = { 0 };
	ssize_t count = closed ? read(fd, response, sizeof(response) - 1) : -1;
	close(fd);
	WAIT_UNTIL(atomic_load(&server_client_count) == 0, 1);
	return sent && closed && (count <= 0 || strncmp(response, "HTTP/1.1 200 ", 13));
}

static void malformed_or_excess_headers_cannot_dispatch(void) {
	char request[2048];
	size_t used = snprintf(request, sizeof(request), "GET /fixture-file HTTP/1.1\r\nX:");
	memset(request + used, 'a', 1100);
	memcpy(request + used + 1100, "\r\n\r\n", 4);
	ASSERT_TRUE(http_block_is_rejected(request, used + 1104));
	const char nul_header[] = "GET /fixture-file HTTP/1.1\r\nX: a\0b\r\n\r\n";
	ASSERT_TRUE(http_block_is_rejected(nul_header, sizeof(nul_header) - 1));
	for (int i = 64; i <= 65; i++) {
		used = snprintf(request, sizeof(request), "GET /fixture-file HTTP/1.1\r\n");
		for (int k = 0; k < i; k++) {
			memcpy(request + used, "X:a\r\n", 5);
			used += 5;
		}
		memcpy(request + used, "\r\n", 2);
		used += 2;
		if (i == 65) {
			ASSERT_TRUE(http_block_is_rejected(request, used));
		} else {
			int fd = connect_loopback(indigo_server_tcp_port);
			ASSERT_TRUE(fd >= 0);
			bool sent = write(fd, request, used) == (ssize_t)used;
			char response[256];
			bool received = read_reply(fd, response, sizeof(response));
			close(fd);
			ASSERT_TRUE(sent && received && !strncmp(response, "HTTP/1.1 200 ", 13));
			ASSERT_TRUE(WAIT_UNTIL(atomic_load(&server_client_count) == 0, 1));
		}
	}
}

static atomic_bool put_framing_preserved;

static bool framing_put_handler(indigo_uni_handle *handle, char *method, char *path, char *params) {
	char header[1024], body[4];
	bool length_seen = false;
	while (indigo_uni_read_line(handle, header, sizeof(header) - 1) > 0) {
		length_seen = length_seen || !strcmp(header, "Content-Length: 4");
	}
	bool preserved = length_seen && indigo_uni_read(handle, body, sizeof(body)) == sizeof(body) && !memcmp(body, "\0dat", 4);
	atomic_store(&put_framing_preserved, preserved);
	indigo_uni_printf(handle, "HTTP/1.1 200 OK\r\nContent-Length: 0\r\nConnection: close\r\n\r\n");
	return false;
}

static void complete_put_headers_and_coalesced_body_are_preserved(void) {
	indigo_server_add_handler("/framing-put", framing_put_handler);
	atomic_store(&put_framing_preserved, false);
	int fd = connect_loopback(indigo_server_tcp_port);
	ASSERT_TRUE(fd >= 0);
	const char request[] = "PUT /framing-put HTTP/1.1\r\nContent-Length: 4\r\n\r\n\0dat";
	bool sent = write(fd, request, sizeof(request) - 1) == sizeof(request) - 1;
	char response[256];
	bool received = read_reply(fd, response, sizeof(response));
	close(fd);
	indigo_server_remove_resource("/framing-put");
	ASSERT_TRUE(sent && received);
	ASSERT_TRUE(!strncmp(response, "HTTP/1.1 200 ", 13));
	ASSERT_TRUE(atomic_load(&put_framing_preserved));
}

static const char post_json_body[] = "{\n\"value\":\"a%20+b\"}";
static const unsigned char post_binary_body[] = { 0, 'a', '\n', 0xff };
static atomic_bool post_handler_entered;

// This fixture owns framing just like an existing PUT handler; it also checks its
// endpoint explicitly because the shared registry intentionally matches prefixes.
static bool framing_post_handler(indigo_uni_handle *handle, char *method, char *path, char *params) {
	atomic_store(&post_handler_entered, true);
	const char *query = strchr(path, '?');
	size_t path_size = query ? (size_t)(query - path) : strlen(path);
	if (path_size != strlen("/framing-post") || strncmp(path, "/framing-post", path_size)) {
		indigo_uni_printf(handle, "HTTP/1.1 404 Not Found\r\nContent-Length: 0\r\nConnection: close\r\n\r\n");
		return false;
	}
	char header[1024];
	size_t size = 0;
	bool json = false;
	bool binary = false;
	bool keep_alive = false;
	while (indigo_uni_read_line(handle, header, sizeof(header) - 1) > 0) {
		if (!strncmp(header, "Content-Length: ", 16)) {
			size = strtoul(header + 16, NULL, 10);
		} else if (!strcmp(header, "Content-Type: application/json")) {
			json = true;
		} else if (!strcmp(header, "Content-Type: application/octet-stream")) {
			binary = true;
		} else if (!strcmp(header, "Connection: keep-alive")) {
			keep_alive = true;
		}
	}
	unsigned char body[64];
	bool preserved = !strcmp(method, "POST") && params == NULL && (!query || !strcmp(query + 1, "raw=a%20b")) && size > 0 && size <= sizeof(body) && indigo_uni_read(handle, (char *)body, size) == (long)size;
	preserved = preserved && ((json && size == sizeof(post_json_body) - 1 && !memcmp(body, post_json_body, size)) || (binary && size == sizeof(post_binary_body) && !memcmp(body, post_binary_body, size)));
	indigo_uni_printf(handle, "HTTP/1.1 %s\r\nContent-Length: 0\r\nConnection: %s\r\n\r\n", preserved ? "200 OK" : "400 Bad Request", preserved && keep_alive ? "keep-alive" : "close");
	return preserved && keep_alive;
}

static void post_framing_case(bool binary, bool fragmented, bool keep_alive) {
	indigo_server_add_handler("/framing-post", framing_post_handler);
	int fd = connect_loopback(indigo_server_tcp_port);
	ASSERT_TRUE(fd >= 0);
	const void *body = binary ? (const void *)post_binary_body : (const void *)post_json_body;
	size_t body_size = binary ? sizeof(post_binary_body) : sizeof(post_json_body) - 1;
	bool passed = true;
	for (int i = 0; i < (keep_alive ? 2 : 1); i++) {
		atomic_store(&post_handler_entered, false);
		char request[256];
		int length = snprintf(request, sizeof(request), "POST /framing-post?raw=a%%20b HTTP/1.1\r\nContent-Type: %s\r\nContent-Length: %zu\r\nConnection: %s\r\n\r\n", binary ? "application/octet-stream" : "application/json", body_size, keep_alive && i == 0 ? "keep-alive" : "close");
		bool sent;
		if (fragmented) {
			sent = write(fd, request, length) == length;
			sent = WAIT_UNTIL(atomic_load(&post_handler_entered), 1) && sent;
			sent = write(fd, body, 1) == 1 && sent;
			sent = write(fd, (const char *)body + 1, body_size - 1) == (ssize_t)body_size - 1 && sent;
		} else {
			memcpy(request + length, body, body_size);
			sent = write(fd, request, length + body_size) == (ssize_t)(length + body_size);
		}
		char response[256];
		bool received = read_reply(fd, response, sizeof(response));
		passed = sent && received && !strncmp(response, "HTTP/1.1 200 ", 13) && passed;
	}
	close(fd);
	indigo_server_remove_resource("/framing-post");
	ASSERT_TRUE(passed);
}

static void post_json_headers_and_body_are_preserved(void) {
	post_framing_case(false, false, false);
}

static void post_binary_and_fragmented_body_are_preserved(void) {
	post_framing_case(true, true, false);
}

static void post_callback_can_keep_connection_alive(void) {
	post_framing_case(false, false, true);
}

static void post_handler_checks_exact_path(void) {
	indigo_server_add_handler("/framing-post", framing_post_handler);
	atomic_store(&post_handler_entered, false);
	int fd = connect_loopback(indigo_server_tcp_port);
	ASSERT_TRUE(fd >= 0);
	const char request[] = "POST /framing-post-extra HTTP/1.1\r\nContent-Length: 0\r\n\r\n";
	bool sent = write(fd, request, sizeof(request) - 1) == sizeof(request) - 1;
	char response[256];
	bool received = read_reply(fd, response, sizeof(response));
	close(fd);
	indigo_server_remove_resource("/framing-post");
	ASSERT_TRUE(sent && received && !strncmp(response, "HTTP/1.1 404 ", 13));
	ASSERT_TRUE(atomic_load(&post_handler_entered));
}

static void post_to_builtin_resources_is_not_a_put_upload(void) {
	void *previous = upload_property->items[0].blob.value;
	char blob_path[128];
	snprintf(blob_path, sizeof(blob_path), "/blob/%p.bin", upload_property->items);
	const char *paths[] = { blob_path, "/fixture-file", "/missing-post" };
	for (int i = 0; i < 3; i++) {
		int fd = connect_loopback(indigo_server_tcp_port);
		ASSERT_TRUE(fd >= 0);
		char request[256];
		int length = snprintf(request, sizeof(request), "POST %s HTTP/1.1\r\nContent-Length: 4\r\n\r\ndata", paths[i]);
		bool sent = write(fd, request, length) == length;
		char response[256];
		bool received = read_reply(fd, response, sizeof(response));
		close(fd);
		ASSERT_TRUE(sent && received && !strncmp(response, i == 2 ? "HTTP/1.1 404 " : "HTTP/1.1 405 ", 13));
	}
	ASSERT_TRUE(upload_property->items[0].blob.value == previous);
}

static void complete_http_keepalive_requests_are_preserved(void) {
	int fd = connect_loopback(indigo_server_tcp_port);
	ASSERT_TRUE(fd >= 0);
	for (int i = 0; i < 2; i++) {
		const char *request = i ? "GET /fixture-file HTTP/1.1\r\nConnection: close\r\n\r\n" : "GET /fixture-file HTTP/1.1\r\n\r\n";
		bool sent = write(fd, request, strlen(request)) == (ssize_t)strlen(request);
		char response[512];
		bool received = read_reply(fd, response, sizeof(response));
		if (!sent || !received || strncmp(response, "HTTP/1.1 200 ", 13)) {
			close(fd);
			ASSERT_TRUE(false);
		}
		if (i == 0) {
			indigo_usleep((long)(INDIGO_HTTP_HEADER_PROGRESS_TIMEOUT * 500000));
		}
	}
	close(fd);
	ASSERT_TRUE(WAIT_UNTIL(atomic_load(&server_client_count) == 0, 1));
}

static void established_json_and_websocket_survive_http_deadlines(void) {
	for (int websocket = 0; websocket <= 1; websocket++) {
		int fd = connect_loopback(indigo_server_tcp_port);
		ASSERT_TRUE(fd >= 0);
		const char *request = websocket ? "GET / HTTP/1.1\r\nUpgrade: websocket\r\nSec-WebSocket-Key: dGhlIHNhbXBsZSBub25jZQ==\r\n\r\n" : "{\"getProperties\":{\"version\":\"3.0\",\"device\":\"No such fixture\"}}";
		bool sent = write(fd, request, strlen(request)) == (ssize_t)strlen(request);
		bool upgraded = !websocket;
		if (websocket) {
			char response[1024] = { 0 };
			size_t used = 0;
			while (used + 1 < sizeof(response) && strstr(response, "\r\n\r\n") == NULL && read(fd, response + used, 1) == 1) {
				used++;
			}
			upgraded = !strncmp(response, "HTTP/1.1 101 ", 13);
		}
		bool accepted = WAIT_UNTIL(atomic_load(&server_client_count) == 1, 1);
		indigo_usleep((long)((INDIGO_HTTP_HEADER_TOTAL_TIMEOUT + 0.1) * 1000000));
		bool retained = atomic_load(&server_client_count) == 1;
		close(fd);
		bool released = WAIT_UNTIL(atomic_load(&server_client_count) == 0, 1);
		ASSERT_TRUE(sent && upgraded && accepted && retained && released);
	}
}

static void idle_initial_connections_expire(void) {
	ASSERT_TRUE(WAIT_UNTIL(atomic_load(&server_client_count) == 0, 2));
	int fd = connect_loopback(indigo_server_tcp_port);
	ASSERT_TRUE(fd >= 0);
	ASSERT_TRUE(WAIT_UNTIL(atomic_load(&server_client_count) == 1, 1));
	char byte;
	ASSERT_EQ_INT(0, read(fd, &byte, 1));
	close(fd);
	ASSERT_TRUE(WAIT_UNTIL(atomic_load(&server_client_count) == 0, 1));
}

static void established_xml_survives_initial_deadline(void) {
	int fd = connect_loopback(indigo_server_tcp_port);
	ASSERT_TRUE(fd >= 0);
	const char *request = "<getProperties version='3.0' device='No such fixture'/>";
	ASSERT_EQ_INT(strlen(request), write(fd, request, strlen(request)));
	ASSERT_TRUE(WAIT_UNTIL(atomic_load(&server_client_count) == 1, 1));
	indigo_usleep((long)((INDIGO_HTTP_HEADER_TOTAL_TIMEOUT + 0.1) * 1000000));
	ASSERT_EQ_INT(1, atomic_load(&server_client_count));
	ASSERT_EQ_INT(strlen(request), write(fd, request, strlen(request)));
	close(fd);
	ASSERT_TRUE(WAIT_UNTIL(atomic_load(&server_client_count) == 0, 1));
}

#ifdef INDIGO_HTTP_FAULT_INJECTION
static void admission_limit_and_spawn_failure_recover(void) {
	ASSERT_TRUE(WAIT_UNTIL(atomic_load(&server_client_count) == 0, 2));
	atomic_store(&fail_worker, true);
	int rejected = connect_loopback(indigo_server_tcp_port);
	ASSERT_TRUE(rejected >= 0);
	char byte;
	ASSERT_EQ_INT(0, read(rejected, &byte, 1));
	close(rejected);
	int sockets[INDIGO_TCP_WORKER_LIMIT];
	const char *request = "<getProperties version='3.0' device='No such fixture'/>";
	for (int i = 0; i < INDIGO_TCP_WORKER_LIMIT; i++) {
		sockets[i] = connect_loopback(indigo_server_tcp_port);
		ASSERT_TRUE(sockets[i] >= 0);
		ASSERT_EQ_INT(strlen(request), write(sockets[i], request, strlen(request)));
	}
	ASSERT_TRUE(WAIT_UNTIL(atomic_load(&server_client_count) == INDIGO_TCP_WORKER_LIMIT, 2));
	rejected = connect_loopback(indigo_server_tcp_port);
	ASSERT_TRUE(rejected >= 0);
	ASSERT_EQ_INT(0, read(rejected, &byte, 1));
	close(rejected);
	for (int i = 0; i < INDIGO_TCP_WORKER_LIMIT; i++) {
		close(sockets[i]);
	}
	ASSERT_TRUE(WAIT_UNTIL(atomic_load(&server_client_count) == 0, 2));
	ASSERT_TRUE(upload("Content-Length: 0\r\n", "", 0, 200));
}

static void file_download_cleanup(void) {
	for (int fault = 0; fault <= 4; fault++) {
		ASSERT_TRUE(WAIT_UNTIL(atomic_load(&server_client_count) == 0, 2));
		int previous = atomic_load(&file_opens);
		atomic_store(&file_fault, fault);
		int fd = connect_loopback(indigo_server_tcp_port);
		ASSERT_TRUE(fd >= 0);
		const char *request = "GET /fixture-file HTTP/1.1\r\nConnection: close\r\n\r\n";
		ASSERT_EQ_INT(strlen(request), write(fd, request, strlen(request)));
		char response[4096];
		bool received = read_reply(fd, response, sizeof(response));
		close(fd);
		ASSERT_TRUE(received);
		ASSERT_TRUE(WAIT_UNTIL(atomic_load(&server_client_count) == 0, 2));
		ASSERT_EQ_INT(previous + 1, atomic_load(&file_opens));
		ASSERT_EQ_INT(0, atomic_load(&file_handles));
		if (fault == 4) {
			ASSERT_EQ_INT(0, strlen(response));
			continue;
		}
		ASSERT_TRUE(!strncmp(response, "HTTP/1.1 200 ", 13));
		char *body = strstr(response, "\r\n\r\n");
		ASSERT_TRUE(body != NULL);
		ASSERT_EQ_INT(fault == 0 ? 7 : 0, strlen(body + 4));
	}
}
#endif

static atomic_bool retirement_entered;
static atomic_bool retirement_release;
static atomic_int retirement_calls;
static atomic_bool retirement_timed_out;

struct retirement_request {
	bool all;
	atomic_bool started;
	atomic_bool done;
};

static bool retirement_handler(indigo_uni_handle *handle, char *method, char *path, char *params) {
	if (atomic_fetch_add(&retirement_calls, 1) == 0) {
		atomic_store(&retirement_entered, true);
		if (!WAIT_UNTIL(atomic_load(&retirement_release), 5)) {
			atomic_store(&retirement_timed_out, true);
		}
	}
	indigo_uni_printf(handle, "HTTP/1.1 200 OK\r\nContent-Length: 7\r\nConnection: close\r\n\r\nretired");
	return false;
}

static void *retire_fixture(void *data) {
	struct retirement_request *request = data;
	atomic_store(&request->started, true);
	if (request->all) {
		indigo_server_remove_resources();
	} else {
		indigo_server_remove_resource("/retirement");
	}
	atomic_store(&request->done, true);
	return NULL;
}

static bool fixture_response(const char *path, char *response, size_t size) {
	int fd = connect_loopback(indigo_server_tcp_port);
	if (fd < 0) {
		return false;
	}
	char request[256];
	int length = snprintf(request, sizeof(request), "GET %s HTTP/1.1\r\nConnection: close\r\n\r\n", path);
	bool success = write(fd, request, length) == length && read_reply(fd, response, size);
	close(fd);
	return success;
}

static void resource_metadata_is_owned(void) {
	static unsigned char payload[] = "owned";
	char path[] = "/owned-resource";
	char content_type[] = "text/plain";
	indigo_server_add_resource(path, payload, sizeof(payload) - 1, content_type);
	memset(path + 1, 'x', sizeof(path) - 2);
	memset(content_type, 'x', sizeof(content_type) - 1);
	char response[4096];
	bool success = fixture_response("/owned-resource", response, sizeof(response));
	indigo_server_remove_resource("/owned-resource");
	ASSERT_TRUE(success);
	ASSERT_TRUE(strstr(response, "Content-Type: text/plain\r\n") != NULL);
	ASSERT_TRUE(strstr(response, "\r\n\r\nowned") != NULL);
	char file_name[] = "/tmp/indigo-resource-owned-XXXXXX";
	int file = mkstemp(file_name);
	ASSERT_TRUE(file >= 0);
	ASSERT_EQ_INT(5, write(file, payload, 5));
	close(file);
	char saved_name[sizeof(file_name)];
	memcpy(saved_name, file_name, sizeof(file_name));
	indigo_server_add_file_resource("/owned-file", file_name, "text/plain");
	memset(file_name + 1, 'x', sizeof(file_name) - 2);
	success = fixture_response("/owned-file", response, sizeof(response));
	indigo_server_remove_resource("/owned-file");
	unlink(saved_name);
	ASSERT_TRUE(success);
	ASSERT_TRUE(strstr(response, "HTTP/1.1 200 OK") != NULL);
	ASSERT_TRUE(strstr(response, "\r\n\r\nowned") != NULL);
}

static void resource_retirement_case(const char *method, bool all) {
	atomic_store(&retirement_entered, false);
	atomic_store(&retirement_release, false);
	atomic_store(&retirement_calls, 0);
	atomic_store(&retirement_timed_out, false);
	indigo_server_add_handler("/retirement", retirement_handler);
	int fd = connect_loopback(indigo_server_tcp_port);
	ASSERT_TRUE(fd >= 0);
	char request[256];
	int length = snprintf(request, sizeof(request), "%s /retirement HTTP/1.1\r\nConnection: close\r\nContent-Length: 0\r\n\r\n", method);
	ASSERT_EQ_INT(length, write(fd, request, length));
	ASSERT_TRUE(WAIT_UNTIL(atomic_load(&retirement_entered), 2));
	struct retirement_request first = { .all = all };
	struct retirement_request second = { 0 };
	pthread_t remover;
	pthread_t overlapping_remover;
	ASSERT_EQ_INT(0, pthread_create(&remover, NULL, retire_fixture, &first));
	// Observe withdrawal while the first callback is still held, without scheduling assumptions.
	char response[4096];
	bool withdrawn = false;
	double deadline = indigo_monotonic_time() + 2;
	while (!withdrawn && indigo_monotonic_time() < deadline) {
		withdrawn = fixture_response("/retirement", response, sizeof(response)) && strstr(response, "HTTP/1.1 404 ") != NULL;
	}
	bool waited = !atomic_load(&first.done);
	int second_created = pthread_create(&overlapping_remover, NULL, retire_fixture, &second);
	bool overlap_started = second_created == 0 && WAIT_UNTIL(atomic_load(&second.started), 1);
	bool overlap_waited = overlap_started && !WAIT_UNTIL(atomic_load(&second.done), 0.05);
	static unsigned char payload[] = "new";
	indigo_server_add_resource("/retirement-new", payload, sizeof(payload) - 1, "text/plain");
	bool registry_available = fixture_response("/retirement-new", response, sizeof(response)) && strstr(response, "\r\n\r\nnew") != NULL;
	atomic_store(&retirement_release, true);
	bool completed_response = read_reply(fd, response, sizeof(response));
	close(fd);
	pthread_join(remover, NULL);
	if (second_created == 0) {
		pthread_join(overlapping_remover, NULL);
	}
	bool new_registration_survived = fixture_response("/retirement-new", response, sizeof(response)) && strstr(response, "\r\n\r\nnew") != NULL;
	indigo_server_remove_resource("/retirement-new");
	ASSERT_TRUE(withdrawn);
	ASSERT_TRUE(waited);
	ASSERT_TRUE(registry_available);
	ASSERT_TRUE(completed_response);
	ASSERT_TRUE(atomic_load(&first.done));
	ASSERT_TRUE(overlap_waited);
	ASSERT_TRUE(atomic_load(&second.done));
	ASSERT_TRUE(!atomic_load(&retirement_timed_out));
	ASSERT_TRUE(new_registration_survived);
}

static void get_handler_retirement_waits(void) {
	resource_retirement_case("GET", false);
}

static void put_handler_retirement_waits(void) {
	resource_retirement_case("PUT", false);
}

static void post_handler_retirement_waits(void) {
	resource_retirement_case("POST", false);
}

static void remove_all_preserves_new_registrations(void) {
	resource_retirement_case("GET", true);
}

int main(int argc, char **argv) {
	indigo_test_use_private_home();
	signal(SIGPIPE, SIG_IGN);
	indigo_use_blob_caching = true;
	indigo_start();
	upload_property = indigo_init_blob_property(NULL, "Transport fixture", "X_UPLOAD", "Test", "Upload", INDIGO_OK_STATE, 1);
	upload_property->perm = INDIGO_WO_PERM;
	indigo_init_blob_item(upload_property->items, "ITEM", "Item");
	indigo_define_property(NULL, upload_property, NULL);
	char file_path[] = "/tmp/indigo-http-file-XXXXXX";
	int file_fd = mkstemp(file_path);
	if (file_fd < 0 || write(file_fd, "fixture", 7) != 7) {
		return 1;
	}
	close(file_fd);
	indigo_server_add_file_resource("/fixture-file", file_path, "application/octet-stream");
	if (!start_test_server()) {
		stop_test_server();
		return 1;
	}
	indigo_test_case tests[] = {
		{ "idle initial connections expire", idle_initial_connections_expire },
		{ "partial HTTP request and headers expire", partial_http_request_and_headers_expire },
		{ "progressing HTTP framing total deadline", progressing_http_framing_has_total_deadline },
		{ "HTTP header size and peer close bounds", http_header_size_and_peer_close_bounds },
		{ "malformed or excess headers cannot dispatch", malformed_or_excess_headers_cannot_dispatch },
		{ "complete PUT headers and coalesced body", complete_put_headers_and_coalesced_body_are_preserved },
		{ "POST JSON headers and body", post_json_headers_and_body_are_preserved },
		{ "POST binary fragmented body", post_binary_and_fragmented_body_are_preserved },
		{ "POST callback keepalive", post_callback_can_keep_connection_alive },
		{ "POST handler exact path", post_handler_checks_exact_path },
		{ "POST built-in resource restrictions", post_to_builtin_resources_is_not_a_put_upload },
		{ "complete HTTP keepalive", complete_http_keepalive_requests_are_preserved },
		{ "established JSON and WebSocket idle sessions", established_json_and_websocket_survive_http_deadlines },
		{ "established XML idle session", established_xml_survives_initial_deadline },
#ifdef INDIGO_HTTP_FAULT_INJECTION
		{ "admission limit and spawn failure", admission_limit_and_spawn_failure_recover },
		{ "file download cleanup", file_download_cleanup },
#endif
		{ "malformed framing preserves cache", malformed_framing_preserves_cache },
		{ "short EOF preserves cache", short_eof_preserves_cache },
		{ "valid empty and whitespace length", valid_empty_and_ows_upload },
		{ "incompressible gzip download is complete", incompressible_gzip_download_is_complete },
		{ "private receive and responsive publication", private_receive_does_not_block_publication },
		{ "stalled body deadline", stalled_body_times_out_without_publication },
#ifdef INDIGO_BLOB_UPLOAD_TOTAL_TIMEOUT
		{ "absolute deadline despite progress", absolute_deadline_bounds_progressing_body },
#endif
		{ "retirement during receive", retirement_during_receive_rejects_publication },
		{ "resource metadata ownership", resource_metadata_is_owned },
		{ "GET handler retirement", get_handler_retirement_waits },
		{ "PUT handler retirement", put_handler_retirement_waits },
		{ "POST handler retirement", post_handler_retirement_waits },
		{ "remove all preserves new registrations", remove_all_preserves_new_registrations }
	};
	int result = indigo_run_tests("transport HTTP security", tests, sizeof(tests) / sizeof(tests[0]));
	stop_test_server();
	indigo_server_remove_resources();
	unlink(file_path);
	indigo_release_property(upload_property);
	indigo_stop();
	indigo_test_remove_private_home();
	return result || indigo_test_failures;
}
