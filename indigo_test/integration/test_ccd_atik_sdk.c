// Copyright (c) 2026 INDIGO initiative
// All rights reserved.
//
// You may use this software under the terms of 'INDIGO Astronomy
// open-source license' (see LICENSE.md).
//
// THIS SOFTWARE IS PROVIDED BY THE AUTHORS 'AS IS' AND ANY EXPRESS
// OR IMPLIED WARRANTIES, INCLUDING, BUT NOT LIMITED TO, THE IMPLIED
// WARRANTIES OF MERCHANTABILITY AND FITNESS FOR A PARTICULAR PURPOSE
// ARE DISCLAIMED. IN NO EVENT SHALL THE AUTHOR BE LIABLE FOR ANY
// DIRECT, INDIRECT, INCIDENTAL, SPECIAL, EXEMPLARY, OR CONSEQUENTIAL
// DAMAGES (INCLUDING, BUT NOT LIMITED TO, PROCUREMENT OF SUBSTITUTE
// GOODS OR SERVICES; LOSS OF USE, DATA, OR PROFITS; OR BUSINESS
// INTERRUPTION) HOWEVER CAUSED AND ON ANY THEORY OF LIABILITY,
// WHETHER IN CONTRACT, STRICT LIABILITY, OR TORT (INCLUDING
// NEGLIGENCE OR OTHERWISE) ARISING IN ANY WAY OUT OF THE USE OF THIS
// SOFTWARE, EVEN IF ADVISED OF THE POSSIBILITY OF SUCH DAMAGE.

// Code is generated by AI

#include <stdatomic.h>
#include <limits.h>
#include <stdbool.h>
#include <pthread.h>
#include <unistd.h>
#include <dirent.h>
#include <indigo/indigo_usb_utils.h>
#include <indigo/indigo_ccd_driver.h>
#include <indigo_drivers/ccd_atik/indigo_ccd_atik.h>
#include "AtikCameras.h"
#include "simulator_test_common.h"
#include "ccd_test_noise.h"
#define CAMERAS 12
#define PROPERTIES 80
typedef struct {
	atomic_bool visible, opened, exposing;
	bool guider, wheel, cooler, heater, presets, shutter;
	atomic_int preview, dark, slot_count, moving, malformed, short_option, ready_stuck, flushing;
	atomic_int sensor_width, sensor_height, bx, by, left, top, width, height, preset, gain, offset, heater_power, temperature, target, relay, slot, wheel_target;
	atomic_int opens, closes, starts, stops, dark_calls, wheel_wrap_reads, abort_readout_ms, drain_checks, temperature_in_drain;
	double exposure, end, drain_end;
	uint16_t *pixels;
	size_t pixel_count;
	double pulse_on[4], pulse_ms[4];
} mock_camera;
typedef struct {
	char name[INDIGO_NAME_SIZE];
	indigo_property *properties[PROPERTIES];
	int updates[PROPERTIES];
} observed_device;
static mock_camera cameras[CAMERAS];
static observed_device observed[CAMERAS * 3];
static indigo_device *logical[CAMERAS * 3];
static int request_revisions[CAMERAS * 3][PROPERTIES];
static pthread_mutex_t observation_mutex = PTHREAD_MUTEX_INITIALIZER;
static int usb_devices[CAMERAS];
static libusb_hotplug_callback_fn usb_callback;
static atomic_int attached, updates_after_detach, lock_count, fail_lock, unbalanced_unlock;
static atomic_int fail_register, fail_descriptor, wrong_vendor, usb_refs, usb_ref_balance[CAMERAS], invalid_usb_unref;
static atomic_int blobs, bad_blob, sdk_after_close;
static _Atomic(const char *) fail_call;
static atomic_int fail_attach, fail_queue, sdk_active[CAMERAS], sdk_overlap, sdk_on_bus, gates_entered;
static atomic_int commands[64], temperature_reads, image_reads;
static pthread_t bus_thread;
static atomic_int clock_shift, discovery_fail, bad_string, not_camera, discovery_calls;
static indigo_queue *driver_queue;
static char config_folder[] = "/tmp/indigo_atik_test_XXXXXX";
static pthread_mutex_t gate_mutex = PTHREAD_MUTEX_INITIALIZER;
static pthread_cond_t gate_condition = PTHREAD_COND_INITIALIZER;
static const char *gate_call;
static bool gate_release;

static void enter_gate(const char *name) {
	pthread_mutex_lock(&gate_mutex);
	if (gate_call && !strcmp(gate_call, name)) {
		atomic_fetch_add(&gates_entered, 1);
		while (!gate_release) {
			pthread_cond_wait(&gate_condition, &gate_mutex);
		}
	}
	pthread_mutex_unlock(&gate_mutex);
}

static void release_gate(void) {
	pthread_mutex_lock(&gate_mutex);
	gate_release = true;
	gate_call = NULL;
	pthread_cond_broadcast(&gate_condition);
	pthread_mutex_unlock(&gate_mutex);
}

static void arm_gate(const char *name) {
	pthread_mutex_lock(&gate_mutex);
	gate_release = false;
	gate_call = name;
	atomic_store(&gates_entered, 0);
	pthread_mutex_unlock(&gate_mutex);
}

static void block_queue(indigo_device *device) {
	enter_gate("queue");
}
static const char *command_names[64];

static int command_index(const char *name) {
	for (int i = 0; i < 64; i++) {
		if (!command_names[i]) {
			command_names[i] = name;
		}
		if (!strcmp(command_names[i], name)) {
			return i;
		}
	}
	return 0;
}
static pthread_mutex_t command_mutex = PTHREAD_MUTEX_INITIALIZER;
typedef struct {
	int index;
} sdk_scope;

static sdk_scope sdk_enter(ArtemisHandle h, const char *name) {
	int index = (mock_camera *)h - cameras;
	if (atomic_fetch_add(&sdk_active[index], 1)) {
		atomic_fetch_add(&sdk_overlap, 1);
	}
	if (pthread_equal(bus_thread, pthread_self())) {
		atomic_fetch_add(&sdk_on_bus, 1);
	}
	pthread_mutex_lock(&command_mutex);
	atomic_fetch_add(&commands[command_index(name)], 1);
	pthread_mutex_unlock(&command_mutex);
	enter_gate(name);
	return (sdk_scope) { index };
}

static void sdk_leave(sdk_scope *scope) {
	atomic_fetch_sub(&sdk_active[scope->index], 1);
}
#define SDK_SCOPE sdk_scope scope __attribute__((cleanup(sdk_leave))) = sdk_enter(h, __func__)
const char *atik_test_config_folder(void) {
	return config_folder;
}
indigo_queue *atik_test_queue_create(indigo_device *device) {
	if (atomic_load(&fail_queue)) {
		return NULL;
	}
	driver_queue = indigo_queue_create(device);
	return driver_queue;
}

double atik_test_monotonic_time(void) {
	return indigo_monotonic_time() + atomic_load(&clock_shift);
}

void atik_test_execute_in(indigo_device *device, double delay, indigo_timer_callback callback) {
	indigo_execute_handler_in(device, delay == 5 ? .1 : delay, callback);
}

static int failed(const char *name) {
	const char *failure = atomic_load(&fail_call);
	return failure && !strcmp(failure, name) ? ARTEMIS_OPERATION_FAILED : ARTEMIS_OK;
}

static mock_camera *camera(ArtemisHandle handle) {
	mock_camera *c = handle;
	if (!c || !c->opened) {
		atomic_fetch_add(&sdk_after_close, 1);
	}
	return c ? c : cameras;
}

static int device_index(const char *name) {
	int index = -1;
	sscanf(name, "Atik test %d", &index);
	return index >= 0 && index < CAMERAS ? 3 * index + (strstr(name, "(guider)") ? 1 : strstr(name, "(wheel)") ? 2 : 0) : -1;
}

static int property_index(int index, const char *name, bool create) {
	int empty = -1;
	for (int i = 0; i < PROPERTIES; i++) {
		if (observed[index].properties[i] && !strcmp(observed[index].properties[i]->name, name)) {
			return i;
		}
		if (!observed[index].properties[i] && empty < 0) {
			empty = i;
		}
	}
	return create ? empty : -1;
}

static indigo_result observe(indigo_client *client, indigo_device *device, indigo_property *property, const char *message) {
	if (property->state == INDIGO_ALERT_STATE) { fprintf(stderr, "%s: %s\n", property->name, message ? message : "ALERT"); }
	int index = device_index(property->device);
	if (index < 0) {
		return INDIGO_OK;
	}
	if (!logical[index]) {
		atomic_fetch_add(&updates_after_detach, 1);
	}
	pthread_mutex_lock(&observation_mutex);
	int slot = property_index(index, property->name, true);
	if (slot >= 0) {
		indigo_release_property(observed[index].properties[slot]);
		observed[index].properties[slot] = indigo_copy_property(NULL, property);
		observed[index].updates[slot]++;
	}
	pthread_mutex_unlock(&observation_mutex);
	return INDIGO_OK;
}

static indigo_result observe_delete(indigo_client *client, indigo_device *device, indigo_property *property, const char *message) {
	int index = device_index(property->device);
	if (index < 0) {
		return INDIGO_OK;
	}
	pthread_mutex_lock(&observation_mutex);
	for (int i = 0; i < PROPERTIES; i++) {
		indigo_property *cached = observed[index].properties[i];
		if (cached && (!property->name[0] || !strcmp(cached->name, property->name))) {
			indigo_release_property(cached);
			observed[index].properties[i] = NULL;
		}
	}
	pthread_mutex_unlock(&observation_mutex);
	return INDIGO_OK;
}

static indigo_result observe_image(indigo_client *client, indigo_device *device, indigo_property *property, const char *message) {
	if (!strcmp(property->name, "CCD_IMAGE") && property->state == INDIGO_OK_STATE && property->items[0].blob.size > 0) {
		indigo_item *item = property->items;
		if (!strcmp(item->blob.format, ".raw")) {
			indigo_raw_header h = { 0 };
			memcpy(&h, item->blob.value, sizeof(h));
			mock_camera *c = cameras + device_index(device->name) / 3;
			bool valid = h.signature == INDIGO_RAW_MONO16 && h.width == c->width / c->bx && h.height == c->height / c->by;
			for (int i = 0; valid && i < h.width * h.height; i++) {
				uint16_t pixel;
				memcpy(&pixel, (char *)item->blob.value + sizeof(h) + 2 * i, 2);
				valid = pixel == ccd_test_noise((c->top + i / h.width * c->by) * c->sensor_width + c->left + i % h.width * c->bx, 0);
			}
			if (!valid) {
				atomic_fetch_add(&bad_blob, 1);
			}
		}
		atomic_fetch_add(&blobs, 1);
	}
	return observe(client, device, property, message);
}
static indigo_client test_client = { .name = "Atik fake SDK", .version = INDIGO_VERSION_CURRENT, .define_property = observe, .update_property = observe_image, .delete_property = observe_delete };

indigo_result atik_test_attach(indigo_device *device) {
	int index = device_index(device->name);
	if (index < 0) {
		return INDIGO_FAILED;
	}
	if (atomic_load(&fail_attach) == index + 1) {
		return INDIGO_FAILED;
	}
	logical[index] = device;
	snprintf(observed[index].name, INDIGO_NAME_SIZE, "%s", device->name);
	indigo_result result = indigo_attach_device(device);
	if (result == INDIGO_OK) {
		atomic_fetch_add(&attached, 1);
	}
	return result;
}

indigo_result atik_test_detach(indigo_device *device) {
	int index = device_index(device->name);
	indigo_result result = indigo_detach_device(device);
	logical[index] = NULL;
	atomic_fetch_sub(&attached, 1);
	return result;
}

static indigo_property *snapshot(int index, const char *name) {
	pthread_mutex_lock(&observation_mutex);
	int slot = property_index(index, name, false);
	indigo_property *copy = slot < 0 ? NULL : indigo_copy_property(NULL, observed[index].properties[slot]);
	pthread_mutex_unlock(&observation_mutex);
	return copy;
}

static int state(int index, const char *name) {
	indigo_property *property = snapshot(index, name);
	int value = property ? (int)property->state : -1;
	indigo_release_property(property);
	return value;
}

static bool wait_state(int index, const char *name, int expected) {
	for (int i = 0; i < 400; i++) {
		pthread_mutex_lock(&observation_mutex);
		int slot = property_index(index, name, false);
		bool ready = slot >= 0 && observed[index].properties[slot]->state == expected && observed[index].updates[slot] > request_revisions[index][slot];
		pthread_mutex_unlock(&observation_mutex);
		if (ready) {
			return true;
		}
		indigo_usleep(10000);
	}
	fprintf(stderr, "device %d property %s: expected state %d, got %d\n", index, name, expected, state(index, name));
	return false;
}

static bool wait_count(atomic_int *value, int expected) {
	for (int i = 0; i < 400; i++) {
		if (atomic_load(value) == expected) {
			return true;
		}
		indigo_usleep(10000);
	}
	fprintf(stderr, "counter expected %d, got %d\n", expected, atomic_load(value));
	return false;
}

void atik_test_usb_start(void) {
}

indigo_result atik_test_lock(indigo_device *device) {
	if (atomic_load(&fail_lock)) {
		return INDIGO_FAILED;
	}
	atomic_fetch_add(&lock_count, 1);
	return INDIGO_OK;
}

indigo_result atik_test_unlock(indigo_device *device) {
	if (atomic_load(&lock_count) == 0) {
		atomic_fetch_add(&unbalanced_unlock, 1);
		return INDIGO_FAILED;
	}
	atomic_fetch_sub(&lock_count, 1);
	return INDIGO_OK;
}

int LIBUSB_CALL atik_test_usb_register(libusb_context *ctx, int events, int flags, int vid, int pid, int cls, libusb_hotplug_callback_fn callback, void *data, libusb_hotplug_callback_handle *handle) {
	if (atomic_load(&fail_register)) {
		return LIBUSB_ERROR_OTHER;
	}
	usb_callback = callback;
	callback(NULL, (libusb_device *)&usb_devices[0], LIBUSB_HOTPLUG_EVENT_DEVICE_ARRIVED, NULL);
	return LIBUSB_SUCCESS;
}

int atik_test_usb_register_sim(libusb_context *ctx, libusb_hotplug_event events, libusb_hotplug_flag flags, int vid, int pid, int cls, libusb_hotplug_callback_fn callback, void *data, libusb_hotplug_callback_handle *handle) {
	return atik_test_usb_register(ctx, events, flags, vid, pid, cls, callback, data, handle);
}

void LIBUSB_CALL atik_test_usb_deregister(libusb_context *ctx, libusb_hotplug_callback_handle handle) {
	usb_callback = NULL;
}

int atik_test_usb_deregister_poll(libusb_context *ctx, libusb_hotplug_callback_handle handle) {
	usb_callback = NULL;
	return LIBUSB_SUCCESS;
}

libusb_device *LIBUSB_CALL atik_test_usb_ref(libusb_device *device) {
	atomic_fetch_add(&usb_refs, 1);
	atomic_fetch_add(&usb_ref_balance[(int *)device - usb_devices], 1);
	return device;
}

void LIBUSB_CALL atik_test_usb_unref(libusb_device *device) {
	atomic_fetch_sub(&usb_refs, 1);
	if (atomic_fetch_sub(&usb_ref_balance[(int *)device - usb_devices], 1) <= 0) {
		atomic_fetch_add(&invalid_usb_unref, 1);
	}
}

int LIBUSB_CALL atik_test_usb_descriptor(libusb_device *device, struct libusb_device_descriptor *descriptor) {
	memset(descriptor, 0, sizeof(*descriptor));
	descriptor->idVendor = atomic_load(&wrong_vendor) ? 0xffff : ((int *)device - usb_devices) % 2 ? 0x04b4 : 0x20e7;
	descriptor->idProduct = 0x1001;
	return atomic_load(&fail_descriptor) ? LIBUSB_ERROR_IO : LIBUSB_SUCCESS;
}

static void usb_event(int index, bool arrive) {
	usb_callback(NULL, (libusb_device *)&usb_devices[index], arrive ? LIBUSB_HOTPLUG_EVENT_DEVICE_ARRIVED : LIBUSB_HOTPLUG_EVENT_DEVICE_LEFT, NULL);
}

int ArtemisAPIVersion(void) {
	return 20220913;
}

int ArtemisDLLVersion(void) {
	return 20220913;
}

void ArtemisSetDebugCallback(void (*callback)(const char *)) {
}

void ArtemisShutdown(void) {
}

int ArtemisDeviceCount(void) {
	atomic_fetch_add(&discovery_calls, 1);
	if (discovery_fail) {
		return -1;
	}
	int count = 0;
	for (int i = 0; i < CAMERAS; i++) {
		count += cameras[i].visible;
	}
	return count;
}

static mock_camera *by_index(int index) {
	for (int i = 0; i < CAMERAS; i++) {
		if (cameras[i].visible && index-- == 0) {
			return cameras + i;
		}
	}
	return NULL;
}

BOOL ArtemisDeviceSerial(int index, char *serial) {
	mock_camera *c = by_index(index);
	if (!c) {
		return false;
	}
	if (bad_string) {
		memset(serial, 'X', 100);
		return true;
	}
	sprintf(serial, "SERIAL-%ld", c - cameras);
	return true;
}

BOOL ArtemisDeviceName(int index, char *name) {
	mock_camera *c = by_index(index);
	if (!c) {
		return false;
	}
	sprintf(name, "Atik test %ld", c - cameras);
	return true;
}

BOOL ArtemisDeviceIsCamera(int index) {
	return !not_camera && by_index(index) != NULL;
}

BOOL ArtemisDeviceHasGuidePort(int index) {
	return by_index(index)->guider;
}

BOOL ArtemisDeviceHasFilterWheel(int index) {
	return by_index(index)->wheel;
}

ArtemisHandle ArtemisConnect(int index) {
	mock_camera *c = by_index(index);
	if (!c || failed(__func__)) {
		return NULL;
	}
	c->opened = true;
	c->opens++;
	return c;
}

BOOL ArtemisDisconnect(ArtemisHandle h) {
	SDK_SCOPE;
	mock_camera *c = camera(h);
	c->opened = false;
	c->closes++;
	return true;
}

int ArtemisProperties(ArtemisHandle h, struct ARTEMISPROPERTIES *p) {
	SDK_SCOPE;
	mock_camera *c = camera(h);
	if (failed(__func__)) {
		return failed(__func__);
	}
	memset(p, 0, sizeof(*p));
	p->nPixelsX = c->sensor_width;
	p->nPixelsY = c->sensor_height;
	p->PixelMicronsX = p->PixelMicronsY = 5.4;
	p->cameraflags = (c->heater ? ARTEMIS_PROPERTIES_CAMERAFLAGS_HAS_WINDOW_HEATER : 0) | (c->shutter ? ARTEMIS_PROPERTIES_CAMERAFLAGS_HAS_SHUTTER : 0);
	return 0;
}

int ArtemisGetMaxBin(ArtemisHandle h, int *x, int *y) {
	SDK_SCOPE;
	mock_camera *c = camera(h);
	*x = *y = c->malformed == 1 ? 0 : 4;
	return failed(__func__);
}

int ArtemisSetPreview(ArtemisHandle h, bool on) {
	SDK_SCOPE;
	camera(h)->preview = on;
	return failed(__func__);
}

int ArtemisSetDarkMode(ArtemisHandle h, bool on) {
	SDK_SCOPE;
	camera(h)->dark_calls++;
	if (!camera(h)->shutter) {
		return ARTEMIS_INVALID_FUNCTION;
	}
	camera(h)->dark = on;
	return failed(__func__);
}

int ArtemisBin(ArtemisHandle h, int x, int y) {
	SDK_SCOPE;
	if (failed(__func__)) {
		return failed(__func__);
	}
	mock_camera *c = camera(h);
	c->bx = x;
	c->by = y;
	return failed(__func__);
}

int ArtemisSubframe(ArtemisHandle h, int x, int y, int w, int height) {
	SDK_SCOPE;
	if (failed(__func__)) {
		return failed(__func__);
	}
	mock_camera *c = camera(h);
	c->left = x;
	c->top = y;
	c->width = w;
	c->height = height;
	return failed(__func__);
}

int ArtemisStartExposure(ArtemisHandle h, float seconds) {
	SDK_SCOPE;
	if (failed(__func__)) {
		return failed(__func__);
	}
	mock_camera *c = camera(h);
	if (c->drain_end > indigo_monotonic_time()) {
		return ARTEMIS_OPERATION_FAILED;
	}
	c->exposure = seconds;
	c->end = indigo_monotonic_time() + seconds;
	c->exposing = true;
	c->starts++;
	return failed(__func__);
}

int ArtemisStopExposure(ArtemisHandle h) {
	SDK_SCOPE;
	if (failed(__func__)) {
		return failed(__func__);
	}
	mock_camera *c = camera(h);
	c->drain_end = indigo_monotonic_time() + c->abort_readout_ms / 1000.0;
	c->exposing = false;
	c->stops++;
	return failed(__func__);
}

int ArtemisCameraState(ArtemisHandle h) {
	SDK_SCOPE;
	mock_camera *c = camera(h);
	if (c->drain_end > indigo_monotonic_time()) {
		c->drain_checks++;
		return CAMERA_DOWNLOADING;
	}
	return failed(__func__) ? CAMERA_ERROR : c->flushing ? CAMERA_FLUSHING : c->exposing ? CAMERA_EXPOSING : CAMERA_IDLE;
}

float ArtemisExposureTimeRemaining(ArtemisHandle h) {
	SDK_SCOPE;
	mock_camera *c = camera(h);
	return fmax(0, c->end - indigo_monotonic_time());
}

BOOL ArtemisImageReady(ArtemisHandle h) {
	SDK_SCOPE;
	mock_camera *c = camera(h);
	return !c->ready_stuck && c->exposing && indigo_monotonic_time() >= c->end;
}

BOOL ArtemisImageFailed(ArtemisHandle h) {
	SDK_SCOPE;
	camera(h);
	return failed(__func__) != 0;
}

int ArtemisGetImageData(ArtemisHandle h, int *x, int *y, int *w, int *height, int *bx, int *by) {
	SDK_SCOPE;
	mock_camera *c = camera(h);
	*x = c->left;
	*y = c->top;
	*w = c->malformed == 2 ? INT_MAX : c->width / c->bx;
	*height = c->height / c->by;
	*bx = c->bx;
	*by = c->by;
	return failed(__func__);
}

void *ArtemisImageBuffer(ArtemisHandle h) {
	mock_camera *c = camera(h);
	int w = c->width / c->bx, height = c->height / c->by;
	if (c->pixel_count < (size_t)w * height) {
		c->pixels = realloc(c->pixels, (size_t)w * height * 2);
		c->pixel_count = (size_t)w * height;
	}
	for (int i = 0; i < w * height; i++) {
		c->pixels[i] = ccd_test_noise((c->top + i / w * c->by) * c->sensor_width + c->left + i % w * c->bx, 0);
	}
	c->exposing = false;
	return failed(__func__) ? NULL : c->pixels;
}

int ArtemisTemperatureSensorInfo(ArtemisHandle h, int sensor, int *value) {
	SDK_SCOPE;
	mock_camera *c = camera(h);
	if (sensor && c->drain_end > indigo_monotonic_time()) {
		c->temperature_in_drain++;
	}
	*value = sensor ? c->temperature : c->cooler ? 1 : 0;
	return failed(__func__);
}

int ArtemisCoolingInfo(ArtemisHandle h, int *flags, int *level, int *min, int *max, int *target) {
	SDK_SCOPE;
	mock_camera *c = camera(h);
	*flags = c->cooler ? 3 : 0;
	*level = 100;
	*min = 0;
	*max = c->malformed == 3 ? 0 : 200;
	*target = c->target;
	return failed(__func__);
}

int ArtemisSetCooling(ArtemisHandle h, int value) {
	SDK_SCOPE;
	if (failed(__func__)) {
		return failed(__func__);
	}
	camera(h)->target = value;
	return failed(__func__);
}

int ArtemisCoolerWarmUp(ArtemisHandle h) {
	SDK_SCOPE;
	camera(h);
	return failed(__func__);
}

int ArtemisGetWindowHeaterPower(ArtemisHandle h, int *value) {
	SDK_SCOPE;
	*value = camera(h)->heater_power;
	return failed(__func__);
}

int ArtemisSetWindowHeaterPower(ArtemisHandle h, int value) {
	SDK_SCOPE;
	if (failed(__func__)) {
		return failed(__func__);
	}
	camera(h)->heater_power = value;
	return failed(__func__);
}

bool ArtemisHasCameraSpecificOption(ArtemisHandle h, unsigned short id) {
	SDK_SCOPE;
	return camera(h)->presets;
}
int ArtemisCameraSpecificOptionGetData(ArtemisHandle h, unsigned short id, unsigned char *data, int length, int *actual) { SDK_SCOPE; mock_camera *c = camera(h); uint16_t values[3] = { 0, id == 5 ? 60 : 511, id == 5 ? c->gain : c->offset }; *actual = id == 1 ? 2 : 6; if (id == 1) { values[0] = c->preset; } memcpy(data, values, *actual); if (c->short_option) { (*actual)--; } return failed(__func__); }

int ArtemisCameraSpecificOptionSetData(ArtemisHandle h, unsigned short id, unsigned char *data, int length) {
	SDK_SCOPE;
	if (failed(__func__)) {
		return failed(__func__);
	}
	mock_camera *c = camera(h);
	uint16_t value;
	memcpy(&value, data, 2);
	if (id == 1) {
		c->preset = value;
	} else if (id == 5) {
		c->gain = value;
	} else {
		c->offset = value;
	}
	return failed(__func__);
}

int ArtemisGuidePort(ArtemisHandle h, int mask) {
	SDK_SCOPE;
	if (failed(__func__)) {
		return failed(__func__);
	}
	mock_camera *c = camera(h);
	double now = indigo_monotonic_time();
	for (int i = 0; i < 4; i++) {
		if ((mask & (1 << i)) && !(c->relay & (1 << i))) {
			c->pulse_on[i] = now;
		}
		if (!(mask & (1 << i)) && (c->relay & (1 << i))) {
			c->pulse_ms[i] = (now - c->pulse_on[i]) * 1000;
		}
	}
	c->relay = mask;
	return failed(__func__);
	}

int ArtemisFilterWheelInfo(ArtemisHandle h, int *count, int *moving, int *current, int *target) {
	SDK_SCOPE;
	mock_camera *c = camera(h);
	*count = c->slot_count;
	*moving = c->moving;
	*current = c->malformed == 4 ? -1 : c->malformed == 5 ? *count : c->slot;
	if (c->malformed == 5) {
		c->wheel_wrap_reads++;
	}
	*target = c->wheel_target;
	return failed(__func__);
}

int ArtemisFilterWheelMove(ArtemisHandle h, int slot) {
	SDK_SCOPE;
	if (failed(__func__)) {
		return failed(__func__);
	}
	mock_camera *c = camera(h);
	c->slot = c->wheel_target = slot;
	return failed(__func__);
}

static void remember_request(const char *device, const char *property) {
	int index = device_index(device);
	pthread_mutex_lock(&observation_mutex);
	int slot = index < 0 ? -1 : property_index(index, property, false);
	if (slot >= 0) {
		request_revisions[index][slot] = observed[index].updates[slot];
	}
	pthread_mutex_unlock(&observation_mutex);
}

static indigo_result request_number(indigo_client *client, const char *device, const char *property, int count, const char **items, double *values) {
	remember_request(device, property);
	return indigo_change_number_property(client, device, property, count, items, values);
}

static indigo_result request_number_1(indigo_client *client, const char *device, const char *property, const char *item, double value) {
	remember_request(device, property);
	return indigo_change_number_property_1(client, device, property, item, value);
}

static indigo_result request_switch(indigo_client *client, const char *device, const char *property, const char *item, bool value) {
	remember_request(device, property);
	return indigo_change_switch_property_1(client, device, property, item, value);
}

static indigo_result request_text(indigo_client *client, const char *device, const char *property, const char *item, const char *value) {
	remember_request(device, property);
	return indigo_change_text_property_1(client, device, property, item, value);
}

#define indigo_change_number_property request_number
#define indigo_change_number_property_1 request_number_1
#define indigo_change_switch_property_1 request_switch
#define indigo_change_text_property_1 request_text

static bool set_switch(int index, const char *property, const char *item, bool value) {
	return indigo_change_switch_property_1(&test_client, observed[index].name, property, item, value) == INDIGO_OK;
}

static bool connect_device(int index, bool connect) {
	return set_switch(index, "CONNECTION", connect ? "CONNECTED" : "DISCONNECTED", true) && wait_state(index, "CONNECTION", INDIGO_OK_STATE);
}

static void baseline_camera(void) {
	ASSERT_TRUE(connect_device(0, true));
	ASSERT_TRUE(set_switch(0, "CCD_IMAGE_FORMAT", "RAW", true));
	ASSERT_EQ_INT(indigo_change_number_property_1(&test_client, observed[0].name, "CCD_EXPOSURE", "EXPOSURE", .01), INDIGO_OK);
	ASSERT_TRUE(wait_state(0, "CCD_EXPOSURE", INDIGO_OK_STATE));
	ASSERT_EQ_INT(atomic_load(&blobs), 1);
	ASSERT_EQ_INT(atomic_load(&bad_blob), 0);
	ASSERT_TRUE(connect_device(0, false));
}

static void baseline_guider(void) {
	ASSERT_TRUE(connect_device(1, true));
	ASSERT_EQ_INT(indigo_change_number_property_1(&test_client, observed[1].name, "GUIDER_GUIDE_RA", "EAST", 20), INDIGO_OK);
	ASSERT_TRUE(wait_state(1, "GUIDER_GUIDE_RA", INDIGO_OK_STATE));
	ASSERT_EQ_INT(cameras[0].relay, 0);
	ASSERT_TRUE(connect_device(1, false));
}

static void baseline_wheel(void) {
	ASSERT_TRUE(connect_device(2, true));
	ASSERT_EQ_INT(indigo_change_number_property_1(&test_client, observed[2].name, "WHEEL_SLOT", "SLOT", 5), INDIGO_OK);
	ASSERT_TRUE(wait_state(2, "WHEEL_SLOT", INDIGO_OK_STATE));
	ASSERT_EQ_INT(cameras[0].slot, 4);
	ASSERT_TRUE(connect_device(2, false));
}

static bool number(int index, const char *prop, const char *item, double value, int expected) {
	return indigo_change_number_property_1(&test_client, observed[index].name, prop, item, value) == INDIGO_OK && wait_state(index, prop, expected);
}

static bool toggle(int index, const char *prop, const char *item, int expected) {
	return set_switch(index, prop, item, true) && wait_state(index, prop, expected);
}

static double value(int index, const char *prop, const char *item) {
	indigo_property *p = snapshot(index, prop);
	double result = -99999;
	if (p) {
		for (int i = 0; i < p->count; i++) {
			if (!strcmp(p->items[i].name, item)) {
				result = p->items[i].number.value;
			}
		}
	}
	indigo_release_property(p);
	return result;
}

static void metadata_profiles(void) {
	const unsigned interfaces[] = { INDIGO_INTERFACE_CCD, INDIGO_INTERFACE_GUIDER, INDIGO_INTERFACE_WHEEL };
	for (int i = 0; i < 3; i++) {
		indigo_property *property = snapshot(i, "INFO");
		ASSERT_TRUE(property != NULL);
		indigo_item *item = indigo_get_item(property, "DEVICE_INTERFACE");
		ASSERT_TRUE(item != NULL);
		unsigned interface = strtoul(item->text.value, NULL, 10);
		indigo_release_property(property);
		ASSERT_TRUE((interface & interfaces[i]) != 0);
	}
	indigo_driver_info info;
	ASSERT_EQ_INT(INDIGO_OK, indigo_ccd_atik(INDIGO_DRIVER_INFO, &info));
	ASSERT_EQ_INT(0x03000024, info.version);
	ASSERT_EQ_INT(-1, state(0, "X_PRESETS"));
	ASSERT_TRUE(connect_device(0, true));
	const char *props[] = { "CCD_INFO", "CCD_READ_MODE", "CCD_GAIN", "CCD_OFFSET", "X_PRESETS", "X_WINDOW_HEATER", "CCD_TEMPERATURE", "CCD_COOLER", "CCD_COOLER_POWER" };
	for (int i = 0; i < ARRAY_SIZE(props); i++) {
		ASSERT_TRUE(state(0, props[i]) >= 0);
	}
	indigo_property *contract = snapshot(0, "X_PRESETS");
	ASSERT_TRUE(contract != NULL);
	ASSERT_EQ_INT(INDIGO_SWITCH_VECTOR, contract->type);
	ASSERT_EQ_INT(INDIGO_RW_PERM, contract->perm);
	ASSERT_EQ_INT(INDIGO_ONE_OF_MANY_RULE, contract->rule);
	ASSERT_EQ_INT(4, contract->count);
	const char *items[] = { "CUSTOM", "LOW", "MED", "HIGH" };
	for (int i = 0; i < 4; i++) {
		ASSERT_STREQ(items[i], contract->items[i].name);
	}
	indigo_release_property(contract);
	contract = snapshot(0, "X_WINDOW_HEATER");
	ASSERT_TRUE(contract != NULL);
	ASSERT_EQ_INT(INDIGO_NUMBER_VECTOR, contract->type);
	ASSERT_EQ_INT(1, contract->count);
	ASSERT_STREQ("POWER", contract->items[0].name);
	ASSERT_EQ_INT(0, contract->items[0].number.min);
	ASSERT_EQ_INT(255, contract->items[0].number.max);
	ASSERT_EQ_INT(1, contract->items[0].number.step);
	indigo_release_property(contract);
	contract = snapshot(0, "CCD_MODE");
	ASSERT_TRUE(contract != NULL);
	ASSERT_EQ_INT(3, contract->count);
	indigo_release_property(contract);
	ASSERT_EQ_INT(-1, state(0, "ATIK_PRESETS"));
	ASSERT_EQ_INT(-1, state(0, "ATIK_WINDOW_HEATER"));
	ASSERT_EQ_INT(-1, state(0, "CCD_STREAMING"));
	ASSERT_TRUE(connect_device(0, false));
	cameras[0].cooler = cameras[0].heater = cameras[0].presets = false;
	ASSERT_TRUE(connect_device(0, true));
	const char *hidden[] = { "X_PRESETS", "X_WINDOW_HEATER", "CCD_GAIN", "CCD_OFFSET", "CCD_COOLER", "CCD_TEMPERATURE" };
	for (int i = 0; i < ARRAY_SIZE(hidden); i++) {
		ASSERT_EQ_INT(-1, state(0, hidden[i]));
	}
}

static void shared_lifecycle(void) {
	const int permutations[][3] = { { 0, 1, 2 }, { 0, 2, 1 }, { 1, 0, 2 }, { 1, 2, 0 }, { 2, 0, 1 }, { 2, 1, 0 } };
	for (int i = 0; i < 6; i++) {
		int opens = cameras[0].opens;
		for (int j = 0; j < 3; j++) {
			ASSERT_TRUE(connect_device(permutations[i][j], true));
		}
		ASSERT_EQ_INT(opens + 1, cameras[0].opens);
		ASSERT_EQ_INT(INDIGO_BUSY, indigo_ccd_atik(INDIGO_DRIVER_SHUTDOWN, NULL));
		ASSERT_TRUE(connect_device(1, false));
		ASSERT_TRUE(toggle(0, "CCD_IMAGE_FORMAT", "RAW", INDIGO_OK_STATE));
		ASSERT_TRUE(number(0, "CCD_EXPOSURE", "EXPOSURE", .01, INDIGO_OK_STATE));
		ASSERT_TRUE(connect_device(0, false));
		ASSERT_TRUE(number(2, "WHEEL_SLOT", "SLOT", 3, INDIGO_OK_STATE));
		ASSERT_TRUE(connect_device(2, false));
		ASSERT_EQ_INT(cameras[0].opens, cameras[0].closes);
	}
}

static void initialization_failures(void) {
	const char *calls[] = { "ArtemisConnect", "ArtemisProperties", "ArtemisGetMaxBin", "ArtemisTemperatureSensorInfo", "ArtemisCoolingInfo", "ArtemisGetWindowHeaterPower", "ArtemisCameraSpecificOptionGetData" };
	for (int i = 0; i < ARRAY_SIZE(calls); i++) {
		fail_call = calls[i];
		ASSERT_TRUE(set_switch(0, "CONNECTION", "CONNECTED", true));
		ASSERT_TRUE(wait_state(0, "CONNECTION", INDIGO_ALERT_STATE));
		ASSERT_EQ_INT(0, lock_count);
		ASSERT_FALSE(cameras[0].opened);
		fail_call = NULL;
		ASSERT_TRUE(connect_device(0, true));
		ASSERT_TRUE(connect_device(0, false));
	}
	ASSERT_TRUE(connect_device(1, true));
	fail_call = "ArtemisProperties";
	ASSERT_TRUE(set_switch(0, "CONNECTION", "CONNECTED", true));
	ASSERT_TRUE(wait_state(0, "CONNECTION", INDIGO_ALERT_STATE));
	ASSERT_TRUE(cameras[0].opened);
	fail_call = NULL;
	ASSERT_TRUE(number(1, "GUIDER_GUIDE_RA", "EAST", 10, INDIGO_OK_STATE));
}

static void malformed_initialization(void) {
	for (int malformed = 1; malformed <= 3; malformed += 2) {
		cameras[0].malformed = malformed;
		ASSERT_TRUE(set_switch(0, "CONNECTION", "CONNECTED", true));
		ASSERT_TRUE(wait_state(0, "CONNECTION", INDIGO_ALERT_STATE));
		ASSERT_FALSE(cameras[0].opened);
	}
	cameras[0].malformed = 0;
	cameras[0].short_option = 1;
	ASSERT_TRUE(set_switch(0, "CONNECTION", "CONNECTED", true));
	ASSERT_TRUE(wait_state(0, "CONNECTION", INDIGO_ALERT_STATE));
	cameras[0].short_option = 0;
	ASSERT_TRUE(connect_device(0, true));
}

static void shutterless_acquisition(void) {
	cameras[0].shutter = false;
	ASSERT_TRUE(connect_device(0, true));
	const char *types[] = { "LIGHT", "DARK", "BIAS", "DARKFLAT", "FLAT" };
	for (int i = 0; i < ARRAY_SIZE(types); i++) {
		ASSERT_TRUE(set_switch(0, "CCD_FRAME_TYPE", types[i], true));
		ASSERT_TRUE(number(0, "CCD_EXPOSURE", "EXPOSURE", .01, INDIGO_OK_STATE));
	}
	ASSERT_EQ_INT(5, blobs);
	ASSERT_EQ_INT(0, cameras[0].dark_calls);
	ASSERT_TRUE(connect_device(0, false));
	cameras[0].shutter = true;
	ASSERT_TRUE(connect_device(0, true));
	ASSERT_TRUE(number(0, "CCD_EXPOSURE", "EXPOSURE", .01, INDIGO_OK_STATE));
	ASSERT_EQ_INT(1, cameras[0].dark_calls);
}

static void acquisition_errors(void) {
	ASSERT_TRUE(connect_device(0, true));
	const char *calls[] = { "ArtemisSetPreview", "ArtemisSetDarkMode", "ArtemisBin", "ArtemisSubframe", "ArtemisStartExposure", "ArtemisImageFailed", "ArtemisGetImageData", "ArtemisImageBuffer" };
	for (int i = 0; i < ARRAY_SIZE(calls); i++) {
		int images = blobs;
		fail_call = calls[i];
		ASSERT_TRUE(number(0, "CCD_EXPOSURE", "EXPOSURE", .01, INDIGO_ALERT_STATE));
		ASSERT_EQ_INT(images, blobs);
		fail_call = NULL;
		ASSERT_TRUE(number(0, "CCD_EXPOSURE", "EXPOSURE", .01, INDIGO_OK_STATE));
	}
	cameras[0].malformed = 2;
	ASSERT_TRUE(number(0, "CCD_EXPOSURE", "EXPOSURE", .01, INDIGO_ALERT_STATE));
	cameras[0].malformed = 0;
	ASSERT_TRUE(number(0, "CCD_EXPOSURE", "EXPOSURE", .01, INDIGO_OK_STATE));
}

static void geometry_and_payload(void) {
	ASSERT_TRUE(connect_device(0, true));
	ASSERT_TRUE(toggle(0, "CCD_IMAGE_FORMAT", "RAW", INDIGO_OK_STATE));
	ASSERT_TRUE(number(0, "CCD_EXPOSURE", "EXPOSURE", .01, INDIGO_OK_STATE));
	ASSERT_TRUE(number(0, "CCD_BIN", "HORIZONTAL", 2, INDIGO_OK_STATE));
	ASSERT_TRUE(number(0, "CCD_BIN", "VERTICAL", 4, INDIGO_OK_STATE));
	const char *items[] = { "LEFT", "TOP", "WIDTH", "HEIGHT" };
	double values[] = { 12, 16, 128, 96 };
	ASSERT_EQ_INT(INDIGO_OK, indigo_change_number_property(&test_client, observed[0].name, "CCD_FRAME", 4, items, values));
	ASSERT_TRUE(wait_state(0, "CCD_FRAME", INDIGO_OK_STATE));
	ASSERT_TRUE(number(0, "CCD_EXPOSURE", "EXPOSURE", .01, INDIGO_OK_STATE));
	ASSERT_EQ_INT(0, bad_blob);
	ASSERT_EQ_INT(12, cameras[0].left);
	ASSERT_EQ_INT(4, cameras[0].by);
}

static void durations_and_frame_types(void) {
	ASSERT_TRUE(connect_device(0, true));
	const double durations[] = { .001, .1, 1.5, 2.5 };
	for (int i = 0; i < ARRAY_SIZE(durations); i++) {
		double start = indigo_monotonic_time();
		ASSERT_TRUE(number(0, "CCD_EXPOSURE", "EXPOSURE", durations[i], INDIGO_OK_STATE));
		ASSERT_TRUE(fabs(cameras[0].exposure - durations[i]) < .00001);
		ASSERT_TRUE(indigo_monotonic_time() - start >= durations[i]);
	}
	const char *types[] = { "DARK", "DARKFLAT", "BIAS", "FLAT", "LIGHT" };
	for (int i = 0; i < ARRAY_SIZE(types); i++) {
		ASSERT_TRUE(toggle(0, "CCD_FRAME_TYPE", types[i], INDIGO_OK_STATE));
		ASSERT_TRUE(number(0, "CCD_EXPOSURE", "EXPOSURE", .01, INDIGO_OK_STATE));
		ASSERT_EQ_INT(i < 3, cameras[0].dark);
		if (i == 2) {
			ASSERT_TRUE(fabs(cameras[0].exposure - .001) < .00001);
		}
	}
	ASSERT_TRUE(toggle(0, "CCD_READ_MODE", "HIGH_SPEED", INDIGO_OK_STATE));
	ASSERT_TRUE(number(0, "CCD_EXPOSURE", "EXPOSURE", .01, INDIGO_OK_STATE));
	ASSERT_EQ_INT(1, cameras[0].preview);
}

static void cooling_and_controls(void) {
	ASSERT_TRUE(connect_device(0, true));
	ASSERT_TRUE(number(0, "CCD_TEMPERATURE", "TEMPERATURE", -10.25, INDIGO_BUSY_STATE));
	ASSERT_TRUE(wait_count(&cameras[0].target, -1025));
	ASSERT_EQ_INT(12, (int)value(0, "CCD_TEMPERATURE", "TEMPERATURE"));
	ASSERT_TRUE(number(0, "X_WINDOW_HEATER", "POWER", 255, INDIGO_OK_STATE));
	ASSERT_EQ_INT(255, cameras[0].heater_power);
	const char *presets[] = { "LOW", "MED", "HIGH", "CUSTOM" };
	for (int i = 0; i < 4; i++) {
		ASSERT_TRUE(toggle(0, "X_PRESETS", presets[i], INDIGO_OK_STATE));
		ASSERT_EQ_INT((i + 1) % 4, cameras[0].preset);
		ASSERT_TRUE(i == 3 ? state(0, "CCD_GAIN") >= 0 : state(0, "CCD_GAIN") < 0);
	}
	ASSERT_TRUE(number(0, "CCD_GAIN", "GAIN", 60, INDIGO_OK_STATE));
	ASSERT_TRUE(number(0, "CCD_OFFSET", "OFFSET", 511, INDIGO_OK_STATE));
	ASSERT_EQ_INT(60, cameras[0].gain);
	ASSERT_EQ_INT(511, cameras[0].offset);
	fail_call = "ArtemisCameraSpecificOptionSetData";
	ASSERT_TRUE(toggle(0, "X_PRESETS", "LOW", INDIGO_ALERT_STATE));
	ASSERT_EQ_INT(0, cameras[0].preset);
	ASSERT_TRUE(number(0, "CCD_GAIN", "GAIN", 1, INDIGO_ALERT_STATE));
	ASSERT_EQ_INT(60, (int)value(0, "CCD_GAIN", "GAIN"));
	fail_call = "ArtemisSetWindowHeaterPower";
	ASSERT_TRUE(number(0, "X_WINDOW_HEATER", "POWER", 0, INDIGO_ALERT_STATE));
	ASSERT_EQ_INT(255, (int)value(0, "X_WINDOW_HEATER", "POWER"));
	fail_call = "ArtemisSetCooling";
	ASSERT_TRUE(number(0, "CCD_TEMPERATURE", "TEMPERATURE", -5, INDIGO_ALERT_STATE));
	fail_call = "ArtemisCoolerWarmUp";
	ASSERT_TRUE(toggle(0, "CCD_COOLER", "OFF", INDIGO_ALERT_STATE));
	fail_call = NULL;
	ASSERT_TRUE(toggle(0, "CCD_COOLER", "OFF", INDIGO_OK_STATE));
}

static void wheel_errors(void) {
	fail_call = "ArtemisFilterWheelInfo";
	ASSERT_TRUE(set_switch(2, "CONNECTION", "CONNECTED", true));
	ASSERT_TRUE(wait_state(2, "CONNECTION", INDIGO_ALERT_STATE));
	fail_call = NULL;
	ASSERT_TRUE(connect_device(2, true));
	for (int slot = 1; slot <= 5; slot += 2) {
		ASSERT_TRUE(number(2, "WHEEL_SLOT", "SLOT", slot, INDIGO_OK_STATE));
	}
	ASSERT_TRUE(number(2, "WHEEL_SLOT", "SLOT", 5, INDIGO_OK_STATE));
	fail_call = "ArtemisFilterWheelMove";
	ASSERT_TRUE(number(2, "WHEEL_SLOT", "SLOT", 1, INDIGO_ALERT_STATE));
	fail_call = "ArtemisFilterWheelInfo";
	ASSERT_TRUE(number(2, "WHEEL_SLOT", "SLOT", 1, INDIGO_ALERT_STATE));
	fail_call = NULL;
	cameras[0].malformed = 4;
	ASSERT_TRUE(number(2, "WHEEL_SLOT", "SLOT", 3, INDIGO_ALERT_STATE));
	cameras[0].malformed = 0;
	ASSERT_TRUE(number(2, "WHEEL_SLOT", "SLOT", 3, INDIGO_OK_STATE));
	ASSERT_TRUE(connect_device(2, false));
	cameras[0].slot_count = 8;
	ASSERT_TRUE(connect_device(2, true));
	ASSERT_TRUE(number(2, "WHEEL_SLOT", "SLOT", 8, INDIGO_OK_STATE));
}

static void guide_axes_and_replacement(void) {
	ASSERT_TRUE(connect_device(1, true));
	const char *items[] = { "EAST", "WEST", "NORTH", "SOUTH" };
	for (int i = 0; i < 4; i++) {
		ASSERT_TRUE(number(1, i < 2 ? "GUIDER_GUIDE_RA" : "GUIDER_GUIDE_DEC", items[i], 20, INDIGO_OK_STATE));
	}
	ASSERT_TRUE(number(1, "GUIDER_GUIDE_RA", "EAST", 300, INDIGO_BUSY_STATE));
	ASSERT_TRUE(number(1, "GUIDER_GUIDE_DEC", "NORTH", 20, INDIGO_OK_STATE));
	ASSERT_EQ_INT(4, cameras[0].relay);
	ASSERT_TRUE(number(1, "GUIDER_GUIDE_RA", "WEST", 20, INDIGO_OK_STATE));
	ASSERT_EQ_INT(0, cameras[0].relay);
	ASSERT_TRUE(number(1, "GUIDER_GUIDE_RA", "EAST", 300, INDIGO_BUSY_STATE));
	ASSERT_TRUE(number(1, "GUIDER_GUIDE_RA", "EAST", 0, INDIGO_OK_STATE));
	ASSERT_EQ_INT(0, cameras[0].relay);
	fail_call = "ArtemisGuidePort";
	ASSERT_TRUE(number(1, "GUIDER_GUIDE_RA", "EAST", 20, INDIGO_ALERT_STATE));
	fail_call = NULL;
	ASSERT_TRUE(number(1, "GUIDER_GUIDE_RA", "EAST", 20, INDIGO_OK_STATE));
}

static void abort_readout_restart(void) {
	ASSERT_TRUE(connect_device(0, true));
	cameras[0].abort_readout_ms = 500;
	ASSERT_TRUE(number(0, "CCD_EXPOSURE", "EXPOSURE", 2, INDIGO_BUSY_STATE));
	ASSERT_TRUE(wait_count(&cameras[0].starts, 1));
	ASSERT_TRUE(set_switch(0, "CCD_ABORT_EXPOSURE", "ABORT_EXPOSURE", true));
	ASSERT_TRUE(wait_state(0, "CCD_ABORT_EXPOSURE", INDIGO_OK_STATE));
	ASSERT_TRUE(number(0, "CCD_EXPOSURE", "EXPOSURE", .01, INDIGO_OK_STATE));
	ASSERT_EQ_INT(2, cameras[0].starts);
	ASSERT_EQ_INT(1, blobs);
	ASSERT_TRUE(cameras[0].drain_checks > 0);
	cameras[0].abort_readout_ms = 10000;
	ASSERT_TRUE(number(0, "CCD_EXPOSURE", "EXPOSURE", 2, INDIGO_BUSY_STATE));
	ASSERT_TRUE(wait_count(&cameras[0].starts, 3));
	ASSERT_TRUE(set_switch(0, "CCD_ABORT_EXPOSURE", "ABORT_EXPOSURE", true));
	ASSERT_TRUE(wait_state(0, "CCD_ABORT_EXPOSURE", INDIGO_OK_STATE));
	arm_gate("queue");
	ASSERT_TRUE(number(0, "CCD_EXPOSURE", "EXPOSURE", .01, INDIGO_BUSY_STATE));
	indigo_execute_handler(logical[0], block_queue);
	ASSERT_TRUE(wait_count(&gates_entered, 1));
	clock_shift = 200;
	release_gate();
	ASSERT_TRUE(wait_state(0, "CCD_EXPOSURE", INDIGO_ALERT_STATE));
	ASSERT_EQ_INT(3, cameras[0].starts);
	ASSERT_EQ_INT(0, cameras[0].temperature_in_drain);
	ASSERT_TRUE(connect_device(0, false));
	clock_shift = 0;
	cameras[0].drain_end = 0;
	ASSERT_TRUE(connect_device(0, true));
	ASSERT_TRUE(number(0, "CCD_EXPOSURE", "EXPOSURE", .01, INDIGO_OK_STATE));
}

static void abort_and_busy(void) {
	ASSERT_TRUE(connect_device(0, true));
	ASSERT_TRUE(connect_device(1, true));
	ASSERT_TRUE(number(0, "CCD_EXPOSURE", "EXPOSURE", 2.5, INDIGO_BUSY_STATE));
	ASSERT_TRUE(number(0, "CCD_BIN", "HORIZONTAL", 2, INDIGO_ALERT_STATE));
	ASSERT_TRUE(number(0, "CCD_GAIN", "GAIN", 55, INDIGO_ALERT_STATE));
	ASSERT_TRUE(toggle(0, "X_PRESETS", "HIGH", INDIGO_ALERT_STATE));
	ASSERT_TRUE(number(1, "GUIDER_GUIDE_RA", "EAST", 20, INDIGO_OK_STATE));
	ASSERT_TRUE(toggle(0, "CCD_ABORT_EXPOSURE", "ABORT_EXPOSURE", INDIGO_OK_STATE));
	ASSERT_TRUE(number(0, "CCD_EXPOSURE", "EXPOSURE", .01, INDIGO_OK_STATE));
}

static void deadlines_and_recovery(void) {
	ASSERT_TRUE(connect_device(0, true));
	cameras[0].flushing = 1;
	ASSERT_TRUE(number(0, "CCD_EXPOSURE", "EXPOSURE", .01, INDIGO_BUSY_STATE));
	indigo_usleep(30000);
	clock_shift = 200;
	ASSERT_TRUE(wait_state(0, "CCD_EXPOSURE", INDIGO_ALERT_STATE));
	clock_shift = 0;
	cameras[0].flushing = 0;
	cameras[0].ready_stuck = 1;
	ASSERT_TRUE(number(0, "CCD_EXPOSURE", "EXPOSURE", .01, INDIGO_BUSY_STATE));
	indigo_usleep(30000);
	clock_shift = 200;
	ASSERT_TRUE(wait_state(0, "CCD_EXPOSURE", INDIGO_ALERT_STATE));
	clock_shift = 0;
	cameras[0].ready_stuck = 0;
	ASSERT_TRUE(number(0, "CCD_EXPOSURE", "EXPOSURE", .01, INDIGO_OK_STATE));
	ASSERT_TRUE(connect_device(2, true));
	cameras[0].moving = 1;
	ASSERT_TRUE(number(2, "WHEEL_SLOT", "SLOT", 3, INDIGO_BUSY_STATE));
	indigo_usleep(30000);
	clock_shift = 200;
	ASSERT_TRUE(wait_state(2, "WHEEL_SLOT", INDIGO_ALERT_STATE));
	clock_shift = 0;
	cameras[0].moving = 0;
	ASSERT_TRUE(number(2, "WHEEL_SLOT", "SLOT", 1, INDIGO_OK_STATE));
}

static void pending_start_abort(void) {
	ASSERT_TRUE(connect_device(0, true));
	arm_gate("queue");
	indigo_execute_handler(logical[0], block_queue);
	ASSERT_TRUE(wait_count(&gates_entered, 1));
	ASSERT_TRUE(number(0, "CCD_EXPOSURE", "EXPOSURE", 2.5, INDIGO_BUSY_STATE));
	ASSERT_TRUE(set_switch(0, "CCD_ABORT_EXPOSURE", "ABORT_EXPOSURE", true));
	release_gate();
	ASSERT_TRUE(wait_state(0, "CCD_ABORT_EXPOSURE", INDIGO_OK_STATE));
	ASSERT_EQ_INT(0, cameras[0].starts);
	ASSERT_TRUE(number(0, "CCD_EXPOSURE", "EXPOSURE", .01, INDIGO_OK_STATE));
}

static void readout_disconnect(void) {
	ASSERT_TRUE(connect_device(0, true));
	arm_gate("ArtemisGetImageData");
	ASSERT_TRUE(number(0, "CCD_EXPOSURE", "EXPOSURE", .01, INDIGO_BUSY_STATE));
	ASSERT_TRUE(wait_count(&gates_entered, 1));
	ASSERT_TRUE(set_switch(0, "CONNECTION", "DISCONNECTED", true));
	release_gate();
	ASSERT_TRUE(wait_state(0, "CONNECTION", INDIGO_OK_STATE));
	ASSERT_FALSE(cameras[0].opened);
	ASSERT_TRUE(connect_device(0, true));
	ASSERT_TRUE(number(0, "CCD_EXPOSURE", "EXPOSURE", .01, INDIGO_OK_STATE));
}

static void active_removal(void) {
	ASSERT_TRUE(connect_device(0, true));
	ASSERT_TRUE(connect_device(1, true));
	ASSERT_TRUE(connect_device(2, true));
	ASSERT_TRUE(number(0, "CCD_EXPOSURE", "EXPOSURE", 5, INDIGO_BUSY_STATE));
	ASSERT_TRUE(number(1, "GUIDER_GUIDE_RA", "EAST", 2000, INDIGO_BUSY_STATE));
	cameras[0].moving = 1;
	ASSERT_TRUE(number(2, "WHEEL_SLOT", "SLOT", 3, INDIGO_BUSY_STATE));
	cameras[0].visible = false;
	usb_event(0, false);
	ASSERT_TRUE(wait_count(&attached, 0));
	ASSERT_FALSE(cameras[0].opened);
	cameras[0].visible = true;
	cameras[0].moving = 0;
	usb_event(0, true);
	ASSERT_TRUE(wait_count(&attached, 3));
	ASSERT_TRUE(connect_device(0, true));
	ASSERT_TRUE(number(0, "CCD_EXPOSURE", "EXPOSURE", .01, INDIGO_OK_STATE));
}

static void discovery_identity(void) {
	cameras[1].visible = true;
	usb_event(1, true);
	ASSERT_TRUE(wait_count(&attached, 4));
	usb_event(1, true);
	ASSERT_TRUE(connect_device(3, true));
	cameras[0].visible = false;
	usb_event(0, false);
	ASSERT_TRUE(wait_count(&attached, 1));
	ASSERT_TRUE(number(3, "CCD_EXPOSURE", "EXPOSURE", .01, INDIGO_OK_STATE));
	ASSERT_TRUE(connect_device(3, false));
	ASSERT_TRUE(connect_device(3, true));
	ASSERT_TRUE(number(3, "CCD_EXPOSURE", "EXPOSURE", .01, INDIGO_OK_STATE));
}

static void discovery_rollback(void) {
	ASSERT_EQ_INT(INDIGO_OK, indigo_ccd_atik(INDIGO_DRIVER_SHUTDOWN, NULL));
	fail_register = 1;
	ASSERT_EQ_INT(INDIGO_FAILED, indigo_ccd_atik(INDIGO_DRIVER_INIT, NULL));
	fail_register = 0;
	fail_queue = 1;
	ASSERT_EQ_INT(INDIGO_FAILED, indigo_ccd_atik(INDIGO_DRIVER_INIT, NULL));
	fail_queue = 0;
	fail_attach = 1;
	ASSERT_EQ_INT(INDIGO_OK, indigo_ccd_atik(INDIGO_DRIVER_INIT, NULL));
	indigo_queue_drain(driver_queue);
	ASSERT_EQ_INT(0, attached);
	fail_attach = 0;
	usb_event(0, true);
	ASSERT_TRUE(wait_count(&attached, 3));
	fail_lock = 1;
	ASSERT_TRUE(set_switch(0, "CONNECTION", "CONNECTED", true));
	ASSERT_TRUE(wait_state(0, "CONNECTION", INDIGO_ALERT_STATE));
	fail_lock = 0;
	ASSERT_TRUE(connect_device(0, true));
}

static void discovery_filters_and_strings(void) {
	ASSERT_EQ_INT(INDIGO_OK, indigo_ccd_atik(INDIGO_DRIVER_SHUTDOWN, NULL));
	wrong_vendor = 1;
	ASSERT_EQ_INT(INDIGO_OK, indigo_ccd_atik(INDIGO_DRIVER_INIT, NULL));
	indigo_queue_drain(driver_queue);
	ASSERT_EQ_INT(0, attached);
	wrong_vendor = 0;
	fail_descriptor = 1;
	usb_event(0, true);
	indigo_queue_drain(driver_queue);
	ASSERT_EQ_INT(0, attached);
	fail_descriptor = 0;
	bad_string = 1;
	usb_event(0, true);
	indigo_queue_drain(driver_queue);
	ASSERT_EQ_INT(0, attached);
	bad_string = 0;
	not_camera = 1;
	usb_event(0, true);
	indigo_queue_drain(driver_queue);
	ASSERT_EQ_INT(0, attached);
	not_camera = 0;
	usb_event(0, true);
	ASSERT_TRUE(wait_count(&attached, 3));
	discovery_fail = 1;
	usb_event(1, false);
	indigo_queue_drain(driver_queue);
	ASSERT_EQ_INT(3, attached);
	discovery_fail = 0;
	ASSERT_TRUE(connect_device(0, true));
}

static void delayed_discovery_and_shutdown(void) {
	ASSERT_EQ_INT(INDIGO_OK, indigo_ccd_atik(INDIGO_DRIVER_SHUTDOWN, NULL));
	cameras[0].visible = false;
	int before = discovery_calls;
	ASSERT_EQ_INT(INDIGO_OK, indigo_ccd_atik(INDIGO_DRIVER_INIT, NULL));
	ASSERT_TRUE(wait_count(&discovery_calls, before + 1));
	cameras[0].visible = true;
	ASSERT_TRUE(wait_count(&attached, 3));
	ASSERT_EQ_INT(INDIGO_OK, indigo_ccd_atik(INDIGO_DRIVER_SHUTDOWN, NULL));
	cameras[0].visible = false;
	ASSERT_EQ_INT(INDIGO_OK, indigo_ccd_atik(INDIGO_DRIVER_INIT, NULL));
	ASSERT_EQ_INT(INDIGO_OK, indigo_ccd_atik(INDIGO_DRIVER_SHUTDOWN, NULL));
	ASSERT_EQ_INT(0, usb_refs);
	cameras[0].visible = true;
	ASSERT_EQ_INT(INDIGO_OK, indigo_ccd_atik(INDIGO_DRIVER_INIT, NULL));
	ASSERT_TRUE(wait_count(&attached, 3));
}

static void capacity_and_survivors(void) {
	for (int i = 1; i < CAMERAS; i++) {
		cameras[i].visible = true;
		usb_event(i, true);
	}
	ASSERT_TRUE(wait_count(&attached, 5));
	ASSERT_TRUE(connect_device(3, true));
	cameras[0].visible = false;
	usb_event(0, false);
	indigo_queue_drain(driver_queue);
	ASSERT_TRUE(number(3, "CCD_EXPOSURE", "EXPOSURE", .01, INDIGO_OK_STATE));
	usb_event(10, true);
	usb_event(11, true);
	indigo_queue_drain(driver_queue);
	ASSERT_TRUE(attached == 5);
}

static void optional_slave_attach_failure(void) {
	ASSERT_EQ_INT(INDIGO_OK, indigo_ccd_atik(INDIGO_DRIVER_SHUTDOWN, NULL));
	fail_attach = 2;
	ASSERT_EQ_INT(INDIGO_OK, indigo_ccd_atik(INDIGO_DRIVER_INIT, NULL));
	ASSERT_TRUE(wait_count(&attached, 2));
	ASSERT_TRUE(connect_device(0, true));
	ASSERT_TRUE(number(0, "CCD_EXPOSURE", "EXPOSURE", .01, INDIGO_OK_STATE));
	ASSERT_TRUE(connect_device(0, false));
	cameras[0].visible = false;
	usb_event(0, false);
	ASSERT_TRUE(wait_count(&attached, 0));
	fail_attach = 0;
	cameras[0].visible = true;
	usb_event(0, true);
	ASSERT_TRUE(wait_count(&attached, 3));
}

static void crop_383_image(void) {
	cameras[0].sensor_width = 3354;
	cameras[0].sensor_height = 2529;
	ASSERT_TRUE(connect_device(0, true));
	ASSERT_EQ_INT(3326, (int)value(0, "CCD_INFO", "WIDTH"));
	ASSERT_EQ_INT(2504, (int)value(0, "CCD_INFO", "HEIGHT"));
	ASSERT_TRUE(toggle(0, "CCD_IMAGE_FORMAT", "RAW", INDIGO_OK_STATE));
	ASSERT_TRUE(number(0, "CCD_EXPOSURE", "EXPOSURE", .01, INDIGO_OK_STATE));
	ASSERT_EQ_INT(0, bad_blob);
}

static void poll_errors_and_cancellation(void) {
	ASSERT_TRUE(connect_device(0, true));
	fail_call = "ArtemisTemperatureSensorInfo";
	ASSERT_TRUE(wait_state(0, "CCD_TEMPERATURE", INDIGO_ALERT_STATE));
	fail_call = NULL;
	ASSERT_TRUE(wait_state(0, "CCD_TEMPERATURE", INDIGO_OK_STATE));
	cameras[0].malformed = 3;
	ASSERT_TRUE(wait_state(0, "CCD_COOLER_POWER", INDIGO_ALERT_STATE));
	cameras[0].malformed = 0;
	ASSERT_TRUE(wait_state(0, "CCD_COOLER_POWER", INDIGO_OK_STATE));
	ASSERT_TRUE(number(0, "CCD_TEMPERATURE", "TEMPERATURE", -10, INDIGO_BUSY_STATE));
	ASSERT_TRUE(wait_count(&cameras[0].target, -1000));
	cameras[0].temperature = -1000;
	ASSERT_TRUE(wait_state(0, "CCD_TEMPERATURE", INDIGO_OK_STATE));
	ASSERT_TRUE(connect_device(0, false));
	indigo_usleep(150000);
	ASSERT_EQ_INT(0, sdk_after_close);
}

static void preset_readback_failures(void) {
	ASSERT_TRUE(connect_device(0, true));
	ASSERT_TRUE(toggle(0, "X_PRESETS", "LOW", INDIGO_OK_STATE));
	cameras[0].short_option = 1;
	ASSERT_TRUE(toggle(0, "X_PRESETS", "CUSTOM", INDIGO_ALERT_STATE));
	ASSERT_EQ_INT(-1, state(0, "CCD_GAIN"));
	cameras[0].short_option = 0;
	ASSERT_TRUE(toggle(0, "X_PRESETS", "CUSTOM", INDIGO_OK_STATE));
	ASSERT_TRUE(number(0, "CCD_GAIN", "GAIN", 0, INDIGO_OK_STATE));
	ASSERT_TRUE(number(0, "CCD_OFFSET", "OFFSET", 0, INDIGO_OK_STATE));
}

static void wheel_wraparound_position(void) {
	cameras[0].slot = cameras[0].wheel_target = 4;
	ASSERT_TRUE(connect_device(2, true));
	cameras[0].moving = 4;
	cameras[0].malformed = 5;
	ASSERT_TRUE(number(2, "WHEEL_SLOT", "SLOT", 1, INDIGO_BUSY_STATE));
	ASSERT_TRUE(wait_count(&cameras[0].wheel_wrap_reads, 1));
	arm_gate("queue");
	indigo_execute_handler(logical[2], block_queue);
	ASSERT_TRUE(wait_count(&gates_entered, 1));
	indigo_property *slot = snapshot(2, "WHEEL_SLOT");
	bool retained = slot && slot->state == INDIGO_BUSY_STATE && slot->items[0].number.value == 5;
	indigo_release_property(slot);
	release_gate();
	ASSERT_TRUE(retained);
	cameras[0].malformed = 0;
	cameras[0].moving = 0;
	ASSERT_TRUE(wait_state(2, "WHEEL_SLOT", INDIGO_OK_STATE));
	ASSERT_TRUE(connect_device(2, false));
	cameras[0].malformed = 5;
	ASSERT_TRUE(set_switch(2, "CONNECTION", "CONNECTED", true));
	ASSERT_TRUE(wait_state(2, "CONNECTION", INDIGO_ALERT_STATE));
	cameras[0].malformed = 0;
	ASSERT_TRUE(connect_device(2, true));
	ASSERT_TRUE(number(2, "WHEEL_SLOT", "SLOT", 2, INDIGO_OK_STATE));
}

static void initial_wheel_unknown_target(void) {
	cameras[0].moving = 1;
	cameras[0].wheel_target = 209;
	ASSERT_TRUE(connect_device(2, true));
	ASSERT_TRUE(wait_state(2, "WHEEL_SLOT", INDIGO_ALERT_STATE));
	ASSERT_EQ_INT(209, cameras[0].wheel_target);
	ASSERT_TRUE(number(2, "WHEEL_SLOT", "SLOT", 3, INDIGO_BUSY_STATE));
	ASSERT_TRUE(wait_count(&cameras[0].wheel_target, 2));
	cameras[0].moving = 0;
	ASSERT_TRUE(wait_state(2, "WHEEL_SLOT", INDIGO_OK_STATE));
	cameras[0].moving = 1;
	ASSERT_TRUE(number(2, "WHEEL_SLOT", "SLOT", 4, INDIGO_BUSY_STATE));
	ASSERT_TRUE(wait_count(&cameras[0].wheel_target, 3));
	cameras[0].wheel_target = 209;
	ASSERT_TRUE(wait_state(2, "WHEEL_SLOT", INDIGO_ALERT_STATE));
	cameras[0].moving = 0;
	ASSERT_TRUE(number(2, "WHEEL_SLOT", "SLOT", 1, INDIGO_OK_STATE));
}

static void initial_wheel_moving(void) {
	cameras[0].moving = 1;
	cameras[0].wheel_target = 3;
	ASSERT_TRUE(connect_device(2, true));
	ASSERT_TRUE(wait_state(2, "WHEEL_SLOT", INDIGO_BUSY_STATE));
	cameras[0].slot = 3;
	cameras[0].moving = 0;
	ASSERT_TRUE(wait_state(2, "WHEEL_SLOT", INDIGO_OK_STATE));
	ASSERT_TRUE(connect_device(2, false));
	cameras[0].malformed = 4;
	ASSERT_TRUE(set_switch(2, "CONNECTION", "CONNECTED", true));
	ASSERT_TRUE(wait_state(2, "CONNECTION", INDIGO_ALERT_STATE));
	cameras[0].malformed = 0;
	ASSERT_TRUE(connect_device(2, true));
}

static void countdown_with_occupied_queue(void) {
	ASSERT_TRUE(connect_device(0, true));
	ASSERT_TRUE(number(0, "CCD_EXPOSURE", "EXPOSURE", 2.5, INDIGO_BUSY_STATE));
	ASSERT_TRUE(wait_count(&cameras[0].starts, 1));
	arm_gate("queue");
	indigo_execute_handler(logical[0], block_queue);
	ASSERT_TRUE(wait_count(&gates_entered, 1));
	double deadline = indigo_monotonic_time() + 2;
	while (value(0, "CCD_EXPOSURE", "EXPOSURE") > 2 && indigo_monotonic_time() < deadline) {
		indigo_usleep(10000);
	}
	bool progressed = value(0, "CCD_EXPOSURE", "EXPOSURE") <= 2;
	release_gate();
	ASSERT_TRUE(progressed);
	ASSERT_TRUE(wait_state(0, "CCD_EXPOSURE", INDIGO_OK_STATE));
	ASSERT_TRUE(fabs(cameras[0].exposure - 2.5) < .0001);
}

static void guide_duration_measurements(void) {
	ASSERT_TRUE(connect_device(0, true));
	ASSERT_TRUE(connect_device(1, true));
	const char *items[] = { "NORTH", "SOUTH", "EAST", "WEST" };
	const double durations[] = { 20, 50, 100, 250, 500 };
	double errors[80];
	int samples = 0;
	for (int workload = 0; workload < 2; workload++) {
		if (workload) {
			ASSERT_TRUE(number(0, "CCD_EXPOSURE", "EXPOSURE", 16.5, INDIGO_BUSY_STATE));
		}
		for (int direction = 0; direction < 4; direction++) {
			ASSERT_TRUE(number(1, direction < 2 ? "GUIDER_GUIDE_DEC" : "GUIDER_GUIDE_RA", items[direction], 20, INDIGO_OK_STATE));
			for (int sample = 0; sample < 10; sample++) {
				int j = sample % 5;
				ASSERT_TRUE(number(1, direction < 2 ? "GUIDER_GUIDE_DEC" : "GUIDER_GUIDE_RA", items[direction], durations[j], INDIGO_OK_STATE));
				double error = cameras[0].pulse_ms[direction] - durations[j];
				errors[samples++] = error;
				printf("pulse %s requested %.0f measured %.3f error %+.3f ms (%+.2f%%) workload=%d\n", items[direction], durations[j], cameras[0].pulse_ms[direction], error, error * 100 / durations[j], workload);
			}
		}
		if (workload) {
			ASSERT_TRUE(toggle(0, "CCD_ABORT_EXPOSURE", "ABORT_EXPOSURE", INDIGO_OK_STATE));
		}
	}
	double sum = 0, squares = 0, min = errors[0], max = errors[0];
	for (int i = 0; i < samples; i++) {
		sum += errors[i];
		squares += errors[i] * errors[i];
		min = fmin(min, errors[i]);
		max = fmax(max, errors[i]);
	}
	for (int i = 1; i < samples; i++) {
		double v = errors[i];
		int j = i;
		while (j > 0 && errors[j - 1] > v) {
			errors[j] = errors[j - 1];
			j--;
		}
		errors[j] = v;
	}
	printf("pulse signed errors n=%d min=%.3f mean=%.3f median=%.3f p95=%.3f p99=%.3f max=%.3f stddev=%.3f maxabs=%.3f ms\n", samples, min, sum / samples, (errors[39] + errors[40]) / 2, errors[75], errors[79], max, sqrt(fmax(0, squares / samples - sum * sum / samples / samples)), fmax(fabs(min), fabs(max)));
}

static void stop_failure_recovery(void) {
	ASSERT_TRUE(connect_device(0, true));
	ASSERT_TRUE(number(0, "CCD_EXPOSURE", "EXPOSURE", 5, INDIGO_BUSY_STATE));
	ASSERT_TRUE(wait_count(&cameras[0].starts, 1));
	fail_call = "ArtemisStopExposure";
	ASSERT_TRUE(toggle(0, "CCD_ABORT_EXPOSURE", "ABORT_EXPOSURE", INDIGO_ALERT_STATE));
	ASSERT_TRUE(cameras[0].exposing);
	fail_call = NULL;
	ASSERT_TRUE(toggle(0, "CCD_ABORT_EXPOSURE", "ABORT_EXPOSURE", INDIGO_OK_STATE));
	ASSERT_FALSE(cameras[0].exposing);
	ASSERT_TRUE(number(0, "CCD_EXPOSURE", "EXPOSURE", .01, INDIGO_OK_STATE));
}

static void mode_bin_synchronization(void) {
	ASSERT_TRUE(connect_device(0, true));
	ASSERT_TRUE(toggle(0, "CCD_MODE", "BIN_2x2", INDIGO_OK_STATE));
	ASSERT_TRUE(wait_state(0, "CCD_BIN", INDIGO_OK_STATE));
	ASSERT_EQ_INT(2, (int)value(0, "CCD_BIN", "HORIZONTAL"));
	ASSERT_TRUE(number(0, "CCD_EXPOSURE", "EXPOSURE", .01, INDIGO_OK_STATE));
	ASSERT_EQ_INT(2, cameras[0].bx);
	ASSERT_EQ_INT(2, cameras[0].by);
}

static void configuration_gain_offset(void) {
	ASSERT_TRUE(connect_device(0, true));
	ASSERT_EQ_INT(INDIGO_OK, indigo_change_text_property_1(&test_client, observed[0].name, "CCD_LOCAL_MODE", "DIR", config_folder));
	ASSERT_TRUE(wait_state(0, "CCD_LOCAL_MODE", INDIGO_OK_STATE));
	ASSERT_TRUE(number(0, "CCD_GAIN", "GAIN", 40, INDIGO_OK_STATE));
	ASSERT_TRUE(number(0, "CCD_OFFSET", "OFFSET", 123, INDIGO_OK_STATE));
	ASSERT_TRUE(toggle(0, "CONFIG", "SAVE", INDIGO_OK_STATE));
	ASSERT_TRUE(number(0, "CCD_GAIN", "GAIN", 10, INDIGO_OK_STATE));
	ASSERT_TRUE(number(0, "CCD_OFFSET", "OFFSET", 50, INDIGO_OK_STATE));
	ASSERT_TRUE(toggle(0, "CONFIG", "LOAD", INDIGO_OK_STATE));
	ASSERT_TRUE(wait_count(&cameras[0].gain, 40));
	ASSERT_TRUE(wait_count(&cameras[0].offset, 123));
}

static void wheel_busy_preserves_target(void) {
	ASSERT_TRUE(connect_device(2, true));
	cameras[0].moving = 1;
	ASSERT_TRUE(number(2, "WHEEL_SLOT", "SLOT", 3, INDIGO_BUSY_STATE));
	ASSERT_TRUE(wait_count(&cameras[0].wheel_target, 2));
	ASSERT_EQ_INT(INDIGO_OK, indigo_change_number_property_1(&test_client, observed[2].name, "WHEEL_SLOT", "SLOT", 5));
	cameras[0].moving = 0;
	ASSERT_TRUE(wait_state(2, "WHEEL_SLOT", INDIGO_OK_STATE));
	ASSERT_EQ_INT(2, cameras[0].wheel_target);
}

static void guide_off_failure_recovers(void) {
	ASSERT_TRUE(connect_device(1, true));
	ASSERT_TRUE(number(1, "GUIDER_GUIDE_RA", "EAST", 100, INDIGO_BUSY_STATE));
	ASSERT_TRUE(wait_count(&cameras[0].relay, 4));
	fail_call = "ArtemisGuidePort";
	ASSERT_TRUE(wait_state(1, "GUIDER_GUIDE_RA", INDIGO_ALERT_STATE));
	fail_call = NULL;
	ASSERT_TRUE(number(1, "GUIDER_GUIDE_RA", "EAST", 20, INDIGO_OK_STATE));
	ASSERT_EQ_INT(0, cameras[0].relay);
}

static void readout_state_failure(void) {
	ASSERT_TRUE(connect_device(0, true));
	cameras[0].ready_stuck = 1;
	ASSERT_TRUE(number(0, "CCD_EXPOSURE", "EXPOSURE", .1, INDIGO_BUSY_STATE));
	ASSERT_TRUE(wait_count(&cameras[0].starts, 1));
	fail_call = "ArtemisCameraState";
	ASSERT_TRUE(wait_state(0, "CCD_EXPOSURE", INDIGO_ALERT_STATE));
	fail_call = NULL;
	cameras[0].ready_stuck = 0;
	ASSERT_TRUE(number(0, "CCD_EXPOSURE", "EXPOSURE", .01, INDIGO_OK_STATE));
}

static void end_fixture(void) {
	release_gate();
	fail_call = NULL;
	fail_attach = fail_register = fail_queue = fail_lock = 0;
	for (int i = CAMERAS * 3 - 1; i >= 0; i--) {
		if (logical[i] && state(i, "CONNECTION") >= 0) {
			indigo_property *p = snapshot(i, "CONNECTION");
			bool connected = p && p->items[0].sw.value;
			indigo_release_property(p);
			if (connected) {
				ASSERT_TRUE(connect_device(i, false));
			}
		}
	}
	ASSERT_EQ_INT(INDIGO_OK, indigo_ccd_atik(INDIGO_DRIVER_SHUTDOWN, NULL));
	ASSERT_EQ_INT(0, attached);
	ASSERT_EQ_INT(0, lock_count);
	ASSERT_EQ_INT(0, sdk_after_close);
	ASSERT_EQ_INT(0, sdk_overlap);
	ASSERT_EQ_INT(0, sdk_on_bus);
	ASSERT_EQ_INT(0, usb_refs);
	ASSERT_EQ_INT(0, invalid_usb_unref);
	ASSERT_EQ_INT(0, updates_after_detach);
}

static void begin_fixture(void) {
	for (int i = 0; i < CAMERAS; i++) {
		free(cameras[i].pixels);
	}
	DIR *dir = opendir(config_folder);
	if (dir) {
		struct dirent *entry;
		while ((entry = readdir(dir))) {
			if (entry->d_name[0] != '.') {
				char path[1024];
				snprintf(path, sizeof(path), "%s/%s", config_folder, entry->d_name);
				unlink(path);
			}
		}
		closedir(dir);
	}
	memset(cameras, 0, sizeof(cameras));
	memset(request_revisions, 0, sizeof(request_revisions));
	blobs = bad_blob = clock_shift = discovery_fail = bad_string = not_camera = 0;
	fail_call = NULL;
	for (int i = 0; i < CAMERAS; i++) {
		cameras[i].sensor_width = 640;
		cameras[i].sensor_height = 480;
		cameras[i].bx = cameras[i].by = 1;
		cameras[i].temperature = 1200;
		cameras[i].slot_count = 5;
	}
	cameras[0].visible = true;
	cameras[0].shutter = cameras[0].guider = cameras[0].wheel = cameras[0].cooler = cameras[0].heater = cameras[0].presets = true;
	ASSERT_EQ_INT(INDIGO_OK, indigo_ccd_atik(INDIGO_DRIVER_INIT, NULL));
	ASSERT_TRUE(wait_count(&attached, 3));
}

int main(int argc, char **argv) {
	setvbuf(stdout, NULL, _IONBF, 0);
	if (!mkdtemp(config_folder)) {
		return 1;
	}
	bus_thread = pthread_self();
	indigo_set_log_level(INDIGO_LOG_ERROR);
	indigo_start();
	indigo_attach_client(&test_client);
	const indigo_test_case tests[] = {
		{ "shutterless_acquisition", shutterless_acquisition },
		{ "final_mode_bin_synchronization", mode_bin_synchronization },
		{ "final_configuration_gain_offset", configuration_gain_offset },
		{ "final_wheel_busy_preserves_target", wheel_busy_preserves_target },
		{ "final_guide_off_failure_recovers", guide_off_failure_recovers },
		{ "final_readout_state_failure", readout_state_failure },
		{ "discovery_filters_and_strings", discovery_filters_and_strings },
		{ "delayed_discovery_and_shutdown", delayed_discovery_and_shutdown },
		{ "capacity_and_survivors", capacity_and_survivors },
		{ "optional_slave_attach_failure", optional_slave_attach_failure },
		{ "crop_383_image", crop_383_image },
		{ "poll_errors_and_cancellation", poll_errors_and_cancellation },
		{ "preset_readback_failures", preset_readback_failures },
		{ "wheel_wraparound_position", wheel_wraparound_position },
		{ "initial_wheel_unknown_target", initial_wheel_unknown_target },
		{ "initial_wheel_moving", initial_wheel_moving },
		{ "countdown_with_occupied_queue", countdown_with_occupied_queue },
		{ "guide_duration_measurements", guide_duration_measurements },
		{ "stop_failure_recovery", stop_failure_recovery },
		{ "baseline_camera", baseline_camera },
		{ "baseline_guider", baseline_guider },
		{ "baseline_wheel", baseline_wheel },
		{ "metadata_profiles", metadata_profiles },
		{ "shared_lifecycle", shared_lifecycle },
		{ "initialization_failures", initialization_failures },
		{ "malformed_initialization", malformed_initialization },
		{ "acquisition_errors", acquisition_errors },
		{ "geometry_and_payload", geometry_and_payload },
		{ "durations_and_frame_types", durations_and_frame_types },
		{ "cooling_and_controls", cooling_and_controls },
		{ "wheel_errors", wheel_errors },
		{ "guide_axes_and_replacement", guide_axes_and_replacement },
		{ "abort_readout_restart", abort_readout_restart },
		{ "abort_and_busy", abort_and_busy },
		{ "deadlines_and_recovery", deadlines_and_recovery },
		{ "pending_start_abort", pending_start_abort },
		{ "readout_disconnect", readout_disconnect },
		{ "active_removal", active_removal },
		{ "discovery_identity", discovery_identity },
		{ "discovery_rollback", discovery_rollback },
	};
	int result = 0, selected = 0;
	for (int i = 0; i < ARRAY_SIZE(tests); i++) {
		if (argc > 1 && !strstr(tests[i].name, argv[1])) {
			continue;
		}
		selected++;
		alarm(40);
		begin_fixture();
		result |= indigo_run_tests("Atik fake SDK", tests + i, 1);
		end_fixture();
		alarm(0);
	}
	indigo_detach_client(&test_client);
	indigo_stop();
	for (int i = 0; i < CAMERAS; i++) {
		free(cameras[i].pixels);
	}
	DIR *dir = opendir(config_folder);
	if (dir) {
		struct dirent *entry;
		while ((entry = readdir(dir))) {
			if (entry->d_name[0] != '.') {
				char path[1024];
				snprintf(path, sizeof(path), "%s/%s", config_folder, entry->d_name);
				unlink(path);
			}
		}
		closedir(dir);
	}
	rmdir(config_folder);
	return !selected || result || indigo_test_failures;
}
