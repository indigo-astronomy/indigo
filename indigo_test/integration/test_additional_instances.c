// Copyright (c) 2026 INDIGO initiative
// All rights reserved.
//
// You may use this software under the terms of 'INDIGO Astronomy
// open-source license' (see LICENSE.md).
//
// THIS SOFTWARE IS PROVIDED BY THE AUTHORS 'AS IS' AND ANY EXPRESS
// OR IMPLIED WARRANTIES, INCLUDING, BUT NOT LIMITED TO, THE IMPLIED
// WARRANTIES OF MERCHANTABILITY AND FITNESS FOR A PARTICULAR PURPOSE
// ARE DISCLAIMED. IN NO EVENT SHALL THE AUTHOR BE LIABLE FOR ANY
// DIRECT, INDIRECT, INCIDENTAL, SPECIAL, EXEMPLARY, OR CONSEQUENTIAL
// DAMAGES (INCLUDING, BUT NOT LIMITED TO, PROCUREMENT OF SUBSTITUTE
// GOODS OR SERVICES; LOSS OF USE, DATA, OR PROFITS; OR BUSINESS
// INTERRUPTION) HOWEVER CAUSED AND ON ANY THEORY OF LIABILITY,
// WHETHER IN CONTRACT, STRICT LIABILITY, OR TORT (INCLUDING
// NEGLIGENCE OR OTHERWISE) ARISING IN ANY WAY OUT OF THE USE OF THIS
// SOFTWARE, EVEN IF ADVISED OF THE POSSIBILITY OF SUCH DAMAGE.

// Code is generated by AI

#include <stdlib.h>
#include <indigo/indigo_driver.h>
#include "../test_runner.h"

static void *tracked_private_data[2];
static unsigned private_frees[2];
static unsigned slave_detaches[2];
static unsigned master_detaches[2];
static unsigned expected_slaves;

static void observe_free(void *pointer) {
	for (int i = 0; i < 2; i++) {
		if (pointer != NULL && pointer == tracked_private_data[i]) {
			private_frees[i]++;
		}
	}
	free(pointer);
}

// Compile the actual additional-instance handler; observe only its frees.
#define free observe_free
#include "../../indigo_libs/indigo_driver.c"
#undef free

#define CHECK(condition) do { if (!(condition)) { \
	fprintf(stderr, "%s:%d: assertion failed: %s\n", __FILE__, __LINE__, #condition); \
	indigo_test_failures++; \
} } while (0)

static indigo_result fixture_attach(indigo_device *device) {
	indigo_result result = indigo_device_attach(device, "additional-instance-fixture", 1, INDIGO_INTERFACE_AUX);
	if (result == INDIGO_OK) {
		ADDITIONAL_INSTANCES_PROPERTY->hidden = device->base_device != NULL || device->master_device != device;
	}
	return result;
}

static indigo_result fixture_detach(indigo_device *device) {
	for (int i = 0; i < 2; i++) {
		if (device->private_data == tracked_private_data[i]) {
			CHECK(private_frees[i] == 0);
			if (device->master_device == device) {
				CHECK(slave_detaches[i] == expected_slaves);
				master_detaches[i]++;
			} else {
				CHECK(master_detaches[i] == 0);
				slave_detaches[i]++;
			}
		}
	}
	return indigo_device_detach(device);
}

static indigo_device *enumerated_device;
static unsigned enumerated_connections;
static indigo_result observe_property(indigo_client *client, indigo_device *device, indigo_property *property, const char *message) {
	if (device == enumerated_device && !strcmp(property->name, CONNECTION_PROPERTY_NAME)) {
		enumerated_connections++;
	}
	return INDIGO_OK;
}

static void set_count(indigo_device *device, unsigned count) {
	indigo_property *change = indigo_init_number_property(NULL, device->name, ADDITIONAL_INSTANCES_PROPERTY_NAME,
		"", "", INDIGO_OK_STATE, INDIGO_RW_PERM, 1);
	indigo_init_number_item(change->items, ADDITIONAL_INSTANCES_COUNT_ITEM_NAME, "", 0, MAX_ADDITIONAL_INSTANCES, 1, count);
	CHECK(indigo_device_change_property(device, NULL, change) == INDIGO_OK);
	indigo_release_property(change);
}

static void connected(indigo_device *device, bool value) {
	CONNECTION_CONNECTED_ITEM->sw.value = value;
	CONNECTION_DISCONNECTED_ITEM->sw.value = !value;
}

static void lifecycle(unsigned slave_count) {
	indigo_device master = INDIGO_DEVICE_INITIALIZER("Additional Fixture Master", fixture_attach,
		indigo_device_enumerate_properties, NULL, NULL, fixture_detach);
	indigo_device slaves[2];
	void *original_private_data = indigo_safe_malloc(32);
	master.private_data = original_private_data;
	master.master_device = &master;
	expected_slaves = slave_count;
	CHECK(indigo_start() == INDIGO_OK);
	CHECK(indigo_attach_device(&master) == INDIGO_OK);
	for (int j = 0; j < slave_count; j++) {
		slaves[j] = master;
		snprintf(slaves[j].name, sizeof(slaves[j].name), "Additional Fixture Slave %d", j);
		slaves[j].device_context = NULL;
		CHECK(indigo_attach_device(slaves + j) == INDIGO_OK);
	}
	indigo_client observer = { .name = "Additional Fixture Observer", .define_property = observe_property };
	CHECK(indigo_attach_client(&observer) == INDIGO_OK);
	indigo_device *device = &master;
	CHECK(indigo_device_enumerate_properties(device, &observer, NULL) == INDIGO_OK);
	for (int cycle = 0; cycle < 3; cycle++) {
		set_count(device, 2);
		CHECK(ADDITIONAL_INSTANCES_PROPERTY->state == INDIGO_OK_STATE);
		for (int i = 0; i < 2; i++) {
			indigo_device *clone = DEVICE_CONTEXT->additional_device_instances[i];
			CHECK(clone != NULL);
			if (clone == NULL) continue;
			tracked_private_data[i] = clone->private_data;
			private_frees[i] = slave_detaches[i] = master_detaches[i] = 0;
			CHECK(clone->base_device == &master);
			CHECK(clone->master_device == clone);
			CHECK(clone->private_data != original_private_data);
			if (i) CHECK(clone->private_data != tracked_private_data[0]);
			indigo_device *queried[3];
			CHECK(indigo_query_slave_devices(clone, queried, 3) == slave_count);
			for (int j = 0; j < slave_count; j++) {
				indigo_device *slave_clone = ((indigo_device_context *)slaves[j].device_context)->additional_device_instances[i];
				CHECK(slave_clone != NULL);
				if (slave_clone == NULL) continue;
				CHECK(slave_clone->base_device == slaves + j);
				CHECK(slave_clone->master_device == clone);
				CHECK(slave_clone->private_data == clone->private_data);
				enumerated_device = slave_clone;
				enumerated_connections = 0;
				CHECK(indigo_device_enumerate_properties(slave_clone, &observer, NULL) == INDIGO_OK);
				CHECK(enumerated_connections == 1);
			}
			enumerated_device = clone;
			enumerated_connections = 0;
			CHECK(indigo_device_enumerate_properties(clone, &observer, NULL) == INDIGO_OK);
			CHECK(enumerated_connections == 1);
		}
		indigo_device *clone = DEVICE_CONTEXT->additional_device_instances[1];
		connected(clone, true);
		set_count(device, 0);
		CHECK(ADDITIONAL_INSTANCES_PROPERTY->state == INDIGO_ALERT_STATE);
		CHECK(ADDITIONAL_INSTANCES_COUNT_ITEM->number.value == 2);
		CHECK(DEVICE_CONTEXT->additional_device_instances[1] == clone);
		connected(clone, false);
		indigo_device *slave_clone = ((indigo_device_context *)slaves[0].device_context)->additional_device_instances[1];
		connected(slave_clone, true);
		set_count(device, 0);
		CHECK(ADDITIONAL_INSTANCES_PROPERTY->state == INDIGO_ALERT_STATE);
		CHECK(ADDITIONAL_INSTANCES_COUNT_ITEM->number.value == 2);
		CHECK(((indigo_device_context *)slaves[0].device_context)->additional_device_instances[1] == slave_clone);
		connected(slave_clone, false);
		set_count(device, 0);
		CHECK(ADDITIONAL_INSTANCES_PROPERTY->state == INDIGO_OK_STATE);
		for (int i = 0; i < 2; i++) {
			CHECK(DEVICE_CONTEXT->additional_device_instances[i] == NULL);
			CHECK(private_frees[i] == 1);
			CHECK(master_detaches[i] == 1);
			CHECK(slave_detaches[i] == slave_count);
			for (int j = 0; j < slave_count; j++) {
				CHECK(((indigo_device_context *)slaves[j].device_context)->additional_device_instances[i] == NULL);
			}
			tracked_private_data[i] = NULL;
		}
		CHECK(master.base_device == NULL && master.private_data == original_private_data);
		for (int j = 0; j < slave_count; j++) {
			CHECK(slaves[j].base_device == NULL && slaves[j].private_data == original_private_data);
			CHECK(slaves[j].master_device == &master);
		}
		indigo_device *queried[3];
		CHECK(indigo_query_slave_devices(&master, queried, 3) == slave_count);
	}
	CHECK(indigo_detach_client(&observer) == INDIGO_OK);
	for (int j = 0; j < slave_count; j++) CHECK(indigo_detach_device(slaves + j) == INDIGO_OK);
	CHECK(indigo_detach_device(&master) == INDIGO_OK);
	free(original_private_data);
	CHECK(indigo_stop() == INDIGO_OK);
}

static void one_slave(void) { lifecycle(1); }
static void two_slaves(void) { lifecycle(2); }

int main(void) {
	if (!indigo_test_use_private_home()) return 1;
	indigo_test_case cases[] = {
		{ "one slave create enumerate remove recreate and connected guard", one_slave },
		{ "two slaves preserve both bases and shared ownership", two_slaves }
	};
	int result = indigo_run_tests("Additional instance lifecycle", cases, 2);
	indigo_test_remove_private_home();
	return result;
}
