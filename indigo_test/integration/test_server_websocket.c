// Copyright (c) 2026 INDIGO initiative
// All rights reserved.
//
// You may use this software under the terms of 'INDIGO Astronomy
// open-source license' (see LICENSE.md).
//
// THIS SOFTWARE IS PROVIDED BY THE AUTHORS 'AS IS' AND ANY EXPRESS
// OR IMPLIED WARRANTIES, INCLUDING, BUT NOT LIMITED TO, THE IMPLIED
// WARRANTIES OF MERCHANTABILITY AND FITNESS FOR A PARTICULAR PURPOSE
// ARE DISCLAIMED. IN NO EVENT SHALL THE AUTHOR BE LIABLE FOR ANY
// DIRECT, INDIRECT, INCIDENTAL, SPECIAL, EXEMPLARY, OR CONSEQUENTIAL
// DAMAGES (INCLUDING, BUT NOT LIMITED TO, PROCUREMENT OF SUBSTITUTE
// GOODS OR SERVICES; LOSS OF USE, DATA, OR PROFITS; OR BUSINESS
// INTERRUPTION) HOWEVER CAUSED AND ON ANY THEORY OF LIABILITY,
// WHETHER IN CONTRACT, STRICT LIABILITY, OR TORT (INCLUDING
// NEGLIGENCE OR OTHERWISE) ARISING IN ANY WAY OUT OF THE USE OF THIS
// SOFTWARE, EVEN IF ADVISED OF THE POSSIBILITY OF SUCH DAMAGE.

// Code is generated by AI

// WebSocket upgrade handshake of the production TCP server (FND-000045).
//
// The server appends the RFC 6455 GUID to the Sec-WebSocket-Key value in a 256-byte buffer before
// hashing it, so a key longer than 219 bytes used to overflow that buffer. These cases talk to the
// real server on a loopback ephemeral port. The sanitize build compiles indigo_server_tcp.c into the
// test with AddressSanitizer, so a write past the buffer aborts the run instead of passing silently.

#include <arpa/inet.h>
#include <errno.h>
#include <netinet/in.h>
#include <netinet/tcp.h>
#include <pthread.h>
#include <stdatomic.h>
#include <stdio.h>
#include <string.h>
#include <sys/socket.h>
#include <sys/time.h>
#include <unistd.h>

#include <indigo/indigo_bus.h>
#include <indigo/indigo_server_tcp.h>
#include <indigo/indigo_timer.h>

#include "../test_runner.h"

#define WAIT_UNTIL(condition, timeout) ({ double deadline_ = indigo_monotonic_time() + (timeout); bool ready_ = (condition); while (!ready_ && indigo_monotonic_time() < deadline_) { indigo_usleep(5000); ready_ = (condition); } ready_; })

// longest key that fits next to the 36-byte GUID and the NUL in the server's 256-byte buffer
#define LONGEST_ACCEPTED_KEY	219

// Exercise unsigned byte assembly in complete SHA-1 blocks and the final partial block.
extern void sha1(unsigned char hash[20], const void *data, size_t size);

static void sha1_binary_blocks_and_tail(void) {
	unsigned char data[127];
	for (size_t i = 0; i < sizeof(data); i++) {
		data[i] = (unsigned char)(0x80 + i);
	}
	// Expected digests were independently generated with Python hashlib.sha1.
	const struct { size_t size; const char *hex; } vectors[] = {
		{ 64, "9c7aa2b11f270998a63b1b1795cff3890a4eb56f" },
		{ 65, "66bead7b6368ad41c72bf351dbc28969b6169a21" },
		{ 127, "8238481a2447ff5439059b1da7746c12aa0028ad" },
	};
	for (size_t i = 0; i < sizeof(vectors) / sizeof(vectors[0]); i++) {
		unsigned char digest[20];
		char hex[41];
		sha1(digest, data, vectors[i].size);
		for (size_t j = 0; j < sizeof(digest); j++) {
			snprintf(hex + 2 * j, 3, "%02x", digest[j]);
		}
		ASSERT_STREQ(vectors[i].hex, hex);
	}
}

static atomic_int server_client_count;
static atomic_bool server_listening;
static atomic_bool server_finished;
static pthread_t server_thread;
static bool server_started = false;

static void test_server_callback(int count) {
	atomic_store(&server_client_count, count);
	atomic_store(&server_listening, true);
}

static void *test_server_run(void *data) {
	indigo_server_start(test_server_callback);
	atomic_store(&server_finished, true);
	return NULL;
}

static bool start_test_server(void) {
	indigo_use_bonjour = false;
	indigo_server_tcp_port = 0;
	atomic_store(&server_client_count, 0);
	atomic_store(&server_listening, false);
	atomic_store(&server_finished, false);
	if (pthread_create(&server_thread, NULL, test_server_run, NULL) != 0) {
		return false;
	}
	server_started = true;
	if (!WAIT_UNTIL(atomic_load(&server_listening) && indigo_server_tcp_port != 0, 5)) {
		fprintf(stderr, "    TCP server did not start\n");
		return false;
	}
	return true;
}

static int connect_loopback(int port) {
	int fd = socket(AF_INET, SOCK_STREAM, 0);
	if (fd < 0) {
		return -1;
	}
	struct sockaddr_in address = { 0 };
	address.sin_family = AF_INET;
	address.sin_port = htons(port);
	address.sin_addr.s_addr = htonl(INADDR_LOOPBACK);
	if (connect(fd, (struct sockaddr *)&address, sizeof(address)) < 0) {
		close(fd);
		return -1;
	}
	struct timeval timeout = { 5, 0 };
	setsockopt(fd, SOL_SOCKET, SO_RCVTIMEO, &timeout, sizeof(timeout));
	int value = 1;
	setsockopt(fd, IPPROTO_TCP, TCP_NODELAY, &value, sizeof(value));
	return fd;
}

static void stop_test_server(void) {
	if (server_started) {
		WAIT_UNTIL(atomic_load(&server_client_count) == 0, 10);
		int port = indigo_server_tcp_port;
		indigo_server_shutdown();
		if (!WAIT_UNTIL(atomic_load(&server_finished), 1)) {
			// the listener may stay in accept() after its socket is shut down, a connection wakes it
			int fd = connect_loopback(port);
			if (fd >= 0) {
				close(fd);
			}
		}
		if (WAIT_UNTIL(atomic_load(&server_finished), 5)) {
			pthread_join(server_thread, NULL);
		} else {
			fprintf(stderr, "    TCP server thread did not finish\n");
			indigo_test_failures++;
			pthread_detach(server_thread);
		}
		server_started = false;
	}
}

typedef struct {
	char head[2048];
	bool closed_by_server;
} handshake_reply;

// Sends a GET / upgrade request with the given key and reads the reply head up to the empty line.
// With check_close, the rest of the reply is read and closed_by_server tells whether the server then
// closed the connection, which a read timeout would report as false.
static bool websocket_handshake(const char *key, handshake_reply *reply, bool check_close) {
	memset(reply, 0, sizeof(*reply));
	int fd = connect_loopback(indigo_server_tcp_port);
	if (fd < 0) {
		fprintf(stderr, "    connect failed: %s\n", strerror(errno));
		return false;
	}
	char request[2048];
	int length = snprintf(request, sizeof(request), "GET / HTTP/1.1\r\nHost: localhost\r\nUpgrade: websocket\r\nConnection: Upgrade\r\nSec-WebSocket-Version: 13\r\nSec-WebSocket-Key: %s\r\n\r\n", key);
	if (length <= 0 || length >= (int)sizeof(request) || write(fd, request, length) != length) {
		close(fd);
		return false;
	}
	size_t used = 0;
	while (used < sizeof(reply->head) - 1 && strstr(reply->head, "\r\n\r\n") == NULL) {
		ssize_t count = read(fd, reply->head + used, 1);
		if (count <= 0) {
			break;
		}
		used += count;
	}
	if (check_close) {
		char body[256];
		ssize_t count;
		while ((count = read(fd, body, sizeof(body))) > 0) {
		}
		reply->closed_by_server = count == 0;
	}
	close(fd);
	return strstr(reply->head, "\r\n\r\n") != NULL;
}

static void make_key(char *key, int length) {
	memset(key, 'A', length);
	key[length] = 0;
}

// RFC 6455 section 1.3 gives this key and its accept value
static void rfc6455_sample_key_upgrades_with_derived_accept(void) {
	handshake_reply reply;
	ASSERT_TRUE(websocket_handshake("dGhlIHNhbXBsZSBub25jZQ==", &reply, false));
	ASSERT_TRUE(strncmp(reply.head, "HTTP/1.1 101 ", 13) == 0);
	ASSERT_TRUE(strstr(reply.head, "Sec-WebSocket-Accept: s3pPLMBiTxaQ9kYGzzhZRbK+xOo=\r\n") != NULL);
}

static void longest_fitting_key_still_upgrades(void) {
	char key[LONGEST_ACCEPTED_KEY + 1];
	make_key(key, LONGEST_ACCEPTED_KEY);
	handshake_reply reply;
	ASSERT_TRUE(websocket_handshake(key, &reply, false));
	ASSERT_TRUE(strncmp(reply.head, "HTTP/1.1 101 ", 13) == 0);
	// SHA-1 of 219 'A' bytes followed by the GUID, base64 encoded, computed independently with Python hashlib
	ASSERT_TRUE(strstr(reply.head, "Sec-WebSocket-Accept: ofAac6OErSs0N0DdzMrdBM3zQ2A=\r\n") != NULL);
}

static void key_one_byte_too_long_is_refused(void) {
	char key[LONGEST_ACCEPTED_KEY + 2];
	make_key(key, LONGEST_ACCEPTED_KEY + 1);
	handshake_reply reply;
	ASSERT_TRUE(websocket_handshake(key, &reply, true));
	ASSERT_TRUE(strncmp(reply.head, "HTTP/1.1 400 ", 13) == 0);
	ASSERT_TRUE(strstr(reply.head, "Sec-WebSocket-Accept") == NULL);
	ASSERT_TRUE(reply.closed_by_server);
}

static void over_long_key_is_refused_and_server_keeps_serving(void) {
	char key[901];
	make_key(key, 900);
	handshake_reply reply;
	ASSERT_TRUE(websocket_handshake(key, &reply, true));
	ASSERT_TRUE(strncmp(reply.head, "HTTP/1.1 400 ", 13) == 0);
	ASSERT_TRUE(strstr(reply.head, "Sec-WebSocket-Accept") == NULL);
	ASSERT_TRUE(reply.closed_by_server);
	// the refused connection must not take the server down, the next client still upgrades
	ASSERT_TRUE(websocket_handshake("dGhlIHNhbXBsZSBub25jZQ==", &reply, false));
	ASSERT_TRUE(strncmp(reply.head, "HTTP/1.1 101 ", 13) == 0);
}

int main(void) {
	if (!indigo_test_use_private_home()) {
		return 1;
	}
	const indigo_test_case tests[] = {
		{ "sha1_binary_blocks_and_tail", sha1_binary_blocks_and_tail },
		{ "rfc6455_sample_key_upgrades_with_derived_accept", rfc6455_sample_key_upgrades_with_derived_accept },
		{ "longest_fitting_key_still_upgrades", longest_fitting_key_still_upgrades },
		{ "key_one_byte_too_long_is_refused", key_one_byte_too_long_is_refused },
		{ "over_long_key_is_refused_and_server_keeps_serving", over_long_key_is_refused_and_server_keeps_serving }
	};
	int result = 1;
	if (indigo_start() == INDIGO_OK) {
		if (start_test_server()) {
			result = indigo_run_tests("server WebSocket handshake integration tests", tests, (int)(sizeof(tests) / sizeof(tests[0])));
		}
		stop_test_server();
		indigo_stop();
	}
	indigo_test_remove_private_home();
	return result;
}
