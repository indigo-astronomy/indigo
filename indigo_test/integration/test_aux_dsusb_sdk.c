// Copyright (c) 2026 INDIGO initiative
// All rights reserved.
//
// You may use this software under the terms of 'INDIGO Astronomy
// open-source license' (see LICENSE.md).
//
// THIS SOFTWARE IS PROVIDED BY THE AUTHORS 'AS IS' AND ANY EXPRESS
// OR IMPLIED WARRANTIES, INCLUDING, BUT NOT LIMITED TO, THE IMPLIED
// WARRANTIES OF MERCHANTABILITY AND FITNESS FOR A PARTICULAR PURPOSE
// ARE DISCLAIMED. IN NO EVENT SHALL THE AUTHOR BE LIABLE FOR ANY
// DIRECT, INDIRECT, INCIDENTAL, SPECIAL, EXEMPLARY, OR CONSEQUENTIAL
// DAMAGES (INCLUDING, BUT NOT LIMITED TO, PROCUREMENT OF SUBSTITUTE
// GOODS OR SERVICES; LOSS OF USE, DATA, OR PROFITS; OR BUSINESS
// INTERRUPTION) HOWEVER CAUSED AND ON ANY THEORY OF LIABILITY,
// WHETHER IN CONTRACT, STRICT LIABILITY, OR TORT (INCLUDING
// NEGLIGENCE OR OTHERWISE) ARISING IN ANY WAY OUT OF THE USE OF THIS
// SOFTWARE, EVEN IF ADVISED OF THE POSSIBILITY OF SUCH DAMAGE.

// Code is generated by AI

#include <stdatomic.h>
#include <stdint.h>

#include <indigo/indigo_driver.h>
#include <indigo/indigo_usb_utils.h>
#include <libdsusb.h>

#include "serial_simulator_test_common.h"
#include "abort_queue_test_common.h"

extern indigo_result indigo_aux_dsusb(indigo_driver_action, indigo_driver_info *);

static const simulator_driver_case driver = { "Shoestring DSUSB shutter release", "indigo_aux_dsusb", "DSUSB test", indigo_aux_dsusb, true, NULL, 0, NULL, 0, NULL, 0, NULL, 0 };
static const simulator_driver_case second_driver = { "Shoestring DSUSB shutter release", "indigo_aux_dsusb", "DSUSB test 2", indigo_aux_dsusb, true, NULL, 0, NULL, 0, NULL, 0, NULL, 0 };
static atomic_int references, attached, opened, closed, io_calls, invalid_io, fail_queue, fail_register, fail_attach, fail_open, fail_io, fail_stop, fail_nth;
static atomic_int output, rejected_device, timer_delay_ms;
static atomic_bool active_contexts[8];
static libusb_hotplug_callback_fn callback;
static indigo_queue *queue;
static libdsusb_device_context contexts[8];
void (*libdsusb_debug)(const char *);

enum {
	DSUSB_OPEN,
	DSUSB_FOCUS,
	DSUSB_START,
	DSUSB_STOP,
	DSUSB_CLOSE
};

typedef struct {
	int device_id;
	int operation;
	double timestamp;
} trace_event;

static trace_event trace[256];
static int trace_count;
static pthread_mutex_t trace_mutex = PTHREAD_MUTEX_INITIALIZER;

static int device_id(const libdsusb_device_context *context) {
	for (int i = 0; i < (int)ARRAY_SIZE(contexts); i++) {
		if (context == contexts + i) {
			return i;
		}
	}
	return -1;
}

static void record_call(const libdsusb_device_context *context, int operation) {
	pthread_mutex_lock(&trace_mutex);
	if (trace_count < (int)ARRAY_SIZE(trace)) {
		trace[trace_count++] = (trace_event){ device_id(context), operation, indigo_monotonic_time() };
	}
	pthread_mutex_unlock(&trace_mutex);
}

static void reset_trace(void) {
	pthread_mutex_lock(&trace_mutex);
	trace_count = 0;
	pthread_mutex_unlock(&trace_mutex);
}

static int count_calls(int id, int operation) {
	int count = 0;
	pthread_mutex_lock(&trace_mutex);
	for (int i = 0; i < trace_count; i++) {
		if (trace[i].device_id == id && trace[i].operation == operation) {
			count++;
		}
	}
	pthread_mutex_unlock(&trace_mutex);
	return count;
}

static double call_time(int id, int operation, int occurrence) {
	double timestamp = 0;
	pthread_mutex_lock(&trace_mutex);
	for (int i = 0; i < trace_count; i++) {
		if (trace[i].device_id == id && trace[i].operation == operation && occurrence-- == 0) {
			timestamp = trace[i].timestamp;
			break;
		}
	}
	pthread_mutex_unlock(&trace_mutex);
	return timestamp;
}

void dsusb_test_execute_priority_handler_in(indigo_device *device, int priority, double delay, indigo_timer_callback handler) {
	indigo_execute_priority_handler_in(device, priority, delay + timer_delay_ms / 1000.0, handler);
}

indigo_queue *dsusb_test_queue_create(indigo_device *device) {
	if (atomic_exchange(&fail_queue, 0)) {
		return NULL;
	}
	return queue = indigo_queue_create(device);
}

void dsusb_test_usb_start(void) { }

int LIBUSB_CALL dsusb_test_usb_register(libusb_context *context, int events, int flags, int vid, int pid, int device_class, libusb_hotplug_callback_fn handler, void *data, libusb_hotplug_callback_handle *registration) {
	if (atomic_exchange(&fail_register, 0)) {
		return LIBUSB_ERROR_OTHER;
	}
	callback = handler;
	*registration = 1;
	callback(NULL, (libusb_device *)(uintptr_t)1, LIBUSB_HOTPLUG_EVENT_DEVICE_ARRIVED, NULL);
	return 0;
}

int dsusb_test_usb_register_sim(libusb_context *context, libusb_hotplug_event events, libusb_hotplug_flag flags, int vid, int pid, int device_class, libusb_hotplug_callback_fn handler, void *data, libusb_hotplug_callback_handle *registration) {
	return dsusb_test_usb_register(context, events, flags, vid, pid, device_class, handler, data, registration);
}

void LIBUSB_CALL dsusb_test_usb_deregister(libusb_context *context, libusb_hotplug_callback_handle registration) {
	callback = NULL;
}

int dsusb_test_usb_deregister_poll(libusb_context *context, libusb_hotplug_callback_handle registration) {
	dsusb_test_usb_deregister(context, registration);
	return 0;
}

libusb_device * LIBUSB_CALL dsusb_test_usb_ref(libusb_device *device) {
	atomic_fetch_add(&references, 1);
	return device;
}

void LIBUSB_CALL dsusb_test_usb_unref(libusb_device *device) {
	atomic_fetch_sub(&references, 1);
}

indigo_result dsusb_test_usb_path(libusb_device *device, char *path) {
	snprintf(path, INDIGO_VALUE_SIZE, "%d", (int)(uintptr_t)device);
	return INDIGO_OK;
}

indigo_result dsusb_test_attach(indigo_device *device) {
	if (atomic_exchange(&fail_attach, 0)) {
		return INDIGO_FAILED;
	}
	indigo_result result = indigo_attach_device(device);
	if (result == INDIGO_OK) {
		atomic_fetch_add(&attached, 1);
	}
	return result;
}

indigo_result dsusb_test_detach(indigo_device *device) {
	indigo_result result = indigo_detach_device(device);
	atomic_fetch_sub(&attached, 1);
	return result;
}

bool libdsusb_shutter(libusb_device *device, const char **name) {
	static char names[8][INDIGO_NAME_SIZE];
	int id = (int)(uintptr_t)device;
	if (id == rejected_device || id <= 0 || id >= (int)ARRAY_SIZE(names)) {
		return false;
	}
	if (id == 1) {
		snprintf(names[id], sizeof(names[id]), "%s", driver.device_name);
	} else {
		snprintf(names[id], sizeof(names[id]), "%s %d", driver.device_name, id);
	}
	*name = names[id];
	return true;
}

bool libdsusb_open(libusb_device *device, libdsusb_device_context **context) {
	int id = (int)(uintptr_t)device;
	if (atomic_exchange(&fail_open, 0) || id <= 0 || id >= (int)ARRAY_SIZE(contexts)) {
		return false;
	}
	*context = contexts + id;
	active_contexts[id] = true;
	atomic_fetch_add(&opened, 1);
	record_call(*context, DSUSB_OPEN);
	return true;
}

void libdsusb_close(libdsusb_device_context *context) {
	int id = device_id(context);
	if (id >= 0) {
		active_contexts[id] = false;
	}
	record_call(context, DSUSB_CLOSE);
	atomic_fetch_add(&closed, 1);
}

static bool sdk_operation(libdsusb_device_context *context) {
	atomic_fetch_add(&io_calls, 1);
	int id = device_id(context);
	if (id < 0 || !active_contexts[id]) {
		atomic_fetch_add(&invalid_io, 1);
		return false;
	}
	if (fail_nth > 0 && atomic_fetch_sub(&fail_nth, 1) == 1) {
		return false;
	}
	return !atomic_exchange(&fail_io, 0);
}

static bool set_output(libdsusb_device_context *context, int value) {
	if (!sdk_operation(context) || (value == 0 && atomic_exchange(&fail_stop, 0))) {
		return false;
	}
	atomic_store(&output, value);
	return true;
}

bool libdsusb_focus(libdsusb_device_context *context) {
	bool result = set_output(context, 2);
	record_call(context, DSUSB_FOCUS);
	return result;
}

bool libdsusb_start(libdsusb_device_context *context) {
	bool result = set_output(context, 1);
	record_call(context, DSUSB_START);
	return result;
}

bool libdsusb_stop(libdsusb_device_context *context) {
	bool result = set_output(context, 0);
	record_call(context, DSUSB_STOP);
	return result;
}

static bool start_driver(void) {
	if (!bring_up_serial_driver(&driver)) {
		return false;
	}
	indigo_queue_drain(queue);
	return connect_serial_device(&driver, NULL);
}

static bool wait_output(int expected) {
	for (int i = 0; i < 2000; i++) {
		if (output == expected) {
			return true;
		}
		indigo_usleep(1000);
	}
	return false;
}

static void contract(void) {
	assert_simulator_driver_info(&driver);
	SERIAL_CHECK_TRUE(bring_up_serial_driver(&driver));
	indigo_queue_drain(queue);
	enumerate_simulator_device();
	assert_device_interface(INDIGO_INTERFACE_AUX_SHUTTER);
	assert_defined_property(INFO_PROPERTY_NAME);
	assert_defined_property(CONFIG_PROPERTY_NAME);
	assert_defined_property(PROFILE_NAME_PROPERTY_NAME);
	assert_defined_property(PROFILE_PROPERTY_NAME);
	assert_defined_property(CONNECTION_PROPERTY_NAME);
	SERIAL_CHECK_TRUE(find_cached_property("CCD_ABORT_EXPOSURE") == NULL);
	SERIAL_CHECK_TRUE(find_cached_property("CCD_EXPOSURE") == NULL);
	SERIAL_CHECK_TRUE(find_cached_property("X_CONFIG") == NULL);
	SERIAL_CHECK_TRUE(connect_serial_device(&driver, NULL));
	indigo_property *abort_property = find_cached_property("CCD_ABORT_EXPOSURE");
	indigo_property *exposure_property = find_cached_property("CCD_EXPOSURE");
	indigo_property *config_property = find_cached_property("X_CONFIG");
	SERIAL_CHECK_TRUE(abort_property != NULL);
	SERIAL_CHECK_TRUE(exposure_property != NULL);
	SERIAL_CHECK_TRUE(config_property != NULL);
	SERIAL_CHECK_EQ_INT(INDIGO_SWITCH_VECTOR, abort_property->type);
	SERIAL_CHECK_EQ_INT(INDIGO_RW_PERM, abort_property->perm);
	SERIAL_CHECK_EQ_INT(INDIGO_ANY_OF_MANY_RULE, abort_property->rule);
	SERIAL_CHECK_EQ_INT(1, abort_property->count);
	assert_property_has_item("CCD_ABORT_EXPOSURE", "ABORT_EXPOSURE");
	assert_switch_item_value("CCD_ABORT_EXPOSURE", "ABORT_EXPOSURE", false);
	SERIAL_CHECK_EQ_INT(INDIGO_NUMBER_VECTOR, exposure_property->type);
	SERIAL_CHECK_EQ_INT(INDIGO_RW_PERM, exposure_property->perm);
	SERIAL_CHECK_EQ_INT(1, exposure_property->count);
	assert_property_has_item("CCD_EXPOSURE", "EXPOSURE");
	indigo_item *exposure_item = find_cached_item("CCD_EXPOSURE", "EXPOSURE");
	SERIAL_CHECK_TRUE(exposure_item != NULL);
	SERIAL_CHECK_TRUE(exposure_item->number.min == 0);
	SERIAL_CHECK_TRUE(exposure_item->number.max == 1000);
	SERIAL_CHECK_TRUE(exposure_item->number.step == 1);
	SERIAL_CHECK_TRUE(exposure_item->number.value == 0);
	SERIAL_CHECK_TRUE(exposure_item->number.target == 0);
	SERIAL_CHECK_EQ_INT(INDIGO_SWITCH_VECTOR, config_property->type);
	SERIAL_CHECK_EQ_INT(INDIGO_RW_PERM, config_property->perm);
	SERIAL_CHECK_EQ_INT(INDIGO_ANY_OF_MANY_RULE, config_property->rule);
	SERIAL_CHECK_EQ_INT(1, config_property->count);
	assert_property_has_item("X_CONFIG", "FOCUS");
	assert_switch_item_value("X_CONFIG", "FOCUS", false);
	disconnect_serial_device(&driver);
	SERIAL_CHECK_TRUE(find_cached_property("CCD_ABORT_EXPOSURE") == NULL);
	SERIAL_CHECK_TRUE(find_cached_property("CCD_EXPOSURE") == NULL);
	SERIAL_CHECK_TRUE(find_cached_property("X_CONFIG") == NULL);
	disconnect_serial_device(&driver);
cleanup:
	stop_serial_driver(&driver);
	ASSERT_EQ_INT(opened, closed);
	ASSERT_EQ_INT(0, invalid_io);
}

static void direct_exposure_and_errors(void) {
	SERIAL_CHECK_TRUE(start_driver());
	reset_trace();
	unsigned int revision = property_revision("CCD_EXPOSURE");
	indigo_change_number_property_1(&simulator_test_client, driver.device_name, "CCD_EXPOSURE", "EXPOSURE", 0.2);
	SERIAL_CHECK_TRUE(wait_for_property_state_seen_after("CCD_EXPOSURE", INDIGO_BUSY_STATE, revision));
	SERIAL_CHECK_TRUE(wait_output(1));
	SERIAL_CHECK_TRUE(wait_for_property_state_after("CCD_EXPOSURE", INDIGO_OK_STATE, revision));
	SERIAL_CHECK_TRUE(wait_output(0));
	SERIAL_CHECK_EQ_INT(1, count_calls(1, DSUSB_START));
	SERIAL_CHECK_EQ_INT(1, count_calls(1, DSUSB_STOP));
	reset_trace();
	revision = property_revision("CCD_EXPOSURE");
	atomic_store(&fail_io, 1);
	indigo_change_number_property_1(&simulator_test_client, driver.device_name, "CCD_EXPOSURE", "EXPOSURE", 0.2);
	SERIAL_CHECK_TRUE(wait_for_property_state_after("CCD_EXPOSURE", INDIGO_ALERT_STATE, revision));
	SERIAL_CHECK_EQ_INT(1, count_calls(1, DSUSB_START));
	SERIAL_CHECK_EQ_INT(1, count_calls(1, DSUSB_STOP));
	revision = property_revision("CCD_EXPOSURE");
	indigo_change_number_property_1(&simulator_test_client, driver.device_name, "CCD_EXPOSURE", "EXPOSURE", 0.1);
	SERIAL_CHECK_TRUE(wait_for_property_state_after("CCD_EXPOSURE", INDIGO_OK_STATE, revision));
	revision = property_revision("CCD_EXPOSURE");
	indigo_change_number_property_1(&simulator_test_client, driver.device_name, "CCD_EXPOSURE", "EXPOSURE", 0.1);
	SERIAL_CHECK_TRUE(wait_output(1));
	atomic_store(&fail_stop, 1);
	SERIAL_CHECK_TRUE(wait_for_property_state_after("CCD_EXPOSURE", INDIGO_ALERT_STATE, revision));
	SERIAL_CHECK_EQ_INT(1, output);
	revision = property_revision("CCD_ABORT_EXPOSURE");
	indigo_change_switch_property_1(&simulator_test_client, driver.device_name, "CCD_ABORT_EXPOSURE", "ABORT_EXPOSURE", true);
	SERIAL_CHECK_TRUE(wait_output(0));
	SERIAL_CHECK_TRUE(wait_for_property_state_after("CCD_ABORT_EXPOSURE", INDIGO_OK_STATE, revision));
	revision = property_revision("CCD_ABORT_EXPOSURE");
	indigo_change_switch_property_1(&simulator_test_client, driver.device_name, "CCD_ABORT_EXPOSURE", "ABORT_EXPOSURE", true);
	SERIAL_CHECK_TRUE(wait_for_property_state_after("CCD_ABORT_EXPOSURE", INDIGO_OK_STATE, revision));
cleanup:
	atomic_store(&fail_io, 0);
	atomic_store(&fail_stop, 0);
	stop_serial_driver(&driver);
	ASSERT_EQ_INT(opened, closed);
	ASSERT_EQ_INT(0, invalid_io);
}

static void focus_sequence_and_errors(void) {
	SERIAL_CHECK_TRUE(start_driver());
	unsigned int revision = property_revision("X_CONFIG");
	indigo_change_switch_property_1(&simulator_test_client, driver.device_name, "X_CONFIG", "FOCUS", true);
	SERIAL_CHECK_TRUE(wait_for_property_state_after("X_CONFIG", INDIGO_OK_STATE, revision));
	reset_trace();
	revision = property_revision("CCD_EXPOSURE");
	atomic_store(&fail_io, 1);
	indigo_change_number_property_1(&simulator_test_client, driver.device_name, "CCD_EXPOSURE", "EXPOSURE", 0.2);
	SERIAL_CHECK_TRUE(wait_for_property_state_after("CCD_EXPOSURE", INDIGO_ALERT_STATE, revision));
	SERIAL_CHECK_EQ_INT(1, count_calls(1, DSUSB_FOCUS));
	SERIAL_CHECK_EQ_INT(0, count_calls(1, DSUSB_START));
	SERIAL_CHECK_EQ_INT(0, output);
	reset_trace();
	revision = property_revision("CCD_EXPOSURE");
	atomic_store(&fail_nth, 2);
	indigo_change_number_property_1(&simulator_test_client, driver.device_name, "CCD_EXPOSURE", "EXPOSURE", 0.2);
	SERIAL_CHECK_TRUE(wait_output(2));
	SERIAL_CHECK_TRUE(wait_for_property_state_after("CCD_EXPOSURE", INDIGO_ALERT_STATE, revision));
	SERIAL_CHECK_TRUE(wait_output(0));
	SERIAL_CHECK_EQ_INT(1, count_calls(1, DSUSB_FOCUS));
	SERIAL_CHECK_EQ_INT(1, count_calls(1, DSUSB_START));
	SERIAL_CHECK_EQ_INT(1, count_calls(1, DSUSB_STOP));
	reset_trace();
	revision = property_revision("CCD_EXPOSURE");
	indigo_change_number_property_1(&simulator_test_client, driver.device_name, "CCD_EXPOSURE", "EXPOSURE", 0.2);
	SERIAL_CHECK_TRUE(wait_for_property_state_seen_after("CCD_EXPOSURE", INDIGO_BUSY_STATE, revision));
	SERIAL_CHECK_TRUE(wait_for_property_state_after("CCD_EXPOSURE", INDIGO_OK_STATE, revision));
	SERIAL_CHECK_EQ_INT(1, count_calls(1, DSUSB_FOCUS));
	SERIAL_CHECK_EQ_INT(1, count_calls(1, DSUSB_START));
	SERIAL_CHECK_EQ_INT(1, count_calls(1, DSUSB_STOP));
	SERIAL_CHECK_TRUE(call_time(1, DSUSB_FOCUS, 0) < call_time(1, DSUSB_START, 0));
	SERIAL_CHECK_TRUE(call_time(1, DSUSB_START, 0) < call_time(1, DSUSB_STOP, 0));
cleanup:
	atomic_store(&fail_io, 0);
	atomic_store(&fail_nth, 0);
	stop_serial_driver(&driver);
	ASSERT_EQ_INT(opened, closed);
	ASSERT_EQ_INT(0, invalid_io);
}

static void timing_overlap_and_recovery(void) {
	SERIAL_CHECK_TRUE(start_driver());
	reset_trace();
	atomic_store(&timer_delay_ms, 80);
	unsigned int revision = property_revision("CCD_EXPOSURE");
	indigo_change_number_property_1(&simulator_test_client, driver.device_name, "CCD_EXPOSURE", "EXPOSURE", 3.2);
	SERIAL_CHECK_TRUE(wait_for_property_state_seen_after("CCD_EXPOSURE", INDIGO_BUSY_STATE, revision));
	SERIAL_CHECK_TRUE(wait_output(1));
	int starts = count_calls(1, DSUSB_START);
	indigo_change_number_property_1(&simulator_test_client, driver.device_name, "CCD_EXPOSURE", "EXPOSURE", 0.2);
	indigo_usleep(200000);
	SERIAL_CHECK_EQ_INT(starts, count_calls(1, DSUSB_START));
	SERIAL_CHECK_TRUE(find_cached_item("CCD_EXPOSURE", "EXPOSURE")->number.target == 3.2);
	SERIAL_CHECK_TRUE(wait_for_property_state_after("CCD_EXPOSURE", INDIGO_OK_STATE, revision));
	double elapsed = call_time(1, DSUSB_STOP, 0) - call_time(1, DSUSB_START, 0);
	if (elapsed < 3.15 || elapsed > 3.40) {
		fprintf(stderr, "DSUSB 3.2 s exposure took %.6f s with injected timer latency\n", elapsed);
	}
	SERIAL_CHECK_TRUE(elapsed >= 3.15);
	SERIAL_CHECK_TRUE(elapsed <= 3.40);
	SERIAL_CHECK_EQ_INT(1, count_calls(1, DSUSB_START));
	SERIAL_CHECK_EQ_INT(1, count_calls(1, DSUSB_STOP));
	revision = property_revision("CCD_EXPOSURE");
	indigo_change_number_property_1(&simulator_test_client, driver.device_name, "CCD_EXPOSURE", "EXPOSURE", 0.2);
	SERIAL_CHECK_TRUE(wait_for_property_state_after("CCD_EXPOSURE", INDIGO_OK_STATE, revision));
cleanup:
	atomic_store(&timer_delay_ms, 0);
	stop_serial_driver(&driver);
	ASSERT_EQ_INT(opened, closed);
	ASSERT_EQ_INT(0, invalid_io);
}

static void abort_and_removal_races(void) {
	SERIAL_CHECK_TRUE(start_driver());
	indigo_change_switch_property_1(&simulator_test_client, driver.device_name, "X_CONFIG", "FOCUS", true);
	indigo_change_number_property_1(&simulator_test_client, driver.device_name, "CCD_EXPOSURE", "EXPOSURE", 2);
	SERIAL_CHECK_TRUE(wait_output(2));
	unsigned int revision = property_revision("CCD_ABORT_EXPOSURE");
	indigo_change_switch_property_1(&simulator_test_client, driver.device_name, "CCD_ABORT_EXPOSURE", "ABORT_EXPOSURE", true);
	SERIAL_CHECK_TRUE(wait_output(0));
	SERIAL_CHECK_TRUE(wait_for_property_state_after("CCD_ABORT_EXPOSURE", INDIGO_OK_STATE, revision));
	int calls_after_abort = io_calls;
	indigo_usleep(1200000);
	SERIAL_CHECK_EQ_INT(calls_after_abort, io_calls);
	indigo_change_switch_property_1(&simulator_test_client, driver.device_name, "X_CONFIG", "FOCUS", false);
	indigo_change_number_property_1(&simulator_test_client, driver.device_name, "CCD_EXPOSURE", "EXPOSURE", 2);
	SERIAL_CHECK_TRUE(wait_output(1));
	atomic_store(&fail_stop, 1);
	revision = property_revision("CCD_ABORT_EXPOSURE");
	indigo_change_switch_property_1(&simulator_test_client, driver.device_name, "CCD_ABORT_EXPOSURE", "ABORT_EXPOSURE", true);
	SERIAL_CHECK_TRUE(wait_for_property_state_after("CCD_ABORT_EXPOSURE", INDIGO_ALERT_STATE, revision));
	assert_switch_item_value("CCD_ABORT_EXPOSURE", "ABORT_EXPOSURE", false);
	revision = property_revision("CCD_ABORT_EXPOSURE");
	indigo_change_switch_property_1(&simulator_test_client, driver.device_name, "CCD_ABORT_EXPOSURE", "ABORT_EXPOSURE", true);
	SERIAL_CHECK_TRUE(wait_for_property_state_after("CCD_ABORT_EXPOSURE", INDIGO_OK_STATE, revision));
	indigo_change_number_property_1(&simulator_test_client, driver.device_name, "CCD_EXPOSURE", "EXPOSURE", 2);
	SERIAL_CHECK_TRUE(wait_output(1));
	callback(NULL, (libusb_device *)(uintptr_t)1, LIBUSB_HOTPLUG_EVENT_DEVICE_LEFT, NULL);
	indigo_queue_drain(queue);
	SERIAL_CHECK_EQ_INT(0, attached);
	SERIAL_CHECK_EQ_INT(opened, closed);
	int calls_after_removal = io_calls;
	int updates_after_removal = context.update_count;
	indigo_usleep(250000);
	SERIAL_CHECK_EQ_INT(calls_after_removal, io_calls);
	SERIAL_CHECK_EQ_INT(updates_after_removal, context.update_count);
	callback(NULL, (libusb_device *)(uintptr_t)1, LIBUSB_HOTPLUG_EVENT_DEVICE_ARRIVED, NULL);
	indigo_queue_drain(queue);
	SERIAL_CHECK_TRUE(connect_serial_device(&driver, NULL));
cleanup:
	atomic_store(&fail_stop, 0);
	stop_serial_driver(&driver);
	ASSERT_EQ_INT(opened, closed);
	ASSERT_EQ_INT(0, invalid_io);
}

static void queued_abort(void) {
	SERIAL_CHECK_TRUE(start_driver());
	SERIAL_CHECK_TRUE(check_queued_abort(driver.device_name, "CCD_EXPOSURE", "EXPOSURE", 30, false, "CCD_ABORT_EXPOSURE", "ABORT_EXPOSURE", false));
	SERIAL_CHECK_TRUE(check_queued_abort(driver.device_name, "CCD_EXPOSURE", "EXPOSURE", 30, false, "CCD_ABORT_EXPOSURE", "ABORT_EXPOSURE", true));
cleanup:
	stop_serial_driver(&driver);
	ASSERT_EQ_INT(opened, closed);
	ASSERT_EQ_INT(0, invalid_io);
}

static void lifecycle_and_open_rollback(void) {
	SERIAL_CHECK_TRUE(start_driver());
	SERIAL_CHECK_EQ_INT(1, attached);
	SERIAL_CHECK_EQ_INT(INDIGO_BUSY, indigo_aux_dsusb(INDIGO_DRIVER_SHUTDOWN, NULL));
	callback(NULL, (libusb_device *)(uintptr_t)1, LIBUSB_HOTPLUG_EVENT_DEVICE_ARRIVED, NULL);
	indigo_queue_drain(queue);
	SERIAL_CHECK_EQ_INT(1, attached);
	disconnect_serial_device(&driver);
	atomic_store(&fail_open, 1);
	SERIAL_CHECK_TRUE(!connect_serial_device(&driver, NULL));
	SERIAL_CHECK_TRUE(connect_serial_device(&driver, NULL));
	callback(NULL, (libusb_device *)(uintptr_t)1, LIBUSB_HOTPLUG_EVENT_DEVICE_LEFT, NULL);
	indigo_queue_drain(queue);
	SERIAL_CHECK_EQ_INT(0, attached);
	SERIAL_CHECK_EQ_INT(opened, closed);
	callback(NULL, (libusb_device *)(uintptr_t)1, LIBUSB_HOTPLUG_EVENT_DEVICE_ARRIVED, NULL);
	indigo_queue_drain(queue);
	SERIAL_CHECK_TRUE(connect_serial_device(&driver, NULL));
cleanup:
	stop_serial_driver(&driver);
	ASSERT_EQ_INT(0, attached);
	ASSERT_EQ_INT(0, references);
	ASSERT_EQ_INT(opened, closed);
	ASSERT_EQ_INT(0, invalid_io);
}

static void initialization_rollback(void) {
	atomic_store(&fail_queue, 1);
	SERIAL_CHECK_TRUE(!bring_up_serial_driver(&driver));
	SERIAL_CHECK_EQ_INT(0, attached);
	SERIAL_CHECK_TRUE(callback == NULL);
	atomic_store(&fail_register, 1);
	SERIAL_CHECK_TRUE(!bring_up_serial_driver(&driver));
	SERIAL_CHECK_EQ_INT(0, references);
	SERIAL_CHECK_TRUE(callback == NULL);
	atomic_store(&fail_attach, 1);
	SERIAL_CHECK_TRUE(bring_up_serial_driver(&driver));
	indigo_queue_drain(queue);
	SERIAL_CHECK_EQ_INT(0, attached);
	SERIAL_CHECK_EQ_INT(0, references);
	tear_down_serial_driver(&driver);
	SERIAL_CHECK_TRUE(start_driver());
cleanup:
	stop_serial_driver(&driver);
	ASSERT_EQ_INT(0, references);
	ASSERT_EQ_INT(0, attached);
	ASSERT_EQ_INT(opened, closed);
}

static void hotplug_identity_capacity_and_contexts(void) {
	SERIAL_CHECK_TRUE(bring_up_serial_driver(&driver));
	indigo_queue_drain(queue);
	SERIAL_CHECK_EQ_INT(1, attached);
	SERIAL_CHECK_EQ_INT(1, references);
	atomic_store(&rejected_device, 2);
	callback(NULL, (libusb_device *)(uintptr_t)2, LIBUSB_HOTPLUG_EVENT_DEVICE_ARRIVED, NULL);
	indigo_queue_drain(queue);
	SERIAL_CHECK_EQ_INT(1, attached);
	SERIAL_CHECK_EQ_INT(1, references);
	atomic_store(&rejected_device, 0);
	for (int id = 2; id <= 5; id++) {
		callback(NULL, (libusb_device *)(uintptr_t)id, LIBUSB_HOTPLUG_EVENT_DEVICE_ARRIVED, NULL);
	}
	indigo_queue_drain(queue);
	SERIAL_CHECK_EQ_INT(5, attached);
	SERIAL_CHECK_EQ_INT(5, references);
	callback(NULL, (libusb_device *)(uintptr_t)6, LIBUSB_HOTPLUG_EVENT_DEVICE_ARRIVED, NULL);
	callback(NULL, (libusb_device *)(uintptr_t)2, LIBUSB_HOTPLUG_EVENT_DEVICE_ARRIVED, NULL);
	callback(NULL, (libusb_device *)(uintptr_t)7, LIBUSB_HOTPLUG_EVENT_DEVICE_LEFT, NULL);
	indigo_queue_drain(queue);
	SERIAL_CHECK_EQ_INT(5, attached);
	SERIAL_CHECK_EQ_INT(5, references);
	SERIAL_CHECK_TRUE(connect_serial_device(&second_driver, NULL));
	reset_trace();
	unsigned int revision = property_revision("CCD_EXPOSURE");
	indigo_change_number_property_1(&simulator_test_client, second_driver.device_name, "CCD_EXPOSURE", "EXPOSURE", 0.1);
	SERIAL_CHECK_TRUE(wait_for_property_state_after("CCD_EXPOSURE", INDIGO_OK_STATE, revision));
	SERIAL_CHECK_EQ_INT(1, count_calls(2, DSUSB_START));
	SERIAL_CHECK_EQ_INT(1, count_calls(2, DSUSB_STOP));
	disconnect_serial_device(&second_driver);
	callback(NULL, (libusb_device *)(uintptr_t)3, LIBUSB_HOTPLUG_EVENT_DEVICE_LEFT, NULL);
	indigo_queue_drain(queue);
	SERIAL_CHECK_EQ_INT(4, attached);
	callback(NULL, (libusb_device *)(uintptr_t)6, LIBUSB_HOTPLUG_EVENT_DEVICE_ARRIVED, NULL);
	indigo_queue_drain(queue);
	SERIAL_CHECK_EQ_INT(5, attached);
	const int remaining[] = { 1, 2, 4, 5, 6 };
	for (int i = 0; i < (int)ARRAY_SIZE(remaining); i++) {
		callback(NULL, (libusb_device *)(uintptr_t)remaining[i], LIBUSB_HOTPLUG_EVENT_DEVICE_LEFT, NULL);
	}
	indigo_queue_drain(queue);
	SERIAL_CHECK_EQ_INT(0, attached);
	SERIAL_CHECK_EQ_INT(0, references);
cleanup:
	atomic_store(&rejected_device, 0);
	tear_down_serial_driver(&driver);
	ASSERT_EQ_INT(0, attached);
	ASSERT_EQ_INT(0, references);
	ASSERT_EQ_INT(opened, closed);
	ASSERT_EQ_INT(0, invalid_io);
}

static void repeated_init_shutdown(void) {
	bool running = false;
	for (int i = 0; i < 3; i++) {
		SERIAL_CHECK_TRUE(bring_up_serial_driver(&driver));
		running = true;
		indigo_queue_drain(queue);
		SERIAL_CHECK_EQ_INT(INDIGO_OK, indigo_aux_dsusb(INDIGO_DRIVER_INIT, NULL));
		tear_down_serial_driver(&driver);
		running = false;
		SERIAL_CHECK_EQ_INT(INDIGO_OK, indigo_aux_dsusb(INDIGO_DRIVER_SHUTDOWN, NULL));
		SERIAL_CHECK_EQ_INT(0, attached);
		SERIAL_CHECK_EQ_INT(0, references);
	}
	return;
cleanup:
	if (running) {
		stop_serial_driver(&driver);
	}
}

int main(void) {
	setvbuf(stdout, NULL, _IONBF, 0);
	alarm(90);
	const indigo_test_case tests[] = {
		{ "driver metadata, interface and property contract", contract },
		{ "direct exposure, SDK errors and recovery", direct_exposure_and_errors },
		{ "focus sequence and distinct SDK failures", focus_sequence_and_errors },
		{ "monotonic exposure timing, overlap and recovery", timing_overlap_and_recovery },
		{ "abort, stop failure and active removal races", abort_and_removal_races },
		{ "queued exposure abort and false abort", queued_abort },
		{ "duplicate discovery, shutdown guard and open rollback", lifecycle_and_open_rollback },
		{ "queue, registration and attachment rollback", initialization_rollback },
		{ "hotplug identity, capacity and multiple contexts", hotplug_identity_capacity_and_contexts },
		{ "repeated idempotent initialization and shutdown", repeated_init_shutdown }
	};
	return indigo_run_tests("aux_dsusb fake SDK integration tests", tests, ARRAY_SIZE(tests));
}
