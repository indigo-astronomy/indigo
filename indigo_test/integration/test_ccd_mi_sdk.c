// Copyright (c) 2026 INDIGO initiative
// All rights reserved.
//
// You may use this software under the terms of 'INDIGO Astronomy
// open-source license' (see LICENSE.md).
//
// THIS SOFTWARE IS PROVIDED BY THE AUTHORS 'AS IS' AND ANY EXPRESS
// OR IMPLIED WARRANTIES, INCLUDING, BUT NOT LIMITED TO, THE IMPLIED
// WARRANTIES OF MERCHANTABILITY AND FITNESS FOR A PARTICULAR PURPOSE
// ARE DISCLAIMED. IN NO EVENT SHALL THE AUTHOR BE LIABLE FOR ANY
// DIRECT, INDIRECT, INCIDENTAL, SPECIAL, EXEMPLARY, OR CONSEQUENTIAL
// DAMAGES (INCLUDING, BUT NOT LIMITED TO, PROCUREMENT OF SUBSTITUTE
// GOODS OR SERVICES; LOSS OF USE, DATA, OR PROFITS; OR BUSINESS
// INTERRUPTION) HOWEVER CAUSED AND ON ANY THEORY OF LIABILITY,
// WHETHER IN CONTRACT, STRICT LIABILITY, OR TORT (INCLUDING
// NEGLIGENCE OR OTHERWISE) ARISING IN ANY WAY OUT OF THE USE OF THIS
// SOFTWARE, EVEN IF ADVISED OF THE POSSIBILITY OF SUCH DAMAGE.

// Code is generated by AI

#include <stdatomic.h>
#include <stdbool.h>
#include <stdint.h>
#include <stdio.h>
#include <stdlib.h>
#include <string.h>
#include <time.h>
#include <pthread.h>

#include <gxccd.h>
#include <indigo/indigo_ccd_driver.h>
#include <indigo/indigo_usb_utils.h>
#include <indigo_drivers/ccd_mi/indigo_ccd_mi.h>

#include "ccd_test_noise.h"
#include "simulator_test_common.h"

#define CAMERA_COUNT 8
#define SENSOR_WIDTH 96
#define SENSOR_HEIGHT 64

typedef struct camera {
	int index;
	atomic_bool active;
} fake_handle;

typedef struct {
	int eid;
	char description[64];
	bool visible;
	bool guider;
	bool wheel;
	bool cooler;
	bool power;
	bool gain;
	bool asymmetric;
	int width;
	int height;
	int max_bin_x;
	int max_bin_y;
	int read_modes;
	int default_read_mode;
	int filters;
	int max_gain;
	float temperature;
	float power_value;
	float egain;
	atomic_int initialize_calls;
	atomic_int release_calls;
	atomic_int set_binning_calls;
	atomic_int set_read_mode_calls;
	atomic_int start_calls;
	atomic_int ready_calls;
	atomic_int read_calls;
	atomic_int abort_calls;
	atomic_int temperature_writes;
	atomic_int gain_writes;
	atomic_int guide_calls;
	atomic_int filter_calls;
	atomic_int fail_open;
	atomic_int fail_integer;
	atomic_int fail_boolean;
	atomic_int fail_read_mode_enumeration;
	atomic_int fail_binning;
	atomic_int fail_set_read_mode;
	atomic_int fail_start;
	atomic_int fail_ready;
	atomic_int fail_read;
	atomic_int fail_abort;
	atomic_int fail_temperature;
	atomic_int fail_temperature_read;
	atomic_int fail_power_read;
	atomic_int fail_gain;
	atomic_int fail_egain;
	atomic_int fail_guide;
	atomic_int fail_filter;
	atomic_int pending_polls;
	atomic_bool exposing;
	int bin_x;
	int bin_y;
	int left;
	int top;
	int image_width;
	int image_height;
	double exposure;
	bool shutter;
	int read_mode;
	int gain_value;
	float temperature_target;
	int16_t ra;
	int16_t dec;
	int filter;
} fake_camera;

typedef struct {
	bool armed;
	atomic_bool entered;
	pthread_mutex_t mutex;
	pthread_cond_t condition;
} fake_gate;

static fake_camera cameras[CAMERA_COUNT];
static fake_handle handles[CAMERA_COUNT];
static int usb_devices[CAMERA_COUNT];
static int enumeration_order[CAMERA_COUNT];
static int enumeration_count;
static indigo_device *logical_devices[CAMERA_COUNT * 3];
static libusb_hotplug_callback_fn usb_callback;
static atomic_int attached_count, attach_calls, detach_calls, active_handles, duplicate_release;
static atomic_int fail_attach_kind, fail_register, fail_queue;
static atomic_int calls_after_close, concurrent_sdk, sdk_active, blob_count, bad_blob;
static atomic_int fast_poll, usb_refs, usb_unref_errors;
static _Atomic double clock_offset;
static _Atomic double guide_sdk_entry, guide_ra_completion, guide_dec_completion;
static fake_gate read_gate = { .mutex = PTHREAD_MUTEX_INITIALIZER, .condition = PTHREAD_COND_INITIALIZER };
static bool fixture_running;

static const simulator_driver_case ccd_case = { "Moravian Instruments Camera", "indigo_ccd_mi", "MI G0-0300 Test", indigo_ccd_mi, true, NULL, 0, NULL, 0, NULL, 0, NULL, 0 };
static const simulator_driver_case guider_case = { "Moravian Instruments Guider", "indigo_ccd_mi", "MI G0-0300 Test (guider)", indigo_ccd_mi, true, NULL, 0, NULL, 0, NULL, 0, NULL, 0 };
static const simulator_driver_case wheel_case = { "Moravian Instruments Wheel", "indigo_ccd_mi", "MI G0-0300 Test (wheel)", indigo_ccd_mi, true, NULL, 0, NULL, 0, NULL, 0, NULL, 0 };

#define MI_CHECK_TRUE(condition) do { if (!(condition)) { fprintf(stderr, "%s:%d: assertion failed: %s\n", __FILE__, __LINE__, #condition); indigo_test_failures++; goto cleanup; } } while (0)
#define MI_CHECK_EQ(expected, actual) do { int e_ = (expected), a_ = (actual); if (e_ != a_) { fprintf(stderr, "%s:%d: expected %d, got %d\n", __FILE__, __LINE__, e_, a_); indigo_test_failures++; goto cleanup; } } while (0)

static fake_camera *camera_by_eid(int eid) {
	for (int i = 0; i < CAMERA_COUNT; i++) {
		if (cameras[i].eid == eid) {
			return cameras + i;
		}
	}
	return NULL;
}

static fake_camera *camera_from_handle(camera_t *camera) {
	fake_handle *handle = (fake_handle *)camera;
	if (handle == NULL || handle->index < 0 || handle->index >= CAMERA_COUNT || !atomic_load(&handle->active)) {
		atomic_fetch_add(&calls_after_close, 1);
		return NULL;
	}
	return cameras + handle->index;
}

static void sdk_enter(void) {
	if (atomic_fetch_add(&sdk_active, 1) != 0) {
		atomic_fetch_add(&concurrent_sdk, 1);
	}
}

static void sdk_leave(void) {
	atomic_fetch_sub(&sdk_active, 1);
}

static void gate_arm(fake_gate *gate) {
	pthread_mutex_lock(&gate->mutex);
	gate->armed = true;
	atomic_store(&gate->entered, false);
	pthread_mutex_unlock(&gate->mutex);
}

static void gate_release(fake_gate *gate) {
	pthread_mutex_lock(&gate->mutex);
	gate->armed = false;
	pthread_cond_broadcast(&gate->condition);
	pthread_mutex_unlock(&gate->mutex);
}

static void gate_enter(fake_gate *gate) {
	pthread_mutex_lock(&gate->mutex);
	if (gate->armed) {
		atomic_store(&gate->entered, true);
		while (gate->armed) {
			pthread_cond_wait(&gate->condition, &gate->mutex);
		}
	}
	pthread_mutex_unlock(&gate->mutex);
}

static bool wait_atomic(atomic_int *value, int expected) {
	for (int i = 0; i < 300; i++) {
		if (atomic_load(value) == expected) {
			return true;
		}
		indigo_usleep(10000);
	}
	return false;
}

static bool wait_bool(atomic_bool *value, bool expected) {
	for (int i = 0; i < 300; i++) {
		if (atomic_load(value) == expected) {
			return true;
		}
		indigo_usleep(10000);
	}
	return false;
}

static void configure_camera(int index, int eid, const char *description, bool guider, bool wheel) {
	fake_camera *camera = cameras + index;
	camera->eid = eid;
	snprintf(camera->description, sizeof(camera->description), "%s", description);
	camera->visible = true;
	camera->guider = guider;
	camera->wheel = wheel;
	camera->cooler = true;
	camera->power = true;
	camera->gain = true;
	camera->asymmetric = false;
	camera->width = SENSOR_WIDTH;
	camera->height = SENSOR_HEIGHT;
	camera->max_bin_x = 8;
	camera->max_bin_y = 8;
	camera->read_modes = 2;
	camera->default_read_mode = 0;
	camera->filters = 5;
	camera->max_gain = 20;
	camera->temperature = 10;
	camera->power_value = 0;
	camera->egain = 0.5;
	atomic_store(&camera->pending_polls, 0);
	handles[index].index = index;
	usb_devices[index] = index;
	enumeration_order[enumeration_count++] = index;
}

static void reset_fake(bool combined) {
	gate_release(&read_gate);
	memset(cameras, 0, sizeof(cameras));
	memset(handles, 0, sizeof(handles));
	memset(logical_devices, 0, sizeof(logical_devices));
	enumeration_count = 0;
	configure_camera(0, 37, "G0-0300 Test   ", combined, combined);
	atomic_store(&attached_count, 0);
	atomic_store(&attach_calls, 0);
	atomic_store(&detach_calls, 0);
	atomic_store(&active_handles, 0);
	atomic_store(&duplicate_release, 0);
	atomic_store(&fail_attach_kind, 0);
	atomic_store(&fail_register, 0);
	atomic_store(&fail_queue, 0);
	atomic_store(&calls_after_close, 0);
	atomic_store(&concurrent_sdk, 0);
	atomic_store(&sdk_active, 0);
	atomic_store(&blob_count, 0);
	atomic_store(&bad_blob, 0);
	atomic_store(&fast_poll, 0);
	atomic_store(&usb_refs, 0);
	atomic_store(&usb_unref_errors, 0);
	atomic_store(&clock_offset, 0);
	atomic_store(&guide_sdk_entry, 0);
	atomic_store(&guide_ra_completion, 0);
	atomic_store(&guide_dec_completion, 0);
}

static int logical_kind(const char *name) {
	if (strstr(name, "(guider)")) {
		return 1;
	}
	if (strstr(name, "(wheel)")) {
		return 2;
	}
	return 0;
}

indigo_result mi_test_attach(indigo_device *device) {
	atomic_fetch_add(&attach_calls, 1);
	int kind = logical_kind(device->name);
	if (atomic_load(&fail_attach_kind) == kind + 1) {
		atomic_store(&fail_attach_kind, 0);
		return INDIGO_FAILED;
	}
	indigo_result result = indigo_attach_device(device);
	if (result == INDIGO_OK) {
		for (int i = 0; i < CAMERA_COUNT * 3; i++) {
			if (logical_devices[i] == NULL) {
				logical_devices[i] = device;
				break;
			}
		}
		atomic_fetch_add(&attached_count, 1);
	}
	return result;
}

indigo_result mi_test_detach(indigo_device *device) {
	indigo_result result = indigo_detach_device(device);
	for (int i = 0; i < CAMERA_COUNT * 3; i++) {
		if (logical_devices[i] == device) {
			logical_devices[i] = NULL;
			break;
		}
	}
	atomic_fetch_sub(&attached_count, 1);
	atomic_fetch_add(&detach_calls, 1);
	return result;
}

void mi_test_usb_start(void) {
}

indigo_queue *mi_test_queue_create(indigo_device *device) {
	if (atomic_exchange(&fail_queue, 0)) {
		return NULL;
	}
	return indigo_queue_create(device);
}

void mi_test_execute_in(indigo_device *device, double delay, indigo_timer_callback callback) {
	if (atomic_load(&fast_poll) && delay == 5) {
		delay = 0.02;
	}
	indigo_execute_handler_in(device, delay, callback);
}

void mi_test_execute_priority(indigo_device *device, int priority, double delay, indigo_timer_callback callback) {
	indigo_execute_priority_handler_in(device, priority, delay, callback);
}

double mi_test_monotonic_time(void) {
	return indigo_monotonic_time() + atomic_load(&clock_offset);
}

int LIBUSB_CALL mi_test_usb_register(libusb_context *ctx, int events, int flags, int vid, int pid, int cls, libusb_hotplug_callback_fn callback, void *data, libusb_hotplug_callback_handle *handle) {
	if (atomic_exchange(&fail_register, 0)) {
		return LIBUSB_ERROR_OTHER;
	}
	usb_callback = callback;
	for (int i = 0; i < enumeration_count; i++) {
		int index = enumeration_order[i];
		if (cameras[index].visible) {
			callback(NULL, (libusb_device *)(usb_devices + index), LIBUSB_HOTPLUG_EVENT_DEVICE_ARRIVED, NULL);
		}
	}
	return LIBUSB_SUCCESS;
}

int mi_test_usb_register_sim(libusb_context *ctx, libusb_hotplug_event events, libusb_hotplug_flag flags, int vid, int pid, int cls, libusb_hotplug_callback_fn callback, void *data, libusb_hotplug_callback_handle *handle) {
	return mi_test_usb_register(ctx, events, flags, vid, pid, cls, callback, data, handle);
}

int mi_test_usb_deregister_poll(libusb_context *ctx, libusb_hotplug_callback_handle handle) {
	return LIBUSB_SUCCESS;
}

void LIBUSB_CALL mi_test_usb_deregister(libusb_context *ctx, libusb_hotplug_callback_handle handle) {
}

libusb_device *LIBUSB_CALL mi_test_usb_ref(libusb_device *device) {
	atomic_fetch_add(&usb_refs, 1);
	return device;
}

void LIBUSB_CALL mi_test_usb_unref(libusb_device *device) {
	if (atomic_fetch_sub(&usb_refs, 1) <= 0) {
		atomic_fetch_add(&usb_unref_errors, 1);
	}
}

int LIBUSB_CALL mi_test_usb_descriptor(libusb_device *device, struct libusb_device_descriptor *descriptor) {
	memset(descriptor, 0, sizeof(*descriptor));
	descriptor->idVendor = 0x1347;
	return LIBUSB_SUCCESS;
}

void gxccd_enumerate_usb(enum_callback_t callback) {
	sdk_enter();
	for (int i = 0; i < enumeration_count; i++) {
		fake_camera *camera = cameras + enumeration_order[i];
		if (camera->visible) {
			callback(camera->eid);
		}
	}
	sdk_leave();
}

camera_t *gxccd_initialize_usb(int eid) {
	sdk_enter();
	fake_camera *camera = camera_by_eid(eid);
	if (camera == NULL || !camera->visible || atomic_exchange(&camera->fail_open, 0)) {
		sdk_leave();
		return NULL;
	}
	int index = (int)(camera - cameras);
	atomic_store(&handles[index].active, true);
	atomic_fetch_add(&camera->initialize_calls, 1);
	atomic_fetch_add(&active_handles, 1);
	sdk_leave();
	return (camera_t *)(handles + index);
}

void gxccd_release(camera_t *handle) {
	sdk_enter();
	fake_handle *fake = (fake_handle *)handle;
	if (fake == NULL || !atomic_exchange(&fake->active, false)) {
		atomic_fetch_add(&duplicate_release, 1);
	} else {
		atomic_fetch_add(&cameras[fake->index].release_calls, 1);
		atomic_fetch_sub(&active_handles, 1);
	}
	sdk_leave();
}

int gxccd_get_boolean_parameter(camera_t *handle, int index, bool *value) {
	sdk_enter();
	fake_camera *camera = camera_from_handle(handle);
	int result = -1;
	if (camera != NULL && atomic_load(&camera->fail_boolean) != index + 1) {
		switch (index) {
			case GBP_GUIDE: *value = camera->guider; result = 0; break;
			case GBP_FILTERS: *value = camera->wheel; result = 0; break;
			case GBP_COOLER: *value = camera->cooler; result = 0; break;
			case GBP_POWER_UTILIZATION: *value = camera->power; result = 0; break;
			case GBP_GAIN: *value = camera->gain; result = 0; break;
			case GBP_ASYMMETRIC_BINNING: *value = camera->asymmetric; result = 0; break;
			default: *value = false; result = 0; break;
		}
	}
	sdk_leave();
	return result;
}

int gxccd_get_integer_parameter(camera_t *handle, int index, int *value) {
	sdk_enter();
	fake_camera *camera = camera_from_handle(handle);
	int result = -1;
	if (camera != NULL && atomic_load(&camera->fail_integer) != index + 1) {
		switch (index) {
			case GIP_CHIP_W: *value = camera->width; break;
			case GIP_CHIP_D: *value = camera->height; break;
			case GIP_PIXEL_W: *value = 7500; break;
			case GIP_PIXEL_D: *value = 7600; break;
			case GIP_MAX_BINNING_X: *value = camera->max_bin_x; break;
			case GIP_MAX_BINNING_Y: *value = camera->max_bin_y; break;
			case GIP_READ_MODES: *value = camera->read_modes; break;
			case GIP_FILTERS: *value = camera->filters; break;
			case GIP_MINIMAL_EXPOSURE: *value = 10000; break;
			case GIP_MAXIMAL_EXPOSURE: *value = 600000; break;
			case GIP_DEFAULT_READ_MODE: *value = camera->default_read_mode; break;
			case GIP_MAX_GAIN: *value = camera->max_gain; break;
			default: *value = 0; break;
		}
		result = 0;
	}
	sdk_leave();
	return result;
}

int gxccd_get_string_parameter(camera_t *handle, int index, char *buffer, size_t size) {
	sdk_enter();
	fake_camera *camera = camera_from_handle(handle);
	int result = -1;
	if (camera != NULL) {
		snprintf(buffer, size, "%s", camera->description);
		result = 0;
	}
	sdk_leave();
	return result;
}

int gxccd_get_value(camera_t *handle, int index, float *value) {
	sdk_enter();
	fake_camera *camera = camera_from_handle(handle);
	int result = -1;
	if (camera != NULL) {
		if (index == GV_CHIP_TEMPERATURE) {
			if (!atomic_load(&camera->fail_temperature_read)) {
				*value = camera->temperature;
				result = 0;
			}
		} else if (index == GV_POWER_UTILIZATION) {
			if (!atomic_load(&camera->fail_power_read)) {
				*value = camera->power_value;
				result = 0;
			}
		} else if (index == GV_ADC_GAIN && !atomic_load(&camera->fail_egain)) {
			*value = camera->egain;
			result = 0;
		}
	}
	sdk_leave();
	return result;
}

int gxccd_enumerate_read_modes(camera_t *handle, int index, char *buffer, size_t size) {
	sdk_enter();
	fake_camera *camera = camera_from_handle(handle);
	int result = camera != NULL && !atomic_load(&camera->fail_read_mode_enumeration) && index < camera->read_modes ? 0 : -1;
	if (result == 0) {
		snprintf(buffer, size, "Read mode %d", index);
	}
	sdk_leave();
	return result;
}

int gxccd_set_binning(camera_t *handle, int x, int y) {
	sdk_enter();
	fake_camera *camera = camera_from_handle(handle);
	int result = camera == NULL || atomic_exchange(&camera->fail_binning, 0) ? -1 : 0;
	if (result == 0) {
		camera->bin_x = x;
		camera->bin_y = y;
		atomic_fetch_add(&camera->set_binning_calls, 1);
	}
	sdk_leave();
	return result;
}

int gxccd_set_read_mode(camera_t *handle, int mode) {
	sdk_enter();
	fake_camera *camera = camera_from_handle(handle);
	int result = camera == NULL || atomic_exchange(&camera->fail_set_read_mode, 0) ? -1 : 0;
	if (result == 0) {
		camera->read_mode = mode;
		atomic_fetch_add(&camera->set_read_mode_calls, 1);
	}
	sdk_leave();
	return result;
}

int gxccd_start_exposure(camera_t *handle, double exposure, bool shutter, int left, int top, int width, int height) {
	sdk_enter();
	fake_camera *camera = camera_from_handle(handle);
	int result = camera == NULL || atomic_exchange(&camera->fail_start, 0) ? -1 : 0;
	if (result == 0) {
		camera->exposure = exposure;
		camera->shutter = shutter;
		camera->left = left;
		camera->top = top;
		camera->image_width = width;
		camera->image_height = height;
		atomic_store(&camera->exposing, true);
		atomic_store(&camera->ready_calls, 0);
		atomic_fetch_add(&camera->start_calls, 1);
	}
	sdk_leave();
	return result;
}

int gxccd_image_ready(camera_t *handle, bool *ready) {
	sdk_enter();
	fake_camera *camera = camera_from_handle(handle);
	int result = camera == NULL || atomic_load(&camera->fail_ready) ? -1 : 0;
	if (result == 0) {
		int polls = atomic_fetch_add(&camera->ready_calls, 1) + 1;
		*ready = polls > atomic_load(&camera->pending_polls);
	}
	sdk_leave();
	return result;
}

int gxccd_read_image(camera_t *handle, void *buffer, size_t size) {
	sdk_enter();
	fake_camera *camera = camera_from_handle(handle);
	gate_enter(&read_gate);
	int result = camera == NULL || atomic_exchange(&camera->fail_read, 0) ? -1 : 0;
	if (result == 0) {
		size_t pixels = (size_t)camera->image_width * camera->image_height;
		if (size < pixels * 2) {
			result = -1;
		} else {
			uint16_t *image = buffer;
			for (int y = 0; y < camera->image_height; y++) {
				for (int x = 0; x < camera->image_width; x++) {
					unsigned source = (unsigned)(y + camera->top) * SENSOR_WIDTH + x + camera->left;
					image[y * camera->image_width + x] = ccd_test_noise(source, 0);
				}
			}
			atomic_fetch_add(&camera->read_calls, 1);
			atomic_store(&camera->exposing, false);
		}
	}
	sdk_leave();
	return result;
}

int gxccd_abort_exposure(camera_t *handle, bool download) {
	sdk_enter();
	fake_camera *camera = camera_from_handle(handle);
	int result = camera == NULL || atomic_exchange(&camera->fail_abort, 0) ? -1 : 0;
	if (camera != NULL) {
		atomic_fetch_add(&camera->abort_calls, 1);
		if (result == 0) {
			atomic_store(&camera->exposing, false);
		}
	}
	sdk_leave();
	return result;
}

int gxccd_set_temperature(camera_t *handle, float target) {
	sdk_enter();
	fake_camera *camera = camera_from_handle(handle);
	int result = camera == NULL || atomic_exchange(&camera->fail_temperature, 0) ? -1 : 0;
	if (result == 0) {
		camera->temperature_target = target;
		atomic_fetch_add(&camera->temperature_writes, 1);
	}
	sdk_leave();
	return result;
}

int gxccd_set_gain(camera_t *handle, uint16_t gain) {
	sdk_enter();
	fake_camera *camera = camera_from_handle(handle);
	int result = camera == NULL || atomic_exchange(&camera->fail_gain, 0) ? -1 : 0;
	if (result == 0) {
		camera->gain_value = gain;
		atomic_fetch_add(&camera->gain_writes, 1);
	}
	sdk_leave();
	return result;
}

int gxccd_move_telescope(camera_t *handle, int16_t ra, int16_t dec) {
	sdk_enter();
	fake_camera *camera = camera_from_handle(handle);
	int result = camera == NULL || atomic_exchange(&camera->fail_guide, 0) ? -1 : 0;
	if (result == 0) {
		camera->ra = ra;
		camera->dec = dec;
		if (ra != 0 || dec != 0) {
			atomic_store(&guide_sdk_entry, indigo_monotonic_time());
		}
		atomic_fetch_add(&camera->guide_calls, 1);
	}
	sdk_leave();
	return result;
}

int gxccd_set_filter(camera_t *handle, int filter) {
	sdk_enter();
	fake_camera *camera = camera_from_handle(handle);
	int result = camera == NULL || atomic_exchange(&camera->fail_filter, 0) ? -1 : 0;
	if (result == 0) {
		camera->filter = filter;
		atomic_fetch_add(&camera->filter_calls, 1);
	}
	sdk_leave();
	return result;
}

void gxccd_get_last_error(camera_t *handle, char *buffer, size_t size) {
	snprintf(buffer, size, "injected gxccd failure");
}

static indigo_result observe_image(indigo_client *client, indigo_device *device, indigo_property *property, const char *message) {
	if (!strcmp(property->device, guider_case.device_name) && property->state == INDIGO_OK_STATE) {
		if (!strcmp(property->name, GUIDER_GUIDE_RA_PROPERTY_NAME)) {
			atomic_store(&guide_ra_completion, indigo_monotonic_time());
		} else if (!strcmp(property->name, GUIDER_GUIDE_DEC_PROPERTY_NAME)) {
			atomic_store(&guide_dec_completion, indigo_monotonic_time());
		}
	}
	if (!strcmp(property->device, ccd_case.device_name) && !strcmp(property->name, CCD_IMAGE_PROPERTY_NAME) && property->state == INDIGO_OK_STATE && property->count > 0 && property->items[0].blob.size > 0) {
		indigo_item *item = property->items;
		bool valid = item->blob.value != NULL && !strcmp(item->blob.format, ".raw") && item->blob.size >= (long)sizeof(indigo_raw_header);
		if (valid) {
			indigo_raw_header header;
			memcpy(&header, item->blob.value, sizeof(header));
			fake_camera *camera = cameras;
			valid = header.signature == INDIGO_RAW_MONO16 && header.width == (uint32_t)camera->image_width && header.height == (uint32_t)camera->image_height && item->blob.size >= (long)(sizeof(header) + (size_t)header.width * header.height * 2);
			if (valid) {
				uint16_t *pixels = (uint16_t *)((unsigned char *)item->blob.value + sizeof(header));
				for (uint32_t y = 0; y < header.height && valid; y++) {
					for (uint32_t x = 0; x < header.width; x++) {
						unsigned source = (unsigned)(y + camera->top) * SENSOR_WIDTH + x + camera->left;
						if (pixels[y * header.width + x] != ccd_test_noise(source, 0)) {
							valid = false;
							break;
						}
					}
				}
			}
		}
		atomic_fetch_add(&blob_count, 1);
		if (!valid) {
			atomic_fetch_add(&bad_blob, 1);
		}
	}
	return simulator_client_update_property(client, device, property, message);
}

static bool fixture_start_current(int expected_devices) {
	reset_simulator_context(&ccd_case);
	simulator_test_client.update_property = observe_image;
	if (indigo_start() != INDIGO_OK || indigo_attach_client(&simulator_test_client) != INDIGO_OK || indigo_ccd_mi(INDIGO_DRIVER_INIT, NULL) != INDIGO_OK) {
		return false;
	}
	fixture_running = true;
	return wait_atomic(&attached_count, expected_devices);
}

static bool fixture_start(bool combined) {
	reset_fake(combined);
	return fixture_start_current(combined ? 3 : 1);
}

static void fixture_stop(void) {
	if (!fixture_running) {
		return;
	}
	for (int i = 0; i < CAMERA_COUNT * 3; i++) {
		if (logical_devices[i] != NULL) {
			indigo_change_switch_property_1(&simulator_test_client, logical_devices[i]->name, CONNECTION_PROPERTY_NAME, CONNECTION_DISCONNECTED_ITEM_NAME, true);
		}
	}
	indigo_usleep(100000);
	indigo_ccd_mi(INDIGO_DRIVER_SHUTDOWN, NULL);
	indigo_detach_client(&simulator_test_client);
	indigo_stop();
	release_cached_properties();
	fixture_running = false;
}

static void select_device(const simulator_driver_case *driver_case) {
	reset_simulator_context(driver_case);
	simulator_test_client.update_property = observe_image;
	enumerate_simulator_device();
}

static bool connect_device(const simulator_driver_case *driver_case) {
	select_device(driver_case);
	if (indigo_change_switch_property_1(&simulator_test_client, driver_case->device_name, CONNECTION_PROPERTY_NAME, CONNECTION_CONNECTED_ITEM_NAME, true) != INDIGO_OK) {
		return false;
	}
	return wait_for_simulator_connection_state(true);
}

static bool disconnect_device(const simulator_driver_case *driver_case) {
	select_device(driver_case);
	if (indigo_change_switch_property_1(&simulator_test_client, driver_case->device_name, CONNECTION_PROPERTY_NAME, CONNECTION_DISCONNECTED_ITEM_NAME, true) != INDIGO_OK) {
		return false;
	}
	return wait_for_simulator_connection_state(false);
}

static bool expose(double duration) {
	unsigned busy_revision = property_state_revision(CCD_EXPOSURE_PROPERTY_NAME, INDIGO_BUSY_STATE);
	if (indigo_change_number_property_1(&simulator_test_client, ccd_case.device_name, CCD_EXPOSURE_PROPERTY_NAME, CCD_EXPOSURE_ITEM_NAME, duration) != INDIGO_OK) {
		return false;
	}
	return wait_for_property_state_after(CCD_EXPOSURE_PROPERTY_NAME, INDIGO_BUSY_STATE, busy_revision) && wait_for_property_state(CCD_EXPOSURE_PROPERTY_NAME, INDIGO_OK_STATE);
}

static void metadata_and_property_profiles(void) {
	MI_CHECK_TRUE(fixture_start(true));
	indigo_driver_info info = { 0 };
	MI_CHECK_EQ(INDIGO_OK, indigo_ccd_mi(INDIGO_DRIVER_INFO, &info));
	MI_CHECK_TRUE(info.multi_device_support);
	MI_CHECK_EQ(3, atomic_load(&attached_count));
	MI_CHECK_TRUE(connect_device(&ccd_case));
	assert_device_interface(INDIGO_INTERFACE_CCD);
	assert_property_has_item(CCD_INFO_PROPERTY_NAME, CCD_INFO_WIDTH_ITEM_NAME);
	assert_property_has_item(CCD_BIN_PROPERTY_NAME, CCD_BIN_HORIZONTAL_ITEM_NAME);
	assert_property_has_item(CCD_READ_MODE_PROPERTY_NAME, "READ_MODE0");
	assert_property_has_item(CCD_GAIN_PROPERTY_NAME, CCD_GAIN_ITEM_NAME);
	assert_property_has_item(CCD_COOLER_PROPERTY_NAME, CCD_COOLER_ON_ITEM_NAME);
	MI_CHECK_TRUE(disconnect_device(&ccd_case));
	MI_CHECK_TRUE(connect_device(&guider_case));
	assert_device_interface(INDIGO_INTERFACE_GUIDER);
	assert_property_has_item(GUIDER_GUIDE_RA_PROPERTY_NAME, GUIDER_GUIDE_EAST_ITEM_NAME);
	MI_CHECK_EQ(INT16_MAX, (int)find_cached_item(GUIDER_GUIDE_RA_PROPERTY_NAME, GUIDER_GUIDE_EAST_ITEM_NAME)->number.max);
	MI_CHECK_EQ(INT16_MAX, (int)find_cached_item(GUIDER_GUIDE_DEC_PROPERTY_NAME, GUIDER_GUIDE_NORTH_ITEM_NAME)->number.max);
	MI_CHECK_TRUE(disconnect_device(&guider_case));
	MI_CHECK_TRUE(connect_device(&wheel_case));
	assert_device_interface(INDIGO_INTERFACE_WHEEL);
	assert_property_has_item(WHEEL_SLOT_PROPERTY_NAME, WHEEL_SLOT_ITEM_NAME);
	cleanup:
	fixture_stop();
}

static void shared_connection_orders_and_reconnect(void) {
	MI_CHECK_TRUE(fixture_start(true));
	int opens = atomic_load(&cameras[0].initialize_calls);
	int closes = atomic_load(&cameras[0].release_calls);
	MI_CHECK_TRUE(connect_device(&guider_case));
	MI_CHECK_TRUE(connect_device(&ccd_case));
	MI_CHECK_TRUE(connect_device(&wheel_case));
	MI_CHECK_EQ(opens + 1, atomic_load(&cameras[0].initialize_calls));
	MI_CHECK_EQ(1, atomic_load(&active_handles));
	MI_CHECK_TRUE(disconnect_device(&ccd_case));
	MI_CHECK_TRUE(disconnect_device(&guider_case));
	MI_CHECK_EQ(closes, atomic_load(&cameras[0].release_calls));
	MI_CHECK_TRUE(disconnect_device(&wheel_case));
	MI_CHECK_EQ(closes + 1, atomic_load(&cameras[0].release_calls));
	MI_CHECK_TRUE(connect_device(&ccd_case));
	MI_CHECK_TRUE(disconnect_device(&ccd_case));
	cleanup:
	fixture_stop();
}

static void connection_failures_roll_back_and_recover(void) {
	MI_CHECK_TRUE(fixture_start(false));
	select_device(&ccd_case);
	atomic_store(&cameras[0].fail_open, 1);
	indigo_change_switch_property_1(&simulator_test_client, ccd_case.device_name, CONNECTION_PROPERTY_NAME, CONNECTION_CONNECTED_ITEM_NAME, true);
	MI_CHECK_TRUE(wait_for_property_state(CONNECTION_PROPERTY_NAME, INDIGO_ALERT_STATE));
	atomic_store(&cameras[0].fail_integer, GIP_CHIP_W + 1);
	indigo_change_switch_property_1(&simulator_test_client, ccd_case.device_name, CONNECTION_PROPERTY_NAME, CONNECTION_CONNECTED_ITEM_NAME, true);
	MI_CHECK_TRUE(wait_for_property_state(CONNECTION_PROPERTY_NAME, INDIGO_ALERT_STATE));
	atomic_store(&cameras[0].fail_integer, 0);
	atomic_store(&cameras[0].fail_read_mode_enumeration, 1);
	MI_CHECK_TRUE(connect_device(&ccd_case));
	MI_CHECK_TRUE(!strcmp(find_cached_item(CCD_READ_MODE_PROPERTY_NAME, "READ_MODE0")->label, "Read mode 0"));
	MI_CHECK_TRUE(disconnect_device(&ccd_case));
	MI_CHECK_EQ(0, atomic_load(&active_handles));
	MI_CHECK_EQ(0, atomic_load(&duplicate_release));
	cleanup:
	fixture_stop();
}

static void exposure_geometry_frame_types_and_pixels(void) {
	MI_CHECK_TRUE(fixture_start(false));
	MI_CHECK_TRUE(connect_device(&ccd_case));
	indigo_change_switch_property_1(&simulator_test_client, ccd_case.device_name, CCD_IMAGE_FORMAT_PROPERTY_NAME, CCD_IMAGE_FORMAT_RAW_ITEM_NAME, true);
	const char *bin_items[] = { CCD_BIN_HORIZONTAL_ITEM_NAME, CCD_BIN_VERTICAL_ITEM_NAME };
	double bin_values[] = { 2, 2 };
	MI_CHECK_EQ(INDIGO_OK, indigo_change_number_property(&simulator_test_client, ccd_case.device_name, CCD_BIN_PROPERTY_NAME, 2, bin_items, bin_values));
	MI_CHECK_TRUE(wait_for_property_state(CCD_BIN_PROPERTY_NAME, INDIGO_OK_STATE));
	const char *frame_items[] = { CCD_FRAME_LEFT_ITEM_NAME, CCD_FRAME_TOP_ITEM_NAME, CCD_FRAME_WIDTH_ITEM_NAME, CCD_FRAME_HEIGHT_ITEM_NAME };
	double frame_values[] = { 8, 4, 64, 40 };
	MI_CHECK_EQ(INDIGO_OK, indigo_change_number_property(&simulator_test_client, ccd_case.device_name, CCD_FRAME_PROPERTY_NAME, 4, frame_items, frame_values));
	MI_CHECK_TRUE(expose(0.02));
	MI_CHECK_EQ(4, cameras[0].left);
	MI_CHECK_EQ(2, cameras[0].top);
	MI_CHECK_EQ(32, cameras[0].image_width);
	MI_CHECK_EQ(20, cameras[0].image_height);
	MI_CHECK_TRUE(cameras[0].shutter);
	MI_CHECK_EQ(1, atomic_load(&blob_count));
	MI_CHECK_EQ(0, atomic_load(&bad_blob));
	indigo_change_switch_property_1(&simulator_test_client, ccd_case.device_name, CCD_FRAME_TYPE_PROPERTY_NAME, CCD_FRAME_TYPE_DARK_ITEM_NAME, true);
	MI_CHECK_TRUE(expose(0.02));
	MI_CHECK_TRUE(!cameras[0].shutter);
	indigo_change_switch_property_1(&simulator_test_client, ccd_case.device_name, CCD_FRAME_TYPE_PROPERTY_NAME, CCD_FRAME_TYPE_BIAS_ITEM_NAME, true);
	MI_CHECK_TRUE(expose(0.1));
	MI_CHECK_TRUE(cameras[0].exposure == 0.01);
	MI_CHECK_EQ(3, atomic_load(&blob_count));
	cleanup:
	fixture_stop();
}

static void exposure_errors_pending_watchdog_and_recovery(void) {
	MI_CHECK_TRUE(fixture_start(false));
	MI_CHECK_TRUE(connect_device(&ccd_case));
	atomic_store(&cameras[0].fail_binning, 1);
	indigo_change_number_property_1(&simulator_test_client, ccd_case.device_name, CCD_EXPOSURE_PROPERTY_NAME, CCD_EXPOSURE_ITEM_NAME, 0.01);
	MI_CHECK_TRUE(wait_for_property_state(CCD_EXPOSURE_PROPERTY_NAME, INDIGO_ALERT_STATE));
	atomic_store(&cameras[0].fail_start, 1);
	indigo_change_number_property_1(&simulator_test_client, ccd_case.device_name, CCD_EXPOSURE_PROPERTY_NAME, CCD_EXPOSURE_ITEM_NAME, 0.01);
	MI_CHECK_TRUE(wait_for_property_state(CCD_EXPOSURE_PROPERTY_NAME, INDIGO_ALERT_STATE));
	atomic_store(&cameras[0].pending_polls, 3);
	MI_CHECK_TRUE(expose(0.01));
	MI_CHECK_TRUE(atomic_load(&cameras[0].ready_calls) >= 4);
	atomic_store(&cameras[0].fail_ready, 1);
	indigo_change_number_property_1(&simulator_test_client, ccd_case.device_name, CCD_EXPOSURE_PROPERTY_NAME, CCD_EXPOSURE_ITEM_NAME, 0.01);
	MI_CHECK_TRUE(wait_for_property_state(CCD_EXPOSURE_PROPERTY_NAME, INDIGO_ALERT_STATE));
	atomic_store(&cameras[0].fail_ready, 0);
	atomic_store(&cameras[0].fail_read, 1);
	indigo_change_number_property_1(&simulator_test_client, ccd_case.device_name, CCD_EXPOSURE_PROPERTY_NAME, CCD_EXPOSURE_ITEM_NAME, 0.01);
	MI_CHECK_TRUE(wait_for_property_state(CCD_EXPOSURE_PROPERTY_NAME, INDIGO_ALERT_STATE));
	atomic_store(&cameras[0].pending_polls, 100000);
	int starts = atomic_load(&cameras[0].start_calls);
	indigo_change_number_property_1(&simulator_test_client, ccd_case.device_name, CCD_EXPOSURE_PROPERTY_NAME, CCD_EXPOSURE_ITEM_NAME, 0.01);
	MI_CHECK_TRUE(wait_atomic(&cameras[0].start_calls, starts + 1));
	atomic_store(&clock_offset, 31);
	MI_CHECK_TRUE(wait_for_property_state(CCD_EXPOSURE_PROPERTY_NAME, INDIGO_ALERT_STATE));
	atomic_store(&clock_offset, 0);
	atomic_store(&cameras[0].pending_polls, 0);
	MI_CHECK_TRUE(expose(0.01));
	cleanup:
	fixture_stop();
}

static void abort_overlap_and_disconnect_read_race(void) {
	MI_CHECK_TRUE(fixture_start(false));
	MI_CHECK_TRUE(connect_device(&ccd_case));
	atomic_store(&cameras[0].pending_polls, 100);
	int starts = atomic_load(&cameras[0].start_calls);
	indigo_change_number_property_1(&simulator_test_client, ccd_case.device_name, CCD_EXPOSURE_PROPERTY_NAME, CCD_EXPOSURE_ITEM_NAME, 0.05);
	MI_CHECK_TRUE(wait_for_property_state(CCD_EXPOSURE_PROPERTY_NAME, INDIGO_BUSY_STATE));
	MI_CHECK_TRUE(wait_atomic(&cameras[0].start_calls, starts + 1));
	starts++;
	indigo_change_number_property_1(&simulator_test_client, ccd_case.device_name, CCD_EXPOSURE_PROPERTY_NAME, CCD_EXPOSURE_ITEM_NAME, 0.02);
	indigo_usleep(30000);
	MI_CHECK_EQ(starts, atomic_load(&cameras[0].start_calls));
	atomic_store(&cameras[0].fail_abort, 1);
	indigo_change_switch_property_1(&simulator_test_client, ccd_case.device_name, CCD_ABORT_EXPOSURE_PROPERTY_NAME, CCD_ABORT_EXPOSURE_ITEM_NAME, true);
	MI_CHECK_TRUE(wait_for_property_state(CCD_ABORT_EXPOSURE_PROPERTY_NAME, INDIGO_ALERT_STATE));
	indigo_change_number_property_1(&simulator_test_client, ccd_case.device_name, CCD_EXPOSURE_PROPERTY_NAME, CCD_EXPOSURE_ITEM_NAME, 0.05);
	MI_CHECK_TRUE(wait_for_property_state(CCD_EXPOSURE_PROPERTY_NAME, INDIGO_BUSY_STATE));
	indigo_change_switch_property_1(&simulator_test_client, ccd_case.device_name, CCD_ABORT_EXPOSURE_PROPERTY_NAME, CCD_ABORT_EXPOSURE_ITEM_NAME, true);
	MI_CHECK_TRUE(wait_for_property_state(CCD_ABORT_EXPOSURE_PROPERTY_NAME, INDIGO_OK_STATE));
	atomic_store(&cameras[0].pending_polls, 0);
	MI_CHECK_TRUE(expose(0.01));
	gate_arm(&read_gate);
	indigo_change_number_property_1(&simulator_test_client, ccd_case.device_name, CCD_EXPOSURE_PROPERTY_NAME, CCD_EXPOSURE_ITEM_NAME, 0.01);
	MI_CHECK_TRUE(wait_bool(&read_gate.entered, true));
	indigo_change_switch_property_1(&simulator_test_client, ccd_case.device_name, CONNECTION_PROPERTY_NAME, CONNECTION_DISCONNECTED_ITEM_NAME, true);
	gate_release(&read_gate);
	MI_CHECK_TRUE(wait_for_simulator_connection_state(false));
	MI_CHECK_EQ(0, atomic_load(&calls_after_close));
	cleanup:
	gate_release(&read_gate);
	fixture_stop();
}

static void read_mode_binning_and_control_failures(void) {
	MI_CHECK_TRUE(fixture_start(false));
	MI_CHECK_TRUE(connect_device(&ccd_case));
	indigo_change_switch_property_1(&simulator_test_client, ccd_case.device_name, CCD_READ_MODE_PROPERTY_NAME, "READ_MODE1", true);
	MI_CHECK_TRUE(wait_for_property_state(CCD_READ_MODE_PROPERTY_NAME, INDIGO_OK_STATE));
	MI_CHECK_EQ(1, cameras[0].read_mode);
	atomic_store(&cameras[0].fail_set_read_mode, 1);
	indigo_change_switch_property_1(&simulator_test_client, ccd_case.device_name, CCD_READ_MODE_PROPERTY_NAME, "READ_MODE0", true);
	MI_CHECK_TRUE(wait_for_property_state(CCD_READ_MODE_PROPERTY_NAME, INDIGO_ALERT_STATE));
	const char *items[] = { CCD_BIN_HORIZONTAL_ITEM_NAME, CCD_BIN_VERTICAL_ITEM_NAME };
	double invalid[] = { 2, 3 };
	indigo_change_number_property(&simulator_test_client, ccd_case.device_name, CCD_BIN_PROPERTY_NAME, 2, items, invalid);
	MI_CHECK_TRUE(wait_for_property_state(CCD_BIN_PROPERTY_NAME, INDIGO_ALERT_STATE));
	cameras[0].asymmetric = true;
	MI_CHECK_TRUE(disconnect_device(&ccd_case));
	MI_CHECK_TRUE(connect_device(&ccd_case));
	indigo_change_number_property(&simulator_test_client, ccd_case.device_name, CCD_BIN_PROPERTY_NAME, 2, items, invalid);
	MI_CHECK_TRUE(wait_for_property_state(CCD_BIN_PROPERTY_NAME, INDIGO_OK_STATE));
	cleanup:
	fixture_stop();
}

static void cooler_gain_polling_errors_and_recovery(void) {
	MI_CHECK_TRUE(fixture_start(false));
	atomic_store(&fast_poll, 1);
	MI_CHECK_TRUE(connect_device(&ccd_case));
	int writes = atomic_load(&cameras[0].temperature_writes);
	indigo_change_number_property_1(&simulator_test_client, ccd_case.device_name, CCD_TEMPERATURE_PROPERTY_NAME, CCD_TEMPERATURE_ITEM_NAME, -10);
	MI_CHECK_TRUE(wait_for_property_state(CCD_TEMPERATURE_PROPERTY_NAME, INDIGO_BUSY_STATE));
	MI_CHECK_TRUE(wait_atomic(&cameras[0].temperature_writes, writes + 1));
	MI_CHECK_TRUE(cameras[0].temperature_target == -10);
	cameras[0].temperature = -10;
	MI_CHECK_TRUE(wait_for_property_state(CCD_TEMPERATURE_PROPERTY_NAME, INDIGO_OK_STATE));
	atomic_store(&cameras[0].fail_temperature_read, 1);
	MI_CHECK_TRUE(wait_for_property_state(CCD_TEMPERATURE_PROPERTY_NAME, INDIGO_ALERT_STATE));
	atomic_store(&cameras[0].fail_temperature_read, 0);
	atomic_store(&cameras[0].fail_power_read, 1);
	MI_CHECK_TRUE(wait_for_property_state(CCD_COOLER_POWER_PROPERTY_NAME, INDIGO_ALERT_STATE));
	atomic_store(&cameras[0].fail_power_read, 0);
	atomic_store(&cameras[0].fail_temperature, 1);
	indigo_change_switch_property_1(&simulator_test_client, ccd_case.device_name, CCD_COOLER_PROPERTY_NAME, CCD_COOLER_OFF_ITEM_NAME, true);
	MI_CHECK_TRUE(wait_for_property_state(CCD_COOLER_PROPERTY_NAME, INDIGO_ALERT_STATE));
	indigo_change_number_property_1(&simulator_test_client, ccd_case.device_name, CCD_GAIN_PROPERTY_NAME, CCD_GAIN_ITEM_NAME, 7);
	MI_CHECK_TRUE(wait_for_property_state(CCD_GAIN_PROPERTY_NAME, INDIGO_OK_STATE));
	MI_CHECK_EQ(7, cameras[0].gain_value);
	atomic_store(&cameras[0].fail_egain, 1);
	indigo_change_number_property_1(&simulator_test_client, ccd_case.device_name, CCD_GAIN_PROPERTY_NAME, CCD_GAIN_ITEM_NAME, 6);
	MI_CHECK_TRUE(wait_for_property_state(CCD_EGAIN_PROPERTY_NAME, INDIGO_ALERT_STATE));
	atomic_store(&cameras[0].fail_egain, 0);
	atomic_store(&cameras[0].fail_gain, 1);
	indigo_change_number_property_1(&simulator_test_client, ccd_case.device_name, CCD_GAIN_PROPERTY_NAME, CCD_GAIN_ITEM_NAME, 8);
	MI_CHECK_TRUE(wait_for_property_state(CCD_GAIN_PROPERTY_NAME, INDIGO_ALERT_STATE));
	MI_CHECK_TRUE(disconnect_device(&ccd_case));
	int calls = atomic_load(&cameras[0].temperature_writes) + atomic_load(&cameras[0].gain_writes);
	indigo_usleep(100000);
	MI_CHECK_EQ(calls, atomic_load(&cameras[0].temperature_writes) + atomic_load(&cameras[0].gain_writes));
	MI_CHECK_EQ(0, atomic_load(&calls_after_close));
	cleanup:
	fixture_stop();
}

static bool pulse(const char *property, const char *item, int duration) {
	unsigned busy = property_state_revision(property, INDIGO_BUSY_STATE);
	if (indigo_change_number_property_1(&simulator_test_client, guider_case.device_name, property, item, duration) != INDIGO_OK) {
		return false;
	}
	return wait_for_property_state_after(property, INDIGO_BUSY_STATE, busy) && wait_for_property_state(property, INDIGO_OK_STATE);
}

static int compare_double(const void *left, const void *right) {
	double a = *(const double *)left;
	double b = *(const double *)right;
	return a < b ? -1 : a > b;
}

static bool measure_pulse(const char *property, const char *item, int duration, double *error) {
	atomic_store(&guide_sdk_entry, 0);
	if (!strcmp(property, GUIDER_GUIDE_RA_PROPERTY_NAME)) {
		atomic_store(&guide_ra_completion, 0);
	} else {
		atomic_store(&guide_dec_completion, 0);
	}
	if (!pulse(property, item, duration)) {
		return false;
	}
	double entry = atomic_load(&guide_sdk_entry);
	double completion = !strcmp(property, GUIDER_GUIDE_RA_PROPERTY_NAME) ? atomic_load(&guide_ra_completion) : atomic_load(&guide_dec_completion);
	if (entry <= 0 || completion < entry) {
		return false;
	}
	*error = (completion - entry) * 1000 - duration;
	return true;
}

static void guider_directions_overlap_failure_and_timing(void) {
	MI_CHECK_TRUE(fixture_start(true));
	MI_CHECK_TRUE(connect_device(&guider_case));
	const char *properties[] = { GUIDER_GUIDE_RA_PROPERTY_NAME, GUIDER_GUIDE_RA_PROPERTY_NAME, GUIDER_GUIDE_DEC_PROPERTY_NAME, GUIDER_GUIDE_DEC_PROPERTY_NAME };
	const char *items[] = { GUIDER_GUIDE_EAST_ITEM_NAME, GUIDER_GUIDE_WEST_ITEM_NAME, GUIDER_GUIDE_NORTH_ITEM_NAME, GUIDER_GUIDE_SOUTH_ITEM_NAME };
	const int durations[] = { 20, 100, 500 };
	double errors[32], absolute_errors[32], percent_errors[32], absolute_percent_errors[32], min_error = 1e9, max_error = -1e9, sum_error = 0, sum_square = 0, sum_percent = 0, sum_percent_square = 0;
	int samples = 0;
	for (int direction = 0; direction < 4; direction++) {
		double warmup_error = 0;
		MI_CHECK_TRUE(measure_pulse(properties[direction], items[direction], 20, &warmup_error));
		for (unsigned d = 0; d < sizeof(durations) / sizeof(durations[0]); d++) {
			for (int repeat = 0; repeat < 2; repeat++) {
				double error = 0;
				MI_CHECK_TRUE(measure_pulse(properties[direction], items[direction], durations[d], &error));
				if (error < min_error) {
					min_error = error;
				}
				if (error > max_error) {
					max_error = error;
				}
				sum_error += error;
				sum_square += error * error;
				double percent_error = error / durations[d] * 100;
				sum_percent += percent_error;
				sum_percent_square += percent_error * percent_error;
				errors[samples] = error;
				absolute_errors[samples] = fabs(error);
				percent_errors[samples] = percent_error;
				absolute_percent_errors[samples] = fabs(percent_error);
				samples++;
			}
		}
	}
	MI_CHECK_TRUE(connect_device(&ccd_case));
	select_device(&guider_case);
	atomic_store(&cameras[0].pending_polls, 1000);
	int starts = atomic_load(&cameras[0].start_calls);
	indigo_change_number_property_1(&simulator_test_client, ccd_case.device_name, CCD_EXPOSURE_PROPERTY_NAME, CCD_EXPOSURE_ITEM_NAME, 1);
	MI_CHECK_TRUE(wait_atomic(&cameras[0].start_calls, starts + 1));
	for (int direction = 0; direction < 4; direction++) {
		for (int repeat = 0; repeat < 2; repeat++) {
			double error = 0;
			MI_CHECK_TRUE(measure_pulse(properties[direction], items[direction], 100, &error));
			if (error < min_error) {
				min_error = error;
			}
			if (error > max_error) {
				max_error = error;
			}
			sum_error += error;
			sum_square += error * error;
			double percent_error = error;
			sum_percent += percent_error;
			sum_percent_square += percent_error * percent_error;
			errors[samples] = error;
			absolute_errors[samples] = fabs(error);
			percent_errors[samples] = percent_error;
			absolute_percent_errors[samples] = fabs(percent_error);
			samples++;
		}
	}
	indigo_change_switch_property_1(&simulator_test_client, ccd_case.device_name, CCD_ABORT_EXPOSURE_PROPERTY_NAME, CCD_ABORT_EXPOSURE_ITEM_NAME, true);
	qsort(errors, samples, sizeof(double), compare_double);
	qsort(absolute_errors, samples, sizeof(double), compare_double);
	qsort(percent_errors, samples, sizeof(double), compare_double);
	qsort(absolute_percent_errors, samples, sizeof(double), compare_double);
	double mean = sum_error / samples;
	double deviation = sqrt(fmax(0, sum_square / samples - mean * mean));
	double percent_mean = sum_percent / samples;
	double percent_deviation = sqrt(fmax(0, sum_percent_square / samples - percent_mean * percent_mean));
	int p95 = (int)ceil(samples * 0.95) - 1;
	int p99 = (int)ceil(samples * 0.99) - 1;
	double median = samples % 2 ? errors[samples / 2] : (errors[samples / 2 - 1] + errors[samples / 2]) / 2;
	double percent_median = samples % 2 ? percent_errors[samples / 2] : (percent_errors[samples / 2 - 1] + percent_errors[samples / 2]) / 2;
	printf("MI guider SDK-entry/public-completion timing (warm-ups discarded; idle plus active CCD exposure): requested=20/100/500ms actual=requested+error directions=E/W/N/S repeats=2 n=%d signed[min=%+.3f mean=%+.3f median=%+.3f p95=%+.3f p99=%+.3f max=%+.3f stdev=%.3f]ms abs[max=%.3f]ms percent[min=%+.3f mean=%+.3f median=%+.3f p95=%+.3f p99=%+.3f max=%+.3f stdev=%.3f absmax=%.3f]\n", samples, min_error, mean, median, errors[p95], errors[p99], max_error, deviation, absolute_errors[samples - 1], percent_errors[0], percent_mean, percent_median, percent_errors[p95], percent_errors[p99], percent_errors[samples - 1], percent_deviation, absolute_percent_errors[samples - 1]);
	int zero_calls = atomic_load(&cameras[0].guide_calls);
	indigo_change_number_property_1(&simulator_test_client, guider_case.device_name, GUIDER_GUIDE_RA_PROPERTY_NAME, GUIDER_GUIDE_EAST_ITEM_NAME, 0);
	MI_CHECK_TRUE(wait_atomic(&cameras[0].guide_calls, zero_calls + 1));
	MI_CHECK_EQ(0, cameras[0].ra);
	int guide_calls = atomic_load(&cameras[0].guide_calls);
	indigo_change_number_property_1(&simulator_test_client, guider_case.device_name, GUIDER_GUIDE_RA_PROPERTY_NAME, GUIDER_GUIDE_EAST_ITEM_NAME, 200);
	MI_CHECK_TRUE(wait_for_property_state(GUIDER_GUIDE_RA_PROPERTY_NAME, INDIGO_BUSY_STATE));
	MI_CHECK_TRUE(wait_atomic(&cameras[0].guide_calls, guide_calls + 1));
	indigo_change_number_property_1(&simulator_test_client, guider_case.device_name, GUIDER_GUIDE_DEC_PROPERTY_NAME, GUIDER_GUIDE_NORTH_ITEM_NAME, 100);
	MI_CHECK_TRUE(wait_for_property_state(GUIDER_GUIDE_DEC_PROPERTY_NAME, INDIGO_BUSY_STATE));
	MI_CHECK_TRUE(wait_atomic(&cameras[0].guide_calls, guide_calls + 2));
	MI_CHECK_TRUE(cameras[0].ra > 0 && cameras[0].dec > 0);
	MI_CHECK_TRUE(wait_for_property_state(GUIDER_GUIDE_RA_PROPERTY_NAME, INDIGO_OK_STATE));
	atomic_store(&cameras[0].fail_guide, 1);
	indigo_change_number_property_1(&simulator_test_client, guider_case.device_name, GUIDER_GUIDE_RA_PROPERTY_NAME, GUIDER_GUIDE_WEST_ITEM_NAME, 30);
	MI_CHECK_TRUE(wait_for_property_state(GUIDER_GUIDE_RA_PROPERTY_NAME, INDIGO_ALERT_STATE));
	cleanup:
	fixture_stop();
}

static void guider_during_acquisition_and_shared_teardown(void) {
	MI_CHECK_TRUE(fixture_start(true));
	MI_CHECK_TRUE(connect_device(&ccd_case));
	MI_CHECK_TRUE(connect_device(&guider_case));
	select_device(&ccd_case);
	atomic_store(&cameras[0].pending_polls, 5);
	indigo_change_number_property_1(&simulator_test_client, ccd_case.device_name, CCD_EXPOSURE_PROPERTY_NAME, CCD_EXPOSURE_ITEM_NAME, 0.05);
	MI_CHECK_TRUE(wait_for_property_state(CCD_EXPOSURE_PROPERTY_NAME, INDIGO_BUSY_STATE));
	select_device(&guider_case);
	MI_CHECK_TRUE(pulse(GUIDER_GUIDE_RA_PROPERTY_NAME, GUIDER_GUIDE_EAST_ITEM_NAME, 50));
	select_device(&ccd_case);
	MI_CHECK_TRUE(wait_for_property_state(CCD_EXPOSURE_PROPERTY_NAME, INDIGO_OK_STATE));
	MI_CHECK_TRUE(disconnect_device(&guider_case));
	MI_CHECK_EQ(1, atomic_load(&active_handles));
	MI_CHECK_TRUE(disconnect_device(&ccd_case));
	MI_CHECK_EQ(0, atomic_load(&active_handles));
	MI_CHECK_EQ(0, atomic_load(&concurrent_sdk));
	cleanup:
	fixture_stop();
}

static void wheel_slots_failures_and_shared_ownership(void) {
	MI_CHECK_TRUE(fixture_start(true));
	MI_CHECK_TRUE(connect_device(&ccd_case));
	MI_CHECK_TRUE(connect_device(&wheel_case));
	int calls = atomic_load(&cameras[0].filter_calls);
	indigo_change_number_property_1(&simulator_test_client, wheel_case.device_name, WHEEL_SLOT_PROPERTY_NAME, WHEEL_SLOT_ITEM_NAME, 1);
	MI_CHECK_TRUE(wait_for_property_state(WHEEL_SLOT_PROPERTY_NAME, INDIGO_OK_STATE));
	MI_CHECK_EQ(calls, atomic_load(&cameras[0].filter_calls));
	indigo_change_number_property_1(&simulator_test_client, wheel_case.device_name, WHEEL_SLOT_PROPERTY_NAME, WHEEL_SLOT_ITEM_NAME, 5);
	MI_CHECK_TRUE(wait_for_property_state(WHEEL_SLOT_PROPERTY_NAME, INDIGO_OK_STATE));
	MI_CHECK_EQ(4, cameras[0].filter);
	atomic_store(&cameras[0].fail_filter, 1);
	indigo_change_number_property_1(&simulator_test_client, wheel_case.device_name, WHEEL_SLOT_PROPERTY_NAME, WHEEL_SLOT_ITEM_NAME, 2);
	MI_CHECK_TRUE(wait_for_property_state(WHEEL_SLOT_PROPERTY_NAME, INDIGO_ALERT_STATE));
	MI_CHECK_TRUE(wait_for_number_item_value(WHEEL_SLOT_PROPERTY_NAME, WHEEL_SLOT_ITEM_NAME, 5, 0));
	MI_CHECK_TRUE(disconnect_device(&wheel_case));
	MI_CHECK_EQ(1, atomic_load(&active_handles));
	cameras[0].filters = 0;
	select_device(&wheel_case);
	indigo_change_switch_property_1(&simulator_test_client, wheel_case.device_name, CONNECTION_PROPERTY_NAME, CONNECTION_CONNECTED_ITEM_NAME, true);
	MI_CHECK_TRUE(wait_for_property_state(CONNECTION_PROPERTY_NAME, INDIGO_ALERT_STATE));
	MI_CHECK_EQ(1, atomic_load(&active_handles));
	cameras[0].filters = 5;
	MI_CHECK_TRUE(connect_device(&wheel_case));
	MI_CHECK_TRUE(disconnect_device(&wheel_case));
	cleanup:
	fixture_stop();
}

static void hotplug_duplicate_removal_replug_and_capacity(void) {
	MI_CHECK_TRUE(fixture_start(true));
	int attached = atomic_load(&attached_count);
	usb_callback(NULL, (libusb_device *)(usb_devices + 0), LIBUSB_HOTPLUG_EVENT_DEVICE_ARRIVED, NULL);
	indigo_usleep(100000);
	MI_CHECK_EQ(attached, atomic_load(&attached_count));
	cameras[0].visible = false;
	usb_callback(NULL, (libusb_device *)(usb_devices + 0), LIBUSB_HOTPLUG_EVENT_DEVICE_LEFT, NULL);
	MI_CHECK_TRUE(wait_atomic(&attached_count, 0));
	cameras[0].visible = true;
	usb_callback(NULL, (libusb_device *)(usb_devices + 0), LIBUSB_HOTPLUG_EVENT_DEVICE_ARRIVED, NULL);
	MI_CHECK_TRUE(wait_atomic(&attached_count, 3));
	configure_camera(1, 103, "Second", false, false);
	usb_callback(NULL, (libusb_device *)(usb_devices + 1), LIBUSB_HOTPLUG_EVENT_DEVICE_ARRIVED, NULL);
	MI_CHECK_TRUE(wait_atomic(&attached_count, 4));
	configure_camera(2, 511, "Third", false, false);
	usb_callback(NULL, (libusb_device *)(usb_devices + 2), LIBUSB_HOTPLUG_EVENT_DEVICE_ARRIVED, NULL);
	MI_CHECK_TRUE(wait_atomic(&attached_count, 5));
	configure_camera(3, 900, "Overflow", false, false);
	usb_callback(NULL, (libusb_device *)(usb_devices + 3), LIBUSB_HOTPLUG_EVENT_DEVICE_ARRIVED, NULL);
	indigo_usleep(100000);
	MI_CHECK_EQ(5, atomic_load(&attached_count));
	MI_CHECK_EQ(0, atomic_load(&duplicate_release));
	cleanup:
	fixture_stop();
}

static void unsupported_capability_profile(void) {
	reset_fake(false);
	cameras[0].cooler = false;
	cameras[0].power = false;
	cameras[0].gain = false;
	cameras[0].read_modes = 0;
	cameras[0].max_bin_x = cameras[0].max_bin_y = 2;
	atomic_store(&cameras[0].fail_integer, GIP_MAXIMAL_EXPOSURE + 1);
	MI_CHECK_TRUE(fixture_start_current(1));
	MI_CHECK_TRUE(connect_device(&ccd_case));
	MI_CHECK_TRUE(find_cached_property(CCD_TEMPERATURE_PROPERTY_NAME) != NULL);
	MI_CHECK_EQ(INDIGO_RO_PERM, find_cached_property(CCD_TEMPERATURE_PROPERTY_NAME)->perm);
	MI_CHECK_TRUE(find_cached_property(CCD_COOLER_PROPERTY_NAME) == NULL);
	MI_CHECK_TRUE(find_cached_property(CCD_COOLER_POWER_PROPERTY_NAME) == NULL);
	MI_CHECK_TRUE(find_cached_property(CCD_GAIN_PROPERTY_NAME) == NULL);
	MI_CHECK_TRUE(find_cached_property(CCD_EGAIN_PROPERTY_NAME) == NULL);
	MI_CHECK_TRUE(find_cached_property(CCD_READ_MODE_PROPERTY_NAME) == NULL);
	MI_CHECK_EQ(2, find_cached_property(CCD_MODE_PROPERTY_NAME)->count);
	cleanup:
	fixture_stop();
}

static void optional_probe_defaults_and_master_attach_retry(void) {
	reset_fake(true);
	atomic_store(&cameras[0].fail_boolean, GBP_GUIDE + 1);
	MI_CHECK_TRUE(fixture_start_current(2));
	cameras[0].visible = false;
	usb_callback(NULL, (libusb_device *)(usb_devices + 0), LIBUSB_HOTPLUG_EVENT_DEVICE_LEFT, NULL);
	MI_CHECK_TRUE(wait_atomic(&attached_count, 0));
	cameras[0].visible = true;
	atomic_store(&cameras[0].fail_boolean, 0);
	atomic_store(&fail_attach_kind, 1);
	int calls = atomic_load(&attach_calls);
	usb_callback(NULL, (libusb_device *)(usb_devices + 0), LIBUSB_HOTPLUG_EVENT_DEVICE_ARRIVED, NULL);
	MI_CHECK_TRUE(wait_atomic(&attach_calls, calls + 1));
	MI_CHECK_EQ(0, atomic_load(&attached_count));
	usb_callback(NULL, (libusb_device *)(usb_devices + 0), LIBUSB_HOTPLUG_EVENT_DEVICE_ARRIVED, NULL);
	MI_CHECK_TRUE(wait_atomic(&attached_count, 3));
	cleanup:
	fixture_stop();
}

static void hot_unplug_during_exposure_and_recovery(void) {
	MI_CHECK_TRUE(fixture_start(false));
	MI_CHECK_TRUE(connect_device(&ccd_case));
	atomic_store(&cameras[0].pending_polls, 10000);
	indigo_change_number_property_1(&simulator_test_client, ccd_case.device_name, CCD_EXPOSURE_PROPERTY_NAME, CCD_EXPOSURE_ITEM_NAME, 0.05);
	MI_CHECK_TRUE(wait_for_property_state(CCD_EXPOSURE_PROPERTY_NAME, INDIGO_BUSY_STATE));
	cameras[0].visible = false;
	usb_callback(NULL, (libusb_device *)(usb_devices + 0), LIBUSB_HOTPLUG_EVENT_DEVICE_LEFT, NULL);
	MI_CHECK_TRUE(wait_atomic(&attached_count, 0));
	MI_CHECK_EQ(0, atomic_load(&active_handles));
	MI_CHECK_EQ(0, atomic_load(&calls_after_close));
	cameras[0].visible = true;
	atomic_store(&cameras[0].pending_polls, 0);
	usb_callback(NULL, (libusb_device *)(usb_devices + 0), LIBUSB_HOTPLUG_EVENT_DEVICE_ARRIVED, NULL);
	MI_CHECK_TRUE(wait_atomic(&attached_count, 1));
	MI_CHECK_TRUE(connect_device(&ccd_case));
	MI_CHECK_TRUE(expose(0.01));
	cleanup:
	fixture_stop();
}

static void attach_queue_registration_and_shutdown_failures(void) {
	reset_fake(true);
	reset_simulator_context(&ccd_case);
	MI_CHECK_EQ(INDIGO_OK, indigo_start());
	fixture_running = true;
	MI_CHECK_EQ(INDIGO_OK, indigo_attach_client(&simulator_test_client));
	atomic_store(&fail_queue, 1);
	MI_CHECK_TRUE(indigo_ccd_mi(INDIGO_DRIVER_INIT, NULL) != INDIGO_OK);
	atomic_store(&fail_register, 1);
	MI_CHECK_TRUE(indigo_ccd_mi(INDIGO_DRIVER_INIT, NULL) != INDIGO_OK);
	MI_CHECK_EQ(INDIGO_OK, indigo_ccd_mi(INDIGO_DRIVER_INIT, NULL));
	MI_CHECK_TRUE(wait_atomic(&attached_count, 3));
	MI_CHECK_TRUE(connect_device(&ccd_case));
	MI_CHECK_TRUE(indigo_ccd_mi(INDIGO_DRIVER_SHUTDOWN, NULL) != INDIGO_OK);
	MI_CHECK_TRUE(expose(0.01));
	MI_CHECK_TRUE(disconnect_device(&ccd_case));
	cleanup:
	fixture_stop();
}

static void repeated_init_shutdown_and_resource_balance(void) {
	for (int iteration = 0; iteration < 3; iteration++) {
		MI_CHECK_TRUE(fixture_start(iteration == 0));
		if (iteration == 0) {
			MI_CHECK_TRUE(connect_device(&ccd_case));
			MI_CHECK_TRUE(disconnect_device(&ccd_case));
		}
		fixture_stop();
		MI_CHECK_EQ(0, atomic_load(&active_handles));
		MI_CHECK_EQ(0, atomic_load(&calls_after_close));
		MI_CHECK_EQ(0, atomic_load(&usb_unref_errors));
	}
	return;
	cleanup:
	fixture_stop();
}

int main(void) {
	const indigo_test_case tests[] = {
		{ "metadata and CCD/guider/wheel property profiles", metadata_and_property_profiles },
		{ "shared connection orders and reconnect", shared_connection_orders_and_reconnect },
		{ "connection failures roll back and recover", connection_failures_roll_back_and_recover },
		{ "exposure geometry, frame types and deterministic pixels", exposure_geometry_frame_types_and_pixels },
		{ "exposure errors, pending readout, watchdog and recovery", exposure_errors_pending_watchdog_and_recovery },
		{ "abort, overlap rejection and disconnect/read race", abort_overlap_and_disconnect_read_race },
		{ "read mode, binning and control failures", read_mode_binning_and_control_failures },
		{ "cooler, gain and polling errors and recovery", cooler_gain_polling_errors_and_recovery },
		{ "guider directions, overlap, failure and timing", guider_directions_overlap_failure_and_timing },
		{ "guider during acquisition and shared teardown", guider_during_acquisition_and_shared_teardown },
		{ "wheel slots, failures and shared ownership", wheel_slots_failures_and_shared_ownership },
		{ "hotplug duplicate, removal, replug and capacity", hotplug_duplicate_removal_replug_and_capacity },
		{ "unsupported capability profile", unsupported_capability_profile },
		{ "optional probe defaults and master attach retry", optional_probe_defaults_and_master_attach_retry },
		{ "hot unplug during exposure and recovery", hot_unplug_during_exposure_and_recovery },
		{ "queue/registration failure and connected shutdown rejection", attach_queue_registration_and_shutdown_failures },
		{ "repeated INIT/SHUTDOWN and resource balance", repeated_init_shutdown_and_resource_balance }
	};
	return indigo_run_tests("Moravian Instruments fake gxccd integration", tests, ARRAY_SIZE(tests));
}
