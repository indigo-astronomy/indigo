// Copyright (c) 2026 INDIGO initiative
// All rights reserved.
//
// You may use this software under the terms of 'INDIGO Astronomy
// open-source license' (see LICENSE.md).
//
// THIS SOFTWARE IS PROVIDED BY THE AUTHORS 'AS IS' AND ANY EXPRESS
// OR IMPLIED WARRANTIES, INCLUDING, BUT NOT LIMITED TO, THE IMPLIED
// WARRANTIES OF MERCHANTABILITY AND FITNESS FOR A PARTICULAR PURPOSE
// ARE DISCLAIMED. IN NO EVENT SHALL THE AUTHOR BE LIABLE FOR ANY
// DIRECT, INDIRECT, INCIDENTAL, SPECIAL, EXEMPLARY, OR CONSEQUENTIAL
// DAMAGES (INCLUDING, BUT NOT LIMITED TO, PROCUREMENT OF SUBSTITUTE
// GOODS OR SERVICES; LOSS OF USE, DATA, OR PROFITS; OR BUSINESS
// INTERRUPTION) HOWEVER CAUSED AND ON ANY THEORY OF LIABILITY,
// WHETHER IN CONTRACT, STRICT LIABILITY, OR TORT (INCLUDING
// NEGLIGENCE OR OTHERWISE) ARISING IN ANY WAY OUT OF THE USE OF THIS
// SOFTWARE, EVEN IF ADVISED OF THE POSSIBILITY OF SUCH DAMAGE.

// Code is generated by AI

// The Askar-WAF Wi-Fi port selection against a Wi-Fi focuser standing in for the real one: a UDP responder answers
// the WAF:discover broadcast with 127.0.0.1 and a TCP port, and a relay forwards that port to the serial simulator.
// It opens sockets, so it is an opt-in driver test, not part of test-integration.
//
// auto:// selects a serial port only, a discovered askar:// item never becomes auto://askar://...; askar:// without
// a host selects the first discovered Wi-Fi focuser at connect. A real Askar-WAF on the network answers the broadcast
// as well; the connection case does not connect to it and is skipped when such a focuser is listed first.

#include <indigo_drivers/focuser_askar/indigo_focuser_askar.h>

#include "serial_simulator_test_common.h"
#include <indigo/indigo_uni_io.h>
#include <arpa/inet.h>
#include <errno.h>
#include <fcntl.h>
#include <netinet/in.h>
#include <poll.h>
#include <pthread.h>
#include <stdatomic.h>
#include <sys/socket.h>
#include <termios.h>

#ifndef FOCUSER_ASKAR_SIMULATOR_EXECUTABLE
#define FOCUSER_ASKAR_SIMULATOR_EXECUTABLE "build/integration/focuser_askar_simulator"
#endif

#define ASKAR_DISCOVERY_PORT 7676

static const simulator_driver_case askar_focuser = {
	"Askar-WAF Focuser",
	"indigo_focuser_askar",
	"Askar-WAF",
	indigo_focuser_askar,
	false,
	NULL,
	0,
	NULL,
	0,
	NULL,
	0,
	NULL,
	0
};

static external_serial_simulator fixture;
static int relay_listener = -1;
static int responder_socket = -1;
static char wifi_url[64];
static atomic_bool stopping, drop_session;
static atomic_uint ports_ok_defined;
static pthread_t relay_thread, responder_thread;
static bool relay_started, responder_started;

// DEVICE_PORTS is defined OK when a Wi-Fi discovery ends, at attach and after a refresh.
static indigo_result observe_define(indigo_client *client, indigo_device *device, indigo_property *property, const char *message) {
	if (context.driver_case != NULL && !strcmp(property->device, context.driver_case->device_name) && !strcmp(property->name, DEVICE_PORTS_PROPERTY_NAME) && property->state == INDIGO_OK_STATE) {
		atomic_fetch_add(&ports_ok_defined, 1);
	}
	return simulator_client_define_property(client, device, property, message);
}

// One TCP session of the driver, forwarded to the serial simulator until either side closes.
static void relay_session(int client) {
	int serial = open(fixture.port, O_RDWR | O_NOCTTY);
	if (serial < 0) {
		close(client);
		return;
	}
	struct termios settings;
	if (tcgetattr(serial, &settings) == 0) {
		cfmakeraw(&settings);
		tcsetattr(serial, TCSANOW, &settings);
	}
	struct pollfd fds[2] = { { client, POLLIN, 0 }, { serial, POLLIN, 0 } };
	char buffer[256];
	while (!atomic_load(&stopping) && !atomic_load(&drop_session)) {
		int ready = poll(fds, 2, 100);
		if (ready < 0 && errno != EINTR) {
			break;
		}
		if (ready <= 0) {
			continue;
		}
		if (fds[0].revents & (POLLIN | POLLHUP | POLLERR)) {
			ssize_t count = read(client, buffer, sizeof(buffer));
			if (count <= 0 || write(serial, buffer, count) != count) {
				break;
			}
		}
		if (fds[1].revents & (POLLIN | POLLHUP | POLLERR)) {
			ssize_t count = read(serial, buffer, sizeof(buffer));
			if (count <= 0 || send(client, buffer, count, 0) != count) {
				break;
			}
		}
	}
	close(serial);
	close(client);
}

static void *relay_main(void *data) {
	while (!atomic_load(&stopping)) {
		struct pollfd listener = { relay_listener, POLLIN, 0 };
		if (poll(&listener, 1, 100) > 0) {
			int client = accept(relay_listener, NULL, NULL);
			if (client >= 0) {
				relay_session(client);
			}
		}
	}
	return NULL;
}

static void *responder_main(void *data) {
	while (!atomic_load(&stopping)) {
		char request[64];
		struct sockaddr_in from;
		socklen_t length = sizeof(from);
		ssize_t count = recvfrom(responder_socket, request, sizeof(request) - 1, 0, (struct sockaddr *)&from, &length);
		if (count > 0) {
			request[count] = '\0';
			if (!strncmp(request, "WAF:discover", 12)) {
				char reply[64];
				int reply_length = snprintf(reply, sizeof(reply), "WAF:127.0.0.1:%s", strrchr(wifi_url, ':') + 1);
				sendto(responder_socket, reply, reply_length, 0, (struct sockaddr *)&from, length);
			}
		}
	}
	return NULL;
}

static bool start_wifi_focuser(void) {
	if (!start_external_serial_simulator(&fixture, FOCUSER_ASKAR_SIMULATOR_EXECUTABLE)) {
		return false;
	}
	relay_listener = socket(AF_INET, SOCK_STREAM, 0);
	struct sockaddr_in address = { 0 };
	address.sin_family = AF_INET;
	address.sin_addr.s_addr = htonl(INADDR_LOOPBACK);
	socklen_t length = sizeof(address);
	if (relay_listener < 0 || bind(relay_listener, (struct sockaddr *)&address, sizeof(address)) < 0 || listen(relay_listener, 1) < 0 || getsockname(relay_listener, (struct sockaddr *)&address, &length) < 0) {
		fprintf(stderr, "Can't listen for the Wi-Fi focuser (%s)\n", strerror(errno));
		return false;
	}
	snprintf(wifi_url, sizeof(wifi_url), "askar://127.0.0.1:%d", ntohs(address.sin_port));
	responder_socket = socket(AF_INET, SOCK_DGRAM, 0);
	int enable = 1;
	setsockopt(responder_socket, SOL_SOCKET, SO_REUSEADDR, &enable, sizeof(enable));
#ifdef SO_REUSEPORT
	setsockopt(responder_socket, SOL_SOCKET, SO_REUSEPORT, &enable, sizeof(enable));
#endif
	struct timeval timeout = { 0, 100000 };
	setsockopt(responder_socket, SOL_SOCKET, SO_RCVTIMEO, &timeout, sizeof(timeout));
	struct sockaddr_in discovery = { 0 };
	discovery.sin_family = AF_INET;
	discovery.sin_addr.s_addr = htonl(INADDR_ANY);
	discovery.sin_port = htons(ASKAR_DISCOVERY_PORT);
	if (responder_socket < 0 || bind(responder_socket, (struct sockaddr *)&discovery, sizeof(discovery)) < 0) {
		fprintf(stderr, "Can't listen for the Wi-Fi discovery on UDP port %d (%s)\n", ASKAR_DISCOVERY_PORT, strerror(errno));
		return false;
	}
	atomic_store(&stopping, false);
	relay_started = pthread_create(&relay_thread, NULL, relay_main, NULL) == 0;
	responder_started = pthread_create(&responder_thread, NULL, responder_main, NULL) == 0;
	return relay_started && responder_started;
}

static void stop_wifi_focuser(void) {
	atomic_store(&stopping, true);
	if (relay_started) {
		pthread_join(relay_thread, NULL);
	}
	if (responder_started) {
		pthread_join(responder_thread, NULL);
	}
	if (relay_listener >= 0) {
		close(relay_listener);
	}
	if (responder_socket >= 0) {
		close(responder_socket);
	}
	stop_external_serial_simulator(&fixture);
}

// Waits for the end of a Wi-Fi discovery that lists the stand-in focuser.
static bool wifi_port_listed(unsigned before) {
	for (int i = 0; i < 150; i++) {
		indigo_property *ports = find_cached_property(DEVICE_PORTS_PROPERTY_NAME);
		if (atomic_load(&ports_ok_defined) > before && ports != NULL && ports->state == INDIGO_OK_STATE && find_cached_item(DEVICE_PORTS_PROPERTY_NAME, wifi_url) != NULL) {
			return true;
		}
		indigo_usleep(100000);
	}
	fprintf(stderr, "%s was not discovered\n", wifi_url);
	return false;
}

static const char *device_port(void) {
	indigo_item *item = find_cached_item(DEVICE_PORT_PROPERTY_NAME, DEVICE_PORT_ITEM_NAME);
	return item != NULL ? item->text.value : "";
}

static bool driver_up(void) {
	atomic_store(&ports_ok_defined, 0);
	if (!bring_up_serial_driver(&askar_focuser)) {
		return false;
	}
	enumerate_simulator_device();
	return wifi_port_listed(0);
}

// auto:// is a serial port selection: the refresh that lists the Wi-Fi focuser keeps the port free of askar:// items.
static void auto_port_ignores_wifi(void) {
	SERIAL_CHECK_TRUE(driver_up());
	SERIAL_CHECK_EQ_INT(INDIGO_OK, indigo_change_text_property_1_raw(&simulator_test_client, askar_focuser.device_name, DEVICE_PORT_PROPERTY_NAME, DEVICE_PORT_ITEM_NAME, "auto://"));
	SERIAL_CHECK_TRUE(wait_for_property_state(DEVICE_PORT_PROPERTY_NAME, INDIGO_OK_STATE));
	unsigned before = atomic_load(&ports_ok_defined);
	SERIAL_CHECK_EQ_INT(INDIGO_OK, indigo_change_switch_property_1(&simulator_test_client, askar_focuser.device_name, DEVICE_PORTS_PROPERTY_NAME, DEVICE_PORTS_REFRESH_ITEM_NAME, true));
	SERIAL_CHECK_TRUE(wifi_port_listed(before));
	SERIAL_CHECK_TRUE(!strncmp(device_port(), USBSERIAL_AUTO_PREFIX, strlen(USBSERIAL_AUTO_PREFIX)));
	if (strstr(device_port(), "askar://") != NULL) {
		fprintf(stderr, "auto:// selected the Wi-Fi focuser: %s\n", device_port());
		indigo_test_failures++;
	}
cleanup:
	tear_down_serial_driver(&askar_focuser);
}

// A port of plain auto:// is resolved when the device connects, without a refresh: the driver never gets the empty
// path. Which serial port is chosen depends on the host, so only the publish is checked.
static void empty_auto_port_resolved_at_connect(void) {
	SERIAL_CHECK_TRUE(driver_up());
	SERIAL_CHECK_EQ_INT(INDIGO_OK, indigo_change_text_property_1_raw(&simulator_test_client, askar_focuser.device_name, DEVICE_PORT_PROPERTY_NAME, DEVICE_PORT_ITEM_NAME, "auto://"));
	SERIAL_CHECK_TRUE(wait_for_property_state(DEVICE_PORT_PROPERTY_NAME, INDIGO_OK_STATE));
	SERIAL_CHECK_TRUE(!strcmp(device_port(), USBSERIAL_AUTO_PREFIX));
	unsigned port_before = property_revision(DEVICE_PORT_PROPERTY_NAME);
	unsigned connection_before = property_revision(CONNECTION_PROPERTY_NAME);
	SERIAL_CHECK_EQ_INT(INDIGO_OK, indigo_change_switch_property_1(&simulator_test_client, askar_focuser.device_name, CONNECTION_PROPERTY_NAME, CONNECTION_CONNECTED_ITEM_NAME, true));
	bool published = false;
	for (int i = 0; i < 100 && !published; i++) {
		published = property_revision(DEVICE_PORT_PROPERTY_NAME) > port_before;
		if (!published) {
			indigo_usleep(100000);
		}
	}
	SERIAL_CHECK_TRUE(published);
	indigo_property *port = find_cached_property(DEVICE_PORT_PROPERTY_NAME);
	printf("    port at connect: %s (state %d)\n", device_port(), port ? port->state : -1);
	SERIAL_CHECK_TRUE(strcmp(device_port(), USBSERIAL_AUTO_PREFIX) || (port != NULL && port->state == INDIGO_ALERT_STATE));
	SERIAL_CHECK_TRUE(strstr(device_port(), "askar://") == NULL);
	bool finished = false;
	for (int i = 0; i < 100 && !finished; i++) {
		indigo_property *connection = find_cached_property(CONNECTION_PROPERTY_NAME);
		finished = connection != NULL && property_revision(CONNECTION_PROPERTY_NAME) > connection_before && connection->state != INDIGO_BUSY_STATE;
		if (!finished) {
			indigo_usleep(100000);
		}
	}
	SERIAL_CHECK_TRUE(finished);
cleanup:
	disconnect_serial_device(&askar_focuser);
	tear_down_serial_driver(&askar_focuser);
}

// askar:// without a host selects the first discovered Wi-Fi focuser at connect and talks to it over TCP.
static void askar_port_selects_wifi(void) {
	SERIAL_CHECK_TRUE(driver_up());
	indigo_property *ports = find_cached_property(DEVICE_PORTS_PROPERTY_NAME);
	for (int i = 0; ports != NULL && i < ports->count; i++) {
		if (!strncmp(ports->items[i].name, "askar://", 8)) {
			if (strcmp(ports->items[i].name, wifi_url)) {
				printf("    skipped: %s on the network answered the discovery first, it is not connected to\n", ports->items[i].name);
				goto cleanup;
			}
			break;
		}
	}
	SERIAL_CHECK_TRUE(connect_serial_device(&askar_focuser, "askar://"));
	SERIAL_CHECK_TRUE(!strcmp(device_port(), wifi_url));
	SERIAL_CHECK_TRUE(find_cached_property(FOCUSER_POSITION_PROPERTY_NAME) != NULL);
	disconnect_serial_device(&askar_focuser);
	SERIAL_CHECK_TRUE(!context.connected);
cleanup:
	disconnect_serial_device(&askar_focuser);
	tear_down_serial_driver(&askar_focuser);
}

// The focuser closing the connection disconnects the device with ALERT, and the device connects again afterwards. The
// test connects to the stand-in focuser by its URL, so a real Askar-WAF on the network does not matter here.
static void closed_connection_disconnects(void) {
	SERIAL_CHECK_TRUE(driver_up());
	SERIAL_CHECK_TRUE(connect_serial_device(&askar_focuser, wifi_url));
	atomic_store(&drop_session, true);
	bool lost = false;
	for (int i = 0; i < 50 && !lost; i++) {
		lost = !context.connected && context.disconnected && context.last_connection_state == INDIGO_ALERT_STATE;
		indigo_usleep(100000);
	}
	SERIAL_CHECK_TRUE(lost);
	atomic_store(&drop_session, false);
	SERIAL_CHECK_TRUE(connect_serial_device(&askar_focuser, wifi_url));
	SERIAL_CHECK_TRUE(find_cached_property(FOCUSER_POSITION_PROPERTY_NAME) != NULL);
cleanup:
	atomic_store(&drop_session, false);
	disconnect_serial_device(&askar_focuser);
	tear_down_serial_driver(&askar_focuser);
}

int main(void) {
	setvbuf(stdout, NULL, _IOLBF, 0);
	signal(SIGPIPE, SIG_IGN);
	alarm(120);
	simulator_test_client.define_property = observe_define;
	if (!start_wifi_focuser()) {
		stop_wifi_focuser();
		return 1;
	}
	const indigo_test_case tests[] = {
		{ "auto_port_ignores_wifi", auto_port_ignores_wifi },
		{ "empty_auto_port_resolved_at_connect", empty_auto_port_resolved_at_connect },
		{ "askar_port_selects_wifi", askar_port_selects_wifi },
		{ "closed_connection_disconnects", closed_connection_disconnects }
	};
	int result = indigo_run_tests("Askar-WAF Wi-Fi port selection", tests, ARRAY_SIZE(tests));
	stop_wifi_focuser();
	return result;
}
