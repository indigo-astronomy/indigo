// Copyright (c) 2026 INDIGO initiative
// All rights reserved.
//
// You may use this software under the terms of 'INDIGO Astronomy
// open-source license' (see LICENSE.md).
//
// THIS SOFTWARE IS PROVIDED BY THE AUTHORS 'AS IS' AND ANY EXPRESS
// OR IMPLIED WARRANTIES, INCLUDING, BUT NOT LIMITED TO, THE IMPLIED
// WARRANTIES OF MERCHANTABILITY AND FITNESS FOR A PARTICULAR PURPOSE
// ARE DISCLAIMED. IN NO EVENT SHALL THE AUTHOR BE LIABLE FOR ANY
// DIRECT, INDIRECT, INCIDENTAL, SPECIAL, EXEMPLARY, OR CONSEQUENTIAL
// DAMAGES (INCLUDING, BUT NOT LIMITED TO, PROCUREMENT OF SUBSTITUTE
// GOODS OR SERVICES; LOSS OF USE, DATA, OR PROFITS; OR BUSINESS
// INTERRUPTION) HOWEVER CAUSED AND ON ANY THEORY OF LIABILITY,
// WHETHER IN CONTRACT, STRICT LIABILITY, OR TORT (INCLUDING
// NEGLIGENCE OR OTHERWISE) ARISING IN ANY WAY OUT OF THE USE OF THIS
// SOFTWARE, EVEN IF ADVISED OF THE POSSIBILITY OF SUCH DAMAGE.

// Code is generated by AI

// Auto-selection never picks a serial port another device has open or is opening. The binary carries its own copy of
// indigo_driver.c, built with indigo_enumerate_usbserial_devices() replaced by fake_usbserial_devices(), which lists
// USB-serial adapters with matching or nonmatching VID/PID backed by temporary files. The devices are focusers of the test whose
// connection succeeds, fails, stays BUSY or ends without being reported to the base class, as each case needs; the
// port a device "opens" is its DEVICE_PORT at the connect request.

#include <pthread.h>
#include <signal.h>

#include <indigo/indigo_uni_io.h>
#include <indigo/indigo_usbserial_utils.h>
#include <indigo/indigo_focuser_driver.h>

#include "serial_simulator_test_common.h"

// exported by indigo_bus.c, not declared in a public header
extern void indigo_lock_bus(void);
extern void indigo_unlock_bus(void);

#define FAKE_PORT_COUNT	3
// longer than SERIAL_PORT_CLAIM_GRACE in indigo_driver.c
#define CLAIM_EXPIRY_WAIT	6000000

static pthread_mutex_t fake_mutex = PTHREAD_MUTEX_INITIALIZER;
static char fake_ports[FAKE_PORT_COUNT][PATH_MAX];
static char fake_auto_ports[FAKE_PORT_COUNT][INDIGO_VALUE_SIZE];
static int fake_port_count = 0;
static unsigned int fake_matching_ports = (1U << FAKE_PORT_COUNT) - 1;

int fake_usbserial_devices(indigo_serial_info *serial_info, int num_serial_info) {
	pthread_mutex_lock(&fake_mutex);
	int count = fake_port_count < num_serial_info ? fake_port_count : num_serial_info;
	for (int i = 0; i < count; i++) {
		memset(serial_info + i, 0, sizeof(indigo_serial_info));
		serial_info[i].vendor_id = 0x0403;
		bool matching = (fake_matching_ports & (1U << i)) != 0;
		serial_info[i].product_id = matching ? 0x6001 : 0x6002;
		snprintf(serial_info[i].product_string, sizeof(serial_info[i].product_string), "Fake USB-serial %s", matching ? "matching" : "nonmatching");
		snprintf(serial_info[i].path, sizeof(serial_info[i].path), "%.*s", PATH_MAX - 1, fake_ports[i]);
	}
	pthread_mutex_unlock(&fake_mutex);
	return count;
}

// ---- the focusers of the test

typedef enum {
	CONNECT_OK,
	CONNECT_FAIL,
	CONNECT_HOLD,
	CONNECT_UNREPORTED
} connect_mode;

typedef struct {
	connect_mode mode;
	char opened[INDIGO_VALUE_SIZE];
} claim_device_data;

static indigo_device_match_pattern claim_patterns[] = {
	{ 0x0403, 0x6001, "", "", "", false }
};

static indigo_result claim_attach(indigo_device *device) {
	if (indigo_focuser_attach(device, "indigo_focuser_claim", 0x03000001) != INDIGO_OK) {
		return INDIGO_FAILED;
	}
	DEVICE_PORT_PROPERTY->hidden = false;
	DEVICE_PORTS_PROPERTY->hidden = false;
	indigo_enumerate_serial_ports(device, DEVICE_PORTS_PROPERTY);
	return INDIGO_OK;
}

// CONNECT_HOLD leaves the connection BUSY until finish_connection(), CONNECT_UNREPORTED ends it ALERT without passing
// it to the base class, like a driver that publishes the failure itself.
static indigo_result claim_change_property(indigo_device *device, indigo_client *client, indigo_property *property) {
	if (indigo_property_match_changeable(CONNECTION_PROPERTY, property)) {
		if (indigo_ignore_connection_change(device, property)) {
			return INDIGO_OK;
		}
		claim_device_data *data = (claim_device_data *)device->private_data;
		indigo_property_copy_values(CONNECTION_PROPERTY, property, false);
		CONNECTION_PROPERTY->state = INDIGO_OK_STATE;
		if (CONNECTION_CONNECTED_ITEM->sw.value) {
			INDIGO_COPY_VALUE(data->opened, DEVICE_PORT_ITEM->text.value);
			if (data->mode == CONNECT_HOLD) {
				CONNECTION_PROPERTY->state = INDIGO_BUSY_STATE;
				indigo_update_property(device, CONNECTION_PROPERTY, NULL);
				return INDIGO_OK;
			}
			if (data->mode == CONNECT_UNREPORTED) {
				indigo_set_switch(CONNECTION_PROPERTY, CONNECTION_DISCONNECTED_ITEM, true);
				CONNECTION_PROPERTY->state = INDIGO_ALERT_STATE;
				indigo_update_property(device, CONNECTION_PROPERTY, NULL);
				return INDIGO_OK;
			}
			if (data->mode == CONNECT_FAIL) {
				indigo_set_switch(CONNECTION_PROPERTY, CONNECTION_DISCONNECTED_ITEM, true);
				CONNECTION_PROPERTY->state = INDIGO_ALERT_STATE;
			}
		}
		return indigo_focuser_change_property(device, NULL, CONNECTION_PROPERTY);
	}
	return indigo_focuser_change_property(device, client, property);
}

static indigo_result claim_detach(indigo_device *device) {
	return indigo_focuser_detach(device);
}

static claim_device_data data_a, data_b;
static indigo_device device_a = INDIGO_DEVICE_INITIALIZER("Port Claim A", claim_attach, indigo_focuser_enumerate_properties, claim_change_property, NULL, claim_detach);
static indigo_device device_b = INDIGO_DEVICE_INITIALIZER("Port Claim B", claim_attach, indigo_focuser_enumerate_properties, claim_change_property, NULL, claim_detach);

// ---- helpers

static bool attach_devices(connect_mode mode_a, connect_mode mode_b, bool b_shares_master_of_a) {
	memset(&data_a, 0, sizeof(data_a));
	memset(&data_b, 0, sizeof(data_b));
	data_a.mode = mode_a;
	data_b.mode = mode_b;
	device_a.private_data = &data_a;
	device_b.private_data = &data_b;
	device_a.master_device = NULL;
	device_b.master_device = b_shares_master_of_a ? &device_a : NULL;
	INDIGO_REGISER_MATCH_PATTERNS(device_a, claim_patterns, 1);
	INDIGO_REGISER_MATCH_PATTERNS(device_b, claim_patterns, 1);
	if (indigo_attach_device(&device_a) != INDIGO_OK || indigo_attach_device(&device_b) != INDIGO_OK) {
		return false;
	}
	// a change request is only taken by a property the device has defined
	indigo_enumerate_properties(&simulator_test_client, &INDIGO_ALL_PROPERTIES);
	return true;
}

static void port_of(indigo_device *device, char *port) {
	indigo_lock_bus();
	INDIGO_COPY_VALUE(port, DEVICE_PORT_ITEM->text.value);
	indigo_unlock_bus();
}

static bool port_is(indigo_device *device, const char *expected) {
	char port[INDIGO_VALUE_SIZE];
	port_of(device, port);
	if (strcmp(port, expected)) {
		fprintf(stderr, "    '%s' port is %s, expected %s\n", device->name, port, expected);
		return false;
	}
	return true;
}

static bool opened_is(claim_device_data *data, const char *expected) {
	if (strcmp(data->opened, expected)) {
		fprintf(stderr, "    opened %s, expected %s\n", data->opened, expected);
		return false;
	}
	return true;
}

static indigo_property_state connection_state(indigo_device *device) {
	return CONNECTION_PROPERTY->state;
}

static bool is_connected(indigo_device *device) {
	return CONNECTION_CONNECTED_ITEM->sw.value;
}

static bool set_port(indigo_device *device, const char *port) {
	return indigo_change_text_property_1_raw(&simulator_test_client, device->name, DEVICE_PORT_PROPERTY_NAME, DEVICE_PORT_ITEM_NAME, port) == INDIGO_OK;
}

static bool request_connection(indigo_device *device, bool connect) {
	return indigo_change_switch_property_1(&simulator_test_client, device->name, CONNECTION_PROPERTY_NAME, connect ? CONNECTION_CONNECTED_ITEM_NAME : CONNECTION_DISCONNECTED_ITEM_NAME, true) == INDIGO_OK;
}

// Ends a connection left BUSY by CONNECT_HOLD the way a driver's connection handler does.
static void finish_connection(indigo_device *device, bool ok) {
	indigo_lock_bus();
	if (ok) {
		CONNECTION_PROPERTY->state = INDIGO_OK_STATE;
	} else {
		indigo_set_switch(CONNECTION_PROPERTY, CONNECTION_DISCONNECTED_ITEM, true);
		CONNECTION_PROPERTY->state = INDIGO_ALERT_STATE;
	}
	indigo_focuser_change_property(device, NULL, CONNECTION_PROPERTY);
	indigo_unlock_bus();
}

static void detach_device(indigo_device *device) {
	if (device->device_context == NULL) {
		return;
	}
	if (connection_state(device) == INDIGO_BUSY_STATE) {
		finish_connection(device, true);
	}
	if (is_connected(device)) {
		request_connection(device, false);
	}
	indigo_detach_device(device);
}

static void detach_devices(void) {
	detach_device(&device_b);
	detach_device(&device_a);
}

// Lists the first count fake ports and rescans, the way a USB hot-plug event does.
static bool plug_ports(int count) {
	pthread_mutex_lock(&fake_mutex);
	fake_port_count = count;
	pthread_mutex_unlock(&fake_mutex);
	if (device_a.device_context == NULL) {
		return true;
	}
	return indigo_change_switch_property_1(&simulator_test_client, device_a.name, DEVICE_PORTS_PROPERTY_NAME, DEVICE_PORTS_REFRESH_ITEM_NAME, true) == INDIGO_OK;
}

// ---- cases

// Both devices start on the first matching port. Once one connects, the other one moves to the next matching port
// without any request, and connects there.
static void connect_moves_other_device(void) {
	SERIAL_CHECK_TRUE(attach_devices(CONNECT_OK, CONNECT_OK, false));
	SERIAL_CHECK_TRUE(port_is(&device_a, fake_auto_ports[0]));
	SERIAL_CHECK_TRUE(port_is(&device_b, fake_auto_ports[0]));
	SERIAL_CHECK_TRUE(request_connection(&device_a, true));
	SERIAL_CHECK_TRUE(is_connected(&device_a) && connection_state(&device_a) == INDIGO_OK_STATE);
	SERIAL_CHECK_TRUE(opened_is(&data_a, fake_auto_ports[0]));
	SERIAL_CHECK_TRUE(port_is(&device_b, fake_auto_ports[1]));
	SERIAL_CHECK_TRUE(request_connection(&device_b, true));
	SERIAL_CHECK_TRUE(opened_is(&data_b, fake_auto_ports[1]));
	// a freed port does not move the other device back
	SERIAL_CHECK_TRUE(request_connection(&device_a, false));
	SERIAL_CHECK_TRUE(port_is(&device_b, fake_auto_ports[1]));
cleanup:
	detach_devices();
}

// A device switched by hand to a port another device is connecting on is moved to a free port at its own connect,
// also after the grace period: a BUSY connection keeps its claim however long it takes.
static void busy_connection_keeps_claim(void) {
	SERIAL_CHECK_TRUE(attach_devices(CONNECT_HOLD, CONNECT_OK, false));
	SERIAL_CHECK_TRUE(request_connection(&device_a, true));
	SERIAL_CHECK_TRUE(connection_state(&device_a) == INDIGO_BUSY_STATE);
	SERIAL_CHECK_TRUE(opened_is(&data_a, fake_auto_ports[0]));
	SERIAL_CHECK_TRUE(port_is(&device_b, fake_auto_ports[1]));
	indigo_usleep(CLAIM_EXPIRY_WAIT);
	SERIAL_CHECK_TRUE(set_port(&device_b, fake_auto_ports[0]));
	SERIAL_CHECK_TRUE(request_connection(&device_b, true));
	SERIAL_CHECK_TRUE(opened_is(&data_b, fake_auto_ports[1]));
	SERIAL_CHECK_TRUE(port_is(&device_b, fake_auto_ports[1]));
	finish_connection(&device_a, true);
	SERIAL_CHECK_TRUE(is_connected(&device_a) && connection_state(&device_a) == INDIGO_OK_STATE);
cleanup:
	detach_devices();
}

static pthread_mutex_t connect_mutex = PTHREAD_MUTEX_INITIALIZER;
static pthread_cond_t connect_condition = PTHREAD_COND_INITIALIZER;
static int connect_ready;

static void *connect_thread(void *device) {
	pthread_mutex_lock(&connect_mutex);
	connect_ready++;
	pthread_cond_broadcast(&connect_condition);
	while (connect_ready < 2) {
		pthread_cond_wait(&connect_condition, &connect_mutex);
	}
	pthread_mutex_unlock(&connect_mutex);
	request_connection((indigo_device *)device, true);
	return NULL;
}

// Two devices on the same port connected at the same moment, both still BUSY when the other asks: each gets its own port.
static void simultaneous_connects_get_different_ports(void) {
	pthread_t thread_a, thread_b;
	SERIAL_CHECK_TRUE(attach_devices(CONNECT_HOLD, CONNECT_HOLD, false));
	SERIAL_CHECK_TRUE(port_is(&device_a, fake_auto_ports[0]));
	SERIAL_CHECK_TRUE(port_is(&device_b, fake_auto_ports[0]));
	connect_ready = 0;
	pthread_create(&thread_a, NULL, connect_thread, &device_a);
	pthread_create(&thread_b, NULL, connect_thread, &device_b);
	pthread_join(thread_a, NULL);
	pthread_join(thread_b, NULL);
	printf("    A opened %s, B opened %s\n", data_a.opened, data_b.opened);
	SERIAL_CHECK_TRUE(connection_state(&device_a) == INDIGO_BUSY_STATE && connection_state(&device_b) == INDIGO_BUSY_STATE);
	SERIAL_CHECK_TRUE(data_a.opened[0] && data_b.opened[0] && strcmp(data_a.opened, data_b.opened));
	SERIAL_CHECK_TRUE(!strcmp(data_a.opened, fake_auto_ports[0]) || !strcmp(data_b.opened, fake_auto_ports[0]));
	SERIAL_CHECK_TRUE(!strcmp(data_a.opened, fake_auto_ports[1]) || !strcmp(data_b.opened, fake_auto_ports[1]));
	finish_connection(&device_a, true);
	finish_connection(&device_b, true);
cleanup:
	detach_devices();
}

// A connection that fails releases its claim at once, so another device can select the port.
static void failed_connection_releases_claim(void) {
	SERIAL_CHECK_TRUE(attach_devices(CONNECT_FAIL, CONNECT_OK, false));
	SERIAL_CHECK_TRUE(request_connection(&device_a, true));
	SERIAL_CHECK_TRUE(!is_connected(&device_a) && connection_state(&device_a) == INDIGO_ALERT_STATE);
	SERIAL_CHECK_TRUE(opened_is(&data_a, fake_auto_ports[0]));
	SERIAL_CHECK_TRUE(set_port(&device_b, fake_auto_ports[0]));
	SERIAL_CHECK_TRUE(request_connection(&device_b, true));
	SERIAL_CHECK_TRUE(opened_is(&data_b, fake_auto_ports[0]));
cleanup:
	detach_devices();
}

// A driver that ends a failed connection without passing it to the base class leaves its claim behind. The claim
// still protects the port right after the request and expires after the grace period.
static void unreported_claim_expires(void) {
	SERIAL_CHECK_TRUE(attach_devices(CONNECT_UNREPORTED, CONNECT_OK, false));
	SERIAL_CHECK_TRUE(request_connection(&device_a, true));
	SERIAL_CHECK_TRUE(!is_connected(&device_a) && connection_state(&device_a) == INDIGO_ALERT_STATE);
	SERIAL_CHECK_TRUE(set_port(&device_b, fake_auto_ports[0]));
	SERIAL_CHECK_TRUE(request_connection(&device_b, true));
	SERIAL_CHECK_TRUE(opened_is(&data_b, fake_auto_ports[1]));
	SERIAL_CHECK_TRUE(request_connection(&device_b, false));
	indigo_usleep(CLAIM_EXPIRY_WAIT);
	SERIAL_CHECK_TRUE(set_port(&device_b, fake_auto_ports[0]));
	SERIAL_CHECK_TRUE(request_connection(&device_b, true));
	SERIAL_CHECK_TRUE(opened_is(&data_b, fake_auto_ports[0]));
cleanup:
	detach_devices();
}

// A port set without auto:// is claimed, so auto-selection moves away from it, but it is never changed itself, and
// only a connecting device blocks a port: an explicit port of a disconnected device does not.
static void explicit_port_is_claimed_but_kept(void) {
	SERIAL_CHECK_TRUE(attach_devices(CONNECT_OK, CONNECT_OK, false));
	SERIAL_CHECK_TRUE(set_port(&device_b, fake_ports[0]));
	SERIAL_CHECK_TRUE(port_is(&device_a, fake_auto_ports[0]));
	SERIAL_CHECK_TRUE(request_connection(&device_b, true));
	SERIAL_CHECK_TRUE(opened_is(&data_b, fake_ports[0]));
	SERIAL_CHECK_TRUE(port_is(&device_a, fake_auto_ports[1]));
	SERIAL_CHECK_TRUE(request_connection(&device_b, false));
	SERIAL_CHECK_TRUE(set_port(&device_a, fake_auto_ports[0]));
	SERIAL_CHECK_TRUE(request_connection(&device_a, true));
	SERIAL_CHECK_TRUE(opened_is(&data_a, fake_auto_ports[0]));
	SERIAL_CHECK_TRUE(port_is(&device_b, fake_ports[0]));
cleanup:
	detach_devices();
}

static bool set_matching_ports(unsigned int mask) {
	pthread_mutex_lock(&fake_mutex);
	fake_matching_ports = mask;
	pthread_mutex_unlock(&fake_mutex);
	return plug_ports(FAKE_PORT_COUNT);
}

static void claimed_match_uses_free_nonmatching_port(connect_mode mode) {
	SERIAL_CHECK_TRUE(attach_devices(mode, CONNECT_OK, false));
	SERIAL_CHECK_TRUE(set_matching_ports(1U << 2));
	SERIAL_CHECK_TRUE(port_is(&device_a, fake_auto_ports[2]));
	SERIAL_CHECK_TRUE(port_is(&device_b, fake_auto_ports[2]));
	SERIAL_CHECK_TRUE(request_connection(&device_a, true));
	SERIAL_CHECK_TRUE(opened_is(&data_a, fake_auto_ports[2]));
	SERIAL_CHECK_TRUE(port_is(&device_b, fake_auto_ports[0]));
	SERIAL_CHECK_TRUE(set_port(&device_b, fake_auto_ports[2]));
	SERIAL_CHECK_TRUE(request_connection(&device_b, true));
	SERIAL_CHECK_TRUE(opened_is(&data_b, fake_auto_ports[0]));
	SERIAL_CHECK_TRUE(device_b.matched_pattern_index == -1);
	SERIAL_CHECK_TRUE(request_connection(&device_b, false));
	SERIAL_CHECK_TRUE(set_port(&device_b, fake_auto_ports[1]));
	SERIAL_CHECK_TRUE(indigo_change_switch_property_1(&simulator_test_client, device_b.name, DEVICE_PORTS_PROPERTY_NAME, DEVICE_PORTS_REFRESH_ITEM_NAME, true) == INDIGO_OK);
	SERIAL_CHECK_TRUE(port_is(&device_b, fake_auto_ports[1]));
	SERIAL_CHECK_TRUE(request_connection(&device_b, true));
	SERIAL_CHECK_TRUE(opened_is(&data_b, fake_auto_ports[1]));
	SERIAL_CHECK_TRUE(port_is(&device_a, fake_auto_ports[2]));
cleanup:
	detach_devices();
	set_matching_ports((1U << FAKE_PORT_COUNT) - 1);
}

static void connected_match_uses_free_nonmatching_port(void) {
	claimed_match_uses_free_nonmatching_port(CONNECT_OK);
}

static void busy_match_uses_free_nonmatching_port(void) {
	claimed_match_uses_free_nonmatching_port(CONNECT_HOLD);
}

static void free_matches_precede_nonmatching_ports(void) {
	SERIAL_CHECK_TRUE(attach_devices(CONNECT_OK, CONNECT_OK, false));
	SERIAL_CHECK_TRUE(set_port(&device_a, fake_auto_ports[0]));
	SERIAL_CHECK_TRUE(set_port(&device_b, fake_auto_ports[0]));
	SERIAL_CHECK_TRUE(set_matching_ports((1U << 1) | (1U << 2)));
	SERIAL_CHECK_TRUE(port_is(&device_a, fake_auto_ports[1]));
	SERIAL_CHECK_TRUE(request_connection(&device_a, true));
	SERIAL_CHECK_TRUE(port_is(&device_b, fake_auto_ports[2]));
	SERIAL_CHECK_TRUE(request_connection(&device_b, true));
	SERIAL_CHECK_TRUE(opened_is(&data_b, fake_auto_ports[2]));
cleanup:
	detach_devices();
	set_matching_ports((1U << FAKE_PORT_COUNT) - 1);
}

static void no_matches_use_free_ports(void) {
	SERIAL_CHECK_TRUE(attach_devices(CONNECT_OK, CONNECT_OK, false));
	SERIAL_CHECK_TRUE(set_matching_ports(0));
	SERIAL_CHECK_TRUE(set_port(&device_a, USBSERIAL_AUTO_PREFIX));
	SERIAL_CHECK_TRUE(set_port(&device_b, fake_auto_ports[0]));
	SERIAL_CHECK_TRUE(request_connection(&device_a, true));
	SERIAL_CHECK_TRUE(opened_is(&data_a, fake_auto_ports[0]));
	SERIAL_CHECK_TRUE(port_is(&device_b, fake_auto_ports[1]));
	SERIAL_CHECK_TRUE(request_connection(&device_b, true));
	SERIAL_CHECK_TRUE(opened_is(&data_b, fake_auto_ports[1]));
cleanup:
	detach_devices();
	set_matching_ports((1U << FAKE_PORT_COUNT) - 1);
}

// With every port in use the selection is the same as before: the device keeps the taken port, and the
// driver's open is what fails.
static void taken_ports_fall_back(void) {
	SERIAL_CHECK_TRUE(attach_devices(CONNECT_OK, CONNECT_OK, false));
	SERIAL_CHECK_TRUE(plug_ports(1));
	SERIAL_CHECK_TRUE(request_connection(&device_a, true));
	SERIAL_CHECK_TRUE(opened_is(&data_a, fake_auto_ports[0]));
	SERIAL_CHECK_TRUE(port_is(&device_b, fake_auto_ports[0]));
	SERIAL_CHECK_TRUE(request_connection(&device_b, true));
	SERIAL_CHECK_TRUE(opened_is(&data_b, fake_auto_ports[0]));
cleanup:
	plug_ports(FAKE_PORT_COUNT);
	detach_devices();
}

// Devices sharing a port through their master device never block each other.
static void master_device_shares_port(void) {
	SERIAL_CHECK_TRUE(attach_devices(CONNECT_OK, CONNECT_OK, true));
	SERIAL_CHECK_TRUE(request_connection(&device_a, true));
	SERIAL_CHECK_TRUE(opened_is(&data_a, fake_auto_ports[0]));
	SERIAL_CHECK_TRUE(port_is(&device_b, fake_auto_ports[0]));
	SERIAL_CHECK_TRUE(request_connection(&device_b, true));
	SERIAL_CHECK_TRUE(opened_is(&data_b, fake_auto_ports[0]));
cleanup:
	detach_devices();
}

static bool create_fake_ports(void) {
	for (int i = 0; i < FAKE_PORT_COUNT; i++) {
		char path[PATH_MAX] = "/tmp/indigo-serial-port-claim.XXXXXX";
		int fd = mkstemp(path);
		if (fd < 0) {
			return false;
		}
		close(fd);
		if (realpath(path, fake_ports[i]) == NULL) {
			snprintf(fake_ports[i], sizeof(fake_ports[i]), "%s", path);
		}
		snprintf(fake_auto_ports[i], sizeof(fake_auto_ports[i]), "%s%.*s", USBSERIAL_AUTO_PREFIX, INDIGO_VALUE_SIZE - 16, fake_ports[i]);
	}
	fake_port_count = FAKE_PORT_COUNT;
	return true;
}

static void remove_fake_ports(void) {
	for (int i = 0; i < FAKE_PORT_COUNT; i++) {
		if (fake_ports[i][0]) {
			unlink(fake_ports[i]);
		}
	}
}

int main(void) {
	setvbuf(stdout, NULL, _IOLBF, 0);
	alarm(120);
	if (!create_fake_ports() || indigo_start() != INDIGO_OK || indigo_attach_client(&simulator_test_client) != INDIGO_OK) {
		fprintf(stderr, "serial port claim tests: setup failed\n");
		remove_fake_ports();
		return 1;
	}
	const indigo_test_case tests[] = {
		{ "connect_moves_other_device", connect_moves_other_device },
		{ "busy_connection_keeps_claim", busy_connection_keeps_claim },
		{ "simultaneous_connects_get_different_ports", simultaneous_connects_get_different_ports },
		{ "failed_connection_releases_claim", failed_connection_releases_claim },
		{ "unreported_claim_expires", unreported_claim_expires },
		{ "explicit_port_is_claimed_but_kept", explicit_port_is_claimed_but_kept },
		{ "connected_match_uses_free_nonmatching_port", connected_match_uses_free_nonmatching_port },
		{ "busy_match_uses_free_nonmatching_port", busy_match_uses_free_nonmatching_port },
		{ "free_matches_precede_nonmatching_ports", free_matches_precede_nonmatching_ports },
		{ "no_matches_use_free_ports", no_matches_use_free_ports },
		{ "taken_ports_fall_back", taken_ports_fall_back },
		{ "master_device_shares_port", master_device_shares_port }
	};
	int result = indigo_run_tests("Serial port auto-selection skips claimed ports", tests, ARRAY_SIZE(tests));
	indigo_detach_client(&simulator_test_client);
	indigo_stop();
	remove_fake_ports();
	return result;
}
