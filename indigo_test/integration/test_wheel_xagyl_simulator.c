// Copyright (c) 2026 INDIGO initiative
// All rights reserved.
//
// You may use this software under the terms of 'INDIGO Astronomy
// open-source license' (see LICENSE.md).
//
// THIS SOFTWARE IS PROVIDED BY THE AUTHORS 'AS IS' AND ANY EXPRESS
// OR IMPLIED WARRANTIES, INCLUDING, BUT NOT LIMITED TO, THE IMPLIED
// WARRANTIES OF MERCHANTABILITY AND FITNESS FOR A PARTICULAR PURPOSE
// ARE DISCLAIMED. IN NO EVENT SHALL THE AUTHOR BE LIABLE FOR ANY
// DIRECT, INDIRECT, INCIDENTAL, SPECIAL, EXEMPLARY, OR CONSEQUENTIAL
// DAMAGES (INCLUDING, BUT NOT LIMITED TO, PROCUREMENT OF SUBSTITUTE
// GOODS OR SERVICES; LOSS OF USE, DATA, OR PROFITS; OR BUSINESS
// INTERRUPTION) HOWEVER CAUSED AND ON ANY THEORY OF LIABILITY,
// WHETHER IN CONTRACT, STRICT LIABILITY, OR TORT (INCLUDING
// NEGLIGENCE OR OTHERWISE) ARISING IN ANY WAY OUT OF THE USE OF THIS
// SOFTWARE, EVEN IF ADVISED OF THE POSSIBILITY OF SUCH DAMAGE.

// Code is generated by AI

// Wheel class coverage for indigo_wheel_xagyl against the standalone Xagyl simulator over a real
// PTY. The simulator advances one filter position per protocol exchange, so a move spans several
// of the driver's 0.5 s poll cycles and the BUSY -> OK sequence is observable.

#include <indigo_drivers/wheel_xagyl/indigo_wheel_xagyl.h>

#include "serial_simulator_test_common.h"

#ifndef WHEEL_XAGYL_SIMULATOR_EXECUTABLE
#define WHEEL_XAGYL_SIMULATOR_EXECUTABLE "build/integration/wheel_xagyl_simulator"
#endif

static const simulator_driver_case xagyl_wheel = {
	"Xagyl Filter Wheel",
	"indigo_wheel_xagyl",
	"Xagyl Filter Wheel",
	indigo_wheel_xagyl,
	false,
	NULL, 0, NULL, 0, NULL, 0, NULL, 0
};

static const char *const slot_name_items[] = {
	WHEEL_SLOT_NAME_1_ITEM_NAME, WHEEL_SLOT_NAME_2_ITEM_NAME, WHEEL_SLOT_NAME_3_ITEM_NAME,
	WHEEL_SLOT_NAME_4_ITEM_NAME, WHEEL_SLOT_NAME_5_ITEM_NAME, WHEEL_SLOT_NAME_6_ITEM_NAME,
	WHEEL_SLOT_NAME_7_ITEM_NAME
};

static const char *const slot_offset_items[] = {
	WHEEL_SLOT_OFFSET_1_ITEM_NAME, WHEEL_SLOT_OFFSET_2_ITEM_NAME, WHEEL_SLOT_OFFSET_3_ITEM_NAME,
	WHEEL_SLOT_OFFSET_4_ITEM_NAME, WHEEL_SLOT_OFFSET_5_ITEM_NAME, WHEEL_SLOT_OFFSET_6_ITEM_NAME,
	WHEEL_SLOT_OFFSET_7_ITEM_NAME
};

static bool start_xagyl(external_serial_simulator *simulator, const char **arguments) {
	if (arguments == NULL) {
		return start_external_serial_simulator(simulator, WHEEL_XAGYL_SIMULATOR_EXECUTABLE);
	}
	return start_external_serial_simulator_with_args(simulator, WHEEL_XAGYL_SIMULATOR_EXECUTABLE, arguments);
}

static const char *info_text(const char *item_name) {
	indigo_item *item = find_cached_item(INFO_PROPERTY_NAME, item_name);
	return item == NULL ? "" : item->text.value;
}

// The driver reports every move through wheel_move_finalizer, so a completed selection has to end
// OK with the requested slot read back from the device rather than echoed from the request.
static bool select_slot(double slot) {
	if (indigo_change_number_property_1(&simulator_test_client, xagyl_wheel.device_name, WHEEL_SLOT_PROPERTY_NAME, WHEEL_SLOT_ITEM_NAME, slot) != INDIGO_OK) {
		return false;
	}
	return wait_for_property_state(WHEEL_SLOT_PROPERTY_NAME, INDIGO_OK_STATE) && wait_for_number_item_value(WHEEL_SLOT_PROPERTY_NAME, WHEEL_SLOT_ITEM_NAME, slot, 0.001);
}

static void assert_wheel_class_property_completeness(void) {
	static const char *properties[] = {
		WHEEL_SLOT_PROPERTY_NAME,
		WHEEL_SLOT_NAME_PROPERTY_NAME,
		WHEEL_SLOT_OFFSET_PROPERTY_NAME
	};
	assert_defined_properties(properties, ARRAY_SIZE(properties));
}

// -------------------------------------------------------------------------------- metadata

static void metadata_identity_and_property_completeness(void) {
	external_serial_simulator simulator = { 0 };
	bool online = false;
	const char *arguments[] = { "--model", "Xagyl FW5125VX", "--firmware", "FW 3.1.5", "--serial", "XY12345", NULL };
	SERIAL_CHECK_TRUE(start_xagyl(&simulator, arguments));
	SERIAL_CHECK_TRUE(start_serial_driver(&xagyl_wheel, simulator.port));
	online = true;
	SERIAL_CHECK_TRUE(context.connected && context.last_connection_state == INDIGO_OK_STATE);
	assert_device_interface(INDIGO_INTERFACE_WHEEL);
	assert_wheel_class_property_completeness();
	assert_property_has_item(WHEEL_SLOT_PROPERTY_NAME, WHEEL_SLOT_ITEM_NAME);
	assert_number_item_in_range(WHEEL_SLOT_PROPERTY_NAME, WHEEL_SLOT_ITEM_NAME);
	// I0/I1/I3 are read once during open and published through INFO.
	printf("INFO model='%s' firmware='%s' serial='%s'\n", info_text(INFO_DEVICE_MODEL_ITEM_NAME), info_text(INFO_DEVICE_FW_REVISION_ITEM_NAME), info_text(INFO_DEVICE_SERIAL_NUM_ITEM_NAME));
	SERIAL_CHECK_TRUE(!strcmp(info_text(INFO_DEVICE_MODEL_ITEM_NAME), "Xagyl FW5125VX"));
	SERIAL_CHECK_TRUE(!strcmp(info_text(INFO_DEVICE_FW_REVISION_ITEM_NAME), "FW 3.1.5"));
	SERIAL_CHECK_TRUE(!strcmp(info_text(INFO_DEVICE_SERIAL_NUM_ITEM_NAME), "S/N: XY12345"));
cleanup:
	if (online) { stop_serial_driver(&xagyl_wheel); }
	stop_external_serial_simulator(&simulator);
}

// The slot count comes from I8, so the published range and the name/offset item counts have to
// follow the device rather than a compiled-in default.
static void slot_count_and_range_come_from_the_device(void) {
	external_serial_simulator simulator = { 0 };
	bool online = false;
	const char *arguments[] = { "--slots", "7", NULL };
	SERIAL_CHECK_TRUE(start_xagyl(&simulator, arguments));
	SERIAL_CHECK_TRUE(start_serial_driver(&xagyl_wheel, simulator.port));
	online = true;
	assert_property_has_items(WHEEL_SLOT_NAME_PROPERTY_NAME, slot_name_items, 7);
	assert_property_has_items(WHEEL_SLOT_OFFSET_PROPERTY_NAME, slot_offset_items, 7);
	indigo_property *slot = find_cached_property(WHEEL_SLOT_PROPERTY_NAME);
	SERIAL_CHECK_TRUE(slot != NULL);
	printf("Slot range %g..%g for a 7 slot wheel\n", slot->items[0].number.min, slot->items[0].number.max);
	SERIAL_CHECK_TRUE(fabs(slot->items[0].number.min - 1) < .001);
	SERIAL_CHECK_TRUE(fabs(slot->items[0].number.max - 7) < .001);
cleanup:
	if (online) { stop_serial_driver(&xagyl_wheel); }
	stop_external_serial_simulator(&simulator);
}

static void single_slot_wheel_is_accepted(void) {
	external_serial_simulator simulator = { 0 };
	bool online = false;
	const char *arguments[] = { "--slots", "1", NULL };
	SERIAL_CHECK_TRUE(start_xagyl(&simulator, arguments));
	SERIAL_CHECK_TRUE(start_serial_driver(&xagyl_wheel, simulator.port));
	online = true;
	assert_property_has_items(WHEEL_SLOT_NAME_PROPERTY_NAME, slot_name_items, 1);
	indigo_property *slot = find_cached_property(WHEEL_SLOT_PROPERTY_NAME);
	SERIAL_CHECK_TRUE(slot != NULL && fabs(slot->items[0].number.max - 1) < .001);
	SERIAL_CHECK_TRUE(select_slot(1));
cleanup:
	if (online) { stop_serial_driver(&xagyl_wheel); }
	stop_external_serial_simulator(&simulator);
}

// -------------------------------------------------------------------------------- positioning

// First, one intermediate and last slot, in both directions: the simulator steps one position per
// exchange, so this also covers the multi-poll BUSY path in both rotation directions.
static void moves_through_first_intermediate_and_last_slots(void) {
	external_serial_simulator simulator = { 0 };
	bool online = false;
	const char *arguments[] = { "--slots", "7", NULL };
	SERIAL_CHECK_TRUE(start_xagyl(&simulator, arguments));
	SERIAL_CHECK_TRUE(start_serial_driver(&xagyl_wheel, simulator.port));
	online = true;
	SERIAL_CHECK_TRUE(wait_for_number_item_value(WHEEL_SLOT_PROPERTY_NAME, WHEEL_SLOT_ITEM_NAME, 1, 0.001));
	const double slots[] = { 4, 7, 1, 2 };
	for (int i = 0; i < ARRAY_SIZE(slots); i++) {
		SERIAL_CHECK_EQ_INT(INDIGO_OK, indigo_change_number_property_1(&simulator_test_client, xagyl_wheel.device_name, WHEEL_SLOT_PROPERTY_NAME, WHEEL_SLOT_ITEM_NAME, slots[i]));
		SERIAL_CHECK_TRUE(wait_for_property_state(WHEEL_SLOT_PROPERTY_NAME, INDIGO_BUSY_STATE));
		SERIAL_CHECK_TRUE(wait_for_property_state(WHEEL_SLOT_PROPERTY_NAME, INDIGO_OK_STATE));
		SERIAL_CHECK_TRUE(wait_for_number_item_value(WHEEL_SLOT_PROPERTY_NAME, WHEEL_SLOT_ITEM_NAME, slots[i], 0.001));
	}
cleanup:
	if (online) { stop_serial_driver(&xagyl_wheel); }
	stop_external_serial_simulator(&simulator);
}

// Requesting the slot the wheel already holds takes the driver's short-circuit branch, which must
// still complete the request instead of leaving it BUSY.
static void reselecting_the_current_slot_completes(void) {
	external_serial_simulator simulator = { 0 };
	bool online = false;
	SERIAL_CHECK_TRUE(start_xagyl(&simulator, NULL));
	SERIAL_CHECK_TRUE(start_serial_driver(&xagyl_wheel, simulator.port));
	online = true;
	SERIAL_CHECK_TRUE(select_slot(3));
	SERIAL_CHECK_TRUE(select_slot(3));
	SERIAL_CHECK_TRUE(select_slot(3));
cleanup:
	if (online) { stop_serial_driver(&xagyl_wheel); }
	stop_external_serial_simulator(&simulator);
}

// -------------------------------------------------------------------------------- lifecycle

// Reconnecting re-reads identity and slot count, so the selection made before the disconnect must
// not be assumed and the wheel has to be operable again afterwards.
static void reconnect_rebuilds_the_slot_table(void) {
	external_serial_simulator simulator = { 0 };
	bool online = false;
	const char *arguments[] = { "--slots", "5", NULL };
	SERIAL_CHECK_TRUE(start_xagyl(&simulator, arguments));
	SERIAL_CHECK_TRUE(start_serial_driver(&xagyl_wheel, simulator.port));
	online = true;
	SERIAL_CHECK_TRUE(select_slot(4));
	disconnect_serial_device(&xagyl_wheel);
	SERIAL_CHECK_TRUE(!context.connected);
	SERIAL_CHECK_TRUE(connect_serial_device(&xagyl_wheel, simulator.port));
	assert_property_has_items(WHEEL_SLOT_NAME_PROPERTY_NAME, slot_name_items, 5);
	// The wheel kept its physical position across the reconnect and the driver has to report it.
	SERIAL_CHECK_TRUE(wait_for_number_item_value(WHEEL_SLOT_PROPERTY_NAME, WHEEL_SLOT_ITEM_NAME, 4, 0.001));
	SERIAL_CHECK_TRUE(select_slot(2));
cleanup:
	if (online) { stop_serial_driver(&xagyl_wheel); }
	stop_external_serial_simulator(&simulator);
}

// Disconnecting twice has to be tolerated and shutdown has to succeed with nothing connected.
static void repeated_disconnect_is_tolerated(void) {
	external_serial_simulator simulator = { 0 };
	bool online = false;
	SERIAL_CHECK_TRUE(start_xagyl(&simulator, NULL));
	SERIAL_CHECK_TRUE(start_serial_driver(&xagyl_wheel, simulator.port));
	online = true;
	disconnect_serial_device(&xagyl_wheel);
	SERIAL_CHECK_TRUE(!context.connected);
	disconnect_serial_device(&xagyl_wheel);
	SERIAL_CHECK_TRUE(!context.connected);
	online = false;
	tear_down_serial_driver(&xagyl_wheel);
cleanup:
	if (online) { stop_serial_driver(&xagyl_wheel); }
	stop_external_serial_simulator(&simulator);
}

// Opening a port that answers nothing must roll the connection back rather than report success.
static void silent_port_is_refused(void) {
	external_serial_simulator simulator = { 0 };
	SERIAL_CHECK_TRUE(start_xagyl(&simulator, NULL));
	SERIAL_CHECK_TRUE(bring_up_serial_driver(&xagyl_wheel));
	stop_external_serial_simulator(&simulator);
	SERIAL_CHECK_TRUE(!connect_serial_device(&xagyl_wheel, simulator.port));
	SERIAL_CHECK_TRUE(!context.connected);
cleanup:
	tear_down_serial_driver(&xagyl_wheel);
}

int main(void) {
	const indigo_test_case tests[] = {
		{ "metadata_identity_and_property_completeness", metadata_identity_and_property_completeness },
		{ "slot_count_and_range_come_from_the_device", slot_count_and_range_come_from_the_device },
		{ "single_slot_wheel_is_accepted", single_slot_wheel_is_accepted },
		{ "moves_through_first_intermediate_and_last_slots", moves_through_first_intermediate_and_last_slots },
		{ "reselecting_the_current_slot_completes", reselecting_the_current_slot_completes },
		{ "reconnect_rebuilds_the_slot_table", reconnect_rebuilds_the_slot_table },
		{ "repeated_disconnect_is_tolerated", repeated_disconnect_is_tolerated },
		{ "silent_port_is_refused", silent_port_is_refused }
	};
	return indigo_run_tests("Xagyl wheel serial simulator integration tests", tests, ARRAY_SIZE(tests));
}
