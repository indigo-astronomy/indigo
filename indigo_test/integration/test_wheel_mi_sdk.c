// Copyright (c) 2026 INDIGO initiative
// All rights reserved.
//
// You may use this software under the terms of 'INDIGO Astronomy
// open-source license' (see LICENSE.md).
//
// THIS SOFTWARE IS PROVIDED BY THE AUTHORS 'AS IS' AND ANY EXPRESS
// OR IMPLIED WARRANTIES, INCLUDING, BUT NOT LIMITED TO, THE IMPLIED
// WARRANTIES OF MERCHANTABILITY AND FITNESS FOR A PARTICULAR PURPOSE
// ARE DISCLAIMED. IN NO EVENT SHALL THE AUTHOR BE LIABLE FOR ANY
// DIRECT, INDIRECT, INCIDENTAL, SPECIAL, EXEMPLARY, OR CONSEQUENTIAL
// DAMAGES (INCLUDING, BUT NOT LIMITED TO, PROCUREMENT OF SUBSTITUTE
// GOODS OR SERVICES; LOSS OF USE, DATA, OR PROFITS; OR BUSINESS
// INTERRUPTION) HOWEVER CAUSED AND ON ANY THEORY OF LIABILITY,
// WHETHER IN CONTRACT, STRICT LIABILITY, OR TORT (INCLUDING
// NEGLIGENCE OR OTHERWISE) ARISING IN ANY WAY OUT OF THE USE OF THIS
// SOFTWARE, EVEN IF ADVISED OF THE POSSIBILITY OF SUCH DAMAGE.

// Code is generated by AI

#include <stdbool.h>
#include <stdatomic.h>
#include <pthread.h>
#include <stdio.h>
#include <stdlib.h>
#include <string.h>
#include <unistd.h>

#include <gxccd.h>
#include <indigo/indigo_usb_utils.h>
#include <indigo/indigo_wheel_driver.h>
#include <indigo_drivers/wheel_mi/indigo_wheel_mi.h>

#include "simulator_test_common.h"

#define MOCK_WHEELS 12
#define OBSERVED_PROPERTIES 32
#define COMMANDS_PROPERTY "X_MI_SFW_COMMANDS"
#define REINIT_ITEM_NAME "MI_SFW_REINIT"

typedef struct {
	atomic_bool visible;
	atomic_int slots;
	atomic_int current_index;
	atomic_int init_calls;
	atomic_int releases;
	atomic_int open_handles;
	atomic_int set_calls;
	atomic_int last_set_index;
	atomic_int reinit_calls;
	atomic_int reinit_filters;
	atomic_int fail_integer;
	atomic_int fail_string;
	atomic_int fail_set;
	atomic_int fail_reinit;
	char model[64];
	char serial[64];
} mock_wheel;

typedef struct {
	char name[INDIGO_NAME_SIZE];
	indigo_property *properties[OBSERVED_PROPERTIES];
	int updates[OBSERVED_PROPERTIES];
} observed_wheel;

struct fwheel {
	int index;
	unsigned magic;
};

static const unsigned HANDLE_MAGIC = 0x4d495746;
static mock_wheel wheels[MOCK_WHEELS];
static observed_wheel observed[MOCK_WHEELS];
static pthread_mutex_t observation_mutex = PTHREAD_MUTEX_INITIALIZER;
static libusb_hotplug_callback_fn usb_callback;
static int usb_devices[MOCK_WHEELS];
static atomic_int usb_ref_balance[MOCK_WHEELS];
static atomic_int usb_refs, invalid_usb_unref, attached, attach_attempts, fail_attach;
static atomic_int fail_next_init, sdk_after_close, invalid_release;
static atomic_int descriptor_error, registration_error, fail_queue_create, enumerate_reverse;
static atomic_int last_probe_index, late_updates;
static atomic_bool hold_set, release_set, hold_reinit, release_reinit;
static atomic_int set_entered, reinit_entered;

static int id_for_index(int index) {
	return 101 + index * 37;
}

static int index_for_id(int eid) {
	for (int i = 0; i < MOCK_WHEELS; i++) {
		if (eid == id_for_index(i)) {
			return i;
		}
	}
	return -1;
}

static int observed_index(const char *name) {
	for (int i = 0; i < MOCK_WHEELS; i++) {
		if (observed[i].name[0] && !strcmp(observed[i].name, name)) {
			return i;
		}
	}
	return -1;
}

static int property_index(int index, const char *name, bool create) {
	int empty = -1;
	for (int i = 0; i < OBSERVED_PROPERTIES; i++) {
		if (observed[index].properties[i] && !strcmp(observed[index].properties[i]->name, name)) {
			return i;
		}
		if (observed[index].properties[i] == NULL && empty < 0) {
			empty = i;
		}
	}
	return create ? empty : -1;
}

static indigo_result observe(indigo_client *client, indigo_device *device, indigo_property *property, const char *message) {
	int index = observed_index(property->device);
	if (index < 0) {
		return INDIGO_OK;
	}
	pthread_mutex_lock(&observation_mutex);
	int slot = property_index(index, property->name, true);
	if (slot >= 0) {
		indigo_release_property(observed[index].properties[slot]);
		observed[index].properties[slot] = indigo_copy_property(NULL, property);
		observed[index].updates[slot]++;
	}
	pthread_mutex_unlock(&observation_mutex);
	return INDIGO_OK;
}

static indigo_result observe_update(indigo_client *client, indigo_device *device, indigo_property *property, const char *message) {
	int index = observed_index(property->device);
	if (index >= 0 && (!strcmp(property->name, WHEEL_SLOT_PROPERTY_NAME) || !strcmp(property->name, COMMANDS_PROPERTY))) {
		pthread_mutex_lock(&observation_mutex);
		bool defined = property_index(index, property->name, false) >= 0;
		pthread_mutex_unlock(&observation_mutex);
		if (!defined) {
			atomic_fetch_add(&late_updates, 1);
		}
	}
	return observe(client, device, property, message);
}

static indigo_result observe_delete(indigo_client *client, indigo_device *device, indigo_property *property, const char *message) {
	int index = observed_index(property->device);
	if (index < 0) {
		return INDIGO_OK;
	}
	pthread_mutex_lock(&observation_mutex);
	for (int i = 0; i < OBSERVED_PROPERTIES; i++) {
		indigo_property *cached = observed[index].properties[i];
		if (cached && (!property->name[0] || !strcmp(cached->name, property->name))) {
			indigo_release_property(cached);
			observed[index].properties[i] = NULL;
		}
	}
	pthread_mutex_unlock(&observation_mutex);
	return INDIGO_OK;
}

static indigo_client test_client = {
	.name = "Moravian wheel SDK test",
	.version = INDIGO_VERSION_CURRENT,
	.define_property = observe,
	.update_property = observe_update,
	.delete_property = observe_delete
};

static indigo_property *snapshot(int index, const char *name) {
	pthread_mutex_lock(&observation_mutex);
	int slot = property_index(index, name, false);
	indigo_property *copy = slot < 0 ? NULL : indigo_copy_property(NULL, observed[index].properties[slot]);
	pthread_mutex_unlock(&observation_mutex);
	return copy;
}

static int property_state(int index, const char *name) {
	indigo_property *property = snapshot(index, name);
	int result = property ? property->state : -1;
	indigo_release_property(property);
	return result;
}

static double slot_value(int index) {
	indigo_property *property = snapshot(index, WHEEL_SLOT_PROPERTY_NAME);
	double value = property ? property->items[0].number.value : -1;
	indigo_release_property(property);
	return value;
}

static double slot_target(int index) {
	indigo_property *property = snapshot(index, WHEEL_SLOT_PROPERTY_NAME);
	double value = property ? property->items[0].number.target : -1;
	indigo_release_property(property);
	return value;
}

static bool wait_atomic(atomic_int *value, int expected) {
	for (int i = 0; i < 500; i++) {
		if (atomic_load(value) == expected) {
			return true;
		}
		indigo_usleep(10000);
	}
	fprintf(stderr, "counter expected %d, got %d\n", expected, atomic_load(value));
	return false;
}

static bool wait_state(int index, const char *name, int expected) {
	for (int i = 0; i < 500; i++) {
		if (property_state(index, name) == expected) {
			return true;
		}
		indigo_usleep(10000);
	}
	fprintf(stderr, "wheel %d property %s expected state %d, got %d\n", index, name, expected, property_state(index, name));
	return false;
}

static bool wait_slot_max(int index, int expected) {
	for (int i = 0; i < 500; i++) {
		indigo_property *property = snapshot(index, WHEEL_SLOT_PROPERTY_NAME);
		bool match = property && property->items[0].number.max == expected;
		indigo_release_property(property);
		if (match) {
			return true;
		}
		indigo_usleep(10000);
	}
	return false;
}

static bool set_switch(int index, const char *property, const char *item, bool value) {
	return indigo_change_switch_property_1(&test_client, observed[index].name, property, item, value) == INDIGO_OK;
}

static bool connect_wheel(int index, bool connect) {
	if (!set_switch(index, CONNECTION_PROPERTY_NAME, connect ? CONNECTION_CONNECTED_ITEM_NAME : CONNECTION_DISCONNECTED_ITEM_NAME, true) || !wait_state(index, CONNECTION_PROPERTY_NAME, INDIGO_OK_STATE)) {
		return false;
	}
	return (atomic_load(&wheels[index].open_handles) > 0) == connect;
}

static bool set_slot(int index, int slot) {
	return indigo_change_number_property_1(&test_client, observed[index].name, WHEEL_SLOT_PROPERTY_NAME, WHEEL_SLOT_ITEM_NAME, slot) == INDIGO_OK;
}

static bool reinitialize(int index, bool value) {
	return set_switch(index, COMMANDS_PROPERTY, REINIT_ITEM_NAME, value);
}

indigo_queue *miw_test_queue_create(indigo_device *device) {
	if (atomic_exchange(&fail_queue_create, 0)) {
		return NULL;
	}
	return indigo_queue_create(device);
}

indigo_result miw_test_attach(indigo_device *device) {
	atomic_fetch_add(&attach_attempts, 1);
	if (atomic_exchange(&fail_attach, 0)) {
		return INDIGO_FAILED;
	}
	int index = atomic_load(&last_probe_index);
	if (index < 0 || index >= MOCK_WHEELS) {
		return INDIGO_FAILED;
	}
	snprintf(observed[index].name, sizeof(observed[index].name), "%s", device->name);
	indigo_result result = indigo_attach_device(device);
	if (result == INDIGO_OK) {
		atomic_fetch_add(&attached, 1);
	}
	return result;
}

indigo_result miw_test_detach(indigo_device *device) {
	indigo_result result = indigo_detach_device(device);
	atomic_fetch_sub(&attached, 1);
	return result;
}

void miw_test_usb_start(void) {
}

int LIBUSB_CALL miw_test_usb_register(libusb_context *ctx, int events, int flags, int vid, int pid, int cls, libusb_hotplug_callback_fn callback, void *data, libusb_hotplug_callback_handle *handle) {
	if (atomic_load(&registration_error)) {
		return LIBUSB_ERROR_IO;
	}
	usb_callback = callback;
	callback(NULL, (libusb_device *)(usb_devices + 0), LIBUSB_HOTPLUG_EVENT_DEVICE_ARRIVED, NULL);
	return LIBUSB_SUCCESS;
}

int miw_test_usb_register_sim(libusb_context *ctx, libusb_hotplug_event events, libusb_hotplug_flag flags, int vid, int pid, int cls, libusb_hotplug_callback_fn callback, void *data, libusb_hotplug_callback_handle *handle) {
	return miw_test_usb_register(ctx, events, flags, vid, pid, cls, callback, data, handle);
}

void LIBUSB_CALL miw_test_usb_deregister(libusb_context *ctx, libusb_hotplug_callback_handle handle) {
}

int miw_test_usb_deregister_poll(libusb_context *ctx, libusb_hotplug_callback_handle handle) {
	return LIBUSB_SUCCESS;
}

libusb_device *LIBUSB_CALL miw_test_usb_ref(libusb_device *device) {
	int index = (int *)device - usb_devices;
	atomic_fetch_add(&usb_refs, 1);
	atomic_fetch_add(&usb_ref_balance[index], 1);
	return device;
}

void LIBUSB_CALL miw_test_usb_unref(libusb_device *device) {
	int index = (int *)device - usb_devices;
	atomic_fetch_sub(&usb_refs, 1);
	if (atomic_fetch_sub(&usb_ref_balance[index], 1) <= 0) {
		atomic_fetch_add(&invalid_usb_unref, 1);
	}
}

int LIBUSB_CALL miw_test_usb_descriptor(libusb_device *device, struct libusb_device_descriptor *descriptor) {
	memset(descriptor, 0, sizeof(*descriptor));
	descriptor->idVendor = 0x1347;
	descriptor->idProduct = 0x1000 + ((int *)device - usb_devices);
	return atomic_load(&descriptor_error) ? LIBUSB_ERROR_IO : LIBUSB_SUCCESS;
}

static void usb_event(int index, bool arrived) {
	usb_callback(NULL, (libusb_device *)(usb_devices + index), arrived ? LIBUSB_HOTPLUG_EVENT_DEVICE_ARRIVED : LIBUSB_HOTPLUG_EVENT_DEVICE_LEFT, NULL);
}

void gxfw_enumerate_usb(enum_callback_t callback) {
	for (int n = 0; n < MOCK_WHEELS; n++) {
		int index = atomic_load(&enumerate_reverse) ? MOCK_WHEELS - n - 1 : n;
		if (atomic_load(&wheels[index].visible)) {
			callback(id_for_index(index));
		}
	}
}

fwheel_t *gxfw_initialize_usb(int eid) {
	int index = index_for_id(eid);
	if (index < 0 || !atomic_load(&wheels[index].visible) || atomic_exchange(&fail_next_init, 0)) {
		return NULL;
	}
	struct fwheel *handle = malloc(sizeof(*handle));
	if (handle == NULL) {
		return NULL;
	}
	handle->index = index;
	handle->magic = HANDLE_MAGIC;
	atomic_fetch_add(&wheels[index].init_calls, 1);
	atomic_fetch_add(&wheels[index].open_handles, 1);
	return handle;
}

static int checked_index(fwheel_t *wheel) {
	struct fwheel *handle = wheel;
	if (handle == NULL || handle->magic != HANDLE_MAGIC || handle->index < 0 || handle->index >= MOCK_WHEELS) {
		atomic_fetch_add(&sdk_after_close, 1);
		return -1;
	}
	return handle->index;
}

void gxfw_release(fwheel_t *wheel) {
	struct fwheel *handle = wheel;
	int index = checked_index(wheel);
	if (index < 0) {
		atomic_fetch_add(&invalid_release, 1);
		return;
	}
	handle->magic = 0;
	atomic_fetch_sub(&wheels[index].open_handles, 1);
	atomic_fetch_add(&wheels[index].releases, 1);
	free(handle);
}

int gxfw_get_integer_parameter(fwheel_t *wheel, int parameter, int *value) {
	int index = checked_index(wheel);
	if (index < 0) {
		return -1;
	}
	if (atomic_load(&wheels[index].fail_integer) == parameter + 1) {
		return -1;
	}
	if (parameter >= FW_GIP_VERSION_1 && parameter <= FW_GIP_VERSION_4) {
		*value = parameter + 1;
		return 0;
	}
	if (parameter == FW_GIP_WHEEL_ID) {
		*value = id_for_index(index);
		return 0;
	}
	if (parameter == FW_GIP_FILTERS) {
		*value = atomic_load(&wheels[index].slots);
		return 0;
	}
	return -1;
}

int gxfw_get_string_parameter(fwheel_t *wheel, int parameter, char *value, size_t size) {
	int index = checked_index(wheel);
	if (index < 0) {
		return -1;
	}
	if (parameter == FW_GSP_DESCRIPTION) {
		atomic_store(&last_probe_index, index);
	}
	if (atomic_load(&wheels[index].fail_string) == parameter + 1) {
		return -1;
	}
	if (parameter == FW_GSP_DESCRIPTION) {
		snprintf(value, size, "%s", wheels[index].model);
		return 0;
	}
	if (parameter == FW_GSP_MANUFACTURER) {
		snprintf(value, size, "Moravian Instruments");
		return 0;
	}
	if (parameter == FW_GSP_SERIAL_NUMBER) {
		snprintf(value, size, "%s", wheels[index].serial);
		return 0;
	}
	return -1;
}

int gxfw_set_filter(fwheel_t *wheel, int filter) {
	int index = checked_index(wheel);
	if (index < 0) {
		return -1;
	}
	atomic_fetch_add(&wheels[index].set_calls, 1);
	atomic_store(&wheels[index].last_set_index, filter);
	if (atomic_load(&hold_set)) {
		atomic_store(&set_entered, 1);
		for (int i = 0; i < 500 && !atomic_load(&release_set); i++) {
			indigo_usleep(10000);
		}
	}
	if (atomic_load(&wheels[index].fail_set) || !atomic_load(&wheels[index].visible)) {
		return -1;
	}
	atomic_store(&wheels[index].current_index, filter);
	return 0;
}

int gxfw_reinit_filter_wheel(fwheel_t *wheel, int *filters) {
	int index = checked_index(wheel);
	if (index < 0) {
		return -1;
	}
	atomic_fetch_add(&wheels[index].reinit_calls, 1);
	if (atomic_load(&hold_reinit)) {
		atomic_store(&reinit_entered, 1);
		for (int i = 0; i < 500 && !atomic_load(&release_reinit); i++) {
			indigo_usleep(10000);
		}
	}
	if (atomic_load(&wheels[index].fail_reinit) || !atomic_load(&wheels[index].visible)) {
		return -1;
	}
	*filters = atomic_load(&wheels[index].reinit_filters);
	atomic_store(&wheels[index].slots, *filters);
	atomic_store(&wheels[index].current_index, 0);
	return 0;
}

void gxfw_get_last_error(fwheel_t *wheel, char *value, size_t size) {
	if (checked_index(wheel) >= 0) {
		snprintf(value, size, "injected gxfw failure");
	}
}

static void metadata_and_property_contract(void) {
	indigo_driver_info info;
	ASSERT_EQ_INT(INDIGO_OK, indigo_wheel_mi(INDIGO_DRIVER_INFO, &info));
	ASSERT_STREQ("indigo_wheel_mi", info.name);
	ASSERT_STREQ("Moravian Instruments SFW", info.description);
	ASSERT_EQ_INT(0x03000006, info.version);
	ASSERT_TRUE(info.multi_device_support);
	const char *base[] = { INFO_PROPERTY_NAME, CONFIG_PROPERTY_NAME, PROFILE_NAME_PROPERTY_NAME, PROFILE_PROPERTY_NAME, CONNECTION_PROPERTY_NAME };
	for (int i = 0; i < ARRAY_SIZE(base); i++) {
		ASSERT_EQ_INT(INDIGO_OK_STATE, property_state(0, base[i]));
	}
	ASSERT_EQ_INT(-1, property_state(0, WHEEL_SLOT_PROPERTY_NAME));
	ASSERT_EQ_INT(-1, property_state(0, COMMANDS_PROPERTY));
	ASSERT_TRUE(connect_wheel(0, true));
	indigo_property *property = snapshot(0, INFO_PROPERTY_NAME);
	ASSERT_EQ_INT(8, property->count);
	bool interface_ok = false, model_ok = false, serial_ok = false, version_ok = false;
	for (int i = 0; i < property->count; i++) {
		interface_ok |= !strcmp(property->items[i].name, INFO_DEVICE_INTERFACE_ITEM_NAME) && (atoi(property->items[i].text.value) & INDIGO_INTERFACE_WHEEL);
		model_ok |= !strcmp(property->items[i].name, INFO_DEVICE_MODEL_ITEM_NAME) && !strcmp(property->items[i].text.value, "SFW test 0");
		serial_ok |= !strcmp(property->items[i].name, INFO_DEVICE_SERIAL_NUM_ITEM_NAME) && !strcmp(property->items[i].text.value, "MI-SFW-0");
		version_ok |= !strcmp(property->items[i].name, INFO_DEVICE_FW_REVISION_ITEM_NAME) && !strcmp(property->items[i].text.value, "1.2.3.4");
	}
	indigo_release_property(property);
	ASSERT_TRUE(interface_ok && model_ok && serial_ok && version_ok);
	property = snapshot(0, WHEEL_SLOT_PROPERTY_NAME);
	ASSERT_EQ_INT(INDIGO_NUMBER_VECTOR, property->type);
	ASSERT_EQ_INT(INDIGO_RW_PERM, property->perm);
	ASSERT_NEAR(1, property->items[0].number.min, 0);
	ASSERT_NEAR(5, property->items[0].number.max, 0);
	ASSERT_NEAR(1, property->items[0].number.value, 0);
	indigo_release_property(property);
	property = snapshot(0, WHEEL_SLOT_NAME_PROPERTY_NAME);
	ASSERT_EQ_INT(5, property->count);
	indigo_release_property(property);
	property = snapshot(0, WHEEL_SLOT_OFFSET_PROPERTY_NAME);
	ASSERT_EQ_INT(5, property->count);
	indigo_release_property(property);
	property = snapshot(0, COMMANDS_PROPERTY);
	ASSERT_STREQ(COMMANDS_PROPERTY, property->name);
	ASSERT_EQ_INT(INDIGO_SWITCH_VECTOR, property->type);
	ASSERT_EQ_INT(INDIGO_AT_MOST_ONE_RULE, property->rule);
	ASSERT_EQ_INT(1, property->count);
	ASSERT_STREQ(REINIT_ITEM_NAME, property->items[0].name);
	ASSERT_FALSE(property->items[0].sw.value);
	indigo_release_property(property);
	ASSERT_TRUE(connect_wheel(0, false));
	ASSERT_EQ_INT(-1, property_state(0, WHEEL_SLOT_PROPERTY_NAME));
	ASSERT_EQ_INT(-1, property_state(0, COMMANDS_PROPERTY));
}

static void connection_failures_and_optional_metadata(void) {
	atomic_store(&fail_next_init, 1);
	ASSERT_TRUE(set_switch(0, CONNECTION_PROPERTY_NAME, CONNECTION_CONNECTED_ITEM_NAME, true));
	ASSERT_TRUE(wait_state(0, CONNECTION_PROPERTY_NAME, INDIGO_ALERT_STATE));
	atomic_store(&wheels[0].fail_integer, FW_GIP_FILTERS + 1);
	ASSERT_TRUE(set_switch(0, CONNECTION_PROPERTY_NAME, CONNECTION_CONNECTED_ITEM_NAME, true));
	ASSERT_TRUE(wait_state(0, CONNECTION_PROPERTY_NAME, INDIGO_ALERT_STATE));
	atomic_store(&wheels[0].fail_integer, 0);
	int invalid[] = { 0, -1, 25 };
	for (int i = 0; i < ARRAY_SIZE(invalid); i++) {
		atomic_store(&wheels[0].slots, invalid[i]);
		ASSERT_TRUE(set_switch(0, CONNECTION_PROPERTY_NAME, CONNECTION_CONNECTED_ITEM_NAME, true));
		ASSERT_TRUE(wait_state(0, CONNECTION_PROPERTY_NAME, INDIGO_ALERT_STATE));
	}
	atomic_store(&wheels[0].slots, 5);
	atomic_store(&wheels[0].fail_string, FW_GSP_SERIAL_NUMBER + 1);
	atomic_store(&wheels[0].fail_integer, FW_GIP_VERSION_2 + 1);
	ASSERT_TRUE(connect_wheel(0, true));
	indigo_property *property = snapshot(0, INFO_PROPERTY_NAME);
	bool serial_empty = false, version_empty = false;
	for (int i = 0; i < property->count; i++) {
		serial_empty |= !strcmp(property->items[i].name, INFO_DEVICE_SERIAL_NUM_ITEM_NAME) && property->items[i].text.value[0] == 0;
		version_empty |= !strcmp(property->items[i].name, INFO_DEVICE_FW_REVISION_ITEM_NAME) && property->items[i].text.value[0] == 0;
	}
	ASSERT_TRUE(serial_empty && version_empty);
	indigo_release_property(property);
	ASSERT_TRUE(connect_wheel(0, false));
	atomic_store(&wheels[0].fail_string, 0);
	atomic_store(&wheels[0].fail_integer, 0);
}

static void initial_home_failure_and_recovery(void) {
	atomic_store(&wheels[0].fail_set, 1);
	ASSERT_TRUE(connect_wheel(0, true));
	ASSERT_EQ_INT(INDIGO_ALERT_STATE, property_state(0, WHEEL_SLOT_PROPERTY_NAME));
	ASSERT_EQ_INT(1, atomic_load(&wheels[0].set_calls));
	ASSERT_EQ_INT(0, atomic_load(&wheels[0].last_set_index));
	atomic_store(&wheels[0].fail_set, 0);
	ASSERT_TRUE(set_slot(0, 2));
	ASSERT_TRUE(wait_atomic(&wheels[0].set_calls, 2));
	ASSERT_TRUE(wait_state(0, WHEEL_SLOT_PROPERTY_NAME, INDIGO_OK_STATE));
	ASSERT_EQ_INT(2, atomic_load(&wheels[0].set_calls));
	ASSERT_NEAR(2, slot_value(0), 0);
}

static void positioning_boundaries_and_failures(void) {
	ASSERT_TRUE(connect_wheel(0, true));
	int calls = atomic_load(&wheels[0].set_calls);
	ASSERT_TRUE(set_slot(0, 1));
	indigo_usleep(50000);
	ASSERT_TRUE(wait_state(0, WHEEL_SLOT_PROPERTY_NAME, INDIGO_OK_STATE));
	ASSERT_EQ_INT(calls, atomic_load(&wheels[0].set_calls));
	int slots[] = { 3, 5, 1 };
	int indices[] = { 2, 4, 0 };
	for (int i = 0; i < ARRAY_SIZE(slots); i++) {
		int expected_calls = atomic_load(&wheels[0].set_calls) + 1;
		ASSERT_TRUE(set_slot(0, slots[i]));
		ASSERT_TRUE(wait_atomic(&wheels[0].set_calls, expected_calls));
		ASSERT_TRUE(wait_state(0, WHEEL_SLOT_PROPERTY_NAME, INDIGO_OK_STATE));
		ASSERT_EQ_INT(indices[i], atomic_load(&wheels[0].last_set_index));
		ASSERT_NEAR(slots[i], slot_value(0), 0);
	}
	atomic_store(&wheels[0].fail_set, 1);
	int expected_calls = atomic_load(&wheels[0].set_calls) + 1;
	ASSERT_TRUE(set_slot(0, 4));
	ASSERT_TRUE(wait_atomic(&wheels[0].set_calls, expected_calls));
	ASSERT_TRUE(wait_state(0, WHEEL_SLOT_PROPERTY_NAME, INDIGO_ALERT_STATE));
	ASSERT_NEAR(1, slot_value(0), 0);
	ASSERT_NEAR(1, slot_target(0), 0);
	atomic_store(&wheels[0].fail_set, 0);
	expected_calls++;
	ASSERT_TRUE(set_slot(0, 4));
	ASSERT_TRUE(wait_atomic(&wheels[0].set_calls, expected_calls));
	ASSERT_TRUE(wait_state(0, WHEEL_SLOT_PROPERTY_NAME, INDIGO_OK_STATE));
	ASSERT_NEAR(4, slot_value(0), 0);
}

static void reinit_count_failures_and_recovery(void) {
	ASSERT_TRUE(connect_wheel(0, true));
	ASSERT_TRUE(reinitialize(0, false));
	indigo_usleep(50000);
	ASSERT_TRUE(wait_state(0, COMMANDS_PROPERTY, INDIGO_OK_STATE));
	ASSERT_EQ_INT(0, atomic_load(&wheels[0].reinit_calls));
	atomic_store(&wheels[0].reinit_filters, 7);
	ASSERT_TRUE(reinitialize(0, true));
	ASSERT_TRUE(wait_atomic(&wheels[0].reinit_calls, 1));
	ASSERT_TRUE(wait_state(0, COMMANDS_PROPERTY, INDIGO_OK_STATE));
	ASSERT_TRUE(wait_slot_max(0, 7));
	indigo_property *property = snapshot(0, COMMANDS_PROPERTY);
	ASSERT_FALSE(property->items[0].sw.value);
	indigo_release_property(property);
	property = snapshot(0, WHEEL_SLOT_PROPERTY_NAME);
	ASSERT_NEAR(7, property->items[0].number.max, 0);
	ASSERT_NEAR(1, property->items[0].number.value, 0);
	indigo_release_property(property);
	indigo_property *temporary = snapshot(0, WHEEL_SLOT_NAME_PROPERTY_NAME);
	ASSERT_EQ_INT(7, temporary->count);
	indigo_release_property(temporary);
	atomic_store(&wheels[0].fail_reinit, 1);
	ASSERT_TRUE(reinitialize(0, true));
	ASSERT_TRUE(wait_atomic(&wheels[0].reinit_calls, 2));
	ASSERT_TRUE(wait_state(0, COMMANDS_PROPERTY, INDIGO_ALERT_STATE));
	property = snapshot(0, COMMANDS_PROPERTY);
	ASSERT_FALSE(property->items[0].sw.value);
	indigo_release_property(property);
	atomic_store(&wheels[0].fail_reinit, 0);
	int invalid[] = { 0, 25 };
	for (int i = 0; i < ARRAY_SIZE(invalid); i++) {
		atomic_store(&wheels[0].reinit_filters, invalid[i]);
		ASSERT_TRUE(reinitialize(0, true));
		ASSERT_TRUE(wait_atomic(&wheels[0].reinit_calls, 3 + i));
		ASSERT_TRUE(wait_state(0, COMMANDS_PROPERTY, INDIGO_ALERT_STATE));
	}
	atomic_store(&wheels[0].reinit_filters, 4);
	ASSERT_TRUE(reinitialize(0, true));
	ASSERT_TRUE(wait_atomic(&wheels[0].reinit_calls, 5));
	ASSERT_TRUE(wait_state(0, COMMANDS_PROPERTY, INDIGO_OK_STATE));
	property = snapshot(0, WHEEL_SLOT_OFFSET_PROPERTY_NAME);
	ASSERT_EQ_INT(4, property->count);
	indigo_release_property(property);
}

static void move_and_reinit_busy_exclusion(void) {
	ASSERT_TRUE(connect_wheel(0, true));
	atomic_store(&hold_set, true);
	ASSERT_TRUE(set_slot(0, 2));
	ASSERT_TRUE(wait_atomic(&set_entered, 1));
	ASSERT_EQ_INT(INDIGO_BUSY_STATE, property_state(0, WHEEL_SLOT_PROPERTY_NAME));
	ASSERT_TRUE(reinitialize(0, true));
	ASSERT_EQ_INT(INDIGO_ALERT_STATE, property_state(0, COMMANDS_PROPERTY));
	ASSERT_EQ_INT(0, atomic_load(&wheels[0].reinit_calls));
	atomic_store(&release_set, true);
	ASSERT_TRUE(wait_state(0, WHEEL_SLOT_PROPERTY_NAME, INDIGO_OK_STATE));
	atomic_store(&hold_reinit, true);
	atomic_store(&release_reinit, false);
	atomic_store(&wheels[0].reinit_filters, 5);
	ASSERT_TRUE(reinitialize(0, true));
	ASSERT_TRUE(wait_atomic(&reinit_entered, 1));
	ASSERT_EQ_INT(INDIGO_BUSY_STATE, property_state(0, COMMANDS_PROPERTY));
	int calls = atomic_load(&wheels[0].set_calls);
	double rejected_value = slot_value(0), rejected_target = slot_target(0);
	ASSERT_TRUE(set_slot(0, 3));
	ASSERT_EQ_INT(INDIGO_ALERT_STATE, property_state(0, WHEEL_SLOT_PROPERTY_NAME));
	ASSERT_EQ_INT(calls, atomic_load(&wheels[0].set_calls));
	// The reject_change guard marks every item, so the driver-side slot is forced back to the client.
	ASSERT_NEAR(rejected_value, slot_value(0), 0.001);
	ASSERT_NEAR(rejected_target, slot_target(0), 0.001);
	atomic_store(&release_reinit, true);
	ASSERT_TRUE(wait_state(0, COMMANDS_PROPERTY, INDIGO_OK_STATE));
	// A guard must not be sticky once the wheel is idle again.
	ASSERT_TRUE(set_slot(0, 3));
	ASSERT_TRUE(wait_state(0, WHEEL_SLOT_PROPERTY_NAME, INDIGO_OK_STATE));
}

static void disconnect_waits_for_active_sdk_call(void) {
	ASSERT_TRUE(connect_wheel(0, true));
	atomic_store(&hold_set, true);
	ASSERT_TRUE(set_slot(0, 2));
	ASSERT_TRUE(wait_atomic(&set_entered, 1));
	ASSERT_TRUE(set_switch(0, CONNECTION_PROPERTY_NAME, CONNECTION_DISCONNECTED_ITEM_NAME, true));
	ASSERT_EQ_INT(1, atomic_load(&wheels[0].open_handles));
	atomic_store(&release_set, true);
	ASSERT_TRUE(wait_state(0, CONNECTION_PROPERTY_NAME, INDIGO_OK_STATE));
	ASSERT_EQ_INT(0, atomic_load(&wheels[0].open_handles));
	ASSERT_EQ_INT(0, atomic_load(&sdk_after_close));
	ASSERT_TRUE(connect_wheel(0, true));
	ASSERT_TRUE(set_slot(0, 3));
	ASSERT_TRUE(wait_state(0, WHEEL_SLOT_PROPERTY_NAME, INDIGO_OK_STATE));
}

static void unplug_during_active_move_and_replug(void) {
	ASSERT_TRUE(connect_wheel(0, true));
	atomic_store(&hold_set, true);
	ASSERT_TRUE(set_slot(0, 2));
	ASSERT_TRUE(wait_atomic(&set_entered, 1));
	atomic_store(&wheels[0].visible, false);
	usb_event(0, false);
	ASSERT_EQ_INT(1, atomic_load(&attached));
	atomic_store(&release_set, true);
	ASSERT_TRUE(wait_atomic(&attached, 0));
	ASSERT_EQ_INT(0, atomic_load(&wheels[0].open_handles));
	ASSERT_EQ_INT(0, atomic_load(&sdk_after_close));
	atomic_store(&wheels[0].visible, true);
	usb_event(0, true);
	ASSERT_TRUE(wait_atomic(&attached, 1));
	ASSERT_TRUE(connect_wheel(0, true));
	int expected_calls = atomic_load(&wheels[0].set_calls) + 1;
	ASSERT_TRUE(set_slot(0, 5));
	ASSERT_TRUE(wait_atomic(&wheels[0].set_calls, expected_calls));
	ASSERT_TRUE(wait_state(0, WHEEL_SLOT_PROPERTY_NAME, INDIGO_OK_STATE));
}

static void multiple_devices_identity_and_duplicate_names(void) {
	snprintf(wheels[1].model, sizeof(wheels[1].model), "Duplicate");
	snprintf(wheels[2].model, sizeof(wheels[2].model), "Duplicate");
	atomic_store(&wheels[1].visible, true);
	atomic_store(&wheels[2].visible, true);
	atomic_store(&enumerate_reverse, true);
	usb_event(1, true);
	ASSERT_TRUE(wait_atomic(&attached, 2));
	usb_event(2, true);
	ASSERT_TRUE(wait_atomic(&attached, 3));
	ASSERT_TRUE(observed[1].name[0] && observed[2].name[0]);
	ASSERT_TRUE(strcmp(observed[1].name, observed[2].name));
	ASSERT_TRUE(connect_wheel(1, true));
	ASSERT_TRUE(connect_wheel(2, true));
	ASSERT_TRUE(set_slot(1, 3));
	ASSERT_TRUE(wait_atomic(&wheels[1].set_calls, 2));
	ASSERT_TRUE(wait_state(1, WHEEL_SLOT_PROPERTY_NAME, INDIGO_OK_STATE));
	ASSERT_EQ_INT(2, atomic_load(&wheels[1].last_set_index));
	ASSERT_EQ_INT(1, atomic_load(&wheels[2].set_calls));
	atomic_store(&wheels[1].visible, false);
	usb_event(2, false);
	ASSERT_TRUE(wait_atomic(&attached, 2));
	ASSERT_EQ_INT(0, atomic_load(&wheels[1].open_handles));
	ASSERT_EQ_INT(1, atomic_load(&wheels[2].open_handles));
	ASSERT_TRUE(connect_wheel(2, false));
}

static void discovery_failures_retry_and_capacity(void) {
	atomic_store(&wheels[1].visible, true);
	atomic_store(&descriptor_error, 1);
	usb_event(1, true);
	indigo_usleep(100000);
	ASSERT_EQ_INT(1, atomic_load(&attached));
	atomic_store(&descriptor_error, 0);
	atomic_store(&fail_next_init, 1);
	atomic_store(&wheels[1].fail_string, FW_GSP_DESCRIPTION + 1);
	usb_event(1, true);
	ASSERT_TRUE(wait_atomic(&attached, 2));
	ASSERT_STREQ("MI SFW", observed[1].name);
	atomic_store(&wheels[1].fail_string, 0);
	atomic_store(&wheels[2].visible, true);
	atomic_store(&fail_attach, 1);
	usb_event(2, true);
	ASSERT_TRUE(wait_atomic(&attached, 3));
	ASSERT_TRUE(atomic_load(&attach_attempts) >= 4);
	for (int i = 3; i < 5; i++) {
		atomic_store(&wheels[i].visible, true);
		usb_event(i, true);
		ASSERT_TRUE(wait_atomic(&attached, i + 1));
	}
	atomic_store(&wheels[5].visible, true);
	usb_event(5, true);
	indigo_usleep(100000);
	ASSERT_EQ_INT(5, atomic_load(&attached));
	atomic_store(&wheels[0].visible, false);
	usb_event(0, false);
	ASSERT_TRUE(wait_atomic(&attached, 4));
	ASSERT_TRUE(wait_atomic(&attached, 5));
	ASSERT_TRUE(observed[5].name[0]);
}

static void repeated_requests_shutdown_and_lifecycle(void) {
	ASSERT_TRUE(connect_wheel(0, true));
	int init_calls = atomic_load(&wheels[0].init_calls);
	ASSERT_TRUE(connect_wheel(0, true));
	ASSERT_EQ_INT(init_calls, atomic_load(&wheels[0].init_calls));
	ASSERT_EQ_INT(INDIGO_BUSY, indigo_wheel_mi(INDIGO_DRIVER_SHUTDOWN, NULL));
	ASSERT_TRUE(set_slot(0, 2));
	ASSERT_TRUE(wait_state(0, WHEEL_SLOT_PROPERTY_NAME, INDIGO_OK_STATE));
	ASSERT_TRUE(connect_wheel(0, false));
	int releases = atomic_load(&wheels[0].releases);
	ASSERT_TRUE(connect_wheel(0, false));
	ASSERT_EQ_INT(releases, atomic_load(&wheels[0].releases));
	ASSERT_EQ_INT(INDIGO_OK, indigo_wheel_mi(INDIGO_DRIVER_SHUTDOWN, NULL));
	ASSERT_TRUE(wait_atomic(&attached, 0));
	ASSERT_EQ_INT(INDIGO_OK, indigo_wheel_mi(INDIGO_DRIVER_SHUTDOWN, NULL));
	ASSERT_EQ_INT(INDIGO_OK, indigo_wheel_mi(INDIGO_DRIVER_INIT, NULL));
	ASSERT_TRUE(wait_atomic(&attached, 1));
	ASSERT_TRUE(connect_wheel(0, true));
	ASSERT_TRUE(set_slot(0, 4));
	ASSERT_TRUE(wait_state(0, WHEEL_SLOT_PROPERTY_NAME, INDIGO_OK_STATE));
}

static void init_queue_and_registration_failures(void) {
	ASSERT_EQ_INT(INDIGO_OK, indigo_wheel_mi(INDIGO_DRIVER_SHUTDOWN, NULL));
	ASSERT_TRUE(wait_atomic(&attached, 0));
	atomic_store(&fail_queue_create, 1);
	ASSERT_EQ_INT(INDIGO_FAILED, indigo_wheel_mi(INDIGO_DRIVER_INIT, NULL));
	ASSERT_EQ_INT(0, atomic_load(&attached));
	atomic_store(&registration_error, 1);
	ASSERT_EQ_INT(INDIGO_FAILED, indigo_wheel_mi(INDIGO_DRIVER_INIT, NULL));
	ASSERT_EQ_INT(0, atomic_load(&attached));
	atomic_store(&registration_error, 0);
	ASSERT_EQ_INT(INDIGO_OK, indigo_wheel_mi(INDIGO_DRIVER_INIT, NULL));
	ASSERT_TRUE(wait_atomic(&attached, 1));
	ASSERT_TRUE(connect_wheel(0, true));
	ASSERT_TRUE(connect_wheel(0, false));
}

static bool begin_fixture(void) {
	memset(wheels, 0, sizeof(wheels));
	memset(observed, 0, sizeof(observed));
	atomic_store(&usb_refs, 0);
	atomic_store(&invalid_usb_unref, 0);
	atomic_store(&attached, 0);
	atomic_store(&attach_attempts, 0);
	atomic_store(&fail_attach, 0);
	atomic_store(&fail_next_init, 0);
	atomic_store(&sdk_after_close, 0);
	atomic_store(&invalid_release, 0);
	atomic_store(&descriptor_error, 0);
	atomic_store(&registration_error, 0);
	atomic_store(&fail_queue_create, 0);
	atomic_store(&enumerate_reverse, 0);
	atomic_store(&last_probe_index, -1);
	atomic_store(&late_updates, 0);
	atomic_store(&hold_set, false);
	atomic_store(&release_set, false);
	atomic_store(&hold_reinit, false);
	atomic_store(&release_reinit, false);
	atomic_store(&set_entered, 0);
	atomic_store(&reinit_entered, 0);
	for (int i = 0; i < MOCK_WHEELS; i++) {
		atomic_store(&usb_ref_balance[i], 0);
		atomic_store(&wheels[i].slots, 5);
		atomic_store(&wheels[i].reinit_filters, 5);
		atomic_store(&wheels[i].last_set_index, -1);
		snprintf(wheels[i].model, sizeof(wheels[i].model), "SFW test %d", i);
		snprintf(wheels[i].serial, sizeof(wheels[i].serial), "MI-SFW-%d", i);
	}
	atomic_store(&wheels[0].visible, true);
	return indigo_wheel_mi(INDIGO_DRIVER_INIT, NULL) == INDIGO_OK && indigo_wheel_mi(INDIGO_DRIVER_INIT, NULL) == INDIGO_OK && wait_atomic(&attached, 1);
}

static void end_fixture(void) {
	atomic_store(&release_set, true);
	atomic_store(&release_reinit, true);
	for (int i = 0; i < MOCK_WHEELS; i++) {
		if (atomic_load(&wheels[i].open_handles) > 0 && observed[i].name[0]) {
			connect_wheel(i, false);
		}
	}
	ASSERT_EQ_INT(INDIGO_OK, indigo_wheel_mi(INDIGO_DRIVER_SHUTDOWN, NULL));
	ASSERT_EQ_INT(INDIGO_OK, indigo_wheel_mi(INDIGO_DRIVER_SHUTDOWN, NULL));
	ASSERT_EQ_INT(0, atomic_load(&attached));
	ASSERT_EQ_INT(0, atomic_load(&usb_refs));
	ASSERT_EQ_INT(0, atomic_load(&invalid_usb_unref));
	ASSERT_EQ_INT(0, atomic_load(&sdk_after_close));
	ASSERT_EQ_INT(0, atomic_load(&invalid_release));
	for (int i = 0; i < MOCK_WHEELS; i++) {
		ASSERT_EQ_INT(0, atomic_load(&usb_ref_balance[i]));
		ASSERT_EQ_INT(0, atomic_load(&wheels[i].open_handles));
		for (int j = 0; j < OBSERVED_PROPERTIES; j++) {
			indigo_release_property(observed[i].properties[j]);
			observed[i].properties[j] = NULL;
		}
	}
}

int main(void) {
	indigo_start();
	indigo_attach_client(&test_client);
	const indigo_test_case tests[] = {
		{ "metadata and connected property contract", metadata_and_property_contract },
		{ "connection failures and optional metadata fallbacks", connection_failures_and_optional_metadata },
		{ "initial homing failure and recovery", initial_home_failure_and_recovery },
		{ "slot boundaries, no-op, failure and recovery", positioning_boundaries_and_failures },
		{ "reinit count changes, failures and recovery", reinit_count_failures_and_recovery },
		{ "move and reinit mutual BUSY exclusion", move_and_reinit_busy_exclusion },
		{ "disconnect waits for active SDK call", disconnect_waits_for_active_sdk_call },
		{ "unplug during active move and replug", unplug_during_active_move_and_replug },
		{ "multiple devices, reversed identity and duplicate names", multiple_devices_identity_and_duplicate_names },
		{ "discovery failures, generated retry and capacity", discovery_failures_retry_and_capacity },
		{ "repeated requests, shutdown rejection and lifecycle", repeated_requests_shutdown_and_lifecycle },
		{ "queue and hotplug registration rollback", init_queue_and_registration_failures }
	};
	int result = 0;
	for (int i = 0; i < ARRAY_SIZE(tests); i++) {
		if (!begin_fixture()) {
			result = 1;
			break;
		}
		result |= indigo_run_tests("Moravian Instruments wheel fake gxfw integration", tests + i, 1);
		end_fixture();
	}
	indigo_detach_client(&test_client);
	indigo_stop();
	return result || indigo_test_failures ? 1 : 0;
}
