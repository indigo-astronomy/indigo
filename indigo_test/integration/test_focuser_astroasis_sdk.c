// Copyright (c) 2026 INDIGO initiative
// All rights reserved.
//
// You may use this software under the terms of 'INDIGO Astronomy
// open-source license' (see LICENSE.md).
//
// THIS SOFTWARE IS PROVIDED BY THE AUTHORS 'AS IS' AND ANY EXPRESS
// OR IMPLIED WARRANTIES, INCLUDING, BUT NOT LIMITED TO, THE IMPLIED
// WARRANTIES OF MERCHANTABILITY AND FITNESS FOR A PARTICULAR PURPOSE
// ARE DISCLAIMED. IN NO EVENT SHALL THE AUTHOR BE LIABLE FOR ANY
// DIRECT, INDIRECT, INCIDENTAL, SPECIAL, EXEMPLARY, OR CONSEQUENTIAL
// DAMAGES (INCLUDING, BUT NOT LIMITED TO, PROCUREMENT OF SUBSTITUTE
// GOODS OR SERVICES; LOSS OF USE, DATA, OR PROFITS; OR BUSINESS
// INTERRUPTION) HOWEVER CAUSED AND ON ANY THEORY OF LIABILITY,
// WHETHER IN CONTRACT, STRICT LIABILITY, OR TORT (INCLUDING
// NEGLIGENCE OR OTHERWISE) ARISING IN ANY WAY OUT OF THE USE OF THIS
// SOFTWARE, EVEN IF ADVISED OF THE POSSIBILITY OF SUCH DAMAGE.

// Code is generated by AI

#include <stdbool.h>
#include <stdarg.h>
#include <stddef.h>
#include <stdatomic.h>
#include <pthread.h>
#include <dirent.h>
#include <unistd.h>
#include <AOFocus.h>
#include <indigo/indigo_usb_utils.h>
#include <indigo/indigo_focuser_driver.h>
#include <indigo_drivers/focuser_astroasis/indigo_focuser_astroasis.h>
#include "simulator_test_common.h"

#ifndef OAF_REFERENCE_TRACE_PATH
#define OAF_REFERENCE_TRACE_PATH "fixtures/focuser_astroasis/generated_reference_trace.txt"
#endif

#define EXPECTED_VERSION 0x03000009
#define CUSTOM_PREFIX "X_"
#define BEEP_ON_POWER_UP_NAME CUSTOM_PREFIX "BEEP_ON_POWER_UP_PROPERTY"
#define BEEP_ON_MOVE_NAME CUSTOM_PREFIX "BEEP_ON_MOVE_PROPERTY"
#define BACKLASH_DIRECTION_NAME CUSTOM_PREFIX "BACKLASH_DIRECTION_PROPERTY"
#define CUSTOM_SUFFIX_NAME CUSTOM_PREFIX "CUSTOM_SUFFIX"
#define BLUETOOTH_NAME CUSTOM_PREFIX "BLUETOOTH_PROPERTY"
#define BLUETOOTH_NAME_NAME CUSTOM_PREFIX "BLUETOOTH_NAME_PROPERTY"
#define FACTORY_RESET_NAME CUSTOM_PREFIX "FACTORY_RESET_PROPERTY"
#define BOARD_TEMPERATURE_NAME CUSTOM_PREFIX "BOARD_TEMPERATURE_PROPERTY"

#define FOCUSERS 8
#define PROPERTIES 64
#define WAIT_STEPS 600
#define TRACE_RECENT 32

#define CHECK(condition) do { \
	if (!(condition)) { \
		fprintf(stderr, "%s:%d: check failed: %s\n", __FILE__, __LINE__, #condition); \
		indigo_test_failures++; \
		goto cleanup; \
	} \
} while (0)

#define CHECK_EQ(expected, actual) do { \
	long long expected_value = (long long)(expected); \
	long long actual_value = (long long)(actual); \
	if (expected_value != actual_value) { \
		fprintf(stderr, "%s:%d: expected %lld, got %lld: %s\n", __FILE__, __LINE__, expected_value, actual_value, #actual); \
		indigo_test_failures++; \
		goto cleanup; \
	} \
} while (0)

#define CHECK_NEAR(expected, actual, tolerance) do { \
	double expected_value = (expected); \
	double actual_value = (actual); \
	if (fabs(expected_value - actual_value) > (tolerance)) { \
		fprintf(stderr, "%s:%d: expected %g, got %g: %s\n", __FILE__, __LINE__, expected_value, actual_value, #actual); \
		indigo_test_failures++; \
		goto cleanup; \
	} \
} while (0)

#define CHECK_STR(expected, actual) do { \
	const char *expected_value = (expected); \
	const char *actual_value = (actual); \
	if (actual_value == NULL || strcmp(expected_value, actual_value)) { \
		fprintf(stderr, "%s:%d: expected \"%s\", got \"%s\": %s\n", __FILE__, __LINE__, expected_value, actual_value ? actual_value : "(null)", #actual); \
		indigo_test_failures++; \
		goto cleanup; \
	} \
} while (0)

#define EXPECT_EQ(expected, actual) do { \
	long long expected_value = (long long)(expected); \
	long long actual_value = (long long)(actual); \
	if (expected_value != actual_value) { \
		fprintf(stderr, "%s:%d: invariant expected %lld, got %lld: %s\n", __FILE__, __LINE__, expected_value, actual_value, #actual); \
		indigo_test_failures++; \
	} \
} while (0)

enum {
	FN_SCAN,
	FN_OPEN,
	FN_CLOSE,
	FN_MODEL,
	FN_VERSION,
	FN_FRIENDLY_GET,
	FN_FRIENDLY_SET,
	FN_BLUETOOTH_GET,
	FN_BLUETOOTH_SET,
	FN_CONFIG_GET,
	FN_CONFIG_SET,
	FN_STATUS,
	FN_RESET,
	FN_SYNC,
	FN_MOVE,
	FN_MOVE_TO,
	FN_STOP,
	FN_COUNT
};

typedef struct {
	bool usb_present, visible, opened, hold_motion, track_status_after_stop;
	int generation;
	unsigned int firmware;
	AOFocuserConfig config, last_config;
	char model[AO_FOCUSER_NAME_LEN + 1], friendly[AO_FOCUSER_NAME_LEN + 1], bluetooth[AO_FOCUSER_NAME_LEN + 1];
	int position, target, moving, polls_left, motion_polls;
	int temperature_int, temperature_ext, detection;
	int error[FN_COUNT], error_skip[FN_COUNT], calls[FN_COUNT];
	int pending_status_errors_after_stop, status_errors_after_stop, status_calls_after_stop;
	int last_move, last_move_to, last_sync;
	char call_log[4096];
	atomic_int active;
} fake_focuser;

typedef struct {
	char name[INDIGO_NAME_SIZE];
	indigo_property *copy;
	bool defined;
	int revision, updates;
	int state_revisions[4];
	char message[INDIGO_VALUE_SIZE];
} observed_property;

typedef struct {
	char name[INDIGO_NAME_SIZE];
	bool connected;
	observed_property properties[PROPERTIES];
} observed_focuser;

static fake_focuser fakes[FOCUSERS];
static observed_focuser observed[FOCUSERS];
static pthread_mutex_t sdk_mutex = PTHREAD_MUTEX_INITIALIZER;
static pthread_mutex_t observation_mutex = PTHREAD_MUTEX_INITIALIZER;
static pthread_mutex_t trace_mutex = PTHREAD_MUTEX_INITIALIZER;
static libusb_hotplug_callback_fn usb_callback;
static int usb_devices[FOCUSERS];
static atomic_int usb_ref_balance, usb_register_calls, usb_deregister_calls, usb_register_error, registered_vid, registered_pid, registered_flags, registered_events;
static atomic_int attached, attach_attempts, fail_attach, invalid_detach, attach_after_shutdown, lock_count, fail_lock;
static atomic_int sdk_after_close, concurrent_calls, late_updates, last_probe = -1, time_scale_percent = 10;
static atomic_bool scan_reverse, hold_status, status_waiting, driver_stopped;
static atomic_bool trace_enabled;
static char trace_text[65536];
static size_t trace_length;
static char trace_recent[TRACE_RECENT][256];
static int trace_recent_count;
static char config_folder[] = "/tmp/indigo_focuser_astroasis_XXXXXX";

static const char *call_names[FN_COUNT] = { "Scan", "Open", "Close", "GetProductModel", "GetVersion", "GetFriendlyName", "SetFriendlyName", "GetBluetoothName", "SetBluetoothName", "GetConfig", "SetConfig", "GetStatus", "FactoryReset", "SyncPosition", "Move", "MoveTo", "StopMove" };

const char *oaf_test_config_folder(void) {
	return config_folder;
}

static double scaled(double delay) {
	return delay * atomic_load(&time_scale_percent) / 100.0;
}

static void trace_append(bool property, const char *line) {
	if (!atomic_load(&trace_enabled)) {
		return;
	}
	pthread_mutex_lock(&trace_mutex);
	if (property) {
		for (int i = 0; i < trace_recent_count; i++) {
			if (!strcmp(trace_recent[i], line)) {
				pthread_mutex_unlock(&trace_mutex);
				return;
			}
		}
		if (trace_recent_count < TRACE_RECENT) {
			snprintf(trace_recent[trace_recent_count++], sizeof(trace_recent[0]), "%s", line);
		}
	} else {
		trace_recent_count = 0;
	}
	int written = snprintf(trace_text + trace_length, sizeof(trace_text) - trace_length, "%s\n", line);
	if (written > 0 && trace_length + written < sizeof(trace_text)) {
		trace_length += written;
	}
	pthread_mutex_unlock(&trace_mutex);
}

static void trace_printf(bool property, const char *format, ...) {
	char line[256];
	va_list args;
	va_start(args, format);
	vsnprintf(line, sizeof(line), format, args);
	va_end(args);
	trace_append(property, line);
}

static int fake_id(int index) {
	return 1000 + index * 16 + fakes[index].generation;
}

static int fake_index(int id) {
	int offset = id - 1000;
	if (offset < 0 || offset / 16 >= FOCUSERS || offset % 16 != fakes[offset / 16].generation) {
		return -1;
	}
	return offset / 16;
}

static int fake_enter(int index, int call, bool require_open) {
	if (index >= 0 && atomic_fetch_add(&fakes[index].active, 1) > 0) {
		atomic_fetch_add(&concurrent_calls, 1);
	}
	if (index >= 0 && call == FN_STATUS && atomic_load(&hold_status)) {
		atomic_store(&status_waiting, true);
		for (int i = 0; i < WAIT_STEPS && atomic_load(&hold_status); i++) {
			indigo_usleep(10000);
		}
	}
	pthread_mutex_lock(&sdk_mutex);
	if (index < 0) {
		return AO_ERROR_INVALID_ID;
	}
	fake_focuser *fake = fakes + index;
	fake->calls[call]++;
	size_t length = strlen(fake->call_log);
	snprintf(fake->call_log + length, sizeof(fake->call_log) - length, "%s%s", length ? "," : "", call_names[call]);
	if (require_open && !fake->opened) {
		atomic_fetch_add(&sdk_after_close, 1);
		return AO_ERROR_INVALID_STATE;
	}
	if (!fake->visible) {
		return AO_ERROR_COMMUNICATION;
	}
	if (fake->error[call]) {
		if (fake->error_skip[call] > 0) {
			fake->error_skip[call]--;
		} else {
			return fake->error[call];
		}
	}
	return AO_SUCCESS;
}

static AOReturn fake_leave(int index, int result) {
	pthread_mutex_unlock(&sdk_mutex);
	if (index >= 0) {
		atomic_fetch_sub(&fakes[index].active, 1);
	}
	return (AOReturn)result;
}

AOReturn AOFocuserScan(int *number, int *ids) {
	pthread_mutex_lock(&sdk_mutex);
	*number = 0;
	for (int n = 0; n < FOCUSERS; n++) {
		int index = atomic_load(&scan_reverse) ? FOCUSERS - n - 1 : n;
		fakes[index].calls[FN_SCAN]++;
		if (fakes[index].visible) {
			ids[(*number)++] = fake_id(index);
		}
	}
	pthread_mutex_unlock(&sdk_mutex);
	return AO_SUCCESS;
}

AOReturn AOFocuserOpen(int id) {
	int index = fake_index(id);
	int result = fake_enter(index, FN_OPEN, false);
	if (result == AO_SUCCESS) {
		fakes[index].opened = true;
	}
	if (index >= 0) {
		trace_printf(false, "sdk f%d Open -> %d", index, result);
	}
	return fake_leave(index, result);
}

AOReturn AOFocuserClose(int id) {
	int index = fake_index(id);
	int result = fake_enter(index, FN_CLOSE, true);
	if (index >= 0 && fakes[index].opened) {
		fakes[index].opened = false;
		result = AO_SUCCESS;
	}
	if (index >= 0) {
		trace_printf(false, "sdk f%d Close -> %d", index, result);
	}
	return fake_leave(index, result);
}

AOReturn AOFocuserGetProductModel(int id, char *model) {
	int index = fake_index(id);
	int result = fake_enter(index, FN_MODEL, true);
	if (index >= 0) {
		memcpy(model, fakes[index].model, AO_FOCUSER_NAME_LEN);
		atomic_store(&last_probe, index);
		trace_printf(false, "sdk f%d GetProductModel -> %d", index, result);
	}
	return fake_leave(index, result);
}

AOReturn AOFocuserGetVersion(int id, AOFocuserVersion *version) {
	int index = fake_index(id);
	int result = fake_enter(index, FN_VERSION, true);
	if (index >= 0) {
		memset(version, 0, sizeof(*version));
		version->protocal = PROTOCAL_VERSION_16_1_0;
		version->firmware = fakes[index].firmware;
		trace_printf(false, "sdk f%d GetVersion -> %d", index, result);
	}
	return fake_leave(index, result);
}

AOReturn AOFocuserGetFriendlyName(int id, char *name) {
	int index = fake_index(id);
	int result = fake_enter(index, FN_FRIENDLY_GET, true);
	if (index >= 0) {
		memcpy(name, fakes[index].friendly, AO_FOCUSER_NAME_LEN);
		trace_printf(false, "sdk f%d GetFriendlyName -> %d", index, result);
	}
	return fake_leave(index, result);
}

AOReturn AOFocuserSetFriendlyName(int id, char *name) {
	int index = fake_index(id);
	int result = fake_enter(index, FN_FRIENDLY_SET, true);
	if (result == AO_SUCCESS) {
		snprintf(fakes[index].friendly, sizeof(fakes[index].friendly), "%s", name);
	}
	if (index >= 0) {
		trace_printf(false, "sdk f%d SetFriendlyName \"%s\" -> %d", index, name, result);
	}
	return fake_leave(index, result);
}

AOReturn AOFocuserGetBluetoothName(int id, char *name) {
	int index = fake_index(id);
	int result = fake_enter(index, FN_BLUETOOTH_GET, true);
	if (index >= 0) {
		memcpy(name, fakes[index].bluetooth, AO_FOCUSER_NAME_LEN);
		trace_printf(false, "sdk f%d GetBluetoothName -> %d", index, result);
	}
	return fake_leave(index, result);
}

AOReturn AOFocuserSetBluetoothName(int id, char *name) {
	int index = fake_index(id);
	int result = fake_enter(index, FN_BLUETOOTH_SET, true);
	if (result == AO_SUCCESS) {
		snprintf(fakes[index].bluetooth, sizeof(fakes[index].bluetooth), "%s", name);
	}
	if (index >= 0) {
		trace_printf(false, "sdk f%d SetBluetoothName \"%s\" -> %d", index, name, result);
	}
	return fake_leave(index, result);
}

AOReturn AOFocuserGetConfig(int id, AOFocuserConfig *config) {
	int index = fake_index(id);
	int result = fake_enter(index, FN_CONFIG_GET, true);
	if (result == AO_SUCCESS) {
		*config = fakes[index].config;
	}
	if (index >= 0) {
		trace_printf(false, "sdk f%d GetConfig -> %d", index, result);
	}
	return fake_leave(index, result);
}

AOReturn AOFocuserSetConfig(int id, AOFocuserConfig *config) {
	int index = fake_index(id);
	int result = fake_enter(index, FN_CONFIG_SET, true);
	if (index >= 0) {
		fake_focuser *fake = fakes + index;
		unsigned int mask = config->mask;
		int value = 0;
		if (mask == MASK_MAX_STEP) {
			value = config->maxStep;
		} else if (mask == MASK_BACKLASH) {
			value = config->backlash;
		} else if (mask == MASK_BACKLASH_DIRECTION) {
			value = config->backlashDirection;
		} else if (mask == MASK_REVERSE_DIRECTION) {
			value = config->reverseDirection;
		} else if (mask == MASK_BEEP_ON_MOVE) {
			value = config->beepOnMove;
		} else if (mask == MASK_BEEP_ON_STARTUP) {
			value = config->beepOnStartup;
		} else if (mask == MASK_BLUETOOTH) {
			value = config->bluetoothOn;
		} else if (result == AO_SUCCESS) {
			result = AO_ERROR_INVALID_PARAMETER;
		}
		fake->last_config = *config;
		if (result == AO_SUCCESS) {
			if (mask & MASK_MAX_STEP) {
				fake->config.maxStep = config->maxStep;
			}
			if (mask & MASK_BACKLASH) {
				fake->config.backlash = config->backlash;
			}
			if (mask & MASK_BACKLASH_DIRECTION) {
				fake->config.backlashDirection = config->backlashDirection;
			}
			if (mask & MASK_REVERSE_DIRECTION) {
				fake->config.reverseDirection = config->reverseDirection;
			}
			if (mask & MASK_BEEP_ON_MOVE) {
				fake->config.beepOnMove = config->beepOnMove;
			}
			if (mask & MASK_BEEP_ON_STARTUP) {
				fake->config.beepOnStartup = config->beepOnStartup;
			}
			if (mask & MASK_BLUETOOTH) {
				fake->config.bluetoothOn = config->bluetoothOn;
			}
		}
		trace_printf(false, "sdk f%d SetConfig mask=0x%x value=%d -> %d", index, mask, value, result);
	}
	return fake_leave(index, result);
}

AOReturn AOFocuserGetStatus(int id, AOFocuserStatus *status) {
	int index = fake_index(id);
	int result = fake_enter(index, FN_STATUS, true);
	if (result == AO_SUCCESS && fakes[index].track_status_after_stop) {
		fakes[index].status_calls_after_stop++;
		if (fakes[index].status_errors_after_stop > 0) {
			fakes[index].status_errors_after_stop--;
			result = AO_ERROR_COMMUNICATION;
		}
		if (result == AO_SUCCESS || fakes[index].status_calls_after_stop == 3) {
			fakes[index].track_status_after_stop = false;
		}
	}
	if (result == AO_SUCCESS) {
		fake_focuser *fake = fakes + index;
		if (fake->moving && !fake->hold_motion) {
			if (--fake->polls_left <= 0) {
				fake->position = fake->target;
				fake->moving = 0;
			} else {
				fake->position += (fake->target - fake->position) / 2;
			}
		}
		memset(status, 0, sizeof(*status));
		status->temperatureInt = fake->temperature_int;
		status->temperatureExt = fake->temperature_ext;
		status->temperatureDetection = fake->detection;
		status->position = fake->position;
		status->moving = fake->moving;
	}
	return fake_leave(index, result);
}

AOReturn AOFocuserFactoryReset(int id) {
	int index = fake_index(id);
	int result = fake_enter(index, FN_RESET, true);
	if (result == AO_SUCCESS) {
		fake_focuser *fake = fakes + index;
		fake->config.backlash = 0;
		fake->config.backlashDirection = 0;
		fake->config.reverseDirection = 0;
		fake->config.beepOnMove = 1;
		fake->config.beepOnStartup = 1;
		fake->config.bluetoothOn = 1;
		fake->friendly[0] = 0;
	}
	if (index >= 0) {
		trace_printf(false, "sdk f%d FactoryReset -> %d", index, result);
	}
	return fake_leave(index, result);
}

AOReturn AOFocuserSyncPosition(int id, int position) {
	int index = fake_index(id);
	int result = fake_enter(index, FN_SYNC, true);
	if (index >= 0) {
		fakes[index].last_sync = position;
		if (result == AO_SUCCESS) {
			fakes[index].position = fakes[index].target = position;
		}
		trace_printf(false, "sdk f%d SyncPosition %d -> %d", index, position, result);
	}
	return fake_leave(index, result);
}

static void fake_start_motion(fake_focuser *fake, int target) {
	if (target < 0) {
		target = 0;
	}
	if (target > fake->config.maxStep) {
		target = fake->config.maxStep;
	}
	fake->target = target;
	fake->moving = 1;
	fake->polls_left = fake->motion_polls;
}

AOReturn AOFocuserMove(int id, int step) {
	int index = fake_index(id);
	int result = fake_enter(index, FN_MOVE, true);
	if (index >= 0) {
		fakes[index].last_move = step;
		if (result == AO_SUCCESS) {
			fake_start_motion(fakes + index, fakes[index].position + step);
		}
		trace_printf(false, "sdk f%d Move %d -> %d", index, step, result);
	}
	return fake_leave(index, result);
}

AOReturn AOFocuserMoveTo(int id, int position) {
	int index = fake_index(id);
	int result = fake_enter(index, FN_MOVE_TO, true);
	if (index >= 0) {
		fakes[index].last_move_to = position;
		if (result == AO_SUCCESS) {
			fake_start_motion(fakes + index, position);
		}
		trace_printf(false, "sdk f%d MoveTo %d -> %d", index, position, result);
	}
	return fake_leave(index, result);
}

AOReturn AOFocuserStopMove(int id) {
	int index = fake_index(id);
	int result = fake_enter(index, FN_STOP, true);
	if (result == AO_SUCCESS) {
		fakes[index].moving = 0;
		fakes[index].target = fakes[index].position;
		fakes[index].status_errors_after_stop = fakes[index].pending_status_errors_after_stop;
		fakes[index].pending_status_errors_after_stop = 0;
		fakes[index].status_calls_after_stop = 0;
		fakes[index].track_status_after_stop = fakes[index].status_errors_after_stop > 0;
	}
	if (index >= 0) {
		trace_printf(false, "sdk f%d StopMove -> %d", index, result);
	}
	return fake_leave(index, result);
}

AOReturn AOFocuserGetSDKVersion(char *version) {
	strcpy(version, "3.2.1-fake");
	return AO_SUCCESS;
}

AOReturn AOFocuserSetLogLevel(int level) {
	return AO_SUCCESS;
}

bool oaf_test_set_timer(indigo_device *device, double delay, indigo_timer_callback callback, indigo_timer **timer) {
	return indigo_set_timer(device, scaled(delay), callback, timer);
}

bool oaf_test_reschedule_timer(indigo_device *device, double delay, indigo_timer **timer) {
	return indigo_reschedule_timer(device, scaled(delay), timer);
}

void oaf_test_execute_in(indigo_device *device, double delay, indigo_timer_callback callback) {
	indigo_execute_handler_in(device, scaled(delay), callback);
}

void oaf_test_usb_start(void) {
}

indigo_result oaf_test_lock(indigo_device *device) {
	if (atomic_load(&fail_lock)) {
		return INDIGO_FAILED;
	}
	atomic_fetch_add(&lock_count, 1);
	trace_printf(false, "lock");
	return INDIGO_OK;
}

indigo_result oaf_test_unlock(indigo_device *device) {
	atomic_fetch_sub(&lock_count, 1);
	trace_printf(false, "unlock");
	return INDIGO_OK;
}

static int focuser_by_name(const char *name) {
	for (int i = 0; i < FOCUSERS; i++) {
		if (observed[i].name[0] && !strcmp(observed[i].name, name)) {
			return i;
		}
	}
	return -1;
}

indigo_result oaf_test_attach(indigo_device *device) {
	atomic_fetch_add(&attach_attempts, 1);
	if (atomic_load(&driver_stopped)) {
		atomic_fetch_add(&attach_after_shutdown, 1);
	}
	if (atomic_load(&fail_attach) > 0) {
		atomic_fetch_sub(&fail_attach, 1);
		return INDIGO_FAILED;
	}
	int index = atomic_load(&last_probe);
	if (index < 0) {
		return INDIGO_FAILED;
	}
	pthread_mutex_lock(&observation_mutex);
	snprintf(observed[index].name, INDIGO_NAME_SIZE, "%s", device->name);
	observed[index].connected = false;
	pthread_mutex_unlock(&observation_mutex);
	trace_printf(false, "attach f%d", index);
	indigo_result result = indigo_attach_device(device);
	if (result == INDIGO_OK) {
		atomic_fetch_add(&attached, 1);
	} else {
		pthread_mutex_lock(&observation_mutex);
		observed[index].name[0] = 0;
		pthread_mutex_unlock(&observation_mutex);
	}
	return result;
}

indigo_result oaf_test_detach(indigo_device *device) {
	pthread_mutex_lock(&observation_mutex);
	int index = focuser_by_name(device->name);
	pthread_mutex_unlock(&observation_mutex);
	if (index < 0) {
		atomic_fetch_add(&invalid_detach, 1);
		return indigo_detach_device(device);
	}
	trace_printf(false, "detach f%d", index);
	indigo_result result = indigo_detach_device(device);
	pthread_mutex_lock(&observation_mutex);
	observed[index].name[0] = 0;
	observed[index].connected = false;
	for (int i = 0; i < PROPERTIES; i++) {
		indigo_release_property(observed[index].properties[i].copy);
		observed[index].properties[i].copy = NULL;
		observed[index].properties[i].defined = false;
	}
	pthread_mutex_unlock(&observation_mutex);
	atomic_fetch_sub(&attached, 1);
	return result;
}

int LIBUSB_CALL oaf_test_usb_register(libusb_context *ctx, int events, int flags, int vid, int pid, int cls, libusb_hotplug_callback_fn callback, void *data, libusb_hotplug_callback_handle *handle) {
	atomic_fetch_add(&usb_register_calls, 1);
	atomic_store(&registered_vid, vid);
	atomic_store(&registered_pid, pid);
	atomic_store(&registered_flags, flags);
	atomic_store(&registered_events, events);
	int error = atomic_exchange(&usb_register_error, 0);
	if (error) {
		return error;
	}
	usb_callback = callback;
	*handle = 1;
	if (flags & LIBUSB_HOTPLUG_ENUMERATE) {
		for (int i = 0; i < FOCUSERS; i++) {
			pthread_mutex_lock(&sdk_mutex);
			bool present = fakes[i].usb_present;
			pthread_mutex_unlock(&sdk_mutex);
			if (present) {
				callback(NULL, (libusb_device *)&usb_devices[i], LIBUSB_HOTPLUG_EVENT_DEVICE_ARRIVED, data);
			}
		}
	}
	return LIBUSB_SUCCESS;
}

int oaf_test_usb_register_sim(libusb_context *ctx, libusb_hotplug_event events, libusb_hotplug_flag flags, int vid, int pid, int cls, libusb_hotplug_callback_fn callback, void *data, libusb_hotplug_callback_handle *handle) {
	return oaf_test_usb_register(ctx, events, flags, vid, pid, cls, callback, data, handle);
}

void LIBUSB_CALL oaf_test_usb_deregister(libusb_context *ctx, libusb_hotplug_callback_handle handle) {
	atomic_fetch_add(&usb_deregister_calls, 1);
}

int oaf_test_usb_deregister_poll(libusb_context *ctx, libusb_hotplug_callback_handle handle) {
	oaf_test_usb_deregister(ctx, handle);
	return LIBUSB_SUCCESS;
}

libusb_device *LIBUSB_CALL oaf_test_usb_ref(libusb_device *device) {
	atomic_fetch_add(&usb_ref_balance, 1);
	return device;
}

void LIBUSB_CALL oaf_test_usb_unref(libusb_device *device) {
	atomic_fetch_sub(&usb_ref_balance, 1);
}

int LIBUSB_CALL oaf_test_usb_descriptor(libusb_device *device, struct libusb_device_descriptor *descriptor) {
	memset(descriptor, 0, sizeof(*descriptor));
	descriptor->idVendor = 0x338f;
	descriptor->idProduct = 0xa0f0;
	return LIBUSB_SUCCESS;
}

static observed_property *property_slot(int index, const char *name, bool create) {
	for (int i = 0; i < PROPERTIES; i++) {
		if (!strcmp(observed[index].properties[i].name, name)) {
			return observed[index].properties + i;
		}
	}
	if (create) {
		for (int i = 0; i < PROPERTIES; i++) {
			if (!observed[index].properties[i].name[0]) {
				snprintf(observed[index].properties[i].name, INDIGO_NAME_SIZE, "%s", name);
				return observed[index].properties + i;
			}
		}
	}
	return NULL;
}

static bool trace_selected(const char *name) {
	static const char *names[] = { CONNECTION_PROPERTY_NAME, FOCUSER_POSITION_PROPERTY_NAME, FOCUSER_STEPS_PROPERTY_NAME, FOCUSER_ABORT_MOTION_PROPERTY_NAME, FOCUSER_LIMITS_PROPERTY_NAME, FOCUSER_BACKLASH_PROPERTY_NAME, FOCUSER_REVERSE_MOTION_PROPERTY_NAME, FOCUSER_ON_POSITION_SET_PROPERTY_NAME, FOCUSER_DIRECTION_PROPERTY_NAME, FOCUSER_COMPENSATION_PROPERTY_NAME, FOCUSER_MODE_PROPERTY_NAME, BEEP_ON_POWER_UP_NAME, BEEP_ON_MOVE_NAME, BACKLASH_DIRECTION_NAME, CUSTOM_SUFFIX_NAME, BLUETOOTH_NAME, BLUETOOTH_NAME_NAME, FACTORY_RESET_NAME };
	for (int i = 0; i < ARRAY_SIZE(names); i++) {
		if (!strcmp(names[i], name)) {
			return true;
		}
	}
	return false;
}

static void trace_property(int index, indigo_property *property) {
	static const char *states[] = { "IDLE", "OK", "BUSY", "ALERT" };
	if (!atomic_load(&trace_enabled) || !trace_selected(property->name)) {
		return;
	}
	char line[256];
	const char *name = strncmp(property->name, "X_", 2) ? property->name : property->name + 2;
	int length = snprintf(line, sizeof(line), "prop f%d %s %s", index, name, states[property->state & 3]);
	if (property->state != INDIGO_BUSY_STATE) {
		for (int i = 0; i < property->count && length < (int)sizeof(line); i++) {
			indigo_item *item = property->items + i;
			if (property->type == INDIGO_NUMBER_VECTOR) {
				length += snprintf(line + length, sizeof(line) - length, " %s=%g", item->name, item->number.value);
			} else if (property->type == INDIGO_SWITCH_VECTOR && item->sw.value) {
				length += snprintf(line + length, sizeof(line) - length, " %s", item->name);
			} else if (property->type == INDIGO_TEXT_VECTOR) {
				length += snprintf(line + length, sizeof(line) - length, " %s=\"%s\"", item->name, item->text.value);
			}
		}
	}
	trace_append(true, line);
}

static indigo_result observe_property(indigo_device *device, indigo_property *property, bool define) {
	pthread_mutex_lock(&observation_mutex);
	int index = focuser_by_name(property->device);
	if (index < 0) {
		pthread_mutex_unlock(&observation_mutex);
		return INDIGO_OK;
	}
	observed_property *slot = property_slot(index, property->name, true);
	if (slot == NULL) {
		pthread_mutex_unlock(&observation_mutex);
		return INDIGO_OK;
	}
	if (!define && !observed[index].connected && strcmp(property->name, CONNECTION_PROPERTY_NAME) && strcmp(property->name, CONFIG_PROPERTY_NAME) && strcmp(property->name, PROFILE_PROPERTY_NAME) && strcmp(property->name, PROFILE_NAME_PROPERTY_NAME)) {
		atomic_fetch_add(&late_updates, 1);
		fprintf(stderr, "late update of %s.%s\n", property->device, property->name);
	}
	indigo_release_property(slot->copy);
	slot->copy = indigo_copy_property(NULL, property);
	if (define) {
		slot->defined = true;
	}
	slot->revision++;
	if (!define) {
		slot->updates++;
	}
	slot->state_revisions[property->state & 3]++;
	if (!strcmp(property->name, CONNECTION_PROPERTY_NAME) && property->state == INDIGO_OK_STATE) {
		observed[index].connected = property->items[0].sw.value;
	}
	if (!define) {
		trace_property(index, property);
	}
	pthread_mutex_unlock(&observation_mutex);
	return INDIGO_OK;
}

static indigo_result client_define(indigo_client *client, indigo_device *device, indigo_property *property, const char *message) {
	return observe_property(device, property, true);
}

static indigo_result client_update(indigo_client *client, indigo_device *device, indigo_property *property, const char *message) {
	return observe_property(device, property, false);
}

static indigo_result client_delete(indigo_client *client, indigo_device *device, indigo_property *property, const char *message) {
	pthread_mutex_lock(&observation_mutex);
	int index = focuser_by_name(property->device);
	if (index >= 0) {
		for (int i = 0; i < PROPERTIES; i++) {
			observed_property *slot = observed[index].properties + i;
			if (slot->name[0] && (!property->name[0] || !strcmp(slot->name, property->name))) {
				slot->defined = false;
			}
		}
	}
	pthread_mutex_unlock(&observation_mutex);
	return INDIGO_OK;
}

static indigo_result client_message(indigo_client *client, indigo_device *device, indigo_property *property, const char *message) {
	if (property == NULL || message == NULL) {
		return INDIGO_OK;
	}
	pthread_mutex_lock(&observation_mutex);
	int index = focuser_by_name(property->device);
	observed_property *slot = index < 0 ? NULL : property_slot(index, property->name, true);
	if (slot) {
		snprintf(slot->message, sizeof(slot->message), "%s", message);
	}
	pthread_mutex_unlock(&observation_mutex);
	return INDIGO_OK;
}

static indigo_client test_client = { .name = "Astroasis focuser SDK test", .version = INDIGO_VERSION_CURRENT, .define_property = client_define, .update_property = client_update, .delete_property = client_delete, .send_message = client_message, .force_property_updates = true };

static indigo_property *snapshot(int index, const char *name) {
	pthread_mutex_lock(&observation_mutex);
	observed_property *slot = property_slot(index, name, false);
	indigo_property *copy = slot && slot->copy ? indigo_copy_property(NULL, slot->copy) : NULL;
	pthread_mutex_unlock(&observation_mutex);
	return copy;
}

static bool is_defined(int index, const char *name) {
	pthread_mutex_lock(&observation_mutex);
	observed_property *slot = property_slot(index, name, false);
	bool defined = slot && slot->defined;
	pthread_mutex_unlock(&observation_mutex);
	return defined;
}

static int revision(int index, const char *name) {
	pthread_mutex_lock(&observation_mutex);
	observed_property *slot = property_slot(index, name, false);
	int value = slot ? slot->revision : 0;
	pthread_mutex_unlock(&observation_mutex);
	return value;
}

static int update_count(int index, const char *name) {
	pthread_mutex_lock(&observation_mutex);
	observed_property *slot = property_slot(index, name, false);
	int value = slot ? slot->updates : 0;
	pthread_mutex_unlock(&observation_mutex);
	return value;
}

static int state_revision(int index, const char *name, indigo_property_state state) {
	pthread_mutex_lock(&observation_mutex);
	observed_property *slot = property_slot(index, name, false);
	int value = slot ? slot->state_revisions[state & 3] : 0;
	pthread_mutex_unlock(&observation_mutex);
	return value;
}

static int state(int index, const char *name) {
	indigo_property *property = snapshot(index, name);
	int value = property ? (int)property->state : -1;
	indigo_release_property(property);
	return value;
}

static void message(int index, const char *name, char *buffer) {
	pthread_mutex_lock(&observation_mutex);
	observed_property *slot = property_slot(index, name, false);
	snprintf(buffer, INDIGO_VALUE_SIZE, "%s", slot ? slot->message : "");
	pthread_mutex_unlock(&observation_mutex);
}

static indigo_item *find_item(indigo_property *property, const char *item) {
	for (int i = 0; property && i < property->count; i++) {
		if (!strcmp(property->items[i].name, item)) {
			return property->items + i;
		}
	}
	return NULL;
}

static double number(int index, const char *name, const char *item_name, bool target) {
	indigo_property *property = snapshot(index, name);
	indigo_item *item = find_item(property, item_name);
	double value = item ? (target ? item->number.target : item->number.value) : NAN;
	indigo_release_property(property);
	return value;
}

static int switch_value(int index, const char *name, const char *item_name) {
	indigo_property *property = snapshot(index, name);
	indigo_item *item = find_item(property, item_name);
	int value = item ? item->sw.value : -1;
	indigo_release_property(property);
	return value;
}

static void text(int index, const char *name, const char *item_name, char *buffer) {
	indigo_property *property = snapshot(index, name);
	indigo_item *item = find_item(property, item_name);
	snprintf(buffer, INDIGO_VALUE_SIZE, "%s", item ? item->text.value : "");
	indigo_release_property(property);
}

static bool wait_for(bool (*predicate)(void *), void *data, const char *what) {
	for (int i = 0; i < WAIT_STEPS; i++) {
		if (predicate(data)) {
			return true;
		}
		indigo_usleep(10000);
	}
	fprintf(stderr, "timeout waiting for %s\n", what);
	return false;
}

static bool wait_count(atomic_int *counter, int expected) {
	for (int i = 0; i < WAIT_STEPS; i++) {
		if (atomic_load(counter) == expected) {
			return true;
		}
		indigo_usleep(10000);
	}
	fprintf(stderr, "counter expected %d, got %d\n", expected, atomic_load(counter));
	return false;
}

static int fake_calls(int index, int call) {
	pthread_mutex_lock(&sdk_mutex);
	int value = fakes[index].calls[call];
	pthread_mutex_unlock(&sdk_mutex);
	return value;
}

static bool wait_calls(int index, int call, int expected) {
	for (int i = 0; i < WAIT_STEPS; i++) {
		if (fake_calls(index, call) >= expected) {
			return true;
		}
		indigo_usleep(10000);
	}
	fprintf(stderr, "focuser %d %s calls expected >= %d, got %d\n", index, call_names[call], expected, fake_calls(index, call));
	return false;
}

static bool wait_state_after(int index, const char *name, int after, int expected) {
	for (int i = 0; i < WAIT_STEPS; i++) {
		int current = state(index, name);
		if (revision(index, name) > after && current == expected) {
			return true;
		}
		indigo_usleep(10000);
	}
	fprintf(stderr, "focuser %d %s expected state %d after revision %d, got state %d revision %d\n", index, name, expected, after, state(index, name), revision(index, name));
	return false;
}

static bool wait_defined(int index, const char *name, bool defined) {
	for (int i = 0; i < WAIT_STEPS; i++) {
		if (is_defined(index, name) == defined) {
			return true;
		}
		indigo_usleep(10000);
	}
	fprintf(stderr, "focuser %d %s expected defined %d\n", index, name, defined);
	return false;
}

static bool change_switch(int index, const char *property, const char *item) {
	return indigo_change_switch_property_1(&test_client, observed[index].name, property, item, true) == INDIGO_OK;
}

static bool change_number(int index, const char *property, const char *item, double value) {
	return indigo_change_number_property_1(&test_client, observed[index].name, property, item, value) == INDIGO_OK;
}

static bool change_text(int index, const char *property, const char *item, const char *value) {
	return indigo_change_text_property_1(&test_client, observed[index].name, property, item, value) == INDIGO_OK;
}

static bool set_switch_and_wait(int index, const char *property, const char *item, int expected) {
	int before = revision(index, property);
	return change_switch(index, property, item) && wait_state_after(index, property, before, expected);
}

static bool set_number_and_wait(int index, const char *property, const char *item, double value, int expected) {
	int before = revision(index, property);
	return change_number(index, property, item, value) && wait_state_after(index, property, before, expected);
}

static bool set_text_and_wait(int index, const char *property, const char *item, const char *value, int expected) {
	int before = revision(index, property);
	return change_text(index, property, item, value) && wait_state_after(index, property, before, expected);
}

static bool connect_focuser(int index, bool connect) {
	int before = revision(index, CONNECTION_PROPERTY_NAME);
	if (!change_switch(index, CONNECTION_PROPERTY_NAME, connect ? CONNECTION_CONNECTED_ITEM_NAME : CONNECTION_DISCONNECTED_ITEM_NAME)) {
		return false;
	}
	for (int i = 0; i < WAIT_STEPS; i++) {
		int current = state(index, CONNECTION_PROPERTY_NAME);
		if (revision(index, CONNECTION_PROPERTY_NAME) > before && current != INDIGO_BUSY_STATE) {
			return current == INDIGO_OK_STATE && switch_value(index, CONNECTION_PROPERTY_NAME, CONNECTION_CONNECTED_ITEM_NAME) == connect;
		}
		indigo_usleep(10000);
	}
	fprintf(stderr, "focuser %d connection %d timed out\n", index, connect);
	return false;
}

static bool wait_updates(int index, const char *name, int after, int count) {
	for (int i = 0; i < WAIT_STEPS; i++) {
		if (update_count(index, name) >= after + count) {
			return true;
		}
		indigo_usleep(10000);
	}
	fprintf(stderr, "focuser %d %s expected %d updates after %d, got %d\n", index, name, count, after, update_count(index, name));
	return false;
}

static bool connect_and_wait_position(int index) {
	int position = update_count(index, FOCUSER_POSITION_PROPERTY_NAME), temperature = update_count(index, FOCUSER_TEMPERATURE_PROPERTY_NAME);
	if (!connect_focuser(index, true) || !wait_updates(index, FOCUSER_POSITION_PROPERTY_NAME, position, 1) || !wait_updates(index, FOCUSER_TEMPERATURE_PROPERTY_NAME, temperature, 1)) {
		return false;
	}
	return state(index, FOCUSER_POSITION_PROPERTY_NAME) == INDIGO_OK_STATE;
}

static void reset_fake(int index, bool present) {
	fake_focuser *fake = fakes + index;
	memset(fake, 0, sizeof(*fake));
	fake->usb_present = fake->visible = present;
	fake->firmware = 0x01020300;
	fake->config.maxStep = 10000;
	fake->config.backlash = 12;
	fake->config.backlashDirection = 1;
	fake->config.beepOnStartup = 1;
	fake->config.bluetoothOn = 1;
	snprintf(fake->model, sizeof(fake->model), "Oasis Focuser AO-F%d", index);
	snprintf(fake->friendly, sizeof(fake->friendly), "F%d", index);
	snprintf(fake->bluetooth, sizeof(fake->bluetooth), "OasisBT%d", index);
	fake->position = fake->target = 250;
	fake->motion_polls = 2;
	fake->temperature_int = 2000;
	fake->temperature_ext = (int)TEMPERATURE_INVALID;
}

static void reset_all(int present) {
	pthread_mutex_lock(&sdk_mutex);
	for (int i = 0; i < FOCUSERS; i++) {
		reset_fake(i, i < present);
	}
	pthread_mutex_unlock(&sdk_mutex);
	pthread_mutex_lock(&observation_mutex);
	for (int i = 0; i < FOCUSERS; i++) {
		for (int j = 0; j < PROPERTIES; j++) {
			indigo_release_property(observed[i].properties[j].copy);
		}
		memset(observed + i, 0, sizeof(observed[i]));
	}
	pthread_mutex_unlock(&observation_mutex);
	pthread_mutex_lock(&trace_mutex);
	trace_length = 0;
	trace_text[0] = 0;
	trace_recent_count = 0;
	pthread_mutex_unlock(&trace_mutex);
	usb_callback = NULL;
	atomic_store(&trace_enabled, false);
	atomic_store(&usb_ref_balance, 0);
	atomic_store(&usb_register_calls, 0);
	atomic_store(&usb_deregister_calls, 0);
	atomic_store(&usb_register_error, 0);
	atomic_store(&attached, 0);
	atomic_store(&attach_attempts, 0);
	atomic_store(&fail_attach, 0);
	atomic_store(&invalid_detach, 0);
	atomic_store(&attach_after_shutdown, 0);
	atomic_store(&lock_count, 0);
	atomic_store(&fail_lock, 0);
	atomic_store(&sdk_after_close, 0);
	atomic_store(&concurrent_calls, 0);
	atomic_store(&late_updates, 0);
	atomic_store(&last_probe, -1);
	atomic_store(&scan_reverse, false);
	atomic_store(&hold_status, false);
	atomic_store(&status_waiting, false);
	atomic_store(&driver_stopped, false);
}

static void set_error(int index, int call, int error, int skip) {
	pthread_mutex_lock(&sdk_mutex);
	fakes[index].error[call] = error;
	fakes[index].error_skip[call] = skip;
	pthread_mutex_unlock(&sdk_mutex);
}

static void set_hold_motion(int index, bool hold) {
	pthread_mutex_lock(&sdk_mutex);
	fakes[index].hold_motion = hold;
	pthread_mutex_unlock(&sdk_mutex);
}

static void set_status_errors_after_stop(int index, int count) {
	pthread_mutex_lock(&sdk_mutex);
	fakes[index].pending_status_errors_after_stop = count;
	pthread_mutex_unlock(&sdk_mutex);
}

static int status_calls_after_stop(int index) {
	pthread_mutex_lock(&sdk_mutex);
	int count = fakes[index].status_calls_after_stop;
	pthread_mutex_unlock(&sdk_mutex);
	return count;
}

static int fake_int(int index, size_t offset) {
	pthread_mutex_lock(&sdk_mutex);
	int value = *(int *)((char *)(fakes + index) + offset);
	pthread_mutex_unlock(&sdk_mutex);
	return value;
}

static void set_fake_int(int index, size_t offset, int value) {
	pthread_mutex_lock(&sdk_mutex);
	*(int *)((char *)(fakes + index) + offset) = value;
	pthread_mutex_unlock(&sdk_mutex);
}

static bool fake_opened(int index) {
	pthread_mutex_lock(&sdk_mutex);
	bool value = fakes[index].opened;
	pthread_mutex_unlock(&sdk_mutex);
	return value;
}

#define FAKE(index, field) fake_int(index, offsetof(fake_focuser, field))
#define SET_FAKE(index, field, value) set_fake_int(index, offsetof(fake_focuser, field), value)

static void usb_event(int index, bool arrive) {
	pthread_mutex_lock(&sdk_mutex);
	if (arrive && !fakes[index].usb_present) {
		fakes[index].generation = (fakes[index].generation + 1) % 16;
	}
	fakes[index].usb_present = fakes[index].visible = arrive;
	pthread_mutex_unlock(&sdk_mutex);
	usb_callback(NULL, (libusb_device *)&usb_devices[index], arrive ? LIBUSB_HOTPLUG_EVENT_DEVICE_ARRIVED : LIBUSB_HOTPLUG_EVENT_DEVICE_LEFT, NULL);
}

static bool start_driver(int present) {
	reset_all(present);
	if (indigo_focuser_astroasis(INDIGO_DRIVER_INIT, NULL) != INDIGO_OK) {
		return false;
	}
	return wait_count(&attached, present);
}

static void stop_driver(void) {
	atomic_store(&hold_status, false);
	for (int i = 0; i < FOCUSERS; i++) {
		pthread_mutex_lock(&sdk_mutex);
		memset(fakes[i].error, 0, sizeof(fakes[i].error));
		fakes[i].hold_motion = false;
		pthread_mutex_unlock(&sdk_mutex);
	}
	for (int i = 0; i < FOCUSERS; i++) {
		pthread_mutex_lock(&observation_mutex);
		bool connected = observed[i].name[0] && observed[i].connected;
		pthread_mutex_unlock(&observation_mutex);
		if (connected && !connect_focuser(i, false)) {
			fprintf(stderr, "cleanup failed to disconnect focuser %d\n", i);
			indigo_test_failures++;
		}
	}
	atomic_store(&trace_enabled, false);
	if (indigo_focuser_astroasis(INDIGO_DRIVER_SHUTDOWN, NULL) != INDIGO_OK) {
		fprintf(stderr, "cleanup shutdown failed\n");
		indigo_test_failures++;
	}
	atomic_store(&driver_stopped, true);
	indigo_usleep((useconds_t)(scaled(1.5) * 1000000));
	if (atomic_load(&attached) > 0) {
		atomic_store(&driver_stopped, false);
		indigo_focuser_astroasis(INDIGO_DRIVER_INIT, NULL);
		indigo_usleep((useconds_t)(scaled(1.5) * 1000000));
		indigo_focuser_astroasis(INDIGO_DRIVER_SHUTDOWN, NULL);
		atomic_store(&driver_stopped, true);
	}
}

static void finish_test(void) {
	stop_driver();
	EXPECT_EQ(0, atomic_load(&attached));
	EXPECT_EQ(0, atomic_load(&lock_count));
	EXPECT_EQ(0, atomic_load(&usb_ref_balance));
	EXPECT_EQ(0, atomic_load(&sdk_after_close));
	EXPECT_EQ(0, atomic_load(&late_updates));
	EXPECT_EQ(0, atomic_load(&concurrent_calls));
	EXPECT_EQ(0, atomic_load(&invalid_detach));
	EXPECT_EQ(0, atomic_load(&attach_after_shutdown));
	for (int i = 0; i < FOCUSERS; i++) {
		EXPECT_EQ(false, fake_opened(i));
	}
}

// Preservation tests

static void metadata_and_property_inventory(void) {
	typedef struct {
		const char *name;
		indigo_property_type type;
		indigo_property_perm perm;
		indigo_rule rule;
		const char *group;
		const char *label;
		int count;
		const char *items[2];
	} custom_property;
	const custom_property custom[] = {
		{ BEEP_ON_POWER_UP_NAME, INDIGO_SWITCH_VECTOR, INDIGO_RW_PERM, INDIGO_ONE_OF_MANY_RULE, "Advanced", "Beep on power up", 2, { "ON", "OFF" } },
		{ BEEP_ON_MOVE_NAME, INDIGO_SWITCH_VECTOR, INDIGO_RW_PERM, INDIGO_ONE_OF_MANY_RULE, "Advanced", "Beep on move", 2, { "ON", "OFF" } },
		{ BACKLASH_DIRECTION_NAME, INDIGO_SWITCH_VECTOR, INDIGO_RW_PERM, INDIGO_ONE_OF_MANY_RULE, FOCUSER_MAIN_GROUP, "Backlash compensation overshot direction", 2, { "INWARD", "OUTWARD" } },
		{ CUSTOM_SUFFIX_NAME, INDIGO_TEXT_VECTOR, INDIGO_RW_PERM, 0, "Advanced", "Device name custom suffix", 1, { "SUFFIX" } },
		{ BLUETOOTH_NAME, INDIGO_SWITCH_VECTOR, INDIGO_RW_PERM, INDIGO_ONE_OF_MANY_RULE, "Advanced", "Bluetooth", 2, { "ENABLED", "DISABLED" } },
		{ BLUETOOTH_NAME_NAME, INDIGO_TEXT_VECTOR, INDIGO_RW_PERM, 0, "Advanced", "Bluetooth name", 1, { "BLUETOOTH_NAME" } },
		{ FACTORY_RESET_NAME, INDIGO_SWITCH_VECTOR, INDIGO_RW_PERM, INDIGO_ANY_OF_MANY_RULE, "Advanced", "Factory reset", 1, { "RESET" } },
		{ BOARD_TEMPERATURE_NAME, INDIGO_NUMBER_VECTOR, INDIGO_RO_PERM, 0, FOCUSER_MAIN_GROUP, "Temperature 1 (Board)", 1, { "Internal Temp." } }
	};
	const char *before[] = { INFO_PROPERTY_NAME, CONFIG_PROPERTY_NAME, PROFILE_PROPERTY_NAME, PROFILE_NAME_PROPERTY_NAME, CONNECTION_PROPERTY_NAME };
	const char *hidden[] = { SIMULATION_PROPERTY_NAME, DEVICE_PORT_PROPERTY_NAME, DEVICE_PORTS_PROPERTY_NAME, AUTHENTICATION_PROPERTY_NAME, ADDITIONAL_INSTANCES_PROPERTY_NAME, FOCUSER_POSITION_PROPERTY_NAME, FOCUSER_STEPS_PROPERTY_NAME, FOCUSER_SPEED_PROPERTY_NAME, FOCUSER_LIMITS_PROPERTY_NAME };
	const char *connected[] = { FOCUSER_LIMITS_PROPERTY_NAME, FOCUSER_BACKLASH_PROPERTY_NAME, FOCUSER_POSITION_PROPERTY_NAME, FOCUSER_STEPS_PROPERTY_NAME, FOCUSER_ON_POSITION_SET_PROPERTY_NAME, FOCUSER_TEMPERATURE_PROPERTY_NAME, FOCUSER_REVERSE_MOTION_PROPERTY_NAME, FOCUSER_COMPENSATION_PROPERTY_NAME, FOCUSER_MODE_PROPERTY_NAME, FOCUSER_DIRECTION_PROPERTY_NAME, FOCUSER_ABORT_MOTION_PROPERTY_NAME };
	indigo_property *property = NULL;
	char buffer[INDIGO_VALUE_SIZE];
	indigo_driver_info info = { 0 };
	CHECK_EQ(INDIGO_OK, indigo_focuser_astroasis(INDIGO_DRIVER_INFO, &info));
	CHECK_STR("indigo_focuser_astroasis", info.name);
	CHECK_STR("Astroasis Oasis Focuser", info.description);
	CHECK_EQ(EXPECTED_VERSION, info.version);
	CHECK(!info.multi_device_support);
	reset_all(2);
	snprintf(fakes[1].friendly, sizeof(fakes[1].friendly), "%s", "");
	CHECK_EQ(INDIGO_OK, indigo_focuser_astroasis(INDIGO_DRIVER_INIT, NULL));
	CHECK(wait_count(&attached, 2));
	CHECK_STR("Oasis Focuser #F0", observed[0].name);
	CHECK_STR("Oasis Focuser", observed[1].name);
	for (int i = 0; i < ARRAY_SIZE(before); i++) {
		CHECK(is_defined(0, before[i]));
	}
	for (int i = 0; i < ARRAY_SIZE(hidden); i++) {
		CHECK(!is_defined(0, hidden[i]));
	}
	for (int i = 0; i < ARRAY_SIZE(custom); i++) {
		CHECK(!is_defined(0, custom[i].name));
	}
	property = snapshot(0, INFO_PROPERTY_NAME);
	CHECK(property != NULL);
	CHECK_EQ(7, property->count);
	CHECK_STR("Oasis Focuser AO-F0", find_item(property, INFO_DEVICE_MODEL_ITEM_NAME)->text.value);
	CHECK_STR("1.2.3", find_item(property, INFO_DEVICE_FW_REVISION_ITEM_NAME)->text.value);
	CHECK_STR("3.2.1-fake", find_item(property, INFO_DEVICE_HW_REVISION_ITEM_NAME)->text.value);
	CHECK_STR("SDK version", find_item(property, INFO_DEVICE_HW_REVISION_ITEM_NAME)->label);
	snprintf(buffer, sizeof(buffer), "%d", INDIGO_INTERFACE_FOCUSER);
	CHECK_STR(buffer, find_item(property, INFO_DEVICE_INTERFACE_ITEM_NAME)->text.value);
	indigo_release_property(property);
	property = NULL;
	CHECK(connect_and_wait_position(0));
	for (int i = 0; i < ARRAY_SIZE(connected); i++) {
		CHECK(is_defined(0, connected[i]));
	}
	CHECK(!is_defined(0, FOCUSER_SPEED_PROPERTY_NAME));
	for (int i = 0; i < ARRAY_SIZE(custom); i++) {
		CHECK(is_defined(0, custom[i].name));
		property = snapshot(0, custom[i].name);
		CHECK(property != NULL);
		CHECK_EQ(custom[i].type, property->type);
		CHECK_EQ(custom[i].perm, property->perm);
		if (custom[i].type == INDIGO_SWITCH_VECTOR) {
			CHECK_EQ(custom[i].rule, property->rule);
		}
		CHECK_STR(custom[i].group, property->group);
		CHECK_STR(custom[i].label, property->label);
		CHECK_EQ(custom[i].count, property->count);
		for (int j = 0; j < custom[i].count; j++) {
			CHECK_STR(custom[i].items[j], property->items[j].name);
		}
		indigo_release_property(property);
		property = NULL;
	}
	property = snapshot(0, FACTORY_RESET_NAME);
	CHECK_STR("warn_on_set:\"Confirm focuser factory reset?\";", property->items[0].hints);
	indigo_release_property(property);
	property = snapshot(0, BOARD_TEMPERATURE_NAME);
	CHECK_NEAR(-50, property->items[0].number.min, 0);
	CHECK_NEAR(50, property->items[0].number.max, 0);
	indigo_release_property(property);
	property = snapshot(0, FOCUSER_POSITION_PROPERTY_NAME);
	CHECK_EQ(INDIGO_RW_PERM, property->perm);
	CHECK_NEAR(0, property->items[0].number.min, 0);
	CHECK_NEAR(10000, property->items[0].number.max, 0);
	CHECK_NEAR(1, property->items[0].number.step, 0);
	CHECK_NEAR(250, property->items[0].number.value, 0);
	indigo_release_property(property);
	property = snapshot(0, FOCUSER_STEPS_PROPERTY_NAME);
	CHECK_NEAR(0, property->items[0].number.min, 0);
	CHECK_NEAR(10000, property->items[0].number.max, 0);
	indigo_release_property(property);
	property = snapshot(0, FOCUSER_LIMITS_PROPERTY_NAME);
	CHECK_NEAR(0x7fffffff, find_item(property, FOCUSER_LIMITS_MAX_POSITION_ITEM_NAME)->number.max, 0);
	CHECK_NEAR(10000, find_item(property, FOCUSER_LIMITS_MAX_POSITION_ITEM_NAME)->number.value, 0);
	CHECK_NEAR(0, find_item(property, FOCUSER_LIMITS_MIN_POSITION_ITEM_NAME)->number.max, 0);
	indigo_release_property(property);
	property = snapshot(0, FOCUSER_BACKLASH_PROPERTY_NAME);
	CHECK_NEAR(0, property->items[0].number.min, 0);
	CHECK_NEAR(10000, property->items[0].number.max, 0);
	CHECK_NEAR(12, property->items[0].number.value, 0);
	indigo_release_property(property);
	property = snapshot(0, FOCUSER_COMPENSATION_PROPERTY_NAME);
	CHECK_EQ(2, property->count);
	CHECK_NEAR(-10000, property->items[0].number.min, 0);
	CHECK_NEAR(10000, property->items[0].number.max, 0);
	indigo_release_property(property);
	property = snapshot(0, FOCUSER_TEMPERATURE_PROPERTY_NAME);
	CHECK_STR("Temperature 2 (Ambient)", property->label);
	indigo_release_property(property);
	property = NULL;
	CHECK_EQ(true, switch_value(0, FOCUSER_REVERSE_MOTION_PROPERTY_NAME, FOCUSER_REVERSE_MOTION_DISABLED_ITEM_NAME));
	CHECK_EQ(true, switch_value(0, BEEP_ON_POWER_UP_NAME, "ON"));
	CHECK_EQ(true, switch_value(0, BEEP_ON_MOVE_NAME, "OFF"));
	CHECK_EQ(true, switch_value(0, BACKLASH_DIRECTION_NAME, "OUTWARD"));
	CHECK_EQ(true, switch_value(0, BLUETOOTH_NAME, "ENABLED"));
	text(0, BLUETOOTH_NAME_NAME, "BLUETOOTH_NAME", buffer);
	CHECK_STR("OasisBT0", buffer);
	text(0, CUSTOM_SUFFIX_NAME, "SUFFIX", buffer);
	CHECK_STR("F0", buffer);
	CHECK(connect_focuser(0, false));
	for (int i = 0; i < ARRAY_SIZE(custom); i++) {
		CHECK(!is_defined(0, custom[i].name));
	}
	CHECK(!is_defined(0, FOCUSER_POSITION_PROPERTY_NAME));
cleanup:
	indigo_release_property(property);
	finish_test();
}

static void discovery_probe_order_and_failures(void) {
	const int failures[] = { FN_OPEN, FN_VERSION, FN_MODEL, FN_FRIENDLY_GET, FN_BLUETOOTH_GET, FN_CONFIG_GET };
	char log[4096];
	CHECK(start_driver(1));
	pthread_mutex_lock(&sdk_mutex);
	snprintf(log, sizeof(log), "%s", fakes[0].call_log);
	pthread_mutex_unlock(&sdk_mutex);
	CHECK_STR("Open,GetVersion,GetProductModel,GetFriendlyName,GetBluetoothName,GetConfig,Close", log);
	finish_test();
	for (int i = 0; i < ARRAY_SIZE(failures); i++) {
		reset_all(1);
		set_error(0, failures[i], AO_ERROR_COMMUNICATION, 0);
		CHECK_EQ(INDIGO_OK, indigo_focuser_astroasis(INDIGO_DRIVER_INIT, NULL));
		CHECK(wait_calls(0, failures[i], 1));
		indigo_usleep((useconds_t)(scaled(1.5) * 1000000));
		CHECK_EQ(0, atomic_load(&attached));
		CHECK(!fake_opened(0));
		CHECK_EQ(failures[i] == FN_OPEN ? 0 : fake_calls(0, FN_OPEN), fake_calls(0, FN_CLOSE));
		set_error(0, failures[i], 0, 0);
		usb_event(0, true);
		CHECK(wait_count(&attached, 1));
		CHECK_STR("Oasis Focuser #F0", observed[0].name);
		finish_test();
	}
	return;
cleanup:
	finish_test();
}

static void multiple_focusers_and_removal(void) {
	char name[INDIGO_NAME_SIZE];
	reset_all(3);
	snprintf(fakes[1].friendly, sizeof(fakes[1].friendly), "%s", "F0");
	fakes[2].friendly[0] = 0;
	atomic_store(&scan_reverse, true);
	CHECK_EQ(INDIGO_OK, indigo_focuser_astroasis(INDIGO_DRIVER_INIT, NULL));
	CHECK(wait_count(&attached, 3));
	CHECK(!strncmp(observed[0].name, "Oasis Focuser #F0", 17));
	CHECK(!strncmp(observed[1].name, "Oasis Focuser #F0", 17));
	CHECK(strcmp(observed[0].name, observed[1].name));
	CHECK_STR("Oasis Focuser", observed[2].name);
	int attempts = atomic_load(&attach_attempts), probes = fake_calls(2, FN_OPEN);
	usb_event(2, true);
	indigo_usleep((useconds_t)(scaled(3) * 1000000));
	CHECK_EQ(attempts, atomic_load(&attach_attempts));
	CHECK_EQ(probes, fake_calls(2, FN_OPEN));
	CHECK_EQ(3, atomic_load(&attached));
	CHECK(connect_and_wait_position(0));
	CHECK(connect_and_wait_position(2));
	CHECK(set_number_and_wait(2, FOCUSER_POSITION_PROPERTY_NAME, FOCUSER_POSITION_ITEM_NAME, 777, INDIGO_OK_STATE));
	CHECK_EQ(777, FAKE(2, position));
	CHECK_EQ(0, fake_calls(0, FN_MOVE_TO));
	usb_event(1, false);
	CHECK(wait_count(&attached, 2));
	CHECK(observed[1].name[0] == 0);
	CHECK(observed[0].connected && observed[2].connected);
	CHECK_EQ(INDIGO_OK_STATE, state(0, CONNECTION_PROPERTY_NAME));
	snprintf(fakes[1].friendly, sizeof(fakes[1].friendly), "%s", "New");
	usb_event(1, true);
	CHECK(wait_count(&attached, 3));
	snprintf(name, sizeof(name), "%s", observed[1].name);
	CHECK_STR("Oasis Focuser #New", name);
	CHECK(set_number_and_wait(0, FOCUSER_POSITION_PROPERTY_NAME, FOCUSER_POSITION_ITEM_NAME, 900, INDIGO_OK_STATE));
	CHECK_EQ(900, FAKE(0, position));
cleanup:
	finish_test();
}

static void connection_lifecycle_and_shutdown(void) {
	CHECK(start_driver(1));
	int opens = fake_calls(0, FN_OPEN), closes = fake_calls(0, FN_CLOSE), configs = fake_calls(0, FN_CONFIG_GET), names = fake_calls(0, FN_BLUETOOTH_GET);
	CHECK(connect_and_wait_position(0));
	CHECK_EQ(opens + 1, fake_calls(0, FN_OPEN));
	CHECK_EQ(configs + 2, fake_calls(0, FN_CONFIG_GET));
	CHECK_EQ(names + 1, fake_calls(0, FN_BLUETOOTH_GET));
	CHECK_EQ(1, atomic_load(&lock_count));
	CHECK(fake_opened(0));
	CHECK(connect_focuser(0, false));
	CHECK_EQ(1, fake_calls(0, FN_STOP));
	CHECK_EQ(closes + 1, fake_calls(0, FN_CLOSE));
	CHECK_EQ(0, atomic_load(&lock_count));
	CHECK(!fake_opened(0));
	CHECK(!is_defined(0, BEEP_ON_MOVE_NAME));
	CHECK(connect_and_wait_position(0));
	CHECK(fake_opened(0));
	CHECK_EQ(INDIGO_BUSY, indigo_focuser_astroasis(INDIGO_DRIVER_SHUTDOWN, NULL));
	CHECK_EQ(1, atomic_load(&attached));
	CHECK(fake_opened(0));
	CHECK(connect_focuser(0, false));
	CHECK_EQ(INDIGO_OK, indigo_focuser_astroasis(INDIGO_DRIVER_SHUTDOWN, NULL));
	CHECK(wait_count(&attached, 0));
	CHECK_EQ(INDIGO_OK, indigo_focuser_astroasis(INDIGO_DRIVER_SHUTDOWN, NULL));
	CHECK_EQ(1, atomic_load(&usb_deregister_calls));
	CHECK_EQ(INDIGO_OK, indigo_focuser_astroasis(INDIGO_DRIVER_INIT, NULL));
	CHECK(wait_count(&attached, 1));
	CHECK(connect_and_wait_position(0));
	CHECK(connect_focuser(0, false));
cleanup:
	finish_test();
}

static void goto_sync_and_noop(void) {
	CHECK(start_driver(1));
	CHECK(connect_and_wait_position(0));
	CHECK_NEAR(250, number(0, FOCUSER_POSITION_PROPERTY_NAME, FOCUSER_POSITION_ITEM_NAME, false), 0);
	int busy = state_revision(0, FOCUSER_POSITION_PROPERTY_NAME, INDIGO_BUSY_STATE);
	CHECK(set_number_and_wait(0, FOCUSER_POSITION_PROPERTY_NAME, FOCUSER_POSITION_ITEM_NAME, 1500, INDIGO_OK_STATE));
	CHECK(state_revision(0, FOCUSER_POSITION_PROPERTY_NAME, INDIGO_BUSY_STATE) > busy);
	CHECK_EQ(1, fake_calls(0, FN_MOVE_TO));
	CHECK_EQ(1500, FAKE(0, last_move_to));
	CHECK_NEAR(1500, number(0, FOCUSER_POSITION_PROPERTY_NAME, FOCUSER_POSITION_ITEM_NAME, false), 0);
	CHECK_EQ(INDIGO_OK_STATE, state(0, FOCUSER_STEPS_PROPERTY_NAME));
	CHECK(set_number_and_wait(0, FOCUSER_POSITION_PROPERTY_NAME, FOCUSER_POSITION_ITEM_NAME, 1500, INDIGO_OK_STATE));
	CHECK_EQ(1, fake_calls(0, FN_MOVE_TO));
	CHECK(set_switch_and_wait(0, FOCUSER_ON_POSITION_SET_PROPERTY_NAME, FOCUSER_ON_POSITION_SET_SYNC_ITEM_NAME, INDIGO_OK_STATE));
	CHECK(set_number_and_wait(0, FOCUSER_POSITION_PROPERTY_NAME, FOCUSER_POSITION_ITEM_NAME, 4000, INDIGO_OK_STATE));
	CHECK_EQ(1, fake_calls(0, FN_SYNC));
	CHECK_EQ(4000, FAKE(0, last_sync));
	CHECK_EQ(1, fake_calls(0, FN_MOVE_TO));
	CHECK_EQ(0, fake_calls(0, FN_MOVE));
	CHECK_NEAR(4000, number(0, FOCUSER_POSITION_PROPERTY_NAME, FOCUSER_POSITION_ITEM_NAME, false), 0);
	set_error(0, FN_SYNC, AO_ERROR_COMMUNICATION, 0);
	CHECK(set_number_and_wait(0, FOCUSER_POSITION_PROPERTY_NAME, FOCUSER_POSITION_ITEM_NAME, 4100, INDIGO_ALERT_STATE));
	CHECK_EQ(4000, FAKE(0, position));
	CHECK_NEAR(4000, number(0, FOCUSER_POSITION_PROPERTY_NAME, FOCUSER_POSITION_ITEM_NAME, false), 0);
	set_error(0, FN_SYNC, 0, 0);
	set_error(0, FN_STATUS, AO_ERROR_TIMEOUT, 0);
	CHECK(set_number_and_wait(0, FOCUSER_POSITION_PROPERTY_NAME, FOCUSER_POSITION_ITEM_NAME, 4200, INDIGO_ALERT_STATE));
	CHECK_EQ(4200, FAKE(0, position));
	set_error(0, FN_STATUS, 0, 0);
	CHECK(set_number_and_wait(0, FOCUSER_POSITION_PROPERTY_NAME, FOCUSER_POSITION_ITEM_NAME, 4300, INDIGO_OK_STATE));
	CHECK_NEAR(4300, number(0, FOCUSER_POSITION_PROPERTY_NAME, FOCUSER_POSITION_ITEM_NAME, false), 0);
	CHECK(set_switch_and_wait(0, FOCUSER_ON_POSITION_SET_PROPERTY_NAME, FOCUSER_ON_POSITION_SET_GOTO_ITEM_NAME, INDIGO_OK_STATE));
	CHECK(set_number_and_wait(0, FOCUSER_POSITION_PROPERTY_NAME, FOCUSER_POSITION_ITEM_NAME, 100, INDIGO_OK_STATE));
	CHECK_EQ(100, FAKE(0, position));
	CHECK_EQ(4, fake_calls(0, FN_SYNC));
	CHECK_EQ(2, fake_calls(0, FN_MOVE_TO));
cleanup:
	finish_test();
}

static void relative_steps_and_direction(void) {
	CHECK(start_driver(1));
	CHECK(connect_and_wait_position(0));
	CHECK(set_switch_and_wait(0, FOCUSER_DIRECTION_PROPERTY_NAME, FOCUSER_DIRECTION_MOVE_OUTWARD_ITEM_NAME, INDIGO_OK_STATE));
	CHECK(set_number_and_wait(0, FOCUSER_STEPS_PROPERTY_NAME, FOCUSER_STEPS_ITEM_NAME, 200, INDIGO_OK_STATE));
	CHECK_EQ(200, FAKE(0, last_move));
	CHECK_EQ(450, FAKE(0, position));
	CHECK(wait_state_after(0, FOCUSER_POSITION_PROPERTY_NAME, 0, INDIGO_OK_STATE));
	CHECK_NEAR(450, number(0, FOCUSER_POSITION_PROPERTY_NAME, FOCUSER_POSITION_ITEM_NAME, false), 0);
	CHECK(set_switch_and_wait(0, FOCUSER_DIRECTION_PROPERTY_NAME, FOCUSER_DIRECTION_MOVE_INWARD_ITEM_NAME, INDIGO_OK_STATE));
	CHECK(set_number_and_wait(0, FOCUSER_STEPS_PROPERTY_NAME, FOCUSER_STEPS_ITEM_NAME, 100, INDIGO_OK_STATE));
	CHECK_EQ(-100, FAKE(0, last_move));
	CHECK_EQ(350, FAKE(0, position));
	CHECK(set_switch_and_wait(0, FOCUSER_REVERSE_MOTION_PROPERTY_NAME, FOCUSER_REVERSE_MOTION_ENABLED_ITEM_NAME, INDIGO_OK_STATE));
	CHECK(set_number_and_wait(0, FOCUSER_STEPS_PROPERTY_NAME, FOCUSER_STEPS_ITEM_NAME, 50, INDIGO_OK_STATE));
	CHECK_EQ(-50, FAKE(0, last_move));
	CHECK(set_number_and_wait(0, FOCUSER_STEPS_PROPERTY_NAME, FOCUSER_STEPS_ITEM_NAME, 0, INDIGO_OK_STATE));
	CHECK_EQ(4, fake_calls(0, FN_MOVE));
	CHECK_EQ(0, FAKE(0, last_move));
	CHECK_EQ(0, fake_calls(0, FN_MOVE_TO));
cleanup:
	finish_test();
}

static void abort_motion(void) {
	CHECK(start_driver(1));
	CHECK(connect_and_wait_position(0));
	set_hold_motion(0, true);
	int before = revision(0, FOCUSER_POSITION_PROPERTY_NAME);
	CHECK(change_number(0, FOCUSER_POSITION_PROPERTY_NAME, FOCUSER_POSITION_ITEM_NAME, 5000));
	CHECK(wait_state_after(0, FOCUSER_POSITION_PROPERTY_NAME, before, INDIGO_BUSY_STATE));
	CHECK(wait_calls(0, FN_MOVE_TO, 1));
	CHECK(wait_calls(0, FN_STATUS, fake_calls(0, FN_STATUS) + 2));
	CHECK(set_switch_and_wait(0, FOCUSER_ABORT_MOTION_PROPERTY_NAME, FOCUSER_ABORT_MOTION_ITEM_NAME, INDIGO_OK_STATE));
	CHECK_EQ(1, fake_calls(0, FN_STOP));
	CHECK_EQ(false, switch_value(0, FOCUSER_ABORT_MOTION_PROPERTY_NAME, FOCUSER_ABORT_MOTION_ITEM_NAME));
	indigo_usleep((useconds_t)(scaled(1.5) * 1000000));
	CHECK_EQ(INDIGO_OK_STATE, state(0, FOCUSER_POSITION_PROPERTY_NAME));
	CHECK_EQ(INDIGO_OK_STATE, state(0, FOCUSER_STEPS_PROPERTY_NAME));
	CHECK_NEAR(250, number(0, FOCUSER_POSITION_PROPERTY_NAME, FOCUSER_POSITION_ITEM_NAME, false), 0);
	CHECK_EQ(0, FAKE(0, moving));
	set_hold_motion(0, false);
	CHECK(set_number_and_wait(0, FOCUSER_POSITION_PROPERTY_NAME, FOCUSER_POSITION_ITEM_NAME, 800, INDIGO_OK_STATE));
	CHECK_EQ(800, FAKE(0, position));
	CHECK(set_switch_and_wait(0, FOCUSER_ABORT_MOTION_PROPERTY_NAME, FOCUSER_ABORT_MOTION_ITEM_NAME, INDIGO_OK_STATE));
	CHECK_EQ(2, fake_calls(0, FN_STOP));
	set_error(0, FN_STOP, AO_ERROR_COMMUNICATION, 0);
	CHECK(set_switch_and_wait(0, FOCUSER_ABORT_MOTION_PROPERTY_NAME, FOCUSER_ABORT_MOTION_ITEM_NAME, INDIGO_ALERT_STATE));
	CHECK_EQ(INDIGO_OK_STATE, state(0, FOCUSER_POSITION_PROPERTY_NAME));
	set_error(0, FN_STOP, 0, 0);
	CHECK(set_number_and_wait(0, FOCUSER_POSITION_PROPERTY_NAME, FOCUSER_POSITION_ITEM_NAME, 900, INDIGO_OK_STATE));
	CHECK_EQ(900, FAKE(0, position));
cleanup:
	finish_test();
}

static void abort_status_communication_retry(void) {
	CHECK(start_driver(1));
	CHECK(connect_and_wait_position(0));
	set_status_errors_after_stop(0, 2);
	CHECK(set_switch_and_wait(0, FOCUSER_ABORT_MOTION_PROPERTY_NAME, FOCUSER_ABORT_MOTION_ITEM_NAME, INDIGO_OK_STATE));
	CHECK_EQ(3, status_calls_after_stop(0));
	CHECK_EQ(INDIGO_OK_STATE, state(0, FOCUSER_POSITION_PROPERTY_NAME));
	CHECK_EQ(INDIGO_OK_STATE, state(0, FOCUSER_STEPS_PROPERTY_NAME));
	CHECK_EQ(false, switch_value(0, FOCUSER_ABORT_MOTION_PROPERTY_NAME, FOCUSER_ABORT_MOTION_ITEM_NAME));
	set_status_errors_after_stop(0, 3);
	CHECK(set_switch_and_wait(0, FOCUSER_ABORT_MOTION_PROPERTY_NAME, FOCUSER_ABORT_MOTION_ITEM_NAME, INDIGO_OK_STATE));
	CHECK_EQ(3, status_calls_after_stop(0));
	CHECK_EQ(INDIGO_ALERT_STATE, state(0, FOCUSER_POSITION_PROPERTY_NAME));
	CHECK_EQ(INDIGO_OK_STATE, state(0, FOCUSER_STEPS_PROPERTY_NAME));
	CHECK_EQ(false, switch_value(0, FOCUSER_ABORT_MOTION_PROPERTY_NAME, FOCUSER_ABORT_MOTION_ITEM_NAME));
cleanup:
	finish_test();
}

static void motion_poll_failure_and_recovery(void) {
	CHECK(start_driver(1));
	CHECK(connect_and_wait_position(0));
	set_hold_motion(0, true);
	int before = revision(0, FOCUSER_POSITION_PROPERTY_NAME);
	CHECK(change_number(0, FOCUSER_POSITION_PROPERTY_NAME, FOCUSER_POSITION_ITEM_NAME, 3000));
	CHECK(wait_state_after(0, FOCUSER_POSITION_PROPERTY_NAME, before, INDIGO_BUSY_STATE));
	CHECK(wait_calls(0, FN_MOVE_TO, 1));
	before = revision(0, FOCUSER_POSITION_PROPERTY_NAME);
	set_error(0, FN_STATUS, AO_ERROR_COMMUNICATION, 0);
	CHECK(wait_state_after(0, FOCUSER_POSITION_PROPERTY_NAME, before, INDIGO_ALERT_STATE));
	CHECK_EQ(INDIGO_ALERT_STATE, state(0, FOCUSER_STEPS_PROPERTY_NAME));
	set_error(0, FN_STATUS, 0, 0);
	set_hold_motion(0, false);
	CHECK(set_number_and_wait(0, FOCUSER_POSITION_PROPERTY_NAME, FOCUSER_POSITION_ITEM_NAME, 600, INDIGO_OK_STATE));
	CHECK_EQ(600, FAKE(0, position));
	CHECK_EQ(INDIGO_OK_STATE, state(0, FOCUSER_STEPS_PROPERTY_NAME));
cleanup:
	finish_test();
}

static void settings_config_writes(void) {
	typedef struct {
		const char *property;
		const char *item;
		unsigned int mask;
		size_t offset;
		int value;
	} switch_case;
	const switch_case switches[] = {
		{ FOCUSER_REVERSE_MOTION_PROPERTY_NAME, FOCUSER_REVERSE_MOTION_ENABLED_ITEM_NAME, MASK_REVERSE_DIRECTION, offsetof(AOFocuserConfig, reverseDirection), 1 },
		{ FOCUSER_REVERSE_MOTION_PROPERTY_NAME, FOCUSER_REVERSE_MOTION_DISABLED_ITEM_NAME, MASK_REVERSE_DIRECTION, offsetof(AOFocuserConfig, reverseDirection), 0 },
		{ BEEP_ON_POWER_UP_NAME, "OFF", MASK_BEEP_ON_STARTUP, offsetof(AOFocuserConfig, beepOnStartup), 0 },
		{ BEEP_ON_POWER_UP_NAME, "ON", MASK_BEEP_ON_STARTUP, offsetof(AOFocuserConfig, beepOnStartup), 1 },
		{ BEEP_ON_MOVE_NAME, "ON", MASK_BEEP_ON_MOVE, offsetof(AOFocuserConfig, beepOnMove), 1 },
		{ BEEP_ON_MOVE_NAME, "OFF", MASK_BEEP_ON_MOVE, offsetof(AOFocuserConfig, beepOnMove), 0 },
		{ BACKLASH_DIRECTION_NAME, "INWARD", MASK_BACKLASH_DIRECTION, offsetof(AOFocuserConfig, backlashDirection), 0 },
		{ BACKLASH_DIRECTION_NAME, "OUTWARD", MASK_BACKLASH_DIRECTION, offsetof(AOFocuserConfig, backlashDirection), 1 },
		{ BLUETOOTH_NAME, "DISABLED", MASK_BLUETOOTH, offsetof(AOFocuserConfig, bluetoothOn), 0 },
		{ BLUETOOTH_NAME, "ENABLED", MASK_BLUETOOTH, offsetof(AOFocuserConfig, bluetoothOn), 1 }
	};
	CHECK(start_driver(1));
	CHECK(connect_and_wait_position(0));
	for (int i = 0; i < ARRAY_SIZE(switches); i++) {
		int writes = fake_calls(0, FN_CONFIG_SET);
		CHECK(set_switch_and_wait(0, switches[i].property, switches[i].item, INDIGO_OK_STATE));
		CHECK_EQ(writes + 1, fake_calls(0, FN_CONFIG_SET));
		CHECK_EQ(switches[i].mask, FAKE(0, last_config.mask));
		CHECK_EQ(switches[i].value, fake_int(0, offsetof(fake_focuser, config) + switches[i].offset));
		CHECK_EQ(true, switch_value(0, switches[i].property, switches[i].item));
	}
	CHECK(set_number_and_wait(0, FOCUSER_BACKLASH_PROPERTY_NAME, FOCUSER_BACKLASH_ITEM_NAME, 321, INDIGO_OK_STATE));
	CHECK_EQ(MASK_BACKLASH, FAKE(0, last_config.mask));
	CHECK_EQ(321, FAKE(0, config.backlash));
	CHECK_NEAR(321, number(0, FOCUSER_BACKLASH_PROPERTY_NAME, FOCUSER_BACKLASH_ITEM_NAME, false), 0);
	CHECK(set_number_and_wait(0, FOCUSER_LIMITS_PROPERTY_NAME, FOCUSER_LIMITS_MAX_POSITION_ITEM_NAME, 20000, INDIGO_OK_STATE));
	CHECK_EQ(MASK_MAX_STEP, FAKE(0, last_config.mask));
	CHECK_EQ(20000, FAKE(0, config.maxStep));
	CHECK_NEAR(20000, number(0, FOCUSER_LIMITS_PROPERTY_NAME, FOCUSER_LIMITS_MAX_POSITION_ITEM_NAME, false), 0);
	set_error(0, FN_CONFIG_SET, AO_ERROR_COMMUNICATION, 0);
	CHECK(set_number_and_wait(0, FOCUSER_BACKLASH_PROPERTY_NAME, FOCUSER_BACKLASH_ITEM_NAME, 50, INDIGO_ALERT_STATE));
	CHECK_EQ(321, FAKE(0, config.backlash));
	CHECK(set_number_and_wait(0, FOCUSER_LIMITS_PROPERTY_NAME, FOCUSER_LIMITS_MAX_POSITION_ITEM_NAME, 30000, INDIGO_ALERT_STATE));
	CHECK_EQ(20000, FAKE(0, config.maxStep));
	CHECK(set_switch_and_wait(0, FOCUSER_REVERSE_MOTION_PROPERTY_NAME, FOCUSER_REVERSE_MOTION_ENABLED_ITEM_NAME, INDIGO_ALERT_STATE));
	CHECK(set_switch_and_wait(0, BEEP_ON_MOVE_NAME, "ON", INDIGO_ALERT_STATE));
	CHECK(set_switch_and_wait(0, BLUETOOTH_NAME, "DISABLED", INDIGO_ALERT_STATE));
	CHECK_EQ(0, FAKE(0, config.reverseDirection));
	CHECK_EQ(0, FAKE(0, config.beepOnMove));
	CHECK_EQ(1, FAKE(0, config.bluetoothOn));
	set_error(0, FN_CONFIG_SET, 0, 0);
	CHECK(set_number_and_wait(0, FOCUSER_BACKLASH_PROPERTY_NAME, FOCUSER_BACKLASH_ITEM_NAME, 60, INDIGO_OK_STATE));
	CHECK_EQ(60, FAKE(0, config.backlash));
cleanup:
	finish_test();
}

static void suffix_and_bluetooth_name(void) {
	const char *valid[] = { "", "A", "0123456789abcdef0123456789ABCDEF" };
	const char *too_long = "0123456789abcdef0123456789ABCDEFX";
	char buffer[INDIGO_VALUE_SIZE];
	CHECK(start_driver(1));
	CHECK(connect_and_wait_position(0));
	for (int i = 0; i < ARRAY_SIZE(valid); i++) {
		CHECK(set_text_and_wait(0, CUSTOM_SUFFIX_NAME, "SUFFIX", valid[i], INDIGO_OK_STATE));
		CHECK_EQ(i + 1, fake_calls(0, FN_FRIENDLY_SET));
		pthread_mutex_lock(&sdk_mutex);
		snprintf(buffer, sizeof(buffer), "%s", fakes[0].friendly);
		pthread_mutex_unlock(&sdk_mutex);
		CHECK_STR(valid[i], buffer);
		CHECK(set_text_and_wait(0, BLUETOOTH_NAME_NAME, "BLUETOOTH_NAME", valid[i], INDIGO_OK_STATE));
		CHECK_EQ(i + 1, fake_calls(0, FN_BLUETOOTH_SET));
		pthread_mutex_lock(&sdk_mutex);
		snprintf(buffer, sizeof(buffer), "%s", fakes[0].bluetooth);
		pthread_mutex_unlock(&sdk_mutex);
		CHECK_STR(valid[i], buffer);
	}
	CHECK(set_text_and_wait(0, CUSTOM_SUFFIX_NAME, "SUFFIX", too_long, INDIGO_ALERT_STATE));
	CHECK_EQ(3, fake_calls(0, FN_FRIENDLY_SET));
	message(0, CUSTOM_SUFFIX_NAME, buffer);
	CHECK_STR("Custom suffix is too long", buffer);
	CHECK(set_text_and_wait(0, BLUETOOTH_NAME_NAME, "BLUETOOTH_NAME", too_long, INDIGO_ALERT_STATE));
	CHECK_EQ(3, fake_calls(0, FN_BLUETOOTH_SET));
	message(0, BLUETOOTH_NAME_NAME, buffer);
	CHECK_STR("Bluetooth name is too long", buffer);
	set_error(0, FN_FRIENDLY_SET, AO_ERROR_COMMUNICATION, 0);
	set_error(0, FN_BLUETOOTH_SET, AO_ERROR_COMMUNICATION, 0);
	CHECK(set_text_and_wait(0, CUSTOM_SUFFIX_NAME, "SUFFIX", "Bad", INDIGO_ALERT_STATE));
	CHECK(set_text_and_wait(0, BLUETOOTH_NAME_NAME, "BLUETOOTH_NAME", "Bad", INDIGO_ALERT_STATE));
	set_error(0, FN_FRIENDLY_SET, 0, 0);
	set_error(0, FN_BLUETOOTH_SET, 0, 0);
	CHECK(set_text_and_wait(0, CUSTOM_SUFFIX_NAME, "SUFFIX", "Replug", INDIGO_OK_STATE));
	CHECK(connect_focuser(0, false));
	usb_event(0, false);
	CHECK(wait_count(&attached, 0));
	usb_event(0, true);
	CHECK(wait_count(&attached, 1));
	CHECK_STR("Oasis Focuser #Replug", observed[0].name);
cleanup:
	finish_test();
}

static void factory_reset(void) {
	char buffer[INDIGO_VALUE_SIZE];
	CHECK(start_driver(1));
	CHECK(connect_and_wait_position(0));
	CHECK(set_switch_and_wait(0, FACTORY_RESET_NAME, "RESET", INDIGO_OK_STATE));
	CHECK_EQ(1, fake_calls(0, FN_RESET));
	CHECK_EQ(false, switch_value(0, FACTORY_RESET_NAME, "RESET"));
	message(0, FACTORY_RESET_NAME, buffer);
	CHECK_STR("Factory reset completed", buffer);
	set_error(0, FN_RESET, AO_ERROR_COMMUNICATION, 0);
	CHECK(set_switch_and_wait(0, FACTORY_RESET_NAME, "RESET", INDIGO_ALERT_STATE));
	CHECK_EQ(2, fake_calls(0, FN_RESET));
	CHECK_EQ(false, switch_value(0, FACTORY_RESET_NAME, "RESET"));
	message(0, FACTORY_RESET_NAME, buffer);
	CHECK_STR("Factory reset failed", buffer);
cleanup:
	finish_test();
}

static void mode_and_compensation_settings(void) {
	const char *manual[] = { FOCUSER_ON_POSITION_SET_PROPERTY_NAME, FOCUSER_REVERSE_MOTION_PROPERTY_NAME, FOCUSER_DIRECTION_PROPERTY_NAME, FOCUSER_STEPS_PROPERTY_NAME, FOCUSER_ABORT_MOTION_PROPERTY_NAME, FOCUSER_BACKLASH_PROPERTY_NAME };
	const char *items[] = { FOCUSER_COMPENSATION_ITEM_NAME, FOCUSER_COMPENSATION_THRESHOLD_ITEM_NAME };
	const double values[] = { 150, 2 };
	indigo_property *property = NULL;
	CHECK(start_driver(1));
	CHECK(connect_and_wait_position(0));
	int before = revision(0, FOCUSER_COMPENSATION_PROPERTY_NAME);
	CHECK_EQ(INDIGO_OK, indigo_change_number_property(&test_client, observed[0].name, FOCUSER_COMPENSATION_PROPERTY_NAME, 2, items, values));
	CHECK(wait_state_after(0, FOCUSER_COMPENSATION_PROPERTY_NAME, before, INDIGO_OK_STATE));
	CHECK_NEAR(150, number(0, FOCUSER_COMPENSATION_PROPERTY_NAME, FOCUSER_COMPENSATION_ITEM_NAME, false), 0);
	CHECK_NEAR(2, number(0, FOCUSER_COMPENSATION_PROPERTY_NAME, FOCUSER_COMPENSATION_THRESHOLD_ITEM_NAME, false), 0);
	CHECK(set_switch_and_wait(0, FOCUSER_MODE_PROPERTY_NAME, FOCUSER_MODE_AUTOMATIC_ITEM_NAME, INDIGO_OK_STATE));
	for (int i = 0; i < ARRAY_SIZE(manual); i++) {
		CHECK(!is_defined(0, manual[i]));
	}
	CHECK(is_defined(0, FOCUSER_POSITION_PROPERTY_NAME));
	property = snapshot(0, FOCUSER_POSITION_PROPERTY_NAME);
	CHECK_EQ(INDIGO_RO_PERM, property->perm);
	indigo_release_property(property);
	property = NULL;
	CHECK(set_switch_and_wait(0, FOCUSER_MODE_PROPERTY_NAME, FOCUSER_MODE_MANUAL_ITEM_NAME, INDIGO_OK_STATE));
	for (int i = 0; i < ARRAY_SIZE(manual); i++) {
		CHECK(is_defined(0, manual[i]));
	}
	property = snapshot(0, FOCUSER_POSITION_PROPERTY_NAME);
	CHECK_EQ(INDIGO_RW_PERM, property->perm);
	CHECK_EQ(0, fake_calls(0, FN_CONFIG_SET));
cleanup:
	indigo_release_property(property);
	finish_test();
}

static bool wait_temperature_reads(int count) {
	int before = update_count(0, FOCUSER_TEMPERATURE_PROPERTY_NAME);
	return wait_updates(0, FOCUSER_TEMPERATURE_PROPERTY_NAME, before, count);
}

static void temperature_sources(void) {
	char buffer[INDIGO_VALUE_SIZE];
	CHECK(start_driver(1));
	SET_FAKE(0, temperature_int, 2150);
	CHECK(connect_and_wait_position(0));
	CHECK(wait_temperature_reads(1));
	CHECK_NEAR(21.5, number(0, BOARD_TEMPERATURE_NAME, "Internal Temp.", false), 1e-9);
	CHECK_NEAR(21.5, number(0, FOCUSER_TEMPERATURE_PROPERTY_NAME, FOCUSER_TEMPERATURE_ITEM_NAME, false), 1e-9);
	CHECK_EQ(INDIGO_OK_STATE, state(0, FOCUSER_TEMPERATURE_PROPERTY_NAME));
	message(0, FOCUSER_TEMPERATURE_PROPERTY_NAME, buffer);
	CHECK_STR("No temperature sensor connected. Using board temperature as ambient.", buffer);
	SET_FAKE(0, detection, 1);
	SET_FAKE(0, temperature_ext, -1234);
	CHECK(wait_temperature_reads(2));
	CHECK_NEAR(-12.34, number(0, FOCUSER_TEMPERATURE_PROPERTY_NAME, FOCUSER_TEMPERATURE_ITEM_NAME, false), 1e-9);
	CHECK_NEAR(21.5, number(0, BOARD_TEMPERATURE_NAME, "Internal Temp.", false), 1e-9);
	message(0, FOCUSER_TEMPERATURE_PROPERTY_NAME, buffer);
	CHECK_STR("Temperature sensor connected.", buffer);
	SET_FAKE(0, temperature_ext, (int)TEMPERATURE_INVALID);
	CHECK(wait_temperature_reads(2));
	CHECK_NEAR(21.5, number(0, FOCUSER_TEMPERATURE_PROPERTY_NAME, FOCUSER_TEMPERATURE_ITEM_NAME, false), 1e-9);
	message(0, FOCUSER_TEMPERATURE_PROPERTY_NAME, buffer);
	CHECK_STR("No temperature sensor connected. Using board temperature as ambient.", buffer);
	SET_FAKE(0, detection, 0);
	SET_FAKE(0, temperature_ext, 555);
	SET_FAKE(0, temperature_int, 1900);
	CHECK(wait_temperature_reads(2));
	CHECK_NEAR(19, number(0, FOCUSER_TEMPERATURE_PROPERTY_NAME, FOCUSER_TEMPERATURE_ITEM_NAME, false), 1e-9);
	set_error(0, FN_STATUS, AO_ERROR_COMMUNICATION, 0);
	CHECK(wait_temperature_reads(2));
	CHECK_EQ(INDIGO_ALERT_STATE, state(0, FOCUSER_TEMPERATURE_PROPERTY_NAME));
	CHECK_EQ(INDIGO_ALERT_STATE, state(0, BOARD_TEMPERATURE_NAME));
	set_error(0, FN_STATUS, 0, 0);
	CHECK(wait_temperature_reads(2));
	CHECK_EQ(INDIGO_OK_STATE, state(0, FOCUSER_TEMPERATURE_PROPERTY_NAME));
	CHECK_EQ(INDIGO_OK_STATE, state(0, BOARD_TEMPERATURE_NAME));
cleanup:
	finish_test();
}

static void temperature_compensation(void) {
	const char *items[] = { FOCUSER_COMPENSATION_ITEM_NAME, FOCUSER_COMPENSATION_THRESHOLD_ITEM_NAME };
	const double values[] = { 100, 1 };
	CHECK(start_driver(1));
	CHECK(connect_and_wait_position(0));
	int before = revision(0, FOCUSER_COMPENSATION_PROPERTY_NAME);
	CHECK_EQ(INDIGO_OK, indigo_change_number_property(&test_client, observed[0].name, FOCUSER_COMPENSATION_PROPERTY_NAME, 2, items, values));
	CHECK(wait_state_after(0, FOCUSER_COMPENSATION_PROPERTY_NAME, before, INDIGO_OK_STATE));
	CHECK(set_switch_and_wait(0, FOCUSER_MODE_PROPERTY_NAME, FOCUSER_MODE_AUTOMATIC_ITEM_NAME, INDIGO_OK_STATE));
	CHECK(wait_temperature_reads(2));
	CHECK_EQ(0, fake_calls(0, FN_MOVE));
	SET_FAKE(0, temperature_int, 2150);
	CHECK(wait_calls(0, FN_MOVE, 1));
	CHECK_EQ(150, FAKE(0, last_move));
	CHECK(wait_temperature_reads(2));
	CHECK_EQ(INDIGO_OK_STATE, state(0, FOCUSER_POSITION_PROPERTY_NAME));
	CHECK_EQ(400, FAKE(0, position));
	CHECK_NEAR(400, number(0, FOCUSER_POSITION_PROPERTY_NAME, FOCUSER_POSITION_ITEM_NAME, false), 0);
	SET_FAKE(0, temperature_int, 2200);
	CHECK(wait_temperature_reads(3));
	CHECK_EQ(1, fake_calls(0, FN_MOVE));
	SET_FAKE(0, temperature_int, 12300);
	CHECK(wait_temperature_reads(3));
	CHECK_EQ(1, fake_calls(0, FN_MOVE));
	SET_FAKE(0, temperature_int, 2000);
	CHECK(wait_calls(0, FN_MOVE, 2));
	CHECK_EQ(-150, FAKE(0, last_move));
	CHECK(wait_temperature_reads(2));
	CHECK_EQ(250, FAKE(0, position));
	CHECK(set_switch_and_wait(0, FOCUSER_MODE_PROPERTY_NAME, FOCUSER_MODE_MANUAL_ITEM_NAME, INDIGO_OK_STATE));
	SET_FAKE(0, temperature_int, 2300);
	CHECK(wait_temperature_reads(3));
	CHECK_EQ(2, fake_calls(0, FN_MOVE));
	CHECK(set_switch_and_wait(0, FOCUSER_MODE_PROPERTY_NAME, FOCUSER_MODE_AUTOMATIC_ITEM_NAME, INDIGO_OK_STATE));
	CHECK(wait_temperature_reads(3));
	CHECK_EQ(2, fake_calls(0, FN_MOVE));
	SET_FAKE(0, temperature_int, 2450);
	CHECK(wait_calls(0, FN_MOVE, 3));
	CHECK_EQ(150, FAKE(0, last_move));
	CHECK(wait_temperature_reads(2));
	CHECK(set_switch_and_wait(0, FOCUSER_MODE_PROPERTY_NAME, FOCUSER_MODE_MANUAL_ITEM_NAME, INDIGO_OK_STATE));
cleanup:
	finish_test();
}

static bool remove_config_files(void) {
	DIR *directory = opendir(config_folder);
	if (directory == NULL) {
		return false;
	}
	struct dirent *entry;
	char path[PATH_MAX];
	while ((entry = readdir(directory)) != NULL) {
		if (entry->d_name[0] != '.') {
			snprintf(path, sizeof(path), "%s/%s", config_folder, entry->d_name);
			unlink(path);
		}
	}
	closedir(directory);
	return true;
}

static void configuration_save_and_load(void) {
	CHECK(remove_config_files());
	CHECK(start_driver(1));
	CHECK(connect_and_wait_position(0));
	CHECK(set_switch_and_wait(0, BEEP_ON_MOVE_NAME, "ON", INDIGO_OK_STATE));
	CHECK(set_switch_and_wait(0, CONFIG_PROPERTY_NAME, CONFIG_SAVE_ITEM_NAME, INDIGO_OK_STATE));
	CHECK(set_switch_and_wait(0, BEEP_ON_MOVE_NAME, "OFF", INDIGO_OK_STATE));
	CHECK_EQ(0, FAKE(0, config.beepOnMove));
	int writes = fake_calls(0, FN_CONFIG_SET);
	CHECK(set_switch_and_wait(0, CONFIG_PROPERTY_NAME, CONFIG_LOAD_ITEM_NAME, INDIGO_OK_STATE));
	CHECK(wait_calls(0, FN_CONFIG_SET, writes + 1));
	for (int i = 0; i < WAIT_STEPS && FAKE(0, config.beepOnMove) != 1; i++) {
		indigo_usleep(10000);
	}
	CHECK_EQ(1, FAKE(0, config.beepOnMove));
	CHECK_EQ(true, switch_value(0, BEEP_ON_MOVE_NAME, "ON"));
cleanup:
	finish_test();
	remove_config_files();
}

static void disconnect_and_removal_during_motion(void) {
	CHECK(start_driver(1));
	CHECK(connect_and_wait_position(0));
	set_hold_motion(0, true);
	int before = revision(0, FOCUSER_POSITION_PROPERTY_NAME);
	CHECK(change_number(0, FOCUSER_POSITION_PROPERTY_NAME, FOCUSER_POSITION_ITEM_NAME, 7000));
	CHECK(wait_state_after(0, FOCUSER_POSITION_PROPERTY_NAME, before, INDIGO_BUSY_STATE));
	CHECK(wait_calls(0, FN_MOVE_TO, 1));
	CHECK(connect_focuser(0, false));
	CHECK_EQ(1, fake_calls(0, FN_STOP));
	CHECK(!fake_opened(0));
	CHECK_EQ(0, atomic_load(&lock_count));
	int reads = fake_calls(0, FN_STATUS);
	indigo_usleep((useconds_t)(scaled(3) * 1000000));
	CHECK_EQ(reads, fake_calls(0, FN_STATUS));
	set_hold_motion(0, false);
	CHECK(connect_and_wait_position(0));
	CHECK(set_number_and_wait(0, FOCUSER_POSITION_PROPERTY_NAME, FOCUSER_POSITION_ITEM_NAME, 700, INDIGO_OK_STATE));
	set_hold_motion(0, true);
	before = revision(0, FOCUSER_POSITION_PROPERTY_NAME);
	CHECK(change_number(0, FOCUSER_POSITION_PROPERTY_NAME, FOCUSER_POSITION_ITEM_NAME, 9000));
	CHECK(wait_state_after(0, FOCUSER_POSITION_PROPERTY_NAME, before, INDIGO_BUSY_STATE));
	usb_event(0, false);
	CHECK(wait_count(&attached, 0));
	CHECK(!fake_opened(0));
	CHECK_EQ(0, atomic_load(&lock_count));
	CHECK_EQ(2, fake_calls(0, FN_STOP));
	reads = fake_calls(0, FN_STATUS);
	indigo_usleep((useconds_t)(scaled(3) * 1000000));
	CHECK_EQ(reads, fake_calls(0, FN_STATUS));
	set_hold_motion(0, false);
	usb_event(0, true);
	CHECK(wait_count(&attached, 1));
	CHECK(connect_and_wait_position(0));
	CHECK(set_number_and_wait(0, FOCUSER_POSITION_PROPERTY_NAME, FOCUSER_POSITION_ITEM_NAME, 1200, INDIGO_OK_STATE));
cleanup:
	finish_test();
}

static void init_shutdown_cycles(void) {
	indigo_driver_info info = { 0 };
	reset_all(0);
	CHECK_EQ(INDIGO_OK, indigo_focuser_astroasis(INDIGO_DRIVER_INFO, &info));
	CHECK_EQ(INDIGO_OK, indigo_focuser_astroasis(INDIGO_DRIVER_INIT, NULL));
	CHECK_EQ(INDIGO_OK, indigo_focuser_astroasis(INDIGO_DRIVER_INIT, NULL));
	CHECK_EQ(1, atomic_load(&usb_register_calls));
	CHECK_EQ(0x338f, atomic_load(&registered_vid));
	CHECK_EQ(0xa0f0, atomic_load(&registered_pid));
	CHECK_EQ(LIBUSB_HOTPLUG_ENUMERATE, atomic_load(&registered_flags));
	CHECK_EQ(LIBUSB_HOTPLUG_EVENT_DEVICE_ARRIVED | LIBUSB_HOTPLUG_EVENT_DEVICE_LEFT, atomic_load(&registered_events));
	CHECK_EQ(INDIGO_OK, indigo_focuser_astroasis(INDIGO_DRIVER_SHUTDOWN, NULL));
	CHECK_EQ(INDIGO_OK, indigo_focuser_astroasis(INDIGO_DRIVER_SHUTDOWN, NULL));
	CHECK_EQ(1, atomic_load(&usb_deregister_calls));
	for (int cycle = 0; cycle < 3; cycle++) {
		CHECK(start_driver(2));
		CHECK(connect_and_wait_position(1));
		CHECK(connect_focuser(1, false));
		CHECK_EQ(INDIGO_OK, indigo_focuser_astroasis(INDIGO_DRIVER_SHUTDOWN, NULL));
		CHECK(wait_count(&attached, 0));
		CHECK_EQ(0, atomic_load(&usb_ref_balance));
		CHECK(!fake_opened(0) && !fake_opened(1));
	}
cleanup:
	finish_test();
}

static void reference_trace(void) {
	const char *items[] = { FOCUSER_COMPENSATION_ITEM_NAME, FOCUSER_COMPENSATION_THRESHOLD_ITEM_NAME };
	const double values[] = { 25, 3 };
	char expected[65536];
	FILE *file = NULL;
	CHECK(start_driver(1));
	atomic_store(&trace_enabled, true);
	trace_printf(false, "step connect");
	CHECK(connect_and_wait_position(0));
	trace_printf(false, "step goto");
	CHECK(set_number_and_wait(0, FOCUSER_POSITION_PROPERTY_NAME, FOCUSER_POSITION_ITEM_NAME, 1500, INDIGO_OK_STATE));
	CHECK(wait_state_after(0, FOCUSER_STEPS_PROPERTY_NAME, 0, INDIGO_OK_STATE));
	trace_printf(false, "step goto-noop");
	CHECK(set_number_and_wait(0, FOCUSER_POSITION_PROPERTY_NAME, FOCUSER_POSITION_ITEM_NAME, 1500, INDIGO_OK_STATE));
	trace_printf(false, "step steps-outward");
	CHECK(set_switch_and_wait(0, FOCUSER_DIRECTION_PROPERTY_NAME, FOCUSER_DIRECTION_MOVE_OUTWARD_ITEM_NAME, INDIGO_OK_STATE));
	CHECK(set_number_and_wait(0, FOCUSER_STEPS_PROPERTY_NAME, FOCUSER_STEPS_ITEM_NAME, 200, INDIGO_OK_STATE));
	CHECK(wait_state_after(0, FOCUSER_POSITION_PROPERTY_NAME, 0, INDIGO_OK_STATE));
	trace_printf(false, "step steps-inward");
	CHECK(set_switch_and_wait(0, FOCUSER_DIRECTION_PROPERTY_NAME, FOCUSER_DIRECTION_MOVE_INWARD_ITEM_NAME, INDIGO_OK_STATE));
	CHECK(set_number_and_wait(0, FOCUSER_STEPS_PROPERTY_NAME, FOCUSER_STEPS_ITEM_NAME, 100, INDIGO_OK_STATE));
	CHECK(wait_state_after(0, FOCUSER_POSITION_PROPERTY_NAME, 0, INDIGO_OK_STATE));
	trace_printf(false, "step sync");
	CHECK(set_switch_and_wait(0, FOCUSER_ON_POSITION_SET_PROPERTY_NAME, FOCUSER_ON_POSITION_SET_SYNC_ITEM_NAME, INDIGO_OK_STATE));
	CHECK(set_number_and_wait(0, FOCUSER_POSITION_PROPERTY_NAME, FOCUSER_POSITION_ITEM_NAME, 5000, INDIGO_OK_STATE));
	CHECK(wait_state_after(0, FOCUSER_STEPS_PROPERTY_NAME, 0, INDIGO_OK_STATE));
	CHECK(set_switch_and_wait(0, FOCUSER_ON_POSITION_SET_PROPERTY_NAME, FOCUSER_ON_POSITION_SET_GOTO_ITEM_NAME, INDIGO_OK_STATE));
	trace_printf(false, "step abort");
	set_hold_motion(0, true);
	int before = revision(0, FOCUSER_POSITION_PROPERTY_NAME);
	CHECK(change_number(0, FOCUSER_POSITION_PROPERTY_NAME, FOCUSER_POSITION_ITEM_NAME, 9000));
	CHECK(wait_state_after(0, FOCUSER_POSITION_PROPERTY_NAME, before, INDIGO_BUSY_STATE));
	CHECK(wait_calls(0, FN_MOVE_TO, 2));
	CHECK(set_switch_and_wait(0, FOCUSER_ABORT_MOTION_PROPERTY_NAME, FOCUSER_ABORT_MOTION_ITEM_NAME, INDIGO_OK_STATE));
	indigo_usleep((useconds_t)(scaled(1.5) * 1000000));
	set_hold_motion(0, false);
	trace_printf(false, "step reverse");
	CHECK(set_switch_and_wait(0, FOCUSER_REVERSE_MOTION_PROPERTY_NAME, FOCUSER_REVERSE_MOTION_ENABLED_ITEM_NAME, INDIGO_OK_STATE));
	CHECK(set_switch_and_wait(0, FOCUSER_REVERSE_MOTION_PROPERTY_NAME, FOCUSER_REVERSE_MOTION_DISABLED_ITEM_NAME, INDIGO_OK_STATE));
	trace_printf(false, "step backlash");
	CHECK(set_number_and_wait(0, FOCUSER_BACKLASH_PROPERTY_NAME, FOCUSER_BACKLASH_ITEM_NAME, 25, INDIGO_OK_STATE));
	trace_printf(false, "step limits");
	CHECK(set_number_and_wait(0, FOCUSER_LIMITS_PROPERTY_NAME, FOCUSER_LIMITS_MAX_POSITION_ITEM_NAME, 20000, INDIGO_OK_STATE));
	trace_printf(false, "step switches");
	CHECK(set_switch_and_wait(0, BEEP_ON_POWER_UP_NAME, "OFF", INDIGO_OK_STATE));
	CHECK(set_switch_and_wait(0, BEEP_ON_MOVE_NAME, "ON", INDIGO_OK_STATE));
	CHECK(set_switch_and_wait(0, BACKLASH_DIRECTION_NAME, "INWARD", INDIGO_OK_STATE));
	CHECK(set_switch_and_wait(0, BLUETOOTH_NAME, "DISABLED", INDIGO_OK_STATE));
	trace_printf(false, "step names");
	CHECK(set_text_and_wait(0, CUSTOM_SUFFIX_NAME, "SUFFIX", "Trace", INDIGO_OK_STATE));
	CHECK(set_text_and_wait(0, BLUETOOTH_NAME_NAME, "BLUETOOTH_NAME", "TraceBT", INDIGO_OK_STATE));
	trace_printf(false, "step failed-write");
	set_error(0, FN_CONFIG_SET, AO_ERROR_COMMUNICATION, 0);
	CHECK(set_number_and_wait(0, FOCUSER_BACKLASH_PROPERTY_NAME, FOCUSER_BACKLASH_ITEM_NAME, 30, INDIGO_ALERT_STATE));
	set_error(0, FN_CONFIG_SET, 0, 0);
	trace_printf(false, "step reset");
	CHECK(set_switch_and_wait(0, FACTORY_RESET_NAME, "RESET", INDIGO_OK_STATE));
	trace_printf(false, "step compensation");
	before = revision(0, FOCUSER_COMPENSATION_PROPERTY_NAME);
	CHECK_EQ(INDIGO_OK, indigo_change_number_property(&test_client, observed[0].name, FOCUSER_COMPENSATION_PROPERTY_NAME, 2, items, values));
	CHECK(wait_state_after(0, FOCUSER_COMPENSATION_PROPERTY_NAME, before, INDIGO_OK_STATE));
	trace_printf(false, "step disconnect");
	CHECK(connect_focuser(0, false));
	trace_printf(false, "step end");
	atomic_store(&trace_enabled, false);
	const char *write_path = getenv("OAF_WRITE_TRACE");
	if (write_path) {
		file = fopen(write_path, "w");
		CHECK(file != NULL);
		fputs(trace_text, file);
		fclose(file);
		file = NULL;
	}
	file = fopen(OAF_REFERENCE_TRACE_PATH, "r");
	CHECK(file != NULL);
	size_t length = fread(expected, 1, sizeof(expected) - 1, file);
	expected[length] = 0;
	if (strcmp(expected, trace_text)) {
		fprintf(stderr, "reference trace mismatch, actual trace:\n%s\n", trace_text);
		CHECK(false);
	}
cleanup:
	if (file) {
		fclose(file);
	}
	finish_test();
}

// Regression tests for defects reproduced against the original driver

static void defect_open_failure_releases_lock(void) {
	CHECK(start_driver(1));
	set_error(0, FN_OPEN, AO_ERROR_BUSY, 0);
	CHECK(!connect_focuser(0, true));
	CHECK_EQ(INDIGO_ALERT_STATE, state(0, CONNECTION_PROPERTY_NAME));
	CHECK_EQ(0, atomic_load(&lock_count));
	set_error(0, FN_OPEN, 0, 0);
	CHECK(connect_and_wait_position(0));
	CHECK_EQ(1, atomic_load(&lock_count));
cleanup:
	finish_test();
}

static void defect_connect_config_failure_closes_sdk(void) {
	CHECK(start_driver(1));
	set_error(0, FN_CONFIG_GET, AO_ERROR_COMMUNICATION, 0);
	CHECK(!connect_focuser(0, true));
	CHECK_EQ(INDIGO_ALERT_STATE, state(0, CONNECTION_PROPERTY_NAME));
	CHECK(!fake_opened(0));
	CHECK_EQ(0, atomic_load(&lock_count));
cleanup:
	finish_test();
}

static void defect_move_start_failure_alerts(void) {
	const char *items[] = { FOCUSER_COMPENSATION_ITEM_NAME, FOCUSER_COMPENSATION_THRESHOLD_ITEM_NAME };
	const double values[] = { 100, 1 };
	CHECK(start_driver(1));
	CHECK(connect_and_wait_position(0));
	set_error(0, FN_MOVE_TO, AO_ERROR_INVALID_STATE, 0);
	CHECK(set_number_and_wait(0, FOCUSER_POSITION_PROPERTY_NAME, FOCUSER_POSITION_ITEM_NAME, 1000, INDIGO_ALERT_STATE));
	CHECK_EQ(INDIGO_ALERT_STATE, state(0, FOCUSER_STEPS_PROPERTY_NAME));
	set_error(0, FN_MOVE, AO_ERROR_INVALID_STATE, 0);
	CHECK(set_number_and_wait(0, FOCUSER_STEPS_PROPERTY_NAME, FOCUSER_STEPS_ITEM_NAME, 10, INDIGO_ALERT_STATE));
	CHECK_EQ(INDIGO_ALERT_STATE, state(0, FOCUSER_POSITION_PROPERTY_NAME));
	set_error(0, FN_MOVE_TO, 0, 0);
	CHECK(set_number_and_wait(0, FOCUSER_POSITION_PROPERTY_NAME, FOCUSER_POSITION_ITEM_NAME, 300, INDIGO_OK_STATE));
	int before = revision(0, FOCUSER_COMPENSATION_PROPERTY_NAME);
	CHECK_EQ(INDIGO_OK, indigo_change_number_property(&test_client, observed[0].name, FOCUSER_COMPENSATION_PROPERTY_NAME, 2, items, values));
	CHECK(wait_state_after(0, FOCUSER_COMPENSATION_PROPERTY_NAME, before, INDIGO_OK_STATE));
	CHECK(set_switch_and_wait(0, FOCUSER_MODE_PROPERTY_NAME, FOCUSER_MODE_AUTOMATIC_ITEM_NAME, INDIGO_OK_STATE));
	CHECK(wait_temperature_reads(2));
	int moves = fake_calls(0, FN_MOVE);
	SET_FAKE(0, temperature_int, 2200);
	CHECK(wait_calls(0, FN_MOVE, moves + 1));
	CHECK(wait_temperature_reads(2));
	CHECK_EQ(INDIGO_ALERT_STATE, state(0, FOCUSER_POSITION_PROPERTY_NAME));
cleanup:
	finish_test();
}

static void defect_limits_update_position_range(void) {
	indigo_property *property = NULL;
	CHECK(start_driver(1));
	SET_FAKE(0, config.maxStep, 20000);
	CHECK(connect_and_wait_position(0));
	property = snapshot(0, FOCUSER_POSITION_PROPERTY_NAME);
	CHECK_NEAR(20000, property->items[0].number.max, 0);
	indigo_release_property(property);
	property = NULL;
	CHECK(set_number_and_wait(0, FOCUSER_LIMITS_PROPERTY_NAME, FOCUSER_LIMITS_MAX_POSITION_ITEM_NAME, 5000, INDIGO_OK_STATE));
	CHECK(wait_defined(0, FOCUSER_POSITION_PROPERTY_NAME, true));
	property = snapshot(0, FOCUSER_POSITION_PROPERTY_NAME);
	CHECK_NEAR(5000, property->items[0].number.max, 0);
	indigo_release_property(property);
	property = snapshot(0, FOCUSER_STEPS_PROPERTY_NAME);
	CHECK_NEAR(5000, property->items[0].number.max, 0);
cleanup:
	indigo_release_property(property);
	finish_test();
}

static void defect_sdk_calls_serialized(void) {
	CHECK(start_driver(1));
	CHECK(connect_and_wait_position(0));
	atomic_store(&status_waiting, false);
	atomic_store(&hold_status, true);
	for (int i = 0; i < WAIT_STEPS && !atomic_load(&status_waiting); i++) {
		indigo_usleep(10000);
	}
	CHECK(atomic_load(&status_waiting));
	int concurrent = atomic_load(&concurrent_calls);
	int before = revision(0, FOCUSER_BACKLASH_PROPERTY_NAME);
	CHECK(change_number(0, FOCUSER_BACKLASH_PROPERTY_NAME, FOCUSER_BACKLASH_ITEM_NAME, 77));
	indigo_usleep(100000);
	atomic_store(&hold_status, false);
	CHECK(wait_state_after(0, FOCUSER_BACKLASH_PROPERTY_NAME, before, INDIGO_OK_STATE));
	CHECK_EQ(concurrent, atomic_load(&concurrent_calls));
cleanup:
	atomic_store(&hold_status, false);
	finish_test();
}

static void defect_shutdown_cancels_pending_discovery(void) {
	reset_all(1);
	CHECK_EQ(INDIGO_OK, indigo_focuser_astroasis(INDIGO_DRIVER_INIT, NULL));
	CHECK_EQ(INDIGO_OK, indigo_focuser_astroasis(INDIGO_DRIVER_SHUTDOWN, NULL));
	atomic_store(&driver_stopped, true);
	indigo_usleep((useconds_t)(scaled(3) * 1000000));
	CHECK_EQ(0, atomic_load(&attach_after_shutdown));
	CHECK_EQ(0, atomic_load(&attached));
cleanup:
	finish_test();
}

static void defect_failed_init_can_retry(void) {
	reset_all(1);
	atomic_store(&usb_register_error, LIBUSB_ERROR_NO_MEM);
	CHECK_EQ(INDIGO_FAILED, indigo_focuser_astroasis(INDIGO_DRIVER_INIT, NULL));
	CHECK_EQ(INDIGO_OK, indigo_focuser_astroasis(INDIGO_DRIVER_INIT, NULL));
	CHECK_EQ(2, atomic_load(&usb_register_calls));
	CHECK(wait_count(&attached, 1));
cleanup:
	finish_test();
}

static void defect_failed_writes_restore_values(void) {
	char buffer[INDIGO_VALUE_SIZE];
	CHECK(start_driver(1));
	CHECK(connect_and_wait_position(0));
	set_error(0, FN_CONFIG_SET, AO_ERROR_COMMUNICATION, 0);
	CHECK(set_number_and_wait(0, FOCUSER_BACKLASH_PROPERTY_NAME, FOCUSER_BACKLASH_ITEM_NAME, 50, INDIGO_ALERT_STATE));
	CHECK_NEAR(12, number(0, FOCUSER_BACKLASH_PROPERTY_NAME, FOCUSER_BACKLASH_ITEM_NAME, false), 0);
	CHECK(set_number_and_wait(0, FOCUSER_LIMITS_PROPERTY_NAME, FOCUSER_LIMITS_MAX_POSITION_ITEM_NAME, 30000, INDIGO_ALERT_STATE));
	CHECK_NEAR(10000, number(0, FOCUSER_LIMITS_PROPERTY_NAME, FOCUSER_LIMITS_MAX_POSITION_ITEM_NAME, false), 0);
	CHECK(set_switch_and_wait(0, FOCUSER_REVERSE_MOTION_PROPERTY_NAME, FOCUSER_REVERSE_MOTION_ENABLED_ITEM_NAME, INDIGO_ALERT_STATE));
	CHECK_EQ(true, switch_value(0, FOCUSER_REVERSE_MOTION_PROPERTY_NAME, FOCUSER_REVERSE_MOTION_DISABLED_ITEM_NAME));
	CHECK(set_switch_and_wait(0, BEEP_ON_MOVE_NAME, "ON", INDIGO_ALERT_STATE));
	CHECK_EQ(true, switch_value(0, BEEP_ON_MOVE_NAME, "OFF"));
	set_error(0, FN_CONFIG_SET, 0, 0);
	set_error(0, FN_FRIENDLY_SET, AO_ERROR_COMMUNICATION, 0);
	CHECK(set_text_and_wait(0, CUSTOM_SUFFIX_NAME, "SUFFIX", "Bad", INDIGO_ALERT_STATE));
	text(0, CUSTOM_SUFFIX_NAME, "SUFFIX", buffer);
	CHECK_STR("F0", buffer);
	CHECK(set_text_and_wait(0, BLUETOOTH_NAME_NAME, "BLUETOOTH_NAME", "0123456789abcdef0123456789ABCDEFX", INDIGO_ALERT_STATE));
	text(0, BLUETOOTH_NAME_NAME, "BLUETOOTH_NAME", buffer);
	CHECK_STR("OasisBT0", buffer);
cleanup:
	finish_test();
}

static void defect_busy_motion_request_preserves_target(void) {
	CHECK(start_driver(1));
	CHECK(connect_and_wait_position(0));
	set_hold_motion(0, true);
	int before = revision(0, FOCUSER_POSITION_PROPERTY_NAME);
	CHECK(change_number(0, FOCUSER_POSITION_PROPERTY_NAME, FOCUSER_POSITION_ITEM_NAME, 3000));
	CHECK(wait_state_after(0, FOCUSER_POSITION_PROPERTY_NAME, before, INDIGO_BUSY_STATE));
	CHECK(wait_calls(0, FN_MOVE_TO, 1));
	CHECK(change_number(0, FOCUSER_POSITION_PROPERTY_NAME, FOCUSER_POSITION_ITEM_NAME, 7000));
	indigo_usleep(100000);
	set_hold_motion(0, false);
	CHECK(wait_state_after(0, FOCUSER_POSITION_PROPERTY_NAME, before, INDIGO_OK_STATE));
	CHECK_EQ(1, fake_calls(0, FN_MOVE_TO));
	CHECK_NEAR(3000, number(0, FOCUSER_POSITION_PROPERTY_NAME, FOCUSER_POSITION_ITEM_NAME, false), 0);
	CHECK_NEAR(3000, number(0, FOCUSER_POSITION_PROPERTY_NAME, FOCUSER_POSITION_ITEM_NAME, true), 0);
cleanup:
	finish_test();
}

static void defect_reset_off_request_answered(void) {
	CHECK(start_driver(1));
	CHECK(connect_and_wait_position(0));
	int before = revision(0, FACTORY_RESET_NAME);
	CHECK_EQ(INDIGO_OK, indigo_change_switch_property_1(&test_client, observed[0].name, FACTORY_RESET_NAME, "RESET", false));
	CHECK(wait_state_after(0, FACTORY_RESET_NAME, before, INDIGO_OK_STATE));
	CHECK_EQ(0, fake_calls(0, FN_RESET));
cleanup:
	finish_test();
}

static void defect_attach_failure_not_detached(void) {
	reset_all(1);
	atomic_store(&fail_attach, 1);
	CHECK_EQ(INDIGO_OK, indigo_focuser_astroasis(INDIGO_DRIVER_INIT, NULL));
	CHECK(wait_count(&attach_attempts, 1));
	indigo_usleep((useconds_t)(scaled(1.5) * 1000000));
	usb_event(0, true);
	CHECK(wait_count(&attached, 1));
	CHECK(connect_and_wait_position(0));
	CHECK(connect_focuser(0, false));
	CHECK_EQ(INDIGO_OK, indigo_focuser_astroasis(INDIGO_DRIVER_SHUTDOWN, NULL));
	atomic_store(&driver_stopped, true);
	CHECK(wait_count(&attached, 0));
	CHECK_EQ(0, atomic_load(&invalid_detach));
cleanup:
	finish_test();
}

static void capacity_and_slot_reuse(void) {
	reset_all(6);
	CHECK_EQ(INDIGO_OK, indigo_focuser_astroasis(INDIGO_DRIVER_INIT, NULL));
	CHECK(wait_count(&attached, 5));
	indigo_usleep((useconds_t)(scaled(3) * 1000000));
	CHECK_EQ(5, atomic_load(&attached));
	CHECK(observed[5].name[0] == 0);
	CHECK(connect_and_wait_position(0));
	usb_event(2, false);
	CHECK(wait_count(&attached, 4));
	CHECK(wait_count(&attached, 5));
	CHECK_STR("Oasis Focuser #F5", observed[5].name);
	CHECK(observed[0].connected);
	CHECK(connect_and_wait_position(5));
	CHECK(set_number_and_wait(5, FOCUSER_POSITION_PROPERTY_NAME, FOCUSER_POSITION_ITEM_NAME, 1234, INDIGO_OK_STATE));
	CHECK_EQ(1234, FAKE(5, position));
cleanup:
	finish_test();
}

static void delayed_sdk_discovery_retry(void) {
	reset_all(1);
	fakes[0].visible = false;
	CHECK_EQ(INDIGO_OK, indigo_focuser_astroasis(INDIGO_DRIVER_INIT, NULL));
	indigo_usleep(700000);
	CHECK_EQ(0, atomic_load(&attached));
	CHECK(fake_calls(0, FN_SCAN) >= 2);
	pthread_mutex_lock(&sdk_mutex);
	fakes[0].visible = true;
	pthread_mutex_unlock(&sdk_mutex);
	CHECK(wait_count(&attached, 1));
	CHECK_STR("Oasis Focuser #F0", observed[0].name);
	CHECK(connect_and_wait_position(0));
cleanup:
	finish_test();
}

static void urgent_abort_cancels_queued_move(void) {
	CHECK(start_driver(1));
	CHECK(connect_and_wait_position(0));
	atomic_store(&status_waiting, false);
	atomic_store(&hold_status, true);
	for (int i = 0; i < WAIT_STEPS && !atomic_load(&status_waiting); i++) {
		indigo_usleep(10000);
	}
	CHECK(atomic_load(&status_waiting));
	int position = revision(0, FOCUSER_POSITION_PROPERTY_NAME), abort = revision(0, FOCUSER_ABORT_MOTION_PROPERTY_NAME);
	CHECK(change_number(0, FOCUSER_POSITION_PROPERTY_NAME, FOCUSER_POSITION_ITEM_NAME, 6000));
	CHECK(wait_state_after(0, FOCUSER_POSITION_PROPERTY_NAME, position, INDIGO_BUSY_STATE));
	CHECK(change_switch(0, FOCUSER_ABORT_MOTION_PROPERTY_NAME, FOCUSER_ABORT_MOTION_ITEM_NAME));
	indigo_usleep(100000);
	atomic_store(&hold_status, false);
	CHECK(wait_state_after(0, FOCUSER_ABORT_MOTION_PROPERTY_NAME, abort, INDIGO_OK_STATE));
	indigo_usleep((useconds_t)(scaled(3) * 1000000));
	CHECK_EQ(0, fake_calls(0, FN_MOVE_TO));
	CHECK_EQ(1, fake_calls(0, FN_STOP));
	CHECK_EQ(INDIGO_OK_STATE, state(0, FOCUSER_POSITION_PROPERTY_NAME));
	CHECK_EQ(INDIGO_OK_STATE, state(0, FOCUSER_STEPS_PROPERTY_NAME));
	CHECK(set_number_and_wait(0, FOCUSER_POSITION_PROPERTY_NAME, FOCUSER_POSITION_ITEM_NAME, 600, INDIGO_OK_STATE));
	CHECK_EQ(600, FAKE(0, position));
cleanup:
	atomic_store(&hold_status, false);
	finish_test();
}

static int run_cases(const char *suite, const indigo_test_case *cases, int count) {
	if (!mkdtemp(config_folder)) {
		perror("mkdtemp");
		return 1;
	}
	indigo_set_log_level(INDIGO_LOG_ERROR);
	indigo_start();
	indigo_attach_client(&test_client);
	int result = indigo_run_tests(suite, cases, count);
	indigo_detach_client(&test_client);
	indigo_stop();
	remove_config_files();
	rmdir(config_folder);
	return result;
}

int main(int argc, char **argv) {
	const indigo_test_case tests[] = {
		{ "metadata_and_property_inventory", metadata_and_property_inventory },
		{ "discovery_probe_order_and_failures", discovery_probe_order_and_failures },
		{ "multiple_focusers_and_removal", multiple_focusers_and_removal },
		{ "capacity_and_slot_reuse", capacity_and_slot_reuse },
		{ "delayed_sdk_discovery_retry", delayed_sdk_discovery_retry },
		{ "connection_lifecycle_and_shutdown", connection_lifecycle_and_shutdown },
		{ "goto_sync_and_noop", goto_sync_and_noop },
		{ "relative_steps_and_direction", relative_steps_and_direction },
		{ "abort_motion", abort_motion },
		{ "abort_status_communication_retry", abort_status_communication_retry },
		{ "urgent_abort_cancels_queued_move", urgent_abort_cancels_queued_move },
		{ "motion_poll_failure_and_recovery", motion_poll_failure_and_recovery },
		{ "settings_config_writes", settings_config_writes },
		{ "suffix_and_bluetooth_name", suffix_and_bluetooth_name },
		{ "factory_reset", factory_reset },
		{ "mode_and_compensation_settings", mode_and_compensation_settings },
		{ "temperature_sources", temperature_sources },
		{ "temperature_compensation", temperature_compensation },
		{ "configuration_save_and_load", configuration_save_and_load },
		{ "disconnect_and_removal_during_motion", disconnect_and_removal_during_motion },
		{ "init_shutdown_cycles", init_shutdown_cycles },
		{ "reference_trace", reference_trace },
		{ "FOC-01 open_failure_releases_lock", defect_open_failure_releases_lock },
		{ "FOC-02 connect_config_failure_closes_sdk", defect_connect_config_failure_closes_sdk },
		{ "FOC-03 move_start_failure_alerts", defect_move_start_failure_alerts },
		{ "FOC-04 limits_update_position_range", defect_limits_update_position_range },
		{ "FOC-05 sdk_calls_serialized", defect_sdk_calls_serialized },
		{ "FOC-06 shutdown_cancels_pending_discovery", defect_shutdown_cancels_pending_discovery },
		{ "FOC-07 failed_init_can_retry", defect_failed_init_can_retry },
		{ "FOC-08 failed_writes_restore_values", defect_failed_writes_restore_values },
		{ "FOC-09 busy_motion_request_preserves_target", defect_busy_motion_request_preserves_target },
		{ "FOC-10 reset_off_request_answered", defect_reset_off_request_answered },
		{ "FOC-11 attach_failure_not_detached", defect_attach_failure_not_detached }
	};
	if (argc > 1) {
		indigo_test_case selected[ARRAY_SIZE(tests)];
		int count = 0;
		for (int i = 0; i < ARRAY_SIZE(tests); i++) {
			if (strstr(tests[i].name, argv[1])) {
				selected[count++] = tests[i];
			}
		}
		return run_cases("Astroasis focuser SDK integration tests", selected, count);
	}
	return run_cases("Astroasis focuser SDK integration tests", tests, ARRAY_SIZE(tests));
}
