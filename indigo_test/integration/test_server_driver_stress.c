// Copyright (c) 2026 INDIGO initiative
// All rights reserved.
//
// You may use this software under the terms of 'INDIGO Astronomy
// open-source license' (see LICENSE.md).
//
// THIS SOFTWARE IS PROVIDED BY THE AUTHORS 'AS IS' AND ANY EXPRESS
// OR IMPLIED WARRANTIES, INCLUDING, BUT NOT LIMITED TO, THE IMPLIED
// WARRANTIES OF MERCHANTABILITY AND FITNESS FOR A PARTICULAR PURPOSE
// ARE DISCLAIMED. IN NO EVENT SHALL THE AUTHOR BE LIABLE FOR ANY
// DIRECT, INDIRECT, INCIDENTAL, SPECIAL, EXEMPLARY, OR CONSEQUENTIAL
// DAMAGES (INCLUDING, BUT NOT LIMITED TO, PROCUREMENT OF SUBSTITUTE
// GOODS OR SERVICES; LOSS OF USE, DATA, OR PROFITS; OR BUSINESS
// INTERRUPTION) HOWEVER CAUSED AND ON ANY THEORY OF LIABILITY,
// WHETHER IN CONTRACT, STRICT LIABILITY, OR TORT (INCLUDING
// NEGLIGENCE OR OTHERWISE) ARISING IN ANY WAY OUT OF THE USE OF THIS
// SOFTWARE, EVEN IF ADVISED OF THE POSSIBILITY OF SUCH DAMAGE.

// Code is generated by AI

// Driver load and unload stress against the real indigo_server.
//
// Loading and unloading a large set of drivers was reported to hang the server now and then. The server loads and
// unloads drivers synchronously inside its DRIVERS change handler, so this test launches build/bin/indigo_server on a
// free loopback port with a private HOME, connects to it as an ordinary INDIGO client and drives Server.DRIVERS:
//
// * each_driver_loads_and_unloads_alone   every driver is loaded and unloaded on its own, twice, so a defect is
//                                         attributed to the driver that triggers it. The server is restarted after
//                                         a failure and the remaining drivers are still tried;
// * all_drivers_load_then_unload          the whole set is switched on and then off again in one request each;
// * random_driver_sets_load_and_unload    random subsets, every request loads some drivers and unloads others.
//
// Every request is sent as soon as the previous one has been answered, as a client loading a profile does. After
// every request the server must answer DRIVERS within the timeout, still run, and answer a full enumeration: that
// calls into every attached device, so a driver that leaves a device attached after its library was unloaded crashes
// the server right there instead of at some later, unrelated request.
//
// A request without an answer is reported as a hang. The stacks of all server threads are then written next to the
// server log (sample on macOS, gdb on Linux) before the server is killed. Logs and stacks are kept in
// build/integration/server_driver_stress.
//
// The test launches indigo_server and opens loopback sockets, so it is not part of test-integration. Run it with
// make -C indigo_test test-server-driver-stress. Environment:
//
//   INDIGO_STRESS_DRIVERS     regular expression, only matching drivers are used (default: all the server lists)
//   INDIGO_STRESS_EXCLUDE     regular expression, matching drivers are left out
//   INDIGO_STRESS_TIMEOUT     seconds a request may take before it counts as a hang (default 60)
//   INDIGO_STRESS_CYCLES      load all / unload all cycles (default 5)
//   INDIGO_STRESS_ITERATIONS  random requests (default 30)
//   INDIGO_STRESS_SEED        seed of the random sets (default: time), printed so that a failing run can be repeated
//   INDIGO_STRESS_VERBOSE     print every request with its duration

#include <arpa/inet.h>
#include <netinet/in.h>
#include <pthread.h>
#include <regex.h>
#include <signal.h>
#include <sys/socket.h>
#include <sys/wait.h>
#include <time.h>

#include <indigo/indigo_bus.h>
#include <indigo/indigo_client.h>
#include <indigo/indigo_names.h>

#include "../test_runner.h"

#ifndef INDIGO_SERVER_EXECUTABLE
#define INDIGO_SERVER_EXECUTABLE         "../build/bin/indigo_server"
#endif

#define STRESS_ARTIFACTS                 "build/integration/server_driver_stress"
#define SERVER_DEVICE_NAME               "Server"
#define SERVER_START_TIMEOUT             20.0
#define ENUMERATION_TIMEOUT              30.0
#define ALONE_CYCLES                     2
#define LOG_TAIL_LINES                   20
#define LIST_SIZE                        8192

#define ARRAY_SIZE(array) ((int)(sizeof(array) / sizeof((array)[0])))

typedef struct {
	pid_t pid;
	int port;
	bool exited;
	int status;
	indigo_server_entry *entry;
	char log_path[PATH_MAX];
} server_process;

typedef enum {
	REQUEST_OK,
	REQUEST_HUNG,
	REQUEST_DIED
} request_result;

// Server.DRIVERS as last published by the server, written by the client callbacks.
static pthread_mutex_t state_mutex = PTHREAD_MUTEX_INITIALIZER;
static int driver_count = 0;
static char driver_names[INDIGO_MAX_DRIVERS][INDIGO_NAME_SIZE];
static bool driver_loaded[INDIGO_MAX_DRIVERS];
static indigo_property_state drivers_state = INDIGO_IDLE_STATE;
static unsigned long drivers_defines = 0;
static unsigned long drivers_updates = 0;
static char messages[LIST_SIZE];

static bool driver_selected[INDIGO_MAX_DRIVERS];
static double request_timeout = 60;
static bool verbose = false;
static int server_starts = 0;
static server_process *running_server = NULL;
static double longest_request = 0;
static char longest_request_context[256];

// -------------------------------------------------------------------------------- helpers

static double monotonic_seconds(void) {
	struct timespec now;
	clock_gettime(CLOCK_MONOTONIC, &now);
	return now.tv_sec + now.tv_nsec / 1e9;
}

// Prints a diagnostic without failing the case, the caller decides whether the case fails.
static void stress_report(const char *format, ...) {
	va_list args;
	va_start(args, format);
	fprintf(stderr, "    ");
	vfprintf(stderr, format, args);
	fprintf(stderr, "\n");
	va_end(args);
}

#define stress_fail(...) do { \
	stress_report(__VA_ARGS__); \
	indigo_test_failures++; \
} while (0)

static void append(char *list, size_t size, const char *separator, const char *text) {
	size_t used = strlen(list);
	if (used + strlen(separator) + strlen(text) + 4 >= size) {
		if (used + 4 < size && strcmp(list + (used > 3 ? used - 3 : 0), "...")) {
			strcat(list, "...");
		}
		return;
	}
	if (used) {
		strcat(list, separator);
	}
	strcat(list, text);
}

static double env_number(const char *name, double default_value) {
	const char *value = getenv(name);
	return value && *value ? atof(value) : default_value;
}

// -------------------------------------------------------------------------------- client

static bool is_drivers_property(indigo_property *property) {
	return !strcmp(property->device, SERVER_DEVICE_NAME) && !strcmp(property->name, SERVER_DRIVERS_PROPERTY_NAME);
}

static void record_message(const char *message) {
	if (message && *message) {
		pthread_mutex_lock(&state_mutex);
		append(messages, sizeof(messages), "; ", message);
		pthread_mutex_unlock(&state_mutex);
	}
}

static void record_drivers(indigo_property *property, bool define) {
	pthread_mutex_lock(&state_mutex);
	int count = property->count < INDIGO_MAX_DRIVERS ? property->count : INDIGO_MAX_DRIVERS;
	for (int i = 0; i < count; i++) {
		snprintf(driver_names[i], INDIGO_NAME_SIZE, "%s", property->items[i].name);
		driver_loaded[i] = property->items[i].sw.value;
	}
	driver_count = count;
	drivers_state = property->state;
	if (define) {
		drivers_defines++;
	} else {
		drivers_updates++;
	}
	pthread_mutex_unlock(&state_mutex);
}

static indigo_result client_define_property(indigo_client *client, indigo_device *device, indigo_property *property, const char *message) {
	if (is_drivers_property(property)) {
		record_drivers(property, true);
	}
	record_message(message);
	return INDIGO_OK;
}

static indigo_result client_update_property(indigo_client *client, indigo_device *device, indigo_property *property, const char *message) {
	if (is_drivers_property(property)) {
		record_drivers(property, false);
	}
	record_message(message);
	return INDIGO_OK;
}

static indigo_result client_send_message(indigo_client *client, indigo_device *device, indigo_property *property, const char *message) {
	record_message(message);
	return INDIGO_OK;
}

static indigo_client stress_client = {
	.name = "Driver stress client",
	.version = INDIGO_VERSION_CURRENT,
	.define_property = client_define_property,
	.update_property = client_update_property,
	.send_message = client_send_message
};

// -------------------------------------------------------------------------------- server process

static int free_loopback_port(void) {
	int fd = socket(AF_INET, SOCK_STREAM, 0);
	if (fd < 0) {
		return -1;
	}
	struct sockaddr_in address = { 0 };
	address.sin_family = AF_INET;
	address.sin_addr.s_addr = htonl(INADDR_LOOPBACK);
	socklen_t length = sizeof(address);
	int port = -1;
	if (bind(fd, (struct sockaddr *)&address, sizeof(address)) == 0 && getsockname(fd, (struct sockaddr *)&address, &length) == 0) {
		port = ntohs(address.sin_port);
	}
	close(fd);
	return port;
}

static bool server_running(server_process *server) {
	if (server->pid <= 0 || server->exited) {
		return false;
	}
	if (waitpid(server->pid, &server->status, WNOHANG) == server->pid) {
		server->exited = true;
		return false;
	}
	return true;
}

static void describe_exit(server_process *server, char *buffer, size_t size) {
	if (WIFSIGNALED(server->status)) {
		snprintf(buffer, size, "killed by signal %d (%s)", WTERMSIG(server->status), strsignal(WTERMSIG(server->status)));
	} else {
		snprintf(buffer, size, "exited with status %d", WEXITSTATUS(server->status));
	}
}

static void print_log_tail(server_process *server) {
	FILE *file = fopen(server->log_path, "r");
	if (file == NULL) {
		return;
	}
	char lines[LOG_TAIL_LINES][512];
	int count = 0;
	while (fgets(lines[count % LOG_TAIL_LINES], sizeof(lines[0]), file)) {
		count++;
	}
	fclose(file);
	int first = count > LOG_TAIL_LINES ? count - LOG_TAIL_LINES : 0;
	fprintf(stderr, "    last lines of %s:\n", server->log_path);
	for (int i = first; i < count; i++) {
		fprintf(stderr, "      %s", lines[i % LOG_TAIL_LINES]);
	}
}

static void capture_stacks(server_process *server) {
	char path[PATH_MAX + 16];
	char command[2 * PATH_MAX];
	snprintf(path, sizeof(path), "%s.stacks", server->log_path);
#ifdef __APPLE__
	snprintf(command, sizeof(command), "sample %d 2 -file '%s' >/dev/null 2>&1", server->pid, path);
#else
	snprintf(command, sizeof(command), "gdb -p %d -batch -ex 'thread apply all bt' >'%s' 2>&1", server->pid, path);
#endif
	if (system(command) == 0) {
		fprintf(stderr, "    stacks of all server threads: %s\n", path);
	} else {
		fprintf(stderr, "    stacks of the server threads could not be captured (%s)\n", command);
	}
}

static void stop_server(server_process *server) {
	if (server->entry) {
		indigo_disconnect_server(server->entry);
		server->entry = NULL;
	}
	if (server_running(server)) {
		kill(server->pid, SIGKILL);
		waitpid(server->pid, &server->status, 0);
		server->exited = true;
	}
	if (running_server == server) {
		running_server = NULL;
	}
}

static void kill_running_server(void) {
	if (running_server && server_running(running_server)) {
		kill(running_server->pid, SIGKILL);
		waitpid(running_server->pid, NULL, 0);
	}
}

static bool start_server(server_process *server, const char *label) {
	memset(server, 0, sizeof(*server));
	// the server restores the last DRIVERS selection from its configuration, a restart after a failure must not load
	// the driver that caused it again
	char config[PATH_MAX];
	snprintf(config, sizeof(config), "%s/.indigo", indigo_test_home);
	indigo_test_remove_tree(config);
	mkdir("build", 0755);
	mkdir("build/integration", 0755);
	mkdir(STRESS_ARTIFACTS, 0755);
	snprintf(server->log_path, sizeof(server->log_path), STRESS_ARTIFACTS "/%s-%d.log", label, ++server_starts);
	server->port = free_loopback_port();
	if (server->port <= 0) {
		stress_fail("no free loopback port");
		return false;
	}
	pthread_mutex_lock(&state_mutex);
	driver_count = 0;
	drivers_defines = drivers_updates = 0;
	drivers_state = INDIGO_IDLE_STATE;
	messages[0] = 0;
	pthread_mutex_unlock(&state_mutex);
	char port[16];
	snprintf(port, sizeof(port), "%d", server->port);
	server->pid = fork();
	if (server->pid < 0) {
		stress_fail("fork failed: %s", strerror(errno));
		return false;
	}
	if (server->pid == 0) {
		int fd = open(server->log_path, O_WRONLY | O_CREAT | O_TRUNC, 0644);
		if (fd >= 0) {
			dup2(fd, STDOUT_FILENO);
			dup2(fd, STDERR_FILENO);
			close(fd);
		}
		// argv[0] locates the driver list in ../share/indigo, -- keeps a single process without the restarting supervisor
		// so that a crash is seen as a crash
		execl(INDIGO_SERVER_EXECUTABLE, INDIGO_SERVER_EXECUTABLE, "--", "-p", port, "-b-", "-w-", "-c-", "-v", (char *)NULL);
		_exit(127);
	}
	running_server = server;
	char name[INDIGO_NAME_SIZE];
	snprintf(name, sizeof(name), "stress %d", server_starts);
	double deadline = monotonic_seconds() + SERVER_START_TIMEOUT;
	while (monotonic_seconds() < deadline && server_running(server)) {
		if (server->entry == NULL) {
			// the client thread retries the connection itself until the server listens
			indigo_connect_server(name, "127.0.0.1", server->port, &server->entry, NULL);
		}
		pthread_mutex_lock(&state_mutex);
		bool defined = drivers_defines > 0;
		pthread_mutex_unlock(&state_mutex);
		if (defined) {
			return true;
		}
		indigo_usleep(20000);
	}
	if (server_running(server)) {
		stress_fail("%s did not publish %s.%s within %.0fs", INDIGO_SERVER_EXECUTABLE, SERVER_DEVICE_NAME, SERVER_DRIVERS_PROPERTY_NAME, SERVER_START_TIMEOUT);
	} else {
		char reason[64];
		describe_exit(server, reason, sizeof(reason));
		stress_fail("%s %s during start-up", INDIGO_SERVER_EXECUTABLE, reason);
	}
	print_log_tail(server);
	stop_server(server);
	return false;
}

// -------------------------------------------------------------------------------- driver selection

static bool select_drivers(void) {
	const char *include = getenv("INDIGO_STRESS_DRIVERS");
	const char *exclude = getenv("INDIGO_STRESS_EXCLUDE");
	regex_t include_regex, exclude_regex;
	bool has_include = include && *include, has_exclude = exclude && *exclude;
	if (has_include && regcomp(&include_regex, include, REG_EXTENDED | REG_NOSUB)) {
		stress_fail("INDIGO_STRESS_DRIVERS '%s' is not a valid regular expression", include);
		return false;
	}
	if (has_exclude && regcomp(&exclude_regex, exclude, REG_EXTENDED | REG_NOSUB)) {
		stress_fail("INDIGO_STRESS_EXCLUDE '%s' is not a valid regular expression", exclude);
		if (has_include) {
			regfree(&include_regex);
		}
		return false;
	}
	int selected = 0;
	pthread_mutex_lock(&state_mutex);
	for (int i = 0; i < driver_count; i++) {
		driver_selected[i] = (!has_include || regexec(&include_regex, driver_names[i], 0, NULL, 0) == 0) && (!has_exclude || regexec(&exclude_regex, driver_names[i], 0, NULL, 0) != 0);
		selected += driver_selected[i];
	}
	int listed = driver_count;
	pthread_mutex_unlock(&state_mutex);
	if (has_include) {
		regfree(&include_regex);
	}
	if (has_exclude) {
		regfree(&exclude_regex);
	}
	printf("    %d of %d drivers listed by the server selected\n", selected, listed);
	if (selected == 0) {
		stress_fail("no driver selected");
		return false;
	}
	return true;
}

// -------------------------------------------------------------------------------- requests

// Proves that the server is still alive and that every attached device still answers. The DRIVERS definition of the
// first enumeration may arrive before a later device is enumerated, the second, single property enumeration is
// answered only after the first one finished, because the server handles one client's requests in order.
static request_result probe_enumeration(server_process *server, const char *context) {
	static indigo_property drivers_only;
	strcpy(drivers_only.device, SERVER_DEVICE_NAME);
	strcpy(drivers_only.name, SERVER_DRIVERS_PROPERTY_NAME);
	pthread_mutex_lock(&state_mutex);
	unsigned long before = drivers_defines;
	pthread_mutex_unlock(&state_mutex);
	indigo_enumerate_properties(&stress_client, &INDIGO_ALL_PROPERTIES);
	indigo_enumerate_properties(&stress_client, &drivers_only);
	double deadline = monotonic_seconds() + ENUMERATION_TIMEOUT;
	while (true) {
		pthread_mutex_lock(&state_mutex);
		bool done = drivers_defines >= before + 2;
		pthread_mutex_unlock(&state_mutex);
		if (done) {
			return REQUEST_OK;
		}
		if (!server_running(server)) {
			char reason[64];
			describe_exit(server, reason, sizeof(reason));
			stress_report("server %s while enumerating all devices after %s", reason, context);
			print_log_tail(server);
			return REQUEST_DIED;
		}
		if (monotonic_seconds() > deadline) {
			stress_report("server did not finish enumerating all devices within %.0fs after %s", ENUMERATION_TIMEOUT, context);
			capture_stacks(server);
			print_log_tail(server);
			return REQUEST_HUNG;
		}
		indigo_usleep(10000);
	}
}

// Sends Server.DRIVERS with wanted[i] for every listed driver and waits for the answer.
static request_result request_drivers(server_process *server, const bool *wanted, const char *context) {
	static char load_list[LIST_SIZE], unload_list[LIST_SIZE];
	const char *names[INDIGO_MAX_DRIVERS];
	bool values[INDIGO_MAX_DRIVERS];
	load_list[0] = unload_list[0] = 0;
	pthread_mutex_lock(&state_mutex);
	int count = driver_count;
	int loads = 0, unloads = 0;
	for (int i = 0; i < count; i++) {
		names[i] = driver_names[i];
		values[i] = wanted[i];
		if (wanted[i] && !driver_loaded[i]) {
			append(load_list, sizeof(load_list), ", ", driver_names[i]);
			loads++;
		} else if (!wanted[i] && driver_loaded[i]) {
			append(unload_list, sizeof(unload_list), ", ", driver_names[i]);
			unloads++;
		}
	}
	unsigned long before = drivers_updates;
	messages[0] = 0;
	pthread_mutex_unlock(&state_mutex);
	char what[256];
	snprintf(what, sizeof(what), "%s (loading %d, unloading %d)", context, loads, unloads);
	double started = monotonic_seconds();
	indigo_change_switch_property(&stress_client, SERVER_DEVICE_NAME, SERVER_DRIVERS_PROPERTY_NAME, count, names, values);
	while (true) {
		pthread_mutex_lock(&state_mutex);
		bool answered = drivers_updates > before && drivers_state != INDIGO_BUSY_STATE;
		pthread_mutex_unlock(&state_mutex);
		if (answered) {
			break;
		}
		bool running = server_running(server);
		if (!running || monotonic_seconds() - started > request_timeout) {
			if (running) {
				stress_report("server hung: no answer to %s within %.0fs", what, request_timeout);
			} else {
				char reason[64];
				describe_exit(server, reason, sizeof(reason));
				stress_report("server %s during %s", reason, what);
			}
			if (*load_list) {
				fprintf(stderr, "    loading: %s\n", load_list);
			}
			if (*unload_list) {
				fprintf(stderr, "    unloading: %s\n", unload_list);
			}
			if (running) {
				capture_stacks(server);
			}
			print_log_tail(server);
			return running ? REQUEST_HUNG : REQUEST_DIED;
		}
		indigo_usleep(10000);
	}
	double elapsed = monotonic_seconds() - started;
	if (elapsed > longest_request) {
		longest_request = elapsed;
		snprintf(longest_request_context, sizeof(longest_request_context), "%s", what);
	}
	if (verbose) {
		pthread_mutex_lock(&state_mutex);
		printf("    %s: %.2fs%s%s\n", what, elapsed, *messages ? ", messages: " : "", messages);
		pthread_mutex_unlock(&state_mutex);
	}
	return probe_enumeration(server, what);
}

// The wanted state of every listed driver: selected drivers as chosen by the callback, all other ones left as they are.
static void wanted_state(bool *wanted, bool (*choose)(int index, void *data), void *data) {
	pthread_mutex_lock(&state_mutex);
	for (int i = 0; i < driver_count; i++) {
		wanted[i] = driver_selected[i] ? choose(i, data) : driver_loaded[i];
	}
	pthread_mutex_unlock(&state_mutex);
}

static bool choose_constant(int index, void *data) {
	return *(bool *)data;
}

static bool choose_random(int index, void *data) {
	return (rand() & 1) != 0;
}

static void reset_longest_request(void) {
	longest_request = 0;
	longest_request_context[0] = 0;
}

static void print_longest_request(int requests) {
	printf("    %d requests, the longest took %.2fs: %s\n", requests, longest_request, longest_request_context);
}

// -------------------------------------------------------------------------------- tests

static void each_driver_loads_and_unloads_alone(void) {
	server_process server;
	if (!start_server(&server, "alone") || !select_drivers()) {
		stop_server(&server);
		return;
	}
	static char failed[LIST_SIZE], kept[LIST_SIZE];
	failed[0] = kept[0] = 0;
	int failures = 0, requests = 0;
	reset_longest_request();
	pthread_mutex_lock(&state_mutex);
	int count = driver_count;
	static char names[INDIGO_MAX_DRIVERS][INDIGO_NAME_SIZE];
	memcpy(names, driver_names, sizeof(names));
	bool selected[INDIGO_MAX_DRIVERS];
	memcpy(selected, driver_selected, sizeof(selected));
	pthread_mutex_unlock(&state_mutex);
	for (int d = 0; d < count; d++) {
		if (!selected[d]) {
			continue;
		}
		request_result result = REQUEST_OK;
		bool stayed_loaded = false;
		for (int cycle = 0; cycle < ALONE_CYCLES && result == REQUEST_OK; cycle++) {
			for (int step = 0; step < 2 && result == REQUEST_OK; step++) {
				bool wanted[INDIGO_MAX_DRIVERS];
				pthread_mutex_lock(&state_mutex);
				// the item order is fixed while no driver is added through LOAD, look the driver up anyway
				int index = -1;
				for (int i = 0; i < driver_count; i++) {
					wanted[i] = driver_loaded[i];
					if (!strcmp(driver_names[i], names[d])) {
						index = i;
					}
				}
				if (index >= 0) {
					wanted[index] = step == 0;
				}
				pthread_mutex_unlock(&state_mutex);
				if (index < 0) {
					break;
				}
				char context[INDIGO_NAME_SIZE + 64];
				snprintf(context, sizeof(context), "%s %s, cycle %d", step == 0 ? "loading" : "unloading", names[d], cycle + 1);
				result = request_drivers(&server, wanted, context);
				requests++;
				if (result == REQUEST_OK && step == 1) {
					pthread_mutex_lock(&state_mutex);
					stayed_loaded = stayed_loaded || driver_loaded[index];
					pthread_mutex_unlock(&state_mutex);
				}
			}
		}
		if (result != REQUEST_OK) {
			char entry[INDIGO_NAME_SIZE + 32];
			snprintf(entry, sizeof(entry), "%s (%s)", names[d], result == REQUEST_HUNG ? "hang" : "crash");
			append(failed, sizeof(failed), ", ", entry);
			failures++;
			stop_server(&server);
			if (!start_server(&server, "alone")) {
				break;
			}
		} else if (stayed_loaded) {
			append(kept, sizeof(kept), ", ", names[d]);
		}
	}
	print_longest_request(requests);
	if (*kept) {
		// refusing to unload is allowed, the driver then stays loaded and keeps working
		printf("    refused to unload: %s\n", kept);
	}
	if (failures) {
		stress_fail("%d driver(s) hang or crash the server when loaded and unloaded alone: %s", failures, failed);
	}
	stop_server(&server);
}

static void all_drivers_load_then_unload(void) {
	server_process server;
	if (!start_server(&server, "all") || !select_drivers()) {
		stop_server(&server);
		return;
	}
	int cycles = (int)env_number("INDIGO_STRESS_CYCLES", 5);
	int requests = 0;
	reset_longest_request();
	for (int cycle = 0; cycle < cycles; cycle++) {
		for (int step = 0; step < 2; step++) {
			bool on = step == 0;
			bool wanted[INDIGO_MAX_DRIVERS];
			wanted_state(wanted, choose_constant, &on);
			char context[64];
			snprintf(context, sizeof(context), "%s all drivers, cycle %d", on ? "loading" : "unloading", cycle + 1);
			requests++;
			if (request_drivers(&server, wanted, context) != REQUEST_OK) {
				indigo_test_failures++;
				stop_server(&server);
				return;
			}
		}
	}
	print_longest_request(requests);
	stop_server(&server);
}

static void random_driver_sets_load_and_unload(void) {
	server_process server;
	if (!start_server(&server, "random") || !select_drivers()) {
		stop_server(&server);
		return;
	}
	int iterations = (int)env_number("INDIGO_STRESS_ITERATIONS", 30);
	unsigned seed = (unsigned)env_number("INDIGO_STRESS_SEED", (double)time(NULL));
	printf("    INDIGO_STRESS_SEED=%u\n", seed);
	srand(seed);
	int requests = 0;
	reset_longest_request();
	for (int iteration = 0; iteration < iterations; iteration++) {
		bool wanted[INDIGO_MAX_DRIVERS];
		wanted_state(wanted, choose_random, NULL);
		char context[64];
		snprintf(context, sizeof(context), "random set %d", iteration + 1);
		requests++;
		if (request_drivers(&server, wanted, context) != REQUEST_OK) {
			indigo_test_failures++;
			stop_server(&server);
			return;
		}
	}
	print_longest_request(requests);
	stop_server(&server);
}

int main(void) {
	if (access(INDIGO_SERVER_EXECUTABLE, X_OK) != 0) {
		fprintf(stderr, "%s is missing, run 'make all' from the repository root first\n", INDIGO_SERVER_EXECUTABLE);
		return 1;
	}
	indigo_test_use_private_home();
	// diagnostics go to stderr, keep the case results in order with them when the output is redirected
	setvbuf(stdout, NULL, _IOLBF, 0);
	signal(SIGPIPE, SIG_IGN);
	atexit(kill_running_server);
	request_timeout = env_number("INDIGO_STRESS_TIMEOUT", 60);
	verbose = getenv("INDIGO_STRESS_VERBOSE") != NULL;
	// remote devices keep their own names, so the server device is "Server"
	indigo_use_host_suffix = false;
	indigo_start();
	indigo_attach_client(&stress_client);
	const indigo_test_case tests[] = {
		{ "each_driver_loads_and_unloads_alone", each_driver_loads_and_unloads_alone },
		{ "all_drivers_load_then_unload", all_drivers_load_then_unload },
		{ "random_driver_sets_load_and_unload", random_driver_sets_load_and_unload }
	};
	int result = indigo_run_tests("indigo_server driver load and unload stress", tests, ARRAY_SIZE(tests));
	indigo_detach_client(&stress_client);
	indigo_stop();
	indigo_test_remove_private_home();
	return result;
}
