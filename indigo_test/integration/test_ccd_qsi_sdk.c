// Copyright (c) 2026 INDIGO initiative
// All rights reserved.
//
// You may use this software under the terms of 'INDIGO Astronomy
// open-source license' (see LICENSE.md).
//
// THIS SOFTWARE IS PROVIDED BY THE AUTHORS 'AS IS' AND ANY EXPRESS
// OR IMPLIED WARRANTIES, INCLUDING, BUT NOT LIMITED TO, THE IMPLIED
// WARRANTIES OF MERCHANTABILITY AND FITNESS FOR A PARTICULAR PURPOSE
// ARE DISCLAIMED. IN NO EVENT SHALL THE AUTHOR BE LIABLE FOR ANY
// DIRECT, INDIRECT, INCIDENTAL, SPECIAL, EXEMPLARY, OR CONSEQUENTIAL
// DAMAGES (INCLUDING, BUT NOT LIMITED TO, PROCUREMENT OF SUBSTITUTE
// GOODS OR SERVICES; LOSS OF USE, DATA, OR PROFITS; OR BUSINESS
// INTERRUPTION) HOWEVER CAUSED AND ON ANY THEORY OF LIABILITY,
// WHETHER IN CONTRACT, STRICT LIABILITY, OR TORT (INCLUDING
// NEGLIGENCE OR OTHERWISE) ARISING IN ANY WAY OUT OF THE USE OF THIS
// SOFTWARE, EVEN IF ADVISED OF THE POSSIBILITY OF SUCH DAMAGE.

// Code is generated by AI

// Hardware-free integration tests for indigo_ccd_qsi against the deterministic
// fake qsiapi SDK in qsi_fake_sdk.cpp.
//
// The same source is used as the migration characterization suite: building it
// with -DQSI_ORIGINAL_BASELINE links it against the pre-migration hand-written
// driver and skips the cases that cover behavior only the migrated driver
// provides. Without that macro it exercises the generated driver.

#include <stdbool.h>
#include <stdint.h>
#include <stdio.h>
#include <stdlib.h>
#include <string.h>

#include <indigo/indigo_ccd_driver.h>
#include <indigo/indigo_wheel_driver.h>
#include <indigo/indigo_usb_utils.h>
#include <indigo_drivers/ccd_qsi/indigo_ccd_qsi.h>

#include "ccd_test_noise.h"
#include "qsi_fake_sdk.h"
#include "simulator_test_common.h"

#define QSI_VENDOR_ID    0x0403
#define QSI_PRODUCT_ID1  0xEB48
#define QSI_PRODUCT_ID2  0xEB49

#define SENSOR_WIDTH     96
#define SENSOR_HEIGHT    64

#define CAMERA_0_SERIAL  "00600123"
#define CAMERA_0_DESC    "QSI 683ws"
#define CAMERA_0_MODEL   "683ws"
#define CAMERA_1_SERIAL  "00600456"
#define CAMERA_1_DESC    "QSI 690wsg"
#define CAMERA_1_MODEL   "690wsg"

#ifdef QSI_ORIGINAL_BASELINE
#define READOUT_SPEED_PROPERTY_NAME       "QSI_READOUT_SPEED"
#define ANTI_BLOOM_PROPERTY_NAME          "QSI_ANTI_BLOOM"
#define PRE_EXPOSURE_FLUSH_PROPERTY_NAME  "QSI_PRE_EXPOSURE_FLUSH"
#define FAN_MODE_PROPERTY_NAME            "QSI_FAN_MODE"
#else
#define READOUT_SPEED_PROPERTY_NAME       "X_QSI_READOUT_SPEED"
#define ANTI_BLOOM_PROPERTY_NAME          "X_QSI_ANTI_BLOOM"
#define PRE_EXPOSURE_FLUSH_PROPERTY_NAME  "X_QSI_PRE_EXPOSURE_FLUSH"
#define FAN_MODE_PROPERTY_NAME            "X_QSI_FAN_MODE"
#endif

// The hand-written driver attached the filter wheel only while the camera was
// connected; the generated driver attaches it at discovery.
#ifdef QSI_ORIGINAL_BASELINE
#define QSI_WHEEL_AT_DISCOVERY 0
#else
#define QSI_WHEEL_AT_DISCOVERY 1
#endif

// -------------------------------------------------------------------------------- test-side USB and bus stubs

static libusb_hotplug_callback_fn usb_callback;
// One fake libusb_device per camera, plus one foreign device.
static int usb_devices[QSI_FAKE_MAX_CAMERAS + 1];
static int usb_product_ids[QSI_FAKE_MAX_CAMERAS + 1];
static int usb_vendor_ids[QSI_FAKE_MAX_CAMERAS + 1];
static indigo_device *logical_devices[QSI_FAKE_MAX_CAMERAS * 2];
static atomic_int attached_count, attach_calls, detach_calls, usb_refs, usb_unref_errors;
static atomic_int fail_register, blob_count, bad_blob;
static bool fixture_running;
// Set while capturing the reference trace so discovery is recorded too.
static bool trace_discovery;
static int expected_image_width, expected_image_height, expected_left, expected_top, expected_bin;

static const simulator_driver_case ccd_case = { "QSI Camera", "indigo_ccd_qsi", CAMERA_0_DESC " #" CAMERA_0_SERIAL, indigo_ccd_qsi, true, NULL, 0, NULL, 0, NULL, 0, NULL, 0 };
static const simulator_driver_case wheel_case = { "QSI Camera", "indigo_ccd_qsi", CAMERA_0_DESC " (wheel) #" CAMERA_0_SERIAL, indigo_ccd_qsi, true, NULL, 0, NULL, 0, NULL, 0, NULL, 0 };
static const simulator_driver_case second_ccd_case = { "QSI Camera", "indigo_ccd_qsi", CAMERA_1_DESC " #" CAMERA_1_SERIAL, indigo_ccd_qsi, true, NULL, 0, NULL, 0, NULL, 0, NULL, 0 };

// SIMULATION is hidden for non-simulator drivers and the driver does not opt
// into additional instances, so both stay undefined.
static const char *qsi_base_properties[] = {
	INFO_PROPERTY_NAME,
	CONFIG_PROPERTY_NAME,
	PROFILE_NAME_PROPERTY_NAME,
	PROFILE_PROPERTY_NAME,
	CONNECTION_PROPERTY_NAME
};

static const char *qsi_hidden_base_properties[] = {
	SIMULATION_PROPERTY_NAME,
	ADDITIONAL_INSTANCES_PROPERTY_NAME,
	DEVICE_PORT_PROPERTY_NAME,
	DEVICE_BAUDRATE_PROPERTY_NAME,
	DEVICE_PORTS_PROPERTY_NAME,
	AUTHENTICATION_PROPERTY_NAME
};

#define QSI_CHECK_TRUE(condition) do { if (!(condition)) { fprintf(stderr, "%s:%d: assertion failed: %s\n", __FILE__, __LINE__, #condition); indigo_test_failures++; goto cleanup; } } while (0)
#define QSI_CHECK_EQ(expected, actual) do { int e_ = (int)(expected), a_ = (int)(actual); if (e_ != a_) { fprintf(stderr, "%s:%d: expected %d, got %d\n", __FILE__, __LINE__, e_, a_); indigo_test_failures++; goto cleanup; } } while (0)

// Lets a test reach the driver's bounded readout and filter-wheel deadlines
// without waiting for them in real time.
static _Atomic double clock_shift;

double qsi_test_clock(void) {
	return indigo_monotonic_time() + atomic_load(&clock_shift);
}

// The original driver sleeps a full second before every re-enumeration. Scaling
// long waits keeps the suite fast without changing the poll cadence of the
// readout and wheel loops.
void qsi_test_usleep(long delay) {
	if (delay > 100000) {
		delay = 20000;
	}
	indigo_usleep(delay);
}

void qsi_test_usb_start(void) {
}

indigo_result qsi_test_attach(indigo_device *device) {
	atomic_fetch_add(&attach_calls, 1);
	indigo_result result = indigo_attach_device(device);
	if (result == INDIGO_OK) {
		for (int i = 0; i < (int)(sizeof(logical_devices) / sizeof(logical_devices[0])); i++) {
			if (logical_devices[i] == NULL) {
				logical_devices[i] = device;
				break;
			}
		}
		atomic_fetch_add(&attached_count, 1);
	}
	return result;
}

indigo_result qsi_test_detach(indigo_device *device) {
	indigo_result result = indigo_detach_device(device);
	for (int i = 0; i < (int)(sizeof(logical_devices) / sizeof(logical_devices[0])); i++) {
		if (logical_devices[i] == device) {
			logical_devices[i] = NULL;
			break;
		}
	}
	atomic_fetch_sub(&attached_count, 1);
	atomic_fetch_add(&detach_calls, 1);
	return result;
}

static void fire_usb_event(int index, libusb_hotplug_event event) {
	if (usb_callback != NULL) {
		usb_callback(NULL, (libusb_device *)(usb_devices + index), event, NULL);
	}
}

int qsi_test_usb_register(libusb_context *ctx, int events, int flags, int vid, int pid, int cls, libusb_hotplug_callback_fn callback, void *data, libusb_hotplug_callback_handle *handle) {
	if (atomic_exchange(&fail_register, 0)) {
		return LIBUSB_ERROR_OTHER;
	}
	usb_callback = callback;
	for (int i = 0; i < QSI_FAKE_MAX_CAMERAS; i++) {
		qsi_fake_camera *camera = qsi_fake_camera_at(i);
		if (camera != NULL && camera->present && camera->serial[0]) {
			fire_usb_event(i, LIBUSB_HOTPLUG_EVENT_DEVICE_ARRIVED);
		}
	}
	return LIBUSB_SUCCESS;
}

int qsi_test_usb_register_sim(libusb_context *ctx, libusb_hotplug_event events, libusb_hotplug_flag flags, int vid, int pid, int cls, libusb_hotplug_callback_fn callback, void *data, libusb_hotplug_callback_handle *handle) {
	return qsi_test_usb_register(ctx, events, flags, vid, pid, cls, callback, data, handle);
}

int qsi_test_usb_deregister_poll(libusb_context *ctx, libusb_hotplug_callback_handle handle) {
	usb_callback = NULL;
	return LIBUSB_SUCCESS;
}

void LIBUSB_CALL qsi_test_usb_deregister(libusb_context *ctx, libusb_hotplug_callback_handle handle) {
	usb_callback = NULL;
}

libusb_device *LIBUSB_CALL qsi_test_usb_ref(libusb_device *device) {
	atomic_fetch_add(&usb_refs, 1);
	return device;
}

void LIBUSB_CALL qsi_test_usb_unref(libusb_device *device) {
	if (atomic_fetch_sub(&usb_refs, 1) <= 0) {
		atomic_fetch_add(&usb_unref_errors, 1);
	}
}

int LIBUSB_CALL qsi_test_usb_descriptor(libusb_device *device, struct libusb_device_descriptor *descriptor) {
	memset(descriptor, 0, sizeof(*descriptor));
	int index = (int)((int *)device - usb_devices);
	if (index < 0 || index > QSI_FAKE_MAX_CAMERAS) {
		index = 0;
	}
	descriptor->idVendor = (uint16_t)usb_vendor_ids[index];
	descriptor->idProduct = (uint16_t)usb_product_ids[index];
	return LIBUSB_SUCCESS;
}

// -------------------------------------------------------------------------------- image observer

static indigo_result observe_image(indigo_client *client, indigo_device *device, indigo_property *property, const char *message) {
	if (!strcmp(property->device, ccd_case.device_name) && !strcmp(property->name, CCD_IMAGE_PROPERTY_NAME) && property->state == INDIGO_OK_STATE && property->count > 0 && property->items[0].blob.size > 0) {
		indigo_item *item = property->items;
		bool valid = item->blob.value != NULL && !strcmp(item->blob.format, ".raw") && item->blob.size >= (long)sizeof(indigo_raw_header);
		if (valid) {
			indigo_raw_header header;
			memcpy(&header, item->blob.value, sizeof(header));
			valid = header.signature == INDIGO_RAW_MONO16 && header.width == (uint32_t)expected_image_width && header.height == (uint32_t)expected_image_height && item->blob.size >= (long)(sizeof(header) + (size_t)header.width * header.height * 2);
			if (valid) {
				uint16_t *pixels = (uint16_t *)((unsigned char *)item->blob.value + sizeof(header));
				for (uint32_t y = 0; y < header.height && valid; y++) {
					for (uint32_t x = 0; x < header.width; x++) {
						unsigned sensor_x = (unsigned)(expected_left + (int)x * expected_bin);
						unsigned sensor_y = (unsigned)(expected_top + (int)y * expected_bin);
						if (pixels[y * header.width + x] != ccd_test_noise(sensor_y * SENSOR_WIDTH + sensor_x, (unsigned)expected_bin)) {
							valid = false;
							break;
						}
					}
				}
			}
		}
		atomic_fetch_add(&blob_count, 1);
		if (!valid) {
			atomic_fetch_add(&bad_blob, 1);
		}
	}
	return simulator_client_update_property(client, device, property, message);
}

// -------------------------------------------------------------------------------- fixture

static void configure_usb(int index, int vendor, int product) {
	usb_devices[index] = index;
	usb_vendor_ids[index] = vendor;
	usb_product_ids[index] = product;
}

static void reset_fake(int camera_count) {
	qsi_fake_reset();
	memset(logical_devices, 0, sizeof(logical_devices));
	usb_callback = NULL;
	for (int i = 0; i <= QSI_FAKE_MAX_CAMERAS; i++) {
		configure_usb(i, QSI_VENDOR_ID, QSI_PRODUCT_ID1);
	}
	if (camera_count > 0) {
		qsi_fake_add_camera(0, CAMERA_0_SERIAL, CAMERA_0_DESC, CAMERA_0_MODEL);
	}
	if (camera_count > 1) {
		qsi_fake_add_camera(1, CAMERA_1_SERIAL, CAMERA_1_DESC, CAMERA_1_MODEL);
		configure_usb(1, QSI_VENDOR_ID, QSI_PRODUCT_ID2);
	}
	atomic_store(&attached_count, 0);
	atomic_store(&attach_calls, 0);
	atomic_store(&detach_calls, 0);
	atomic_store(&usb_refs, 0);
	atomic_store(&usb_unref_errors, 0);
	atomic_store(&fail_register, 0);
	atomic_store(&blob_count, 0);
	atomic_store(&bad_blob, 0);
	atomic_store(&clock_shift, 0);
	expected_image_width = SENSOR_WIDTH;
	expected_image_height = SENSOR_HEIGHT;
	expected_left = expected_top = 0;
	expected_bin = 1;
}

static bool wait_attached(int expected) {
	for (int i = 0; i < 400; i++) {
		if (atomic_load(&attached_count) == expected) {
			return true;
		}
		indigo_usleep(10000);
	}
	return false;
}

static bool wait_counter(const int *field, int expected) {
	for (int i = 0; i < 400; i++) {
		if (qsi_fake_counter(0, field) == expected) {
			return true;
		}
		indigo_usleep(10000);
	}
	return false;
}

static bool wait_counter_at_least(const int *field, int expected) {
	for (int i = 0; i < 400; i++) {
		if (qsi_fake_counter(0, field) >= expected) {
			return true;
		}
		indigo_usleep(10000);
	}
	return false;
}

static bool wait_gate(void) {
	for (int i = 0; i < 400; i++) {
		if (qsi_fake_gate_entered()) {
			return true;
		}
		indigo_usleep(10000);
	}
	return false;
}

// The original driver attaches the wheel only while the camera is connected,
// the migrated driver attaches it at discovery. Both are satisfied by this
// count, which is asserted per driver where the difference matters.
static bool fixture_start(int camera_count) {
	reset_fake(camera_count);
	qsi_fake_trace_enable(trace_discovery);
	reset_simulator_context(&ccd_case);
	simulator_test_client.update_property = observe_image;
	if (indigo_start() != INDIGO_OK || indigo_attach_client(&simulator_test_client) != INDIGO_OK || indigo_ccd_qsi(INDIGO_DRIVER_INIT, NULL) != INDIGO_OK) {
		return false;
	}
	fixture_running = true;
	for (int i = 0; i < 400; i++) {
		if (atomic_load(&attached_count) >= camera_count) {
			return true;
		}
		indigo_usleep(10000);
	}
	return false;
}

static void fixture_stop(void) {
	if (!fixture_running) {
		return;
	}
	qsi_fake_gate_release();
	for (int i = 0; i < (int)(sizeof(logical_devices) / sizeof(logical_devices[0])); i++) {
		if (logical_devices[i] != NULL) {
			indigo_change_switch_property_1(&simulator_test_client, logical_devices[i]->name, CONNECTION_PROPERTY_NAME, CONNECTION_DISCONNECTED_ITEM_NAME, true);
		}
	}
	indigo_usleep(200000);
	indigo_ccd_qsi(INDIGO_DRIVER_SHUTDOWN, NULL);
	indigo_detach_client(&simulator_test_client);
	indigo_stop();
	release_cached_properties();
	fixture_running = false;
}

static void select_device(const simulator_driver_case *driver_case) {
	reset_simulator_context(driver_case);
	simulator_test_client.update_property = observe_image;
	enumerate_simulator_device();
}

static bool connect_device(const simulator_driver_case *driver_case) {
	select_device(driver_case);
	if (indigo_change_switch_property_1(&simulator_test_client, driver_case->device_name, CONNECTION_PROPERTY_NAME, CONNECTION_CONNECTED_ITEM_NAME, true) != INDIGO_OK) {
		return false;
	}
	return wait_for_simulator_connection_state(true);
}

static bool disconnect_device(const simulator_driver_case *driver_case) {
	select_device(driver_case);
	if (indigo_change_switch_property_1(&simulator_test_client, driver_case->device_name, CONNECTION_PROPERTY_NAME, CONNECTION_DISCONNECTED_ITEM_NAME, true) != INDIGO_OK) {
		return false;
	}
	return wait_for_simulator_connection_state(false);
}

static void use_raw_format(void) {
	indigo_change_switch_property_1(&simulator_test_client, ccd_case.device_name, CCD_IMAGE_FORMAT_PROPERTY_NAME, CCD_IMAGE_FORMAT_RAW_ITEM_NAME, true);
	wait_for_property_state(CCD_IMAGE_FORMAT_PROPERTY_NAME, INDIGO_OK_STATE);
}

// A short exposure can leave BUSY before a state poll observes it, so both
// transitions are asserted through their recorded revisions.
static bool expose(double duration) {
	unsigned busy_revision = property_state_revision(CCD_EXPOSURE_PROPERTY_NAME, INDIGO_BUSY_STATE);
	unsigned ok_revision = property_state_revision(CCD_EXPOSURE_PROPERTY_NAME, INDIGO_OK_STATE);
	if (indigo_change_number_property_1(&simulator_test_client, ccd_case.device_name, CCD_EXPOSURE_PROPERTY_NAME, CCD_EXPOSURE_ITEM_NAME, duration) != INDIGO_OK) {
		return false;
	}
	return wait_for_property_state_seen_after(CCD_EXPOSURE_PROPERTY_NAME, INDIGO_BUSY_STATE, busy_revision) && wait_for_property_state_seen_after(CCD_EXPOSURE_PROPERTY_NAME, INDIGO_OK_STATE, ok_revision);
}

static bool set_frame(int left, int top, int width, int height) {
	static const char *items[] = { CCD_FRAME_LEFT_ITEM_NAME, CCD_FRAME_TOP_ITEM_NAME, CCD_FRAME_WIDTH_ITEM_NAME, CCD_FRAME_HEIGHT_ITEM_NAME };
	double values[] = { left, top, width, height };
	if (indigo_change_number_property(&simulator_test_client, ccd_case.device_name, CCD_FRAME_PROPERTY_NAME, 4, items, values) != INDIGO_OK) {
		return false;
	}
	return wait_for_property_not_busy(CCD_FRAME_PROPERTY_NAME);
}

static bool set_bin(int bin) {
	static const char *items[] = { CCD_BIN_HORIZONTAL_ITEM_NAME, CCD_BIN_VERTICAL_ITEM_NAME };
	double values[] = { bin, bin };
	if (indigo_change_number_property(&simulator_test_client, ccd_case.device_name, CCD_BIN_PROPERTY_NAME, 2, items, values) != INDIGO_OK) {
		return false;
	}
	return wait_for_property_not_busy(CCD_BIN_PROPERTY_NAME);
}

static bool set_frame_type(const char *item) {
	indigo_change_switch_property_1(&simulator_test_client, ccd_case.device_name, CCD_FRAME_TYPE_PROPERTY_NAME, item, true);
	return wait_for_property_state(CCD_FRAME_TYPE_PROPERTY_NAME, INDIGO_OK_STATE);
}

static bool set_switch(const simulator_driver_case *driver_case, const char *property, const char *item) {
	unsigned revision = property_revision(property);
	if (indigo_change_switch_property_1(&simulator_test_client, driver_case->device_name, property, item, true) != INDIGO_OK) {
		return false;
	}
	return wait_for_property_not_busy_after(property, revision);
}

static bool move_wheel(int slot) {
	unsigned revision = property_revision(WHEEL_SLOT_PROPERTY_NAME);
	if (indigo_change_number_property_1(&simulator_test_client, wheel_case.device_name, WHEEL_SLOT_PROPERTY_NAME, WHEEL_SLOT_ITEM_NAME, slot) != INDIGO_OK) {
		return false;
	}
	return wait_for_property_not_busy_after(WHEEL_SLOT_PROPERTY_NAME, revision);
}

// -------------------------------------------------------------------------------- identity and lifecycle

static void qsi_reports_driver_metadata(void) {
	indigo_driver_info info;
	memset(&info, 0, sizeof(info));
	ASSERT_EQ_INT(INDIGO_OK, indigo_ccd_qsi(INDIGO_DRIVER_INFO, &info));
	ASSERT_STREQ("QSI Camera", info.description);
	ASSERT_STREQ("indigo_ccd_qsi", info.name);
	ASSERT_TRUE(info.multi_device_support);
	ASSERT_EQ_INT(INDIGO_DRIVER_SHUTDOWN, info.status);
}

static void qsi_attaches_all_enumerated_cameras(void) {
	QSI_CHECK_TRUE(fixture_start(2));
	QSI_CHECK_TRUE(wait_attached(2 * (1 + QSI_WHEEL_AT_DISCOVERY)));
	QSI_CHECK_TRUE(connect_device(&ccd_case));
	QSI_CHECK_TRUE(disconnect_device(&ccd_case));
	QSI_CHECK_TRUE(connect_device(&second_ccd_case));
	QSI_CHECK_TRUE(disconnect_device(&second_ccd_case));
cleanup:
	fixture_stop();
}

static void qsi_enumerates_common_properties_before_connect(void) {
	QSI_CHECK_TRUE(fixture_start(1));
	select_device(&ccd_case);
	assert_defined_properties(qsi_base_properties, ARRAY_SIZE(qsi_base_properties));
	assert_not_defined_properties(qsi_hidden_base_properties, ARRAY_SIZE(qsi_hidden_base_properties));
	assert_defined_property_count(ARRAY_SIZE(qsi_base_properties));
	assert_not_defined_property(CCD_INFO_PROPERTY_NAME);
	assert_not_defined_property(READOUT_SPEED_PROPERTY_NAME);
cleanup:
	fixture_stop();
}

static void qsi_connects_and_disconnects_ccd(void) {
	QSI_CHECK_TRUE(fixture_start(1));
	QSI_CHECK_TRUE(connect_device(&ccd_case));
	QSI_CHECK_EQ(0, qsi_fake_connected_index());
	QSI_CHECK_TRUE(!strcmp(qsi_fake_selected_serial(), CAMERA_0_SERIAL));
	QSI_CHECK_TRUE(qsi_fake_is_main_camera());
	assert_device_interface(INDIGO_INTERFACE_CCD);
	QSI_CHECK_TRUE(disconnect_device(&ccd_case));
	QSI_CHECK_EQ(-1, qsi_fake_connected_index());
	QSI_CHECK_EQ(0, qsi_fake_calls_after_close());
cleanup:
	fixture_stop();
}

static void qsi_tolerates_repeated_disconnect(void) {
	QSI_CHECK_TRUE(fixture_start(1));
	QSI_CHECK_TRUE(connect_device(&ccd_case));
	QSI_CHECK_TRUE(disconnect_device(&ccd_case));
	// The framework ignores a repeated request, so no new update arrives and the
	// cached state must simply stay disconnected.
	QSI_CHECK_EQ(INDIGO_OK, indigo_change_switch_property_1(&simulator_test_client, ccd_case.device_name, CONNECTION_PROPERTY_NAME, CONNECTION_DISCONNECTED_ITEM_NAME, true));
	indigo_usleep(300000);
	QSI_CHECK_TRUE(wait_for_simulator_connection_state(false));
	QSI_CHECK_EQ(0, qsi_fake_calls_after_close());
cleanup:
	fixture_stop();
}

static void qsi_repeats_init_and_shutdown(void) {
	for (int i = 0; i < 2; i++) {
		QSI_CHECK_TRUE(fixture_start(1));
		QSI_CHECK_TRUE(connect_device(&ccd_case));
		QSI_CHECK_TRUE(disconnect_device(&ccd_case));
		fixture_stop();
	}
	QSI_CHECK_EQ(0, qsi_fake_calls_after_close());
	return;
cleanup:
	fixture_stop();
}

static void qsi_rejects_shutdown_while_connected(void) {
	QSI_CHECK_TRUE(fixture_start(1));
	QSI_CHECK_TRUE(connect_device(&ccd_case));
	QSI_CHECK_EQ(INDIGO_BUSY, indigo_ccd_qsi(INDIGO_DRIVER_SHUTDOWN, NULL));
	QSI_CHECK_EQ(0, qsi_fake_connected_index());
	QSI_CHECK_TRUE(disconnect_device(&ccd_case));
cleanup:
	fixture_stop();
}

static void qsi_rejects_second_camera_while_one_is_connected(void) {
	QSI_CHECK_TRUE(fixture_start(2));
	QSI_CHECK_TRUE(connect_device(&ccd_case));
	select_device(&second_ccd_case);
	indigo_change_switch_property_1(&simulator_test_client, second_ccd_case.device_name, CONNECTION_PROPERTY_NAME, CONNECTION_CONNECTED_ITEM_NAME, true);
	QSI_CHECK_TRUE(wait_for_property_state(CONNECTION_PROPERTY_NAME, INDIGO_ALERT_STATE));
	QSI_CHECK_EQ(0, qsi_fake_connected_index());
	QSI_CHECK_TRUE(disconnect_device(&ccd_case));
	QSI_CHECK_TRUE(connect_device(&second_ccd_case));
	QSI_CHECK_EQ(1, qsi_fake_connected_index());
	QSI_CHECK_TRUE(disconnect_device(&second_ccd_case));
cleanup:
	fixture_stop();
}

// -------------------------------------------------------------------------------- discovery

static void qsi_ignores_duplicate_arrivals(void) {
	QSI_CHECK_TRUE(fixture_start(1));
	int attached = atomic_load(&attached_count);
	fire_usb_event(0, LIBUSB_HOTPLUG_EVENT_DEVICE_ARRIVED);
	fire_usb_event(0, LIBUSB_HOTPLUG_EVENT_DEVICE_ARRIVED);
	indigo_usleep(500000);
	QSI_CHECK_EQ(attached, atomic_load(&attached_count));
cleanup:
	fixture_stop();
}

static void qsi_handles_burst_arrivals(void) {
	QSI_CHECK_TRUE(fixture_start(1));
	qsi_fake_add_camera(1, CAMERA_1_SERIAL, CAMERA_1_DESC, CAMERA_1_MODEL);
	configure_usb(1, QSI_VENDOR_ID, QSI_PRODUCT_ID2);
	for (int i = 0; i < 4; i++) {
		fire_usb_event(1, LIBUSB_HOTPLUG_EVENT_DEVICE_ARRIVED);
	}
	QSI_CHECK_TRUE(wait_attached(2 * (1 + QSI_WHEEL_AT_DISCOVERY)));
	indigo_usleep(300000);
	QSI_CHECK_EQ(2 * (1 + QSI_WHEEL_AT_DISCOVERY), atomic_load(&attached_count));
cleanup:
	fixture_stop();
}

static void qsi_detaches_on_removal(void) {
	QSI_CHECK_TRUE(fixture_start(2));
	QSI_CHECK_TRUE(wait_attached(2 * (1 + QSI_WHEEL_AT_DISCOVERY)));
	qsi_fake_camera_at(1)->present = false;
	fire_usb_event(1, LIBUSB_HOTPLUG_EVENT_DEVICE_LEFT);
	QSI_CHECK_TRUE(wait_attached(1 + QSI_WHEEL_AT_DISCOVERY));
	// The surviving camera must still be usable.
	QSI_CHECK_TRUE(connect_device(&ccd_case));
	QSI_CHECK_TRUE(disconnect_device(&ccd_case));
cleanup:
	fixture_stop();
}

// -------------------------------------------------------------------------------- property contract

static void qsi_publishes_ccd_class_properties(void) {
	QSI_CHECK_TRUE(fixture_start(1));
	QSI_CHECK_TRUE(connect_device(&ccd_case));
	assert_device_interface(INDIGO_INTERFACE_CCD);
	assert_property_has_item(CCD_INFO_PROPERTY_NAME, CCD_INFO_WIDTH_ITEM_NAME);
	assert_property_has_item(CCD_INFO_PROPERTY_NAME, CCD_INFO_HEIGHT_ITEM_NAME);
	assert_property_has_item(CCD_EXPOSURE_PROPERTY_NAME, CCD_EXPOSURE_ITEM_NAME);
	assert_property_has_item(CCD_ABORT_EXPOSURE_PROPERTY_NAME, CCD_ABORT_EXPOSURE_ITEM_NAME);
	assert_property_has_item(CCD_FRAME_PROPERTY_NAME, CCD_FRAME_WIDTH_ITEM_NAME);
	assert_property_has_item(CCD_BIN_PROPERTY_NAME, CCD_BIN_HORIZONTAL_ITEM_NAME);
	assert_property_has_item(CCD_IMAGE_FORMAT_PROPERTY_NAME, CCD_IMAGE_FORMAT_RAW_ITEM_NAME);
	assert_property_has_item(CCD_UPLOAD_MODE_PROPERTY_NAME, CCD_UPLOAD_MODE_CLIENT_ITEM_NAME);
	assert_property_has_item(CCD_COOLER_PROPERTY_NAME, CCD_COOLER_ON_ITEM_NAME);
	assert_property_has_item(CCD_TEMPERATURE_PROPERTY_NAME, CCD_TEMPERATURE_ITEM_NAME);
	assert_property_has_item(CCD_COOLER_POWER_PROPERTY_NAME, CCD_COOLER_POWER_ITEM_NAME);
	assert_property_has_item(CCD_GAIN_PROPERTY_NAME, CCD_GAIN_ITEM_NAME);
	QSI_CHECK_EQ(SENSOR_WIDTH, (int)cached_number_value(CCD_INFO_PROPERTY_NAME, CCD_INFO_WIDTH_ITEM_NAME));
	QSI_CHECK_EQ(SENSOR_HEIGHT, (int)cached_number_value(CCD_INFO_PROPERTY_NAME, CCD_INFO_HEIGHT_ITEM_NAME));
	QSI_CHECK_EQ(16, (int)cached_number_value(CCD_INFO_PROPERTY_NAME, CCD_INFO_BITS_PER_PIXEL_ITEM_NAME));
	QSI_CHECK_EQ(4, (int)cached_number_value(CCD_INFO_PROPERTY_NAME, CCD_INFO_MAX_HORIZONTAL_BIN_ITEM_NAME));
	QSI_CHECK_TRUE(cached_number_value(CCD_INFO_PROPERTY_NAME, CCD_INFO_PIXEL_WIDTH_ITEM_NAME) > 5.3);
	QSI_CHECK_TRUE(disconnect_device(&ccd_case));
cleanup:
	fixture_stop();
}

static void qsi_publishes_custom_properties(void) {
	QSI_CHECK_TRUE(fixture_start(1));
	QSI_CHECK_TRUE(connect_device(&ccd_case));
	assert_property_has_item(READOUT_SPEED_PROPERTY_NAME, "HIGH_QUALITY");
	assert_property_has_item(READOUT_SPEED_PROPERTY_NAME, "FAST_READOUT");
	assert_property_has_item(ANTI_BLOOM_PROPERTY_NAME, "NORMAL");
	assert_property_has_item(ANTI_BLOOM_PROPERTY_NAME, "HIGH");
	assert_property_has_item(PRE_EXPOSURE_FLUSH_PROPERTY_NAME, "NONE");
	assert_property_has_item(PRE_EXPOSURE_FLUSH_PROPERTY_NAME, "VERY_AGGRESSIVE");
	assert_property_has_item(FAN_MODE_PROPERTY_NAME, "OFF");
	assert_property_has_item(FAN_MODE_PROPERTY_NAME, "FULL_SPEED");
	// Initial selection mirrors the SDK readback.
	assert_switch_item_value(READOUT_SPEED_PROPERTY_NAME, "HIGH_QUALITY", true);
	assert_switch_item_value(ANTI_BLOOM_PROPERTY_NAME, "NORMAL", true);
	assert_switch_item_value(PRE_EXPOSURE_FLUSH_PROPERTY_NAME, "NORMAL", true);
	assert_switch_item_value(FAN_MODE_PROPERTY_NAME, "QUIET", true);
	QSI_CHECK_TRUE(disconnect_device(&ccd_case));
	select_device(&ccd_case);
	assert_not_defined_property(READOUT_SPEED_PROPERTY_NAME);
	assert_not_defined_property(FAN_MODE_PROPERTY_NAME);
cleanup:
	fixture_stop();
}

static void qsi_hides_unsupported_capabilities(void) {
	reset_fake(1);
	qsi_fake_camera *camera = qsi_fake_camera_at(0);
	camera->can_set_temperature = false;
	camera->can_get_cooler_power = false;
	camera->can_set_gain = false;
	camera->has_filter_wheel = false;
	camera->filter_count = 0;
	// Undocumented but representable enum values make the driver hide the
	// matching custom property. QSICamera::ReadoutSpeed and AntiBloom have no
	// spare value in their underlying range, so their equivalent branches
	// cannot be driven without undefined behavior and stay visible here.
	camera->reported_fan_mode = 3;
	camera->reported_pre_exposure_flush = 5;
	reset_simulator_context(&ccd_case);
	simulator_test_client.update_property = observe_image;
	QSI_CHECK_EQ(INDIGO_OK, indigo_start());
	QSI_CHECK_EQ(INDIGO_OK, indigo_attach_client(&simulator_test_client));
	QSI_CHECK_EQ(INDIGO_OK, indigo_ccd_qsi(INDIGO_DRIVER_INIT, NULL));
	fixture_running = true;
	QSI_CHECK_TRUE(wait_attached(1));
	QSI_CHECK_TRUE(connect_device(&ccd_case));
	assert_not_defined_property(CCD_TEMPERATURE_PROPERTY_NAME);
	assert_not_defined_property(CCD_COOLER_PROPERTY_NAME);
	assert_not_defined_property(CCD_COOLER_POWER_PROPERTY_NAME);
	assert_not_defined_property(CCD_GAIN_PROPERTY_NAME);
	assert_not_defined_property(PRE_EXPOSURE_FLUSH_PROPERTY_NAME);
	assert_not_defined_property(FAN_MODE_PROPERTY_NAME);
	assert_defined_property(READOUT_SPEED_PROPERTY_NAME);
	assert_defined_property(ANTI_BLOOM_PROPERTY_NAME);
	QSI_CHECK_TRUE(disconnect_device(&ccd_case));
cleanup:
	fixture_stop();
}

static void qsi_builds_modes_for_linear_binning(void) {
	QSI_CHECK_TRUE(fixture_start(1));
	QSI_CHECK_TRUE(connect_device(&ccd_case));
	assert_property_has_item(CCD_MODE_PROPERTY_NAME, "BIN_1x1");
	assert_property_has_item(CCD_MODE_PROPERTY_NAME, "BIN_2x2");
	assert_property_has_item(CCD_MODE_PROPERTY_NAME, "BIN_3x3");
	assert_property_has_item(CCD_MODE_PROPERTY_NAME, "BIN_4x4");
	assert_switch_item_value(CCD_MODE_PROPERTY_NAME, "BIN_1x1", true);
	QSI_CHECK_TRUE(disconnect_device(&ccd_case));
cleanup:
	fixture_stop();
}

static void qsi_builds_modes_for_power_of_two_binning(void) {
	reset_fake(1);
	qsi_fake_camera_at(0)->power_of_two_binning = true;
	reset_simulator_context(&ccd_case);
	simulator_test_client.update_property = observe_image;
	QSI_CHECK_EQ(INDIGO_OK, indigo_start());
	QSI_CHECK_EQ(INDIGO_OK, indigo_attach_client(&simulator_test_client));
	QSI_CHECK_EQ(INDIGO_OK, indigo_ccd_qsi(INDIGO_DRIVER_INIT, NULL));
	fixture_running = true;
	QSI_CHECK_TRUE(wait_attached(1 + QSI_WHEEL_AT_DISCOVERY));
	QSI_CHECK_TRUE(connect_device(&ccd_case));
	assert_property_has_item(CCD_MODE_PROPERTY_NAME, "BIN_1x1");
	assert_property_has_item(CCD_MODE_PROPERTY_NAME, "BIN_2x2");
	assert_property_has_item(CCD_MODE_PROPERTY_NAME, "BIN_4x4");
	QSI_CHECK_TRUE(!has_defined_property("BIN_3x3"));
	QSI_CHECK_TRUE(disconnect_device(&ccd_case));
cleanup:
	fixture_stop();
}

static void qsi_applies_exposure_limits_from_sdk(void) {
	reset_fake(1);
	qsi_fake_camera *camera = qsi_fake_camera_at(0);
	camera->min_exposure = 0.05;
	camera->max_exposure = 1800;
	reset_simulator_context(&ccd_case);
	simulator_test_client.update_property = observe_image;
	QSI_CHECK_EQ(INDIGO_OK, indigo_start());
	QSI_CHECK_EQ(INDIGO_OK, indigo_attach_client(&simulator_test_client));
	QSI_CHECK_EQ(INDIGO_OK, indigo_ccd_qsi(INDIGO_DRIVER_INIT, NULL));
	fixture_running = true;
	QSI_CHECK_TRUE(wait_attached(1 + QSI_WHEEL_AT_DISCOVERY));
	QSI_CHECK_TRUE(connect_device(&ccd_case));
	QSI_CHECK_TRUE(find_cached_item(CCD_EXPOSURE_PROPERTY_NAME, CCD_EXPOSURE_ITEM_NAME)->number.min > 0.049);
	QSI_CHECK_EQ(1800, (int)find_cached_item(CCD_EXPOSURE_PROPERTY_NAME, CCD_EXPOSURE_ITEM_NAME)->number.max);
	QSI_CHECK_TRUE(disconnect_device(&ccd_case));
cleanup:
	fixture_stop();
}

static void qsi_rebuilds_properties_on_reconnect(void) {
	QSI_CHECK_TRUE(fixture_start(1));
	QSI_CHECK_TRUE(connect_device(&ccd_case));
	QSI_CHECK_EQ(SENSOR_WIDTH, (int)cached_number_value(CCD_INFO_PROPERTY_NAME, CCD_INFO_WIDTH_ITEM_NAME));
	QSI_CHECK_TRUE(disconnect_device(&ccd_case));
	qsi_fake_camera_at(0)->width = 64;
	qsi_fake_camera_at(0)->height = 48;
	QSI_CHECK_TRUE(connect_device(&ccd_case));
	QSI_CHECK_EQ(64, (int)cached_number_value(CCD_INFO_PROPERTY_NAME, CCD_INFO_WIDTH_ITEM_NAME));
	QSI_CHECK_EQ(48, (int)cached_number_value(CCD_INFO_PROPERTY_NAME, CCD_INFO_HEIGHT_ITEM_NAME));
	QSI_CHECK_TRUE(disconnect_device(&ccd_case));
cleanup:
	fixture_stop();
}

// -------------------------------------------------------------------------------- initialization failures

static void qsi_reports_connect_failure_and_recovers(void) {
	QSI_CHECK_TRUE(fixture_start(1));
	select_device(&ccd_case);
	qsi_fake_camera_at(0)->fail.connect = 1;
	indigo_change_switch_property_1(&simulator_test_client, ccd_case.device_name, CONNECTION_PROPERTY_NAME, CONNECTION_CONNECTED_ITEM_NAME, true);
	QSI_CHECK_TRUE(wait_for_property_state(CONNECTION_PROPERTY_NAME, INDIGO_ALERT_STATE));
	QSI_CHECK_EQ(-1, qsi_fake_connected_index());
	QSI_CHECK_TRUE(connect_device(&ccd_case));
	QSI_CHECK_TRUE(disconnect_device(&ccd_case));
	QSI_CHECK_EQ(0, qsi_fake_calls_after_close());
cleanup:
	fixture_stop();
}

static void qsi_reports_geometry_read_failure(void) {
	QSI_CHECK_TRUE(fixture_start(1));
	select_device(&ccd_case);
	qsi_fake_camera_at(0)->fail.geometry = 1;
	indigo_change_switch_property_1(&simulator_test_client, ccd_case.device_name, CONNECTION_PROPERTY_NAME, CONNECTION_CONNECTED_ITEM_NAME, true);
	QSI_CHECK_TRUE(wait_for_property_state(CONNECTION_PROPERTY_NAME, INDIGO_ALERT_STATE));
	qsi_fake_camera_at(0)->fail.geometry = 0;
	QSI_CHECK_TRUE(connect_device(&ccd_case));
	QSI_CHECK_TRUE(disconnect_device(&ccd_case));
cleanup:
	fixture_stop();
}

// A failing put_Connected(false) must still release the driver-owned resources
// and leave a device that can be connected again; the leftover SDK session is
// adopted by the next open.
static void qsi_recovers_from_disconnect_failure(void) {
	QSI_CHECK_TRUE(fixture_start(1));
	QSI_CHECK_TRUE(connect_device(&ccd_case));
	qsi_fake_camera *camera = qsi_fake_camera_at(0);
	camera->fail.disconnect = 1;
	QSI_CHECK_TRUE(disconnect_device(&ccd_case));
	// The SDK still holds the camera because the vendor call failed.
	QSI_CHECK_EQ(0, qsi_fake_connected_index());
	camera->fail.disconnect = 0;
	int connects = qsi_fake_counter(0, &camera->connect_calls);
	QSI_CHECK_TRUE(connect_device(&ccd_case));
	QSI_CHECK_EQ(connects, qsi_fake_counter(0, &camera->connect_calls));
	use_raw_format();
	QSI_CHECK_TRUE(expose(0.05));
	QSI_CHECK_EQ(1, atomic_load(&blob_count));
	QSI_CHECK_EQ(0, atomic_load(&bad_blob));
	QSI_CHECK_TRUE(disconnect_device(&ccd_case));
	QSI_CHECK_EQ(-1, qsi_fake_connected_index());
cleanup:
	fixture_stop();
}

// -------------------------------------------------------------------------------- image contract and acquisition

static void qsi_delivers_full_frame(void) {
	QSI_CHECK_TRUE(fixture_start(1));
	QSI_CHECK_TRUE(connect_device(&ccd_case));
	use_raw_format();
	QSI_CHECK_TRUE(expose(0.05));
	QSI_CHECK_EQ(1, atomic_load(&blob_count));
	QSI_CHECK_EQ(0, atomic_load(&bad_blob));
	qsi_fake_camera *camera = qsi_fake_camera_at(0);
	QSI_CHECK_EQ(0, (int)camera->start_x);
	QSI_CHECK_EQ(0, (int)camera->start_y);
	QSI_CHECK_EQ(SENSOR_WIDTH, (int)camera->num_x);
	QSI_CHECK_EQ(SENSOR_HEIGHT, (int)camera->num_y);
	QSI_CHECK_EQ(1, (int)camera->bin_x);
	QSI_CHECK_EQ(1, (int)camera->bin_y);
	QSI_CHECK_TRUE(camera->exposure_light);
	QSI_CHECK_TRUE(disconnect_device(&ccd_case));
cleanup:
	fixture_stop();
}

static void qsi_delivers_subframe_with_binning(void) {
	QSI_CHECK_TRUE(fixture_start(1));
	QSI_CHECK_TRUE(connect_device(&ccd_case));
	use_raw_format();
	QSI_CHECK_TRUE(set_bin(2));
	QSI_CHECK_TRUE(set_frame(16, 8, 32, 24));
	expected_left = 16;
	expected_top = 8;
	expected_bin = 2;
	expected_image_width = 16;
	expected_image_height = 12;
	QSI_CHECK_TRUE(expose(0.05));
	qsi_fake_camera *camera = qsi_fake_camera_at(0);
	QSI_CHECK_EQ(8, (int)camera->start_x);
	QSI_CHECK_EQ(4, (int)camera->start_y);
	QSI_CHECK_EQ(16, (int)camera->num_x);
	QSI_CHECK_EQ(12, (int)camera->num_y);
	QSI_CHECK_EQ(2, (int)camera->bin_x);
	QSI_CHECK_EQ(2, (int)camera->bin_y);
	QSI_CHECK_EQ(1, atomic_load(&blob_count));
	QSI_CHECK_EQ(0, atomic_load(&bad_blob));
	QSI_CHECK_TRUE(disconnect_device(&ccd_case));
cleanup:
	fixture_stop();
}

static void qsi_sends_shutter_flag_per_frame_type(void) {
	QSI_CHECK_TRUE(fixture_start(1));
	QSI_CHECK_TRUE(connect_device(&ccd_case));
	use_raw_format();
	qsi_fake_camera *camera = qsi_fake_camera_at(0);
	QSI_CHECK_TRUE(set_frame_type(CCD_FRAME_TYPE_LIGHT_ITEM_NAME));
	QSI_CHECK_TRUE(expose(0.05));
	QSI_CHECK_TRUE(camera->exposure_light);
	QSI_CHECK_TRUE(set_frame_type(CCD_FRAME_TYPE_FLAT_ITEM_NAME));
	QSI_CHECK_TRUE(expose(0.05));
	QSI_CHECK_TRUE(camera->exposure_light);
	QSI_CHECK_TRUE(set_frame_type(CCD_FRAME_TYPE_DARK_ITEM_NAME));
	QSI_CHECK_TRUE(expose(0.05));
	QSI_CHECK_TRUE(!camera->exposure_light);
	QSI_CHECK_TRUE(set_frame_type(CCD_FRAME_TYPE_DARKFLAT_ITEM_NAME));
	QSI_CHECK_TRUE(expose(0.05));
	QSI_CHECK_TRUE(!camera->exposure_light);
	QSI_CHECK_TRUE(disconnect_device(&ccd_case));
cleanup:
	fixture_stop();
}

static void qsi_uses_shortest_exposure_for_bias(void) {
	QSI_CHECK_TRUE(fixture_start(1));
	QSI_CHECK_TRUE(connect_device(&ccd_case));
	use_raw_format();
	QSI_CHECK_TRUE(set_frame_type(CCD_FRAME_TYPE_BIAS_ITEM_NAME));
	QSI_CHECK_TRUE(expose(2));
	qsi_fake_camera *camera = qsi_fake_camera_at(0);
	QSI_CHECK_TRUE(!camera->exposure_light);
	QSI_CHECK_TRUE(camera->exposure_duration < 0.031);
	QSI_CHECK_TRUE(disconnect_device(&ccd_case));
cleanup:
	fixture_stop();
}

static void qsi_retries_until_image_is_ready(void) {
	QSI_CHECK_TRUE(fixture_start(1));
	QSI_CHECK_TRUE(connect_device(&ccd_case));
	use_raw_format();
	qsi_fake_camera *camera = qsi_fake_camera_at(0);
	camera->not_ready_reads = 5;
	QSI_CHECK_TRUE(expose(0.05));
	QSI_CHECK_TRUE(qsi_fake_counter(0, &camera->image_ready_calls) >= 6);
	QSI_CHECK_EQ(1, qsi_fake_counter(0, &camera->image_array_calls));
	QSI_CHECK_EQ(1, atomic_load(&blob_count));
	QSI_CHECK_EQ(0, atomic_load(&bad_blob));
	QSI_CHECK_TRUE(disconnect_device(&ccd_case));
cleanup:
	fixture_stop();
}

static void qsi_rejects_overlapping_exposure(void) {
	QSI_CHECK_TRUE(fixture_start(1));
	QSI_CHECK_TRUE(connect_device(&ccd_case));
	use_raw_format();
	qsi_fake_camera *camera = qsi_fake_camera_at(0);
	qsi_fake_gate_arm(QSI_FAKE_GATE_IMAGE_READY);
	indigo_change_number_property_1(&simulator_test_client, ccd_case.device_name, CCD_EXPOSURE_PROPERTY_NAME, CCD_EXPOSURE_ITEM_NAME, 0.05);
	QSI_CHECK_TRUE(wait_for_property_state(CCD_EXPOSURE_PROPERTY_NAME, INDIGO_BUSY_STATE));
	QSI_CHECK_TRUE(wait_gate());
	int starts = qsi_fake_counter(0, &camera->start_exposure_calls);
	indigo_change_number_property_1(&simulator_test_client, ccd_case.device_name, CCD_EXPOSURE_PROPERTY_NAME, CCD_EXPOSURE_ITEM_NAME, 0.05);
	indigo_usleep(200000);
	QSI_CHECK_EQ(starts, qsi_fake_counter(0, &camera->start_exposure_calls));
	qsi_fake_gate_release();
	QSI_CHECK_TRUE(wait_for_property_state(CCD_EXPOSURE_PROPERTY_NAME, INDIGO_OK_STATE));
	QSI_CHECK_TRUE(disconnect_device(&ccd_case));
cleanup:
	qsi_fake_gate_release();
	fixture_stop();
}

static void qsi_reports_exposure_start_failure(void) {
	QSI_CHECK_TRUE(fixture_start(1));
	QSI_CHECK_TRUE(connect_device(&ccd_case));
	use_raw_format();
	qsi_fake_camera_at(0)->fail.start_exposure = 1;
	indigo_change_number_property_1(&simulator_test_client, ccd_case.device_name, CCD_EXPOSURE_PROPERTY_NAME, CCD_EXPOSURE_ITEM_NAME, 0.05);
	QSI_CHECK_TRUE(wait_for_property_state(CCD_EXPOSURE_PROPERTY_NAME, INDIGO_ALERT_STATE));
	QSI_CHECK_EQ(0, atomic_load(&blob_count));
	// A failed start must not block the next acquisition.
	QSI_CHECK_TRUE(expose(0.05));
	QSI_CHECK_EQ(1, atomic_load(&blob_count));
	QSI_CHECK_TRUE(disconnect_device(&ccd_case));
cleanup:
	fixture_stop();
}

static void qsi_aborts_exposure_and_reacquires(void) {
	QSI_CHECK_TRUE(fixture_start(1));
	QSI_CHECK_TRUE(connect_device(&ccd_case));
	use_raw_format();
	qsi_fake_camera *camera = qsi_fake_camera_at(0);
	camera->image_never_ready = true;
	indigo_change_number_property_1(&simulator_test_client, ccd_case.device_name, CCD_EXPOSURE_PROPERTY_NAME, CCD_EXPOSURE_ITEM_NAME, 0.05);
	QSI_CHECK_TRUE(wait_for_property_state(CCD_EXPOSURE_PROPERTY_NAME, INDIGO_BUSY_STATE));
	QSI_CHECK_TRUE(wait_counter_at_least(&camera->image_ready_calls, 1));
	indigo_change_switch_property_1(&simulator_test_client, ccd_case.device_name, CCD_ABORT_EXPOSURE_PROPERTY_NAME, CCD_ABORT_EXPOSURE_ITEM_NAME, true);
	QSI_CHECK_TRUE(wait_for_property_not_busy(CCD_EXPOSURE_PROPERTY_NAME));
	QSI_CHECK_TRUE(wait_counter_at_least(&camera->abort_calls, 1));
	QSI_CHECK_EQ(0, atomic_load(&blob_count));
	QSI_CHECK_TRUE(expose(0.05));
	QSI_CHECK_EQ(1, atomic_load(&blob_count));
	QSI_CHECK_EQ(0, atomic_load(&bad_blob));
	QSI_CHECK_TRUE(disconnect_device(&ccd_case));
cleanup:
	fixture_stop();
}

// -------------------------------------------------------------------------------- cooling and temperature

static void qsi_polls_temperature_and_cooler_power(void) {
	QSI_CHECK_TRUE(fixture_start(1));
	qsi_fake_camera *camera = qsi_fake_camera_at(0);
	QSI_CHECK_TRUE(connect_device(&ccd_case));
	QSI_CHECK_TRUE(wait_counter_at_least(&camera->temperature_reads, 1));
	QSI_CHECK_TRUE(wait_counter_at_least(&camera->cooler_power_reads, 1));
	QSI_CHECK_TRUE(wait_for_number_item_value(CCD_TEMPERATURE_PROPERTY_NAME, CCD_TEMPERATURE_ITEM_NAME, 12.5, 0.01));
	QSI_CHECK_TRUE(disconnect_device(&ccd_case));
	int reads = qsi_fake_counter(0, &camera->temperature_reads);
	indigo_usleep(300000);
	QSI_CHECK_EQ(reads, qsi_fake_counter(0, &camera->temperature_reads));
	QSI_CHECK_EQ(0, qsi_fake_calls_after_close());
cleanup:
	fixture_stop();
}

static void qsi_switches_cooler(void) {
	QSI_CHECK_TRUE(fixture_start(1));
	QSI_CHECK_TRUE(connect_device(&ccd_case));
	qsi_fake_camera *camera = qsi_fake_camera_at(0);
	QSI_CHECK_TRUE(set_switch(&ccd_case, CCD_COOLER_PROPERTY_NAME, CCD_COOLER_ON_ITEM_NAME));
	QSI_CHECK_TRUE(camera->cooler_on);
	QSI_CHECK_TRUE(set_switch(&ccd_case, CCD_COOLER_PROPERTY_NAME, CCD_COOLER_OFF_ITEM_NAME));
	QSI_CHECK_TRUE(!camera->cooler_on);
	QSI_CHECK_TRUE(disconnect_device(&ccd_case));
cleanup:
	fixture_stop();
}

static void qsi_sets_target_temperature(void) {
	QSI_CHECK_TRUE(fixture_start(1));
	QSI_CHECK_TRUE(connect_device(&ccd_case));
	qsi_fake_camera *camera = qsi_fake_camera_at(0);
	indigo_change_number_property_1(&simulator_test_client, ccd_case.device_name, CCD_TEMPERATURE_PROPERTY_NAME, CCD_TEMPERATURE_ITEM_NAME, -15);
	QSI_CHECK_TRUE(wait_counter_at_least(&camera->temperature_writes, 1));
	QSI_CHECK_TRUE(camera->target_temperature < -14.99 && camera->target_temperature > -15.01);
	QSI_CHECK_TRUE(wait_for_number_item_value(CCD_TEMPERATURE_PROPERTY_NAME, CCD_TEMPERATURE_ITEM_NAME, -15, 0.01));
	QSI_CHECK_TRUE(wait_for_property_state(CCD_TEMPERATURE_PROPERTY_NAME, INDIGO_OK_STATE));
	QSI_CHECK_TRUE(disconnect_device(&ccd_case));
cleanup:
	fixture_stop();
}

// The generated change dispatch rejects a request while the property is BUSY,
// so cooling in progress deliberately blocks a new target.
static void qsi_rejects_target_change_while_cooling(void) {
	QSI_CHECK_TRUE(fixture_start(1));
	QSI_CHECK_TRUE(connect_device(&ccd_case));
	qsi_fake_camera *camera = qsi_fake_camera_at(0);
	camera->temperature_settles = false;
	indigo_change_number_property_1(&simulator_test_client, ccd_case.device_name, CCD_TEMPERATURE_PROPERTY_NAME, CCD_TEMPERATURE_ITEM_NAME, -15);
	QSI_CHECK_TRUE(wait_counter_at_least(&camera->temperature_writes, 1));
	QSI_CHECK_TRUE(wait_for_property_state(CCD_TEMPERATURE_PROPERTY_NAME, INDIGO_BUSY_STATE));
	int writes = qsi_fake_counter(0, &camera->temperature_writes);
	indigo_change_number_property_1(&simulator_test_client, ccd_case.device_name, CCD_TEMPERATURE_PROPERTY_NAME, CCD_TEMPERATURE_ITEM_NAME, -20);
	indigo_usleep(300000);
	QSI_CHECK_EQ(writes, qsi_fake_counter(0, &camera->temperature_writes));
	QSI_CHECK_TRUE(camera->target_temperature < -14.99 && camera->target_temperature > -15.01);
	QSI_CHECK_TRUE(disconnect_device(&ccd_case));
cleanup:
	fixture_stop();
}

static void qsi_enables_cooler_when_target_is_set(void) {
	QSI_CHECK_TRUE(fixture_start(1));
	QSI_CHECK_TRUE(connect_device(&ccd_case));
	qsi_fake_camera *camera = qsi_fake_camera_at(0);
	QSI_CHECK_TRUE(set_switch(&ccd_case, CCD_COOLER_PROPERTY_NAME, CCD_COOLER_OFF_ITEM_NAME));
	QSI_CHECK_TRUE(!camera->cooler_on);
	indigo_change_number_property_1(&simulator_test_client, ccd_case.device_name, CCD_TEMPERATURE_PROPERTY_NAME, CCD_TEMPERATURE_ITEM_NAME, -10);
	QSI_CHECK_TRUE(wait_counter_at_least(&camera->temperature_writes, 1));
	QSI_CHECK_TRUE(camera->cooler_on);
	QSI_CHECK_TRUE(wait_for_property_state(CCD_COOLER_PROPERTY_NAME, INDIGO_OK_STATE));
	assert_switch_item_value(CCD_COOLER_PROPERTY_NAME, CCD_COOLER_ON_ITEM_NAME, true);
	QSI_CHECK_TRUE(disconnect_device(&ccd_case));
cleanup:
	fixture_stop();
}

static void qsi_reports_cooler_and_temperature_failures(void) {
	QSI_CHECK_TRUE(fixture_start(1));
	QSI_CHECK_TRUE(connect_device(&ccd_case));
	qsi_fake_camera *camera = qsi_fake_camera_at(0);
	camera->fail.cooler_write = 1;
	indigo_change_switch_property_1(&simulator_test_client, ccd_case.device_name, CCD_COOLER_PROPERTY_NAME, CCD_COOLER_ON_ITEM_NAME, true);
	QSI_CHECK_TRUE(wait_for_property_state(CCD_COOLER_PROPERTY_NAME, INDIGO_ALERT_STATE));
	camera->fail.temperature_write = 1;
	indigo_change_number_property_1(&simulator_test_client, ccd_case.device_name, CCD_TEMPERATURE_PROPERTY_NAME, CCD_TEMPERATURE_ITEM_NAME, -20);
	QSI_CHECK_TRUE(wait_for_property_state(CCD_TEMPERATURE_PROPERTY_NAME, INDIGO_ALERT_STATE));
	camera->fail.cooler_write = 0;
	camera->fail.temperature_write = 0;
	QSI_CHECK_TRUE(set_switch(&ccd_case, CCD_COOLER_PROPERTY_NAME, CCD_COOLER_ON_ITEM_NAME));
	QSI_CHECK_TRUE(disconnect_device(&ccd_case));
cleanup:
	fixture_stop();
}

// -------------------------------------------------------------------------------- controls

static void qsi_writes_readout_speed(void) {
	QSI_CHECK_TRUE(fixture_start(1));
	QSI_CHECK_TRUE(connect_device(&ccd_case));
	qsi_fake_camera *camera = qsi_fake_camera_at(0);
	QSI_CHECK_TRUE(set_switch(&ccd_case, READOUT_SPEED_PROPERTY_NAME, "FAST_READOUT"));
	QSI_CHECK_EQ(1, camera->readout_speed);
	QSI_CHECK_TRUE(set_switch(&ccd_case, READOUT_SPEED_PROPERTY_NAME, "HIGH_QUALITY"));
	QSI_CHECK_EQ(0, camera->readout_speed);
	QSI_CHECK_EQ(2, qsi_fake_counter(0, &camera->readout_speed_writes));
	QSI_CHECK_TRUE(disconnect_device(&ccd_case));
cleanup:
	fixture_stop();
}

static void qsi_writes_anti_bloom(void) {
	QSI_CHECK_TRUE(fixture_start(1));
	QSI_CHECK_TRUE(connect_device(&ccd_case));
	qsi_fake_camera *camera = qsi_fake_camera_at(0);
	QSI_CHECK_TRUE(set_switch(&ccd_case, ANTI_BLOOM_PROPERTY_NAME, "HIGH"));
	QSI_CHECK_EQ(1, camera->anti_bloom);
	QSI_CHECK_TRUE(set_switch(&ccd_case, ANTI_BLOOM_PROPERTY_NAME, "NORMAL"));
	QSI_CHECK_EQ(0, camera->anti_bloom);
	QSI_CHECK_TRUE(disconnect_device(&ccd_case));
cleanup:
	fixture_stop();
}

static void qsi_writes_pre_exposure_flush(void) {
	QSI_CHECK_TRUE(fixture_start(1));
	QSI_CHECK_TRUE(connect_device(&ccd_case));
	qsi_fake_camera *camera = qsi_fake_camera_at(0);
	QSI_CHECK_TRUE(set_switch(&ccd_case, PRE_EXPOSURE_FLUSH_PROPERTY_NAME, "NONE"));
	QSI_CHECK_EQ(0, camera->pre_exposure_flush);
	QSI_CHECK_TRUE(set_switch(&ccd_case, PRE_EXPOSURE_FLUSH_PROPERTY_NAME, "MODEST"));
	QSI_CHECK_EQ(1, camera->pre_exposure_flush);
	QSI_CHECK_TRUE(set_switch(&ccd_case, PRE_EXPOSURE_FLUSH_PROPERTY_NAME, "AGGRESSIVE"));
	QSI_CHECK_EQ(3, camera->pre_exposure_flush);
	QSI_CHECK_TRUE(set_switch(&ccd_case, PRE_EXPOSURE_FLUSH_PROPERTY_NAME, "VERY_AGGRESSIVE"));
	QSI_CHECK_EQ(4, camera->pre_exposure_flush);
	QSI_CHECK_TRUE(disconnect_device(&ccd_case));
cleanup:
	fixture_stop();
}

static void qsi_writes_fan_mode(void) {
	QSI_CHECK_TRUE(fixture_start(1));
	QSI_CHECK_TRUE(connect_device(&ccd_case));
	qsi_fake_camera *camera = qsi_fake_camera_at(0);
	QSI_CHECK_TRUE(set_switch(&ccd_case, FAN_MODE_PROPERTY_NAME, "OFF"));
	QSI_CHECK_EQ(0, camera->fan_mode);
	QSI_CHECK_TRUE(set_switch(&ccd_case, FAN_MODE_PROPERTY_NAME, "FULL_SPEED"));
	QSI_CHECK_EQ(2, camera->fan_mode);
	QSI_CHECK_TRUE(set_switch(&ccd_case, FAN_MODE_PROPERTY_NAME, "QUIET"));
	QSI_CHECK_EQ(1, camera->fan_mode);
	QSI_CHECK_TRUE(disconnect_device(&ccd_case));
cleanup:
	fixture_stop();
}

static void qsi_writes_gain(void) {
	QSI_CHECK_TRUE(fixture_start(1));
	QSI_CHECK_TRUE(connect_device(&ccd_case));
	qsi_fake_camera *camera = qsi_fake_camera_at(0);
	indigo_change_number_property_1(&simulator_test_client, ccd_case.device_name, CCD_GAIN_PROPERTY_NAME, CCD_GAIN_ITEM_NAME, 1);
	QSI_CHECK_TRUE(wait_counter_at_least(&camera->gain_writes, 1));
	QSI_CHECK_EQ(1, camera->gain);
	indigo_change_number_property_1(&simulator_test_client, ccd_case.device_name, CCD_GAIN_PROPERTY_NAME, CCD_GAIN_ITEM_NAME, 2);
	QSI_CHECK_TRUE(wait_counter_at_least(&camera->gain_writes, 2));
	QSI_CHECK_EQ(2, camera->gain);
	QSI_CHECK_TRUE(disconnect_device(&ccd_case));
cleanup:
	fixture_stop();
}

static void qsi_reports_control_write_failures(void) {
	QSI_CHECK_TRUE(fixture_start(1));
	QSI_CHECK_TRUE(connect_device(&ccd_case));
	qsi_fake_camera *camera = qsi_fake_camera_at(0);
	camera->fail.readout_speed = 1;
	indigo_change_switch_property_1(&simulator_test_client, ccd_case.device_name, READOUT_SPEED_PROPERTY_NAME, "FAST_READOUT", true);
	QSI_CHECK_TRUE(wait_for_property_state(READOUT_SPEED_PROPERTY_NAME, INDIGO_ALERT_STATE));
	QSI_CHECK_EQ(0, camera->readout_speed);
	camera->fail.anti_bloom = 1;
	indigo_change_switch_property_1(&simulator_test_client, ccd_case.device_name, ANTI_BLOOM_PROPERTY_NAME, "HIGH", true);
	QSI_CHECK_TRUE(wait_for_property_state(ANTI_BLOOM_PROPERTY_NAME, INDIGO_ALERT_STATE));
	camera->fail.pre_exposure_flush = 1;
	indigo_change_switch_property_1(&simulator_test_client, ccd_case.device_name, PRE_EXPOSURE_FLUSH_PROPERTY_NAME, "NONE", true);
	QSI_CHECK_TRUE(wait_for_property_state(PRE_EXPOSURE_FLUSH_PROPERTY_NAME, INDIGO_ALERT_STATE));
	camera->fail.fan_mode = 1;
	indigo_change_switch_property_1(&simulator_test_client, ccd_case.device_name, FAN_MODE_PROPERTY_NAME, "OFF", true);
	QSI_CHECK_TRUE(wait_for_property_state(FAN_MODE_PROPERTY_NAME, INDIGO_ALERT_STATE));
	camera->fail.gain_write = 1;
	indigo_change_number_property_1(&simulator_test_client, ccd_case.device_name, CCD_GAIN_PROPERTY_NAME, CCD_GAIN_ITEM_NAME, 2);
	QSI_CHECK_TRUE(wait_for_property_state(CCD_GAIN_PROPERTY_NAME, INDIGO_ALERT_STATE));
	// Every control must still work once the SDK recovers.
	QSI_CHECK_TRUE(set_switch(&ccd_case, READOUT_SPEED_PROPERTY_NAME, "FAST_READOUT"));
	QSI_CHECK_EQ(1, camera->readout_speed);
	QSI_CHECK_TRUE(disconnect_device(&ccd_case));
cleanup:
	fixture_stop();
}

// -------------------------------------------------------------------------------- wheel

static void qsi_reports_wheel_slot_count(void) {
	QSI_CHECK_TRUE(fixture_start(1));
	QSI_CHECK_TRUE(connect_device(&ccd_case));
	QSI_CHECK_TRUE(connect_device(&wheel_case));
	assert_device_interface(INDIGO_INTERFACE_WHEEL);
	assert_property_has_item(WHEEL_SLOT_PROPERTY_NAME, WHEEL_SLOT_ITEM_NAME);
	QSI_CHECK_EQ(5, (int)find_cached_item(WHEEL_SLOT_PROPERTY_NAME, WHEEL_SLOT_ITEM_NAME)->number.max);
	QSI_CHECK_EQ(5, find_cached_property(WHEEL_SLOT_NAME_PROPERTY_NAME)->count);
	QSI_CHECK_EQ(5, find_cached_property(WHEEL_SLOT_OFFSET_PROPERTY_NAME)->count);
	QSI_CHECK_EQ(1, (int)cached_number_value(WHEEL_SLOT_PROPERTY_NAME, WHEEL_SLOT_ITEM_NAME));
	QSI_CHECK_TRUE(disconnect_device(&wheel_case));
	QSI_CHECK_TRUE(disconnect_device(&ccd_case));
cleanup:
	fixture_stop();
}

static void qsi_moves_wheel_to_first_last_and_intermediate_slots(void) {
	QSI_CHECK_TRUE(fixture_start(1));
	QSI_CHECK_TRUE(connect_device(&ccd_case));
	QSI_CHECK_TRUE(connect_device(&wheel_case));
	qsi_fake_camera *camera = qsi_fake_camera_at(0);
	QSI_CHECK_TRUE(move_wheel(5));
	QSI_CHECK_EQ(4, (int)camera->position);
	QSI_CHECK_EQ(5, (int)cached_number_value(WHEEL_SLOT_PROPERTY_NAME, WHEEL_SLOT_ITEM_NAME));
	QSI_CHECK_TRUE(move_wheel(3));
	QSI_CHECK_EQ(2, (int)camera->position);
	QSI_CHECK_EQ(3, (int)cached_number_value(WHEEL_SLOT_PROPERTY_NAME, WHEEL_SLOT_ITEM_NAME));
	QSI_CHECK_TRUE(move_wheel(1));
	QSI_CHECK_EQ(0, (int)camera->position);
	QSI_CHECK_TRUE(disconnect_device(&wheel_case));
	QSI_CHECK_TRUE(disconnect_device(&ccd_case));
cleanup:
	fixture_stop();
}

static void qsi_reports_already_selected_slot(void) {
	QSI_CHECK_TRUE(fixture_start(1));
	QSI_CHECK_TRUE(connect_device(&ccd_case));
	QSI_CHECK_TRUE(connect_device(&wheel_case));
	qsi_fake_camera *camera = qsi_fake_camera_at(0);
	QSI_CHECK_TRUE(move_wheel(2));
	int writes = qsi_fake_counter(0, &camera->wheel_writes);
	QSI_CHECK_TRUE(move_wheel(2));
	QSI_CHECK_EQ(writes, qsi_fake_counter(0, &camera->wheel_writes));
	QSI_CHECK_EQ(2, (int)cached_number_value(WHEEL_SLOT_PROPERTY_NAME, WHEEL_SLOT_ITEM_NAME));
	QSI_CHECK_TRUE(disconnect_device(&wheel_case));
	QSI_CHECK_TRUE(disconnect_device(&ccd_case));
cleanup:
	fixture_stop();
}

static void qsi_waits_for_wheel_to_settle(void) {
	QSI_CHECK_TRUE(fixture_start(1));
	QSI_CHECK_TRUE(connect_device(&ccd_case));
	QSI_CHECK_TRUE(connect_device(&wheel_case));
	qsi_fake_camera *camera = qsi_fake_camera_at(0);
	camera->wheel_busy_reads = 3;
	QSI_CHECK_TRUE(move_wheel(4));
	QSI_CHECK_EQ(3, (int)camera->position);
	QSI_CHECK_EQ(4, (int)cached_number_value(WHEEL_SLOT_PROPERTY_NAME, WHEEL_SLOT_ITEM_NAME));
	QSI_CHECK_TRUE(disconnect_device(&wheel_case));
	QSI_CHECK_TRUE(disconnect_device(&ccd_case));
cleanup:
	fixture_stop();
}

static void qsi_reports_wheel_move_failure(void) {
	QSI_CHECK_TRUE(fixture_start(1));
	QSI_CHECK_TRUE(connect_device(&ccd_case));
	QSI_CHECK_TRUE(connect_device(&wheel_case));
	qsi_fake_camera *camera = qsi_fake_camera_at(0);
	camera->fail.wheel_write = 1;
	indigo_change_number_property_1(&simulator_test_client, wheel_case.device_name, WHEEL_SLOT_PROPERTY_NAME, WHEEL_SLOT_ITEM_NAME, 4);
	QSI_CHECK_TRUE(wait_for_property_state(WHEEL_SLOT_PROPERTY_NAME, INDIGO_ALERT_STATE));
	camera->fail.wheel_write = 0;
	QSI_CHECK_TRUE(move_wheel(4));
	QSI_CHECK_EQ(3, (int)camera->position);
	QSI_CHECK_TRUE(disconnect_device(&wheel_case));
	QSI_CHECK_TRUE(disconnect_device(&ccd_case));
cleanup:
	fixture_stop();
}

static void qsi_rebuilds_wheel_on_reconnect(void) {
	QSI_CHECK_TRUE(fixture_start(1));
	QSI_CHECK_TRUE(connect_device(&ccd_case));
	QSI_CHECK_TRUE(connect_device(&wheel_case));
	QSI_CHECK_EQ(5, (int)find_cached_item(WHEEL_SLOT_PROPERTY_NAME, WHEEL_SLOT_ITEM_NAME)->number.max);
	QSI_CHECK_TRUE(disconnect_device(&wheel_case));
	QSI_CHECK_TRUE(disconnect_device(&ccd_case));
	qsi_fake_camera_at(0)->filter_count = 8;
	QSI_CHECK_TRUE(connect_device(&ccd_case));
	QSI_CHECK_TRUE(connect_device(&wheel_case));
	QSI_CHECK_EQ(8, (int)find_cached_item(WHEEL_SLOT_PROPERTY_NAME, WHEEL_SLOT_ITEM_NAME)->number.max);
	QSI_CHECK_TRUE(disconnect_device(&wheel_case));
	QSI_CHECK_TRUE(disconnect_device(&ccd_case));
cleanup:
	fixture_stop();
}

// -------------------------------------------------------------------------------- queue and callback behavior

static void qsi_serializes_sdk_access_across_logical_devices(void) {
	QSI_CHECK_TRUE(fixture_start(1));
	QSI_CHECK_TRUE(connect_device(&ccd_case));
	QSI_CHECK_TRUE(connect_device(&wheel_case));
	select_device(&ccd_case);
	use_raw_format();
	// The property cache tracks one device, so the observed device is switched
	// explicitly around every request.
	for (int i = 0; i < 3; i++) {
		select_device(&wheel_case);
		QSI_CHECK_TRUE(move_wheel(i + 1));
		select_device(&ccd_case);
		QSI_CHECK_TRUE(expose(0.05));
	}
	QSI_CHECK_EQ(0, atomic_load(&bad_blob));
	QSI_CHECK_EQ(0, qsi_fake_concurrent_calls());
	QSI_CHECK_TRUE(disconnect_device(&wheel_case));
	QSI_CHECK_TRUE(disconnect_device(&ccd_case));
	QSI_CHECK_EQ(0, qsi_fake_calls_after_close());
cleanup:
	fixture_stop();
}

static void qsi_makes_no_sdk_calls_after_close(void) {
	QSI_CHECK_TRUE(fixture_start(1));
	QSI_CHECK_TRUE(connect_device(&ccd_case));
	use_raw_format();
	QSI_CHECK_TRUE(expose(0.05));
	QSI_CHECK_TRUE(disconnect_device(&ccd_case));
	indigo_usleep(500000);
	QSI_CHECK_EQ(0, qsi_fake_calls_after_close());
cleanup:
	fixture_stop();
}


// -------------------------------------------------------------------------------- migrated driver capabilities

static void qsi_publishes_exposure_countdown(void) {
	QSI_CHECK_TRUE(fixture_start(1));
	QSI_CHECK_TRUE(connect_device(&ccd_case));
	use_raw_format();
	qsi_fake_camera *camera = qsi_fake_camera_at(0);
	camera->not_ready_reads = 2000;
	unsigned busy_revision = property_state_revision(CCD_EXPOSURE_PROPERTY_NAME, INDIGO_BUSY_STATE);
	indigo_change_number_property_1(&simulator_test_client, ccd_case.device_name, CCD_EXPOSURE_PROPERTY_NAME, CCD_EXPOSURE_ITEM_NAME, 4);
	QSI_CHECK_TRUE(wait_for_property_state_seen_after(CCD_EXPOSURE_PROPERTY_NAME, INDIGO_BUSY_STATE, busy_revision));
	// The shared CCD countdown must publish a decreasing remaining time instead
	// of jumping straight from the requested duration to zero.
	QSI_CHECK_TRUE(wait_for_number_item_value(CCD_EXPOSURE_PROPERTY_NAME, CCD_EXPOSURE_ITEM_NAME, 2, 1));
	QSI_CHECK_TRUE(cached_number_value(CCD_EXPOSURE_PROPERTY_NAME, CCD_EXPOSURE_ITEM_NAME) < 4);
	indigo_change_switch_property_1(&simulator_test_client, ccd_case.device_name, CCD_ABORT_EXPOSURE_PROPERTY_NAME, CCD_ABORT_EXPOSURE_ITEM_NAME, true);
	QSI_CHECK_TRUE(wait_for_property_not_busy(CCD_EXPOSURE_PROPERTY_NAME));
	QSI_CHECK_TRUE(disconnect_device(&ccd_case));
cleanup:
	fixture_stop();
}

static void qsi_times_out_stuck_readout(void) {
	QSI_CHECK_TRUE(fixture_start(1));
	QSI_CHECK_TRUE(connect_device(&ccd_case));
	use_raw_format();
	qsi_fake_camera *camera = qsi_fake_camera_at(0);
	camera->image_never_ready = true;
	indigo_change_number_property_1(&simulator_test_client, ccd_case.device_name, CCD_EXPOSURE_PROPERTY_NAME, CCD_EXPOSURE_ITEM_NAME, 0.05);
	QSI_CHECK_TRUE(wait_for_property_state(CCD_EXPOSURE_PROPERTY_NAME, INDIGO_BUSY_STATE));
	QSI_CHECK_TRUE(wait_counter_at_least(&camera->image_ready_calls, 2));
	// Cross the bounded readout deadline instead of waiting it out.
	atomic_store(&clock_shift, 120);
	QSI_CHECK_TRUE(wait_for_property_state(CCD_EXPOSURE_PROPERTY_NAME, INDIGO_ALERT_STATE));
	QSI_CHECK_TRUE(wait_counter_at_least(&camera->abort_calls, 1));
	QSI_CHECK_EQ(0, atomic_load(&blob_count));
	// The queue must still be usable.
	atomic_store(&clock_shift, 0);
	camera->image_never_ready = false;
	QSI_CHECK_TRUE(expose(0.05));
	QSI_CHECK_EQ(1, atomic_load(&blob_count));
	QSI_CHECK_TRUE(disconnect_device(&ccd_case));
cleanup:
	fixture_stop();
}

static void qsi_times_out_stuck_wheel(void) {
	QSI_CHECK_TRUE(fixture_start(1));
	QSI_CHECK_TRUE(connect_device(&ccd_case));
	QSI_CHECK_TRUE(connect_device(&wheel_case));
	qsi_fake_camera *camera = qsi_fake_camera_at(0);
	camera->wheel_never_settles = true;
	unsigned revision = property_revision(WHEEL_SLOT_PROPERTY_NAME);
	indigo_change_number_property_1(&simulator_test_client, wheel_case.device_name, WHEEL_SLOT_PROPERTY_NAME, WHEEL_SLOT_ITEM_NAME, 4);
	QSI_CHECK_TRUE(wait_for_property_state_after(WHEEL_SLOT_PROPERTY_NAME, INDIGO_BUSY_STATE, revision));
	// BUSY is published before the handler runs, so the deadline only exists
	// once the move has actually been issued.
	QSI_CHECK_TRUE(wait_counter_at_least(&camera->wheel_writes, 1));
	QSI_CHECK_TRUE(wait_counter_at_least(&camera->wheel_reads, 3));
	atomic_store(&clock_shift, 120);
	QSI_CHECK_TRUE(wait_for_property_state(WHEEL_SLOT_PROPERTY_NAME, INDIGO_ALERT_STATE));
	atomic_store(&clock_shift, 0);
	camera->wheel_never_settles = false;
	QSI_CHECK_TRUE(move_wheel(4));
	QSI_CHECK_EQ(3, (int)camera->position);
	QSI_CHECK_TRUE(disconnect_device(&wheel_case));
	QSI_CHECK_TRUE(disconnect_device(&ccd_case));
cleanup:
	fixture_stop();
}

static void qsi_disconnects_while_readout_pending(void) {
	QSI_CHECK_TRUE(fixture_start(1));
	QSI_CHECK_TRUE(connect_device(&ccd_case));
	use_raw_format();
	qsi_fake_camera *camera = qsi_fake_camera_at(0);
	camera->image_never_ready = true;
	indigo_change_number_property_1(&simulator_test_client, ccd_case.device_name, CCD_EXPOSURE_PROPERTY_NAME, CCD_EXPOSURE_ITEM_NAME, 0.05);
	QSI_CHECK_TRUE(wait_for_property_state(CCD_EXPOSURE_PROPERTY_NAME, INDIGO_BUSY_STATE));
	QSI_CHECK_TRUE(wait_counter_at_least(&camera->image_ready_calls, 2));
	// The readout poll must not hold the queue, so a disconnect still completes.
	QSI_CHECK_TRUE(disconnect_device(&ccd_case));
	QSI_CHECK_EQ(-1, qsi_fake_connected_index());
	indigo_usleep(500000);
	QSI_CHECK_EQ(0, qsi_fake_calls_after_close());
	QSI_CHECK_EQ(0, atomic_load(&blob_count));
cleanup:
	fixture_stop();
}

static void qsi_removes_device_with_exposure_pending(void) {
	QSI_CHECK_TRUE(fixture_start(1));
	QSI_CHECK_TRUE(connect_device(&ccd_case));
	use_raw_format();
	qsi_fake_camera *camera = qsi_fake_camera_at(0);
	camera->image_never_ready = true;
	indigo_change_number_property_1(&simulator_test_client, ccd_case.device_name, CCD_EXPOSURE_PROPERTY_NAME, CCD_EXPOSURE_ITEM_NAME, 0.05);
	QSI_CHECK_TRUE(wait_for_property_state(CCD_EXPOSURE_PROPERTY_NAME, INDIGO_BUSY_STATE));
	QSI_CHECK_TRUE(wait_counter_at_least(&camera->image_ready_calls, 2));
	QSI_CHECK_TRUE(disconnect_device(&ccd_case));
	camera->present = false;
	fire_usb_event(0, LIBUSB_HOTPLUG_EVENT_DEVICE_LEFT);
	QSI_CHECK_TRUE(wait_attached(0));
	QSI_CHECK_EQ(0, atomic_load(&usb_unref_errors));
cleanup:
	fixture_stop();
}

static void qsi_reports_image_size_mismatch(void) {
	QSI_CHECK_TRUE(fixture_start(1));
	QSI_CHECK_TRUE(connect_device(&ccd_case));
	use_raw_format();
	qsi_fake_camera_at(0)->fail.image_size = 1;
	indigo_change_number_property_1(&simulator_test_client, ccd_case.device_name, CCD_EXPOSURE_PROPERTY_NAME, CCD_EXPOSURE_ITEM_NAME, 0.05);
	QSI_CHECK_TRUE(wait_for_property_state(CCD_EXPOSURE_PROPERTY_NAME, INDIGO_ALERT_STATE));
	QSI_CHECK_EQ(0, atomic_load(&blob_count));
	QSI_CHECK_TRUE(expose(0.05));
	QSI_CHECK_EQ(1, atomic_load(&blob_count));
	QSI_CHECK_EQ(0, atomic_load(&bad_blob));
	QSI_CHECK_TRUE(disconnect_device(&ccd_case));
cleanup:
	fixture_stop();
}

// Discovery probes each camera, so a camera without a filter wheel must not get
// a wheel logical device at all.
static void qsi_attaches_wheel_only_for_cameras_that_have_one(void) {
	reset_fake(1);
	qsi_fake_camera *camera = qsi_fake_camera_at(0);
	camera->has_filter_wheel = false;
	camera->filter_count = 0;
	reset_simulator_context(&ccd_case);
	simulator_test_client.update_property = observe_image;
	QSI_CHECK_EQ(INDIGO_OK, indigo_start());
	QSI_CHECK_EQ(INDIGO_OK, indigo_attach_client(&simulator_test_client));
	QSI_CHECK_EQ(INDIGO_OK, indigo_ccd_qsi(INDIGO_DRIVER_INIT, NULL));
	fixture_running = true;
	QSI_CHECK_TRUE(wait_attached(1));
	indigo_usleep(300000);
	QSI_CHECK_EQ(1, atomic_load(&attached_count));
	QSI_CHECK_TRUE(connect_device(&ccd_case));
	QSI_CHECK_TRUE(disconnect_device(&ccd_case));
cleanup:
	fixture_stop();
}

// A camera that arrives while another one is connected cannot be probed, so the
// wheel is attached optimistically and its connection handler validates it.
static void qsi_wheel_connect_fails_without_filter_wheel(void) {
	QSI_CHECK_TRUE(fixture_start(1));
	QSI_CHECK_TRUE(connect_device(&ccd_case));
	qsi_fake_camera *second = qsi_fake_add_camera(1, CAMERA_1_SERIAL, CAMERA_1_DESC, CAMERA_1_MODEL);
	second->has_filter_wheel = false;
	second->filter_count = 0;
	configure_usb(1, QSI_VENDOR_ID, QSI_PRODUCT_ID2);
	fire_usb_event(1, LIBUSB_HOTPLUG_EVENT_DEVICE_ARRIVED);
	QSI_CHECK_TRUE(wait_attached(4));
	QSI_CHECK_TRUE(disconnect_device(&ccd_case));
	QSI_CHECK_TRUE(connect_device(&second_ccd_case));
	const simulator_driver_case second_wheel_case = { "QSI Camera", "indigo_ccd_qsi", CAMERA_1_DESC " (wheel) #" CAMERA_1_SERIAL, indigo_ccd_qsi, true, NULL, 0, NULL, 0, NULL, 0, NULL, 0 };
	select_device(&second_wheel_case);
	indigo_change_switch_property_1(&simulator_test_client, second_wheel_case.device_name, CONNECTION_PROPERTY_NAME, CONNECTION_CONNECTED_ITEM_NAME, true);
	QSI_CHECK_TRUE(wait_for_property_state(CONNECTION_PROPERTY_NAME, INDIGO_ALERT_STATE));
	// The rejected wheel must not have torn down the camera connection.
	QSI_CHECK_EQ(1, qsi_fake_connected_index());
	QSI_CHECK_TRUE(disconnect_device(&second_ccd_case));
cleanup:
	fixture_stop();
}

static void qsi_rejects_foreign_vid_pid(void) {
	QSI_CHECK_TRUE(fixture_start(1));
	int attached = atomic_load(&attached_count);
	qsi_fake_add_camera(1, CAMERA_1_SERIAL, CAMERA_1_DESC, CAMERA_1_MODEL);
	configure_usb(1, 0x1234, 0x5678);
	fire_usb_event(1, LIBUSB_HOTPLUG_EVENT_DEVICE_ARRIVED);
	indigo_usleep(500000);
	QSI_CHECK_EQ(attached, atomic_load(&attached_count));
	configure_usb(1, QSI_VENDOR_ID, 0x1111);
	fire_usb_event(1, LIBUSB_HOTPLUG_EVENT_DEVICE_ARRIVED);
	indigo_usleep(500000);
	QSI_CHECK_EQ(attached, atomic_load(&attached_count));
cleanup:
	fixture_stop();
}

static void qsi_accepts_both_product_ids(void) {
	QSI_CHECK_TRUE(fixture_start(1));
	QSI_CHECK_TRUE(wait_attached(2));
	qsi_fake_add_camera(1, CAMERA_1_SERIAL, CAMERA_1_DESC, CAMERA_1_MODEL);
	configure_usb(1, QSI_VENDOR_ID, QSI_PRODUCT_ID2);
	fire_usb_event(1, LIBUSB_HOTPLUG_EVENT_DEVICE_ARRIVED);
	QSI_CHECK_TRUE(wait_attached(4));
cleanup:
	fixture_stop();
}

static void qsi_retries_discovery_when_enumeration_is_not_ready(void) {
	reset_fake(1);
	// The first enumeration attempt fails, so discovery has to retry.
	qsi_fake_camera_at(0)->fail.enumerate = 1;
	reset_simulator_context(&ccd_case);
	simulator_test_client.update_property = observe_image;
	QSI_CHECK_EQ(INDIGO_OK, indigo_start());
	QSI_CHECK_EQ(INDIGO_OK, indigo_attach_client(&simulator_test_client));
	QSI_CHECK_EQ(INDIGO_OK, indigo_ccd_qsi(INDIGO_DRIVER_INIT, NULL));
	fixture_running = true;
	QSI_CHECK_TRUE(wait_attached(2));
	QSI_CHECK_TRUE(connect_device(&ccd_case));
	QSI_CHECK_TRUE(disconnect_device(&ccd_case));
cleanup:
	fixture_stop();
}

// Replays a fixed scenario with SDK tracing enabled so the ordered interaction
// sequence of the original driver can be compared against the migrated one.
static int capture_reference_trace(const char *path) {
	// Everything before the "# connect ccd" marker is the discovery phase.
	trace_discovery = true;
	if (!fixture_start(1)) {
		fixture_stop();
		return 1;
	}
	qsi_fake_trace_record("# connect ccd");
	if (!connect_device(&ccd_case)) {
		fixture_stop();
		return 1;
	}
	use_raw_format();
	qsi_fake_trace_record("# connect wheel");
	if (!connect_device(&wheel_case)) {
		fixture_stop();
		return 1;
	}
	qsi_fake_trace_record("# move wheel");
	move_wheel(3);
	qsi_fake_trace_record("# configure frame");
	set_bin(2);
	set_frame(16, 8, 32, 24);
	expected_left = 16;
	expected_top = 8;
	expected_bin = 2;
	expected_image_width = 16;
	expected_image_height = 12;
	qsi_fake_trace_record("# expose");
	expose(0.05);
	qsi_fake_trace_record("# controls");
	set_switch(&ccd_case, READOUT_SPEED_PROPERTY_NAME, "FAST_READOUT");
	set_switch(&ccd_case, ANTI_BLOOM_PROPERTY_NAME, "HIGH");
	set_switch(&ccd_case, PRE_EXPOSURE_FLUSH_PROPERTY_NAME, "MODEST");
	set_switch(&ccd_case, FAN_MODE_PROPERTY_NAME, "FULL_SPEED");
	set_switch(&ccd_case, CCD_COOLER_PROPERTY_NAME, CCD_COOLER_ON_ITEM_NAME);
	qsi_fake_trace_record("# disconnect");
	disconnect_device(&wheel_case);
	disconnect_device(&ccd_case);
	bool ok = qsi_fake_trace_write(path);
	fixture_stop();
	printf("reference trace written to %s\n", path);
	return ok ? 0 : 1;
}

int main(int argc, char **argv) {
	// --only <substring> narrows a debugging run; --trace <path> captures the
	// normalized SDK interaction trace used for the migration comparison.
	const char *only = NULL;
	const char *trace_path = NULL;
	for (int i = 1; i < argc; i++) {
		if (!strcmp(argv[i], "--only") && i + 1 < argc) {
			only = argv[++i];
		} else if (!strcmp(argv[i], "--trace") && i + 1 < argc) {
			trace_path = argv[++i];
		}
	}
	const indigo_test_case tests[] = {
		{ "qsi_reports_driver_metadata", qsi_reports_driver_metadata },
		{ "qsi_attaches_all_enumerated_cameras", qsi_attaches_all_enumerated_cameras },
		{ "qsi_enumerates_common_properties_before_connect", qsi_enumerates_common_properties_before_connect },
		{ "qsi_connects_and_disconnects_ccd", qsi_connects_and_disconnects_ccd },
		{ "qsi_tolerates_repeated_disconnect", qsi_tolerates_repeated_disconnect },
		{ "qsi_repeats_init_and_shutdown", qsi_repeats_init_and_shutdown },
		{ "qsi_rejects_shutdown_while_connected", qsi_rejects_shutdown_while_connected },
		{ "qsi_rejects_second_camera_while_one_is_connected", qsi_rejects_second_camera_while_one_is_connected },
		{ "qsi_ignores_duplicate_arrivals", qsi_ignores_duplicate_arrivals },
		{ "qsi_handles_burst_arrivals", qsi_handles_burst_arrivals },
		{ "qsi_detaches_on_removal", qsi_detaches_on_removal },
		{ "qsi_publishes_ccd_class_properties", qsi_publishes_ccd_class_properties },
		{ "qsi_publishes_custom_properties", qsi_publishes_custom_properties },
		{ "qsi_hides_unsupported_capabilities", qsi_hides_unsupported_capabilities },
		{ "qsi_builds_modes_for_linear_binning", qsi_builds_modes_for_linear_binning },
		{ "qsi_builds_modes_for_power_of_two_binning", qsi_builds_modes_for_power_of_two_binning },
		{ "qsi_applies_exposure_limits_from_sdk", qsi_applies_exposure_limits_from_sdk },
		{ "qsi_rebuilds_properties_on_reconnect", qsi_rebuilds_properties_on_reconnect },
		{ "qsi_reports_connect_failure_and_recovers", qsi_reports_connect_failure_and_recovers },
		{ "qsi_reports_geometry_read_failure", qsi_reports_geometry_read_failure },
		{ "qsi_recovers_from_disconnect_failure", qsi_recovers_from_disconnect_failure },
		{ "qsi_delivers_full_frame", qsi_delivers_full_frame },
		{ "qsi_delivers_subframe_with_binning", qsi_delivers_subframe_with_binning },
		{ "qsi_sends_shutter_flag_per_frame_type", qsi_sends_shutter_flag_per_frame_type },
		{ "qsi_uses_shortest_exposure_for_bias", qsi_uses_shortest_exposure_for_bias },
		{ "qsi_retries_until_image_is_ready", qsi_retries_until_image_is_ready },
		{ "qsi_rejects_overlapping_exposure", qsi_rejects_overlapping_exposure },
		{ "qsi_reports_exposure_start_failure", qsi_reports_exposure_start_failure },
		{ "qsi_aborts_exposure_and_reacquires", qsi_aborts_exposure_and_reacquires },
		{ "qsi_polls_temperature_and_cooler_power", qsi_polls_temperature_and_cooler_power },
		{ "qsi_switches_cooler", qsi_switches_cooler },
		{ "qsi_sets_target_temperature", qsi_sets_target_temperature },
		{ "qsi_rejects_target_change_while_cooling", qsi_rejects_target_change_while_cooling },
		{ "qsi_enables_cooler_when_target_is_set", qsi_enables_cooler_when_target_is_set },
		{ "qsi_reports_cooler_and_temperature_failures", qsi_reports_cooler_and_temperature_failures },
		{ "qsi_writes_readout_speed", qsi_writes_readout_speed },
		{ "qsi_writes_anti_bloom", qsi_writes_anti_bloom },
		{ "qsi_writes_pre_exposure_flush", qsi_writes_pre_exposure_flush },
		{ "qsi_writes_fan_mode", qsi_writes_fan_mode },
		{ "qsi_writes_gain", qsi_writes_gain },
		{ "qsi_reports_control_write_failures", qsi_reports_control_write_failures },
		{ "qsi_reports_wheel_slot_count", qsi_reports_wheel_slot_count },
		{ "qsi_moves_wheel_to_first_last_and_intermediate_slots", qsi_moves_wheel_to_first_last_and_intermediate_slots },
		{ "qsi_reports_already_selected_slot", qsi_reports_already_selected_slot },
		{ "qsi_waits_for_wheel_to_settle", qsi_waits_for_wheel_to_settle },
		{ "qsi_reports_wheel_move_failure", qsi_reports_wheel_move_failure },
		{ "qsi_rebuilds_wheel_on_reconnect", qsi_rebuilds_wheel_on_reconnect },
		{ "qsi_serializes_sdk_access_across_logical_devices", qsi_serializes_sdk_access_across_logical_devices },
		{ "qsi_makes_no_sdk_calls_after_close", qsi_makes_no_sdk_calls_after_close },
		{ "qsi_publishes_exposure_countdown", qsi_publishes_exposure_countdown },
		{ "qsi_times_out_stuck_readout", qsi_times_out_stuck_readout },
		{ "qsi_times_out_stuck_wheel", qsi_times_out_stuck_wheel },
		{ "qsi_disconnects_while_readout_pending", qsi_disconnects_while_readout_pending },
		{ "qsi_removes_device_with_exposure_pending", qsi_removes_device_with_exposure_pending },
		{ "qsi_reports_image_size_mismatch", qsi_reports_image_size_mismatch },
		{ "qsi_attaches_wheel_only_for_cameras_that_have_one", qsi_attaches_wheel_only_for_cameras_that_have_one },
		{ "qsi_wheel_connect_fails_without_filter_wheel", qsi_wheel_connect_fails_without_filter_wheel },
		{ "qsi_rejects_foreign_vid_pid", qsi_rejects_foreign_vid_pid },
		{ "qsi_accepts_both_product_ids", qsi_accepts_both_product_ids },
		{ "qsi_retries_discovery_when_enumeration_is_not_ready", qsi_retries_discovery_when_enumeration_is_not_ready }
	};
	if (trace_path != NULL) {
		return capture_reference_trace(trace_path);
	}
	if (only != NULL) {
		indigo_test_case selected[ARRAY_SIZE(tests)];
		int count = 0;
		for (int i = 0; i < ARRAY_SIZE(tests); i++) {
			if (strstr(tests[i].name, only) != NULL) {
				selected[count++] = tests[i];
			}
		}
		return indigo_run_tests("QSI camera fake SDK integration tests", selected, count);
	}
	return indigo_run_tests("QSI camera fake SDK integration tests", tests, ARRAY_SIZE(tests));
}
