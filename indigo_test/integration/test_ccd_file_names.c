// Copyright (c) 2026 INDIGO initiative
// All rights reserved.
//
// You may use this software under the terms of 'INDIGO Astronomy
// open-source license' (see LICENSE.md).
//
// THIS SOFTWARE IS PROVIDED BY THE AUTHORS 'AS IS' AND ANY EXPRESS
// OR IMPLIED WARRANTIES, INCLUDING, BUT NOT LIMITED TO, THE IMPLIED
// WARRANTIES OF MERCHANTABILITY AND FITNESS FOR A PARTICULAR PURPOSE
// ARE DISCLAIMED. IN NO EVENT SHALL THE AUTHOR BE LIABLE FOR ANY
// DIRECT, INDIRECT, INCIDENTAL, SPECIAL, EXEMPLARY, OR CONSEQUENTIAL
// DAMAGES (INCLUDING, BUT NOT LIMITED TO, PROCUREMENT OF SUBSTITUTE
// GOODS OR SERVICES; LOSS OF USE, DATA, OR PROFITS; OR BUSINESS
// INTERRUPTION) HOWEVER CAUSED AND ON ANY THEORY OF LIABILITY,
// WHETHER IN CONTRACT, STRICT LIABILITY, OR TORT (INCLUDING
// NEGLIGENCE OR OTHERWISE) ARISING IN ANY WAY OUT OF THE USE OF THIS
// SOFTWARE, EVEN IF ADVISED OF THE POSSIBILITY OF SUCH DAMAGE.

// Code is generated by AI

#include <signal.h>
#include <stdlib.h>
#include <string.h>
#include <unistd.h>
#include <sys/resource.h>
#include <sys/stat.h>
#include <indigo/indigo_ccd_driver.h>
#include "../test_runner.h"

#define CHECK(condition) do { if (!(condition)) { fprintf(stderr, "%s:%d: %s\n", __FILE__, __LINE__, #condition); indigo_test_failures++; goto cleanup; } } while (0)
#define CHECK_EQ_INT(expected, actual) CHECK((expected) == (actual))
#define CHECK_STREQ(expected, actual) CHECK(strcmp((expected), (actual)) == 0)

static void capture_frame(indigo_device *device, const char *prefix) {
	unsigned char frame[FITS_HEADER_SIZE + 4] = { 0 };
	INDIGO_COPY_VALUE(CCD_LOCAL_MODE_PREFIX_ITEM->text.value, prefix);
	indigo_process_image(device, frame, 2, 2, 8, true, true, NULL, false);
}

static void set_header(indigo_device *device, const char *name, const char *value) {
	indigo_property *property = indigo_init_text_property(NULL, device->name, CCD_SET_FITS_HEADER_PROPERTY_NAME, "", "", INDIGO_OK_STATE, INDIGO_RW_PERM, 2);
	indigo_init_text_item_raw(property->items, CCD_SET_FITS_HEADER_KEYWORD_ITEM_NAME, "", name);
	indigo_init_text_item_raw(property->items + 1, CCD_SET_FITS_HEADER_VALUE_ITEM_NAME, "", value);
	indigo_ccd_change_property(device, NULL, property);
	indigo_release_property(property);
}

static void file_name_expansion_is_bounded_and_literal(void) {
	indigo_device camera = { 0 }, *device = &camera;
	bool started = false, attached = false;
	indigo_property *baud = NULL, *local = NULL;
	strcpy(camera.name, "Filename Test");
	CHECK_EQ_INT(INDIGO_OK, indigo_start());
	started = true;
	CHECK_EQ_INT(INDIGO_OK, indigo_ccd_attach(device, "filename_test", 1));
	attached = true;
	indigo_set_switch(CONNECTION_PROPERTY, CONNECTION_CONNECTED_ITEM, true);
	CONNECTION_PROPERTY->state = INDIGO_OK_STATE;
	indigo_define_property(device, CCD_SET_FITS_HEADER_PROPERTY, NULL);
	indigo_define_property(device, CCD_LOCAL_MODE_PROPERTY, NULL);
	DEVICE_BAUDRATE_PROPERTY->hidden = false;
	indigo_define_property(device, DEVICE_BAUDRATE_PROPERTY, NULL);
	indigo_set_switch(CCD_UPLOAD_MODE_PROPERTY, CCD_UPLOAD_MODE_LOCAL_ITEM, true);
	indigo_set_switch(CCD_IMAGE_FORMAT_PROPERTY, CCD_IMAGE_FORMAT_RAW_ITEM, true);
	indigo_set_switch(CCD_PREVIEW_PROPERTY, CCD_PREVIEW_DISABLED_ITEM, true);
	char directory[INDIGO_VALUE_SIZE];
	snprintf(directory, sizeof(directory), "%s/", indigo_test_home);
	INDIGO_COPY_VALUE(CCD_LOCAL_MODE_DIR_ITEM->text.value, directory);
	capture_frame(device, "ordinary_XXX");
	CHECK_EQ_INT(INDIGO_OK_STATE, CCD_IMAGE_FILE_PROPERTY->state);
	CHECK_STREQ("ordinary_001.raw", strrchr(CCD_IMAGE_FILE_ITEM->text.value, '/') + 1);
	capture_frame(device, "ordinary_XXX");
	CHECK_STREQ("ordinary_002.raw", strrchr(CCD_IMAGE_FILE_ITEM->text.value, '/') + 1);
	capture_frame(device, "ordinary_%I");
	CHECK_STREQ("ordinary_003.raw", strrchr(CCD_IMAGE_FILE_ITEM->text.value, '/') + 1);
	capture_frame(device, "four_XXXX");
	CHECK_STREQ("four_0001.raw", strrchr(CCD_IMAGE_FILE_ITEM->text.value, '/') + 1);
	capture_frame(device, "four_%4S");
	CHECK_STREQ("four_0002.raw", strrchr(CCD_IMAGE_FILE_ITEM->text.value, '/') + 1);
	capture_frame(device, "repeat_%I_%2I");
	CHECK_STREQ("repeat_001_01.raw", strrchr(CCD_IMAGE_FILE_ITEM->text.value, '/') + 1);
	capture_frame(device, "repeat_%I_%2I");
	CHECK_STREQ("repeat_002_01.raw", strrchr(CCD_IMAGE_FILE_ITEM->text.value, '/') + 1);
	capture_frame(device, "unknown_%Q_%");
	CHECK_STREQ("unknown__Q__.raw", strrchr(CCD_IMAGE_FILE_ITEM->text.value, '/') + 1);
	CCD_EXPOSURE_ITEM->number.target = 1.25;
	CCD_TEMPERATURE_PROPERTY->hidden = false;
	CCD_COOLER_PROPERTY->hidden = false;
	indigo_set_switch(CCD_COOLER_PROPERTY, CCD_COOLER_ON_ITEM, true);
	CCD_TEMPERATURE_ITEM->number.target = -10.5;
	CCD_TEMPERATURE_ITEM->number.value = -8.25;
	indigo_set_switch(CCD_FRAME_TYPE_PROPERTY, CCD_FRAME_TYPE_LIGHT_ITEM, true);
	CCD_GAIN_ITEM->number.value = 12;
	CCD_OFFSET_ITEM->number.value = 3;
	CCD_FRAME_WIDTH_ITEM->number.value = 640;
	CCD_FRAME_HEIGHT_ITEM->number.value = 480;
	CCD_BIN_HORIZONTAL_ITEM->number.value = 2;
	CCD_BIN_VERTICAL_ITEM->number.value = 3;
	capture_frame(device, "%2E_%1T_%2t_%F_%G_%O_%R_%B");
	CHECK_EQ_INT(INDIGO_OK_STATE, CCD_IMAGE_FILE_PROPERTY->state);
	CHECK_STREQ("1.25_-10.5_-8.25_Light_12_3_640x480_BIN2x3.raw", strrchr(CCD_IMAGE_FILE_ITEM->text.value, '/') + 1);

	INDIGO_COPY_VALUE(CCD_LOCAL_MODE_OBJECT_ITEM->text.value, "Object 50%_%%");
	set_header(device, "FILTER", "'Filter 50%'");
	CHECK_EQ_INT(INDIGO_OK_STATE, CCD_SET_FITS_HEADER_PROPERTY->state);
	indigo_item *filter = indigo_get_item(CCD_FITS_HEADERS_PROPERTY, "FILTER");
	CHECK(filter != NULL);
	CHECK_STREQ("'Filter 50%'", indigo_get_text_item_value(filter));
	capture_frame(device, "%o_%C_%2S");
	CHECK_EQ_INT(INDIGO_OK_STATE, CCD_IMAGE_FILE_PROPERTY->state);
	CHECK_STREQ("Object 50%_%%_Filter 50%_01.raw", strrchr(CCD_IMAGE_FILE_ITEM->text.value, '/') + 1);
	char filter_value[59], focus_value[59];
	memset(filter_value, 'f', 58);
	filter_value[0] = '\'';
	filter_value[57] = '\'';
	filter_value[58] = 0;
	memset(focus_value, '7', 58);
	focus_value[58] = 0;
	set_header(device, "FILTER", filter_value);
	set_header(device, "FOCUSPOS", focus_value);
	capture_frame(device, "%C_%P_%J");
	CHECK_EQ_INT(INDIGO_OK_STATE, CCD_IMAGE_FILE_PROPERTY->state);
	const char *name = strrchr(CCD_IMAGE_FILE_ITEM->text.value, '/') + 1;
	CHECK_EQ_INT(56 + 1 + 58 + 1 + 17 + 4, strlen(name));
	CHECK(!strncmp(name, filter_value + 1, 56));
	CHECK(!strncmp(name + 57, focus_value, 58));
	char object[41];
	memset(object, 'o', 40);
	object[40] = 0;
	INDIGO_COPY_VALUE(CCD_LOCAL_MODE_OBJECT_ITEM->text.value, object);
	capture_frame(device, "%o%o%o%o%o%o%o%o%o%o%o%o%o");
	CHECK_EQ_INT(INDIGO_ALERT_STATE, CCD_IMAGE_FILE_PROPERTY->state);
	// Construct ordinary nested directories so the complete path reaches the public value limit.
	char nested[INDIGO_VALUE_SIZE];
	strcpy(nested, directory);
	while (strlen(nested) < 300) {
		strcat(nested, "subdirectory/");
		CHECK(mkdir(nested, 0700) == 0);
	}
	INDIGO_COPY_VALUE(CCD_LOCAL_MODE_DIR_ITEM->text.value, nested);
	char prefix[INDIGO_VALUE_SIZE];
	size_t length = INDIGO_VALUE_SIZE - 1 - strlen(nested) - 4;
	memset(prefix, 'p', length);
	prefix[length] = 0;
	capture_frame(device, prefix);
	CHECK_EQ_INT(INDIGO_OK_STATE, CCD_IMAGE_FILE_PROPERTY->state);
	CHECK_EQ_INT(INDIGO_VALUE_SIZE - 1, strlen(CCD_IMAGE_FILE_ITEM->text.value));
	prefix[length] = 'p';
	prefix[length + 1] = 0;
	capture_frame(device, prefix);
	CHECK_EQ_INT(INDIGO_ALERT_STATE, CCD_IMAGE_FILE_PROPERTY->state);
	// Serial framing and directory separators are rejected when their suffix cannot fit.
	baud = indigo_init_text_property(NULL, device->name, DEVICE_BAUDRATE_PROPERTY_NAME, "", "", INDIGO_OK_STATE, INDIGO_RW_PERM, 1);
	memset(prefix, '9', sizeof(prefix) - 1);
	prefix[sizeof(prefix) - 1] = 0;
	indigo_init_text_item_raw(baud->items, DEVICE_BAUDRATE_ITEM_NAME, "", prefix);
	indigo_device_change_property(device, NULL, baud);
	CHECK_EQ_INT(INDIGO_ALERT_STATE, DEVICE_BAUDRATE_PROPERTY->state);
	indigo_release_property(baud);
	baud = NULL;
	local = indigo_init_text_property(NULL, device->name, CCD_LOCAL_MODE_PROPERTY_NAME, "", "", INDIGO_OK_STATE, INDIGO_RW_PERM, 1);
	indigo_init_text_item_raw(local->items, CCD_LOCAL_MODE_DIR_ITEM_NAME, "", prefix);
	indigo_ccd_change_property(device, NULL, local);
	CHECK_EQ_INT(INDIGO_ALERT_STATE, CCD_LOCAL_MODE_PROPERTY->state);
	indigo_release_property(local);
	local = NULL;
cleanup:
	indigo_release_property(baud);
	indigo_release_property(local);
	if (attached) {
		indigo_set_switch(CONNECTION_PROPERTY, CONNECTION_DISCONNECTED_ITEM, true);
		if (indigo_ccd_detach(device) != INDIGO_OK) {
			indigo_test_failures++;
		}
	}
	if (started && indigo_stop() != INDIGO_OK) {
		indigo_test_failures++;
	}
}

static bool path_exists(const char *path) {
	struct stat status;
	return stat(path, &status) == 0;
}

/* RLIMIT_FSIZE = 0 makes every write to a regular file fail with EFBIG, the same -1 result as a full disk */
static bool limit_file_size(struct rlimit *saved) {
	signal(SIGXFSZ, SIG_IGN);
	if (getrlimit(RLIMIT_FSIZE, saved) != 0) {
		return false;
	}
	struct rlimit limit = *saved;
	limit.rlim_cur = 0;
	return setrlimit(RLIMIT_FSIZE, &limit) == 0;
}

static void restore_file_size(const struct rlimit *saved) {
	setrlimit(RLIMIT_FSIZE, saved);
}

static void failed_local_save_publishes_alert(void) {
	indigo_device camera = { 0 }, *device = &camera;
	bool started = false, attached = false, limited = false;
	struct rlimit saved;
	unsigned char *jpeg = NULL;
	long jpeg_size = 0;
	strcpy(camera.name, "Save Failure Test");
	CHECK_EQ_INT(INDIGO_OK, indigo_start());
	started = true;
	CHECK_EQ_INT(INDIGO_OK, indigo_ccd_attach(device, "save_failure_test", 1));
	attached = true;
	indigo_set_switch(CONNECTION_PROPERTY, CONNECTION_CONNECTED_ITEM, true);
	CONNECTION_PROPERTY->state = INDIGO_OK_STATE;
	indigo_set_switch(CCD_PREVIEW_PROPERTY, CCD_PREVIEW_DISABLED_ITEM, true);
	char directory[INDIGO_VALUE_SIZE];
	snprintf(directory, sizeof(directory), "%s/", indigo_test_home);
	INDIGO_COPY_VALUE(CCD_LOCAL_MODE_DIR_ITEM->text.value, directory);
	/* a small JPEG produced by the CCD base class itself, used as DSLR input */
	unsigned char frame[FITS_HEADER_SIZE + 16 * 16] = { 0 };
	for (int i = 0; i < 16 * 16; i++) {
		frame[FITS_HEADER_SIZE + i] = (unsigned char)i;
	}
	indigo_set_switch(CCD_UPLOAD_MODE_PROPERTY, CCD_UPLOAD_MODE_CLIENT_ITEM, true);
	indigo_set_switch(CCD_IMAGE_FORMAT_PROPERTY, CCD_IMAGE_FORMAT_JPEG_ITEM, true);
	indigo_process_image(device, frame, 16, 16, 8, true, true, NULL, false);
	CHECK(CCD_IMAGE_ITEM->blob.value != NULL && CCD_IMAGE_ITEM->blob.size > 0);
	jpeg_size = CCD_IMAGE_ITEM->blob.size;
	jpeg = malloc(jpeg_size);
	CHECK(jpeg != NULL);
	memcpy(jpeg, CCD_IMAGE_ITEM->blob.value, jpeg_size);
	indigo_set_switch(CCD_UPLOAD_MODE_PROPERTY, CCD_UPLOAD_MODE_LOCAL_ITEM, true);
	/* indigo_process_image() local RAW save */
	indigo_set_switch(CCD_IMAGE_FORMAT_PROPERTY, CCD_IMAGE_FORMAT_RAW_ITEM, true);
	INDIGO_COPY_VALUE(CCD_LOCAL_MODE_PREFIX_ITEM->text.value, "image_XXX");
	CHECK(limit_file_size(&saved));
	limited = true;
	indigo_process_image(device, frame, 16, 16, 8, true, true, NULL, false);
	restore_file_size(&saved);
	limited = false;
	CHECK_EQ_INT(INDIGO_ALERT_STATE, CCD_IMAGE_FILE_PROPERTY->state);
	CHECK(!path_exists(CCD_IMAGE_FILE_ITEM->text.value));
	/* indigo_process_dslr_image() JPEG converted to a RAW save */
	INDIGO_COPY_VALUE(CCD_LOCAL_MODE_PREFIX_ITEM->text.value, "converted_XXX");
	CHECK(limit_file_size(&saved));
	limited = true;
	indigo_process_dslr_image(device, jpeg, jpeg_size, ".jpg", false);
	restore_file_size(&saved);
	limited = false;
	CHECK_EQ_INT(INDIGO_ALERT_STATE, CCD_IMAGE_FILE_PROPERTY->state);
	CHECK(!path_exists(CCD_IMAGE_FILE_ITEM->text.value));
	/* indigo_process_dslr_image() native save */
	indigo_set_switch(CCD_IMAGE_FORMAT_PROPERTY, CCD_IMAGE_FORMAT_JPEG_ITEM, true);
	INDIGO_COPY_VALUE(CCD_LOCAL_MODE_PREFIX_ITEM->text.value, "native_XXX");
	CHECK(limit_file_size(&saved));
	limited = true;
	indigo_process_dslr_image(device, jpeg, jpeg_size, ".jpg", false);
	restore_file_size(&saved);
	limited = false;
	CHECK_EQ_INT(INDIGO_ALERT_STATE, CCD_IMAGE_FILE_PROPERTY->state);
	CHECK(!path_exists(CCD_IMAGE_FILE_ITEM->text.value));
	/* the same saves succeed once writes are possible again */
	indigo_process_dslr_image(device, jpeg, jpeg_size, ".jpg", false);
	CHECK_EQ_INT(INDIGO_OK_STATE, CCD_IMAGE_FILE_PROPERTY->state);
	CHECK(path_exists(CCD_IMAGE_FILE_ITEM->text.value));
	indigo_set_switch(CCD_IMAGE_FORMAT_PROPERTY, CCD_IMAGE_FORMAT_RAW_ITEM, true);
	indigo_process_dslr_image(device, jpeg, jpeg_size, ".jpg", false);
	CHECK_EQ_INT(INDIGO_OK_STATE, CCD_IMAGE_FILE_PROPERTY->state);
	CHECK(path_exists(CCD_IMAGE_FILE_ITEM->text.value));
	indigo_process_image(device, frame, 16, 16, 8, true, true, NULL, false);
	CHECK_EQ_INT(INDIGO_OK_STATE, CCD_IMAGE_FILE_PROPERTY->state);
	CHECK(path_exists(CCD_IMAGE_FILE_ITEM->text.value));
cleanup:
	if (limited) {
		restore_file_size(&saved);
	}
	free(jpeg);
	if (attached) {
		indigo_set_switch(CONNECTION_PROPERTY, CONNECTION_DISCONNECTED_ITEM, true);
		if (indigo_ccd_detach(device) != INDIGO_OK) {
			indigo_test_failures++;
		}
	}
	if (started && indigo_stop() != INDIGO_OK) {
		indigo_test_failures++;
	}
}

int main(void) {
	if (!indigo_test_use_private_home()) {
		return 1;
	}
	const indigo_test_case tests[] = {
		{ "file_name_expansion_is_bounded_and_literal", file_name_expansion_is_bounded_and_literal },
		{ "failed_local_save_publishes_alert", failed_local_save_publishes_alert }
	};
	int result = indigo_run_tests("CCD filename contracts", tests, sizeof(tests) / sizeof(tests[0]));
	indigo_test_remove_private_home();
	return result;
}
