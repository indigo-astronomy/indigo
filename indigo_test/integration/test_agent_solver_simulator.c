// Copyright (c) 2026 INDIGO initiative
// All rights reserved.
//
// You may use this software under the terms of 'INDIGO Astronomy
// open-source license' (see LICENSE.md).
//
// THIS SOFTWARE IS PROVIDED BY THE AUTHORS 'AS IS' AND ANY EXPRESS
// OR IMPLIED WARRANTIES, INCLUDING, BUT NOT LIMITED TO, THE IMPLIED
// WARRANTIES OF MERCHANTABILITY AND FITNESS FOR A PARTICULAR PURPOSE
// ARE DISCLAIMED. IN NO EVENT SHALL THE AUTHOR BE LIABLE FOR ANY
// DIRECT, INDIRECT, INCIDENTAL, SPECIAL, EXEMPLARY, OR CONSEQUENTIAL
// DAMAGES (INCLUDING, BUT NOT LIMITED TO, PROCUREMENT OF SUBSTITUTE
// GOODS OR SERVICES; LOSS OF USE, DATA, OR PROFITS; OR BUSINESS
// INTERRUPTION) HOWEVER CAUSED AND ON ANY THEORY OF LIABILITY,
// WHETHER IN CONTRACT, STRICT LIABILITY, OR TORT (INCLUDING
// NEGLIGENCE OR OTHERWISE) ARISING IN ANY WAY OUT OF THE USE OF THIS
// SOFTWARE, EVEN IF ADVISED OF THE POSSIBILITY OF SUCH DAMAGE.

// Code is generated by AI

// The production Solver Agent with its native quad solver and the real Tycho-2 indexes, fed by the
// related Imager Agent (or Guider Agent) capturing with the CCD simulators.
//
// Set 1, CCD Imager Simulator: the fixed Rosetta nebula frame (1600 x 1200, 8.44"/px) solved at full
// resolution, captured as FITS and as JPEG, downsampled by the agent, binned 2 x 2 by the camera, as a
// sub-frame, in JNow, with each index alone, with a wrong scale hint and repeatedly.
//
// Set 3, the Gaia indexes: a 0.5 x 0.4 degree field for the 0.5 degree index and a 0.2 x 0.16 degree field for the
// 0.2 degree index rendered from the index's own stars (the simulators render Hipparcos only, too sparse for such a
// field) solved with that index alone.
//
// Set 2, CCD Guider Simulator: the catalogue star field (4° over the frame height) rendered for 120
// different combinations of SIMULATION_SETUP (RA, Dec, rotation, side of pier, frame size, magnitude
// limit, epoch, noise, gradient, hot pixels, columns and rows), each solved and compared with what the
// simulator rendered; a few of them through the Guider Agent instead of the Imager Agent, a few captured
// as FITS instead of RAW, a few with a position hint in the hints epoch.
//
// Opt-in: the 2° and 5° indexes (354 MB and 174 MB) are needed in the persistent cache
// $INDIGO_CACHE_BASE/solver, by default ~/.indigo/solver of the real home. An index missing there is
// downloaded by the agent through its X_AGENT_SOLVER_INDEX property once, at the start of the first case
// that needs it; an index already there is only selected, nothing is downloaded again.

#include <math.h>
#include <pthread.h>
#include <stdlib.h>
#include <sys/wait.h>
#include <unistd.h>

#include <indigo/indigo_align.h>
#include <indigo/indigo_driver.h>
#include <indigo/indigo_ccd_driver.h>
#include <indigo/indigo_filter.h>
#include <indigo/indigo_platesolver.h>
#include <indigo_drivers/agent_solver/indigo_agent_solver.h>
#include <indigo_drivers/agent_solver/indigo_solver.h>
#include <indigo_drivers/agent_solver/indigo_solver_utils.h>
#include <indigo_drivers/agent_imager/indigo_agent_imager.h>
#include <indigo_drivers/agent_guider/indigo_agent_guider.h>
#include <indigo_drivers/ccd_simulator/indigo_ccd_simulator.h>

#include "../test_runner.h"

#define SOLVER SOLVER_AGENT_NAME
#define IMAGER "Imager Agent"
#define GUIDER "Guider Agent"
#define IMAGER_CAMERA "CCD Imager Simulator"
#define GUIDER_CAMERA "CCD Guider Simulator"
#define INDEX_PROPERTY "X_AGENT_SOLVER_INDEX"
#define INDEX_2 "INDEX_02DEG_TYC2"
#define INDEX_5 "INDEX_05DEG_TYC2"
#define SETUP "SIMULATION_SETUP"
#define SUITE "Solver agent with the CCD simulators"
#define ARRAY_SIZE(a) (sizeof(a) / sizeof((a)[0]))
#define REQUIRE(c) do { if (!(c)) { fprintf(stderr, "%s:%d: %s\n", __FILE__, __LINE__, #c); indigo_test_failures++; return false; } } while (0)
#define WAIT_UNTIL(condition, timeout) ({ double deadline_ = indigo_monotonic_time() + (timeout); bool ready_ = (condition); while (!ready_ && indigo_monotonic_time() < deadline_) { indigo_usleep(10000); ready_ = (condition); } ready_; })

// the Rosetta frame of the imager simulator as solved by astrometry.net
#define ROSETTA_RA (97.903 / 15)
#define ROSETTA_DEC 5.095
#define ROSETTA_SCALE (8.44 / 3600)
#define ROSETTA_ANGLE 0.80
#define ROSETTA_WIDTH 1600
#define ROSETTA_HEIGHT 1200
// the guider simulator renders 4° over the frame height
#define GUIDER_FOV 4.0
// tolerances: centre in degrees, scale relative, angle in degrees
#define CENTER_TOLERANCE 0.01
#define SCALE_TOLERANCE 0.02
#define ANGLE_TOLERANCE 0.2

typedef enum { ROSETTA, NARROW, SWEEP, SWEEP_FITS, SWEEP_HINT, SWEEP_GUIDER_AGENT } case_kind;

typedef struct {
	double ra, dec, rotation, magnitude, noise, gradient;
	int pier, width, height, epoch, hotpixels, hotcol, hotrow;
} sweep_combination;

typedef struct {
	char device[INDIGO_NAME_SIZE];
	char name[INDIGO_NAME_SIZE];
	indigo_property *property;
	unsigned revision;
	unsigned states[4];
} observation;

static observation cache[4096];
static pthread_mutex_t cache_mutex = PTHREAD_MUTEX_INITIALIZER;
static indigo_client observer;
static char messages[262144];
static bool bus_started, observer_attached, ccd_started, imager_started, guider_started, solver_started;
static case_kind current_kind;
static sweep_combination current;
static const char *cache_base;

static observation *find_observation(const char *device, const char *name) {
	observation *free_entry = NULL;
	for (unsigned i = 0; i < ARRAY_SIZE(cache); i++) {
		if (!*cache[i].name) {
			if (!free_entry) {
				free_entry = cache + i;
			}
		} else if (!strcmp(cache[i].device, device) && !strcmp(cache[i].name, name)) {
			return cache + i;
		}
	}
	if (free_entry) {
		INDIGO_COPY_NAME(free_entry->device, device);
		INDIGO_COPY_NAME(free_entry->name, name);
	}
	return free_entry;
}

static void add_message(const char *device, const char *message) {
	if (message && *message && strlen(messages) + strlen(device) + strlen(message) + 4 < sizeof(messages)) {
		strcat(messages, device);
		strcat(messages, ": ");
		strcat(messages, message);
		strcat(messages, "\n");
	}
}

static indigo_result observe(indigo_property *property, bool update, const char *message) {
	pthread_mutex_lock(&cache_mutex);
	add_message(property->device, message);
	observation *entry = find_observation(property->device, property->name);
	if (entry) {
		indigo_release_property(entry->property);
		entry->property = indigo_copy_property(NULL, property);
		entry->revision++;
		if (update && property->state <= INDIGO_ALERT_STATE) {
			entry->states[property->state]++;
		}
	}
	pthread_mutex_unlock(&cache_mutex);
	return INDIGO_OK;
}

static indigo_result defined(indigo_client *client, indigo_device *device, indigo_property *property, const char *message) {
	return observe(property, false, message);
}

static indigo_result updated(indigo_client *client, indigo_device *device, indigo_property *property, const char *message) {
	return observe(property, true, message);
}

static indigo_result deleted(indigo_client *client, indigo_device *device, indigo_property *property, const char *message) {
	pthread_mutex_lock(&cache_mutex);
	for (unsigned i = 0; i < ARRAY_SIZE(cache); i++) {
		observation *entry = cache + i;
		if (*entry->name && !strcmp(entry->device, property->device) && (!*property->name || !strcmp(entry->name, property->name))) {
			indigo_release_property(entry->property);
			memset(entry, 0, sizeof(*entry));
		}
	}
	pthread_mutex_unlock(&cache_mutex);
	return INDIGO_OK;
}

static indigo_result message_received(indigo_client *client, indigo_device *device, indigo_property *property, const char *message) {
	pthread_mutex_lock(&cache_mutex);
	add_message(device->name, message);
	pthread_mutex_unlock(&cache_mutex);
	return INDIGO_OK;
}

static void dump_messages(void) {
	pthread_mutex_lock(&cache_mutex);
	fprintf(stderr, "---- messages ----\n%s------------------\n", messages);
	pthread_mutex_unlock(&cache_mutex);
}

static bool exists(const char *device, const char *name) {
	pthread_mutex_lock(&cache_mutex);
	observation *entry = find_observation(device, name);
	bool result = entry && entry->property;
	pthread_mutex_unlock(&cache_mutex);
	return result;
}

static unsigned revision(const char *device, const char *name) {
	pthread_mutex_lock(&cache_mutex);
	observation *entry = find_observation(device, name);
	unsigned result = entry ? entry->revision : 0;
	pthread_mutex_unlock(&cache_mutex);
	return result;
}

static unsigned state_count(const char *device, const char *name, indigo_property_state state) {
	pthread_mutex_lock(&cache_mutex);
	observation *entry = find_observation(device, name);
	unsigned result = entry ? entry->states[state] : 0;
	pthread_mutex_unlock(&cache_mutex);
	return result;
}

static int state(const char *device, const char *name) {
	pthread_mutex_lock(&cache_mutex);
	observation *entry = find_observation(device, name);
	int result = entry && entry->property ? (int)entry->property->state : -1;
	pthread_mutex_unlock(&cache_mutex);
	return result;
}

static bool item_lookup(const char *device, const char *name, const char *item_name, indigo_item *result) {
	bool found = false;
	pthread_mutex_lock(&cache_mutex);
	observation *entry = find_observation(device, name);
	if (entry && entry->property) {
		for (int i = 0; i < entry->property->count; i++) {
			if (!strcmp(entry->property->items[i].name, item_name)) {
				*result = entry->property->items[i];
				found = true;
				break;
			}
		}
	}
	pthread_mutex_unlock(&cache_mutex);
	return found;
}

static double number(const char *device, const char *name, const char *item_name) {
	indigo_item item;
	return item_lookup(device, name, item_name, &item) ? item.number.value : NAN;
}

static bool switch_value(const char *device, const char *name, const char *item_name) {
	indigo_item item;
	return item_lookup(device, name, item_name, &item) && item.sw.value;
}

static bool has_item(const char *device, const char *name, const char *item_name) {
	indigo_item item;
	return item_lookup(device, name, item_name, &item);
}

static bool change_switch_and_wait(const char *device, const char *name, const char *item_name, bool value, indigo_property_state expected, double timeout) {
	REQUIRE(WAIT_UNTIL(has_item(device, name, item_name), 10));
	unsigned before = revision(device, name);
	REQUIRE(indigo_change_switch_property_1(&observer, device, name, item_name, value) == INDIGO_OK);
	if (!WAIT_UNTIL(revision(device, name) > before && state(device, name) == (int)expected && switch_value(device, name, item_name) == value, timeout)) {
		fprintf(stderr, "%s.%s.%s = %d did not settle in state %d (state %d)\n", device, name, item_name, value, expected, state(device, name));
		dump_messages();
		return false;
	}
	return true;
}

static bool change_numbers(const char *device, const char *name, int count, const char **items, const double *values) {
	REQUIRE(WAIT_UNTIL(exists(device, name), 10));
	unsigned before = revision(device, name);
	REQUIRE(indigo_change_number_property(&observer, device, name, count, items, values) == INDIGO_OK);
	if (!WAIT_UNTIL(revision(device, name) > before && state(device, name) != INDIGO_BUSY_STATE, 10)) {
		fprintf(stderr, "%s.%s did not settle after a number change (state %d)\n", device, name, state(device, name));
		return false;
	}
	return true;
}

static bool change_number(const char *device, const char *name, const char *item_name, double value) {
	return change_numbers(device, name, 1, (const char *[]){ item_name }, (double []){ value });
}

static bool relate(const char *agent, const char *related) {
	REQUIRE(WAIT_UNTIL(has_item(agent, FILTER_RELATED_AGENT_LIST_PROPERTY_NAME, related), 10));
	REQUIRE(indigo_change_switch_property_1(&observer, agent, FILTER_RELATED_AGENT_LIST_PROPERTY_NAME, related, true) == INDIGO_OK);
	REQUIRE(WAIT_UNTIL(switch_value(agent, FILTER_RELATED_AGENT_LIST_PROPERTY_NAME, related), 10));
	return true;
}

static double wcs(const char *item_name) {
	return number(SOLVER, AGENT_PLATESOLVER_WCS_PROPERTY_NAME, item_name);
}

static double distance(double ra1, double dec1, double ra2, double dec2) {
	double d2r = M_PI / 180;
	double sdd = sin((dec2 - dec1) * d2r / 2);
	double sdr = sin((ra2 - ra1) * 15 * d2r / 2);
	double a = sdd * sdd + cos(dec1 * d2r) * cos(dec2 * d2r) * sdr * sdr;
	return 2 * atan2(sqrt(a), sqrt(1 - a)) / d2r;
}

// Runs one Solver Agent process and waits for its end in the expected state
static bool run_process(const char *operation, indigo_property_state expected, double timeout) {
	unsigned busy = state_count(SOLVER, AGENT_START_PROCESS_PROPERTY_NAME, INDIGO_BUSY_STATE);
	REQUIRE(indigo_change_switch_property_1(&observer, SOLVER, AGENT_START_PROCESS_PROPERTY_NAME, operation, true) == INDIGO_OK);
	REQUIRE(WAIT_UNTIL(state_count(SOLVER, AGENT_START_PROCESS_PROPERTY_NAME, INDIGO_BUSY_STATE) > busy, 10));
	if (!WAIT_UNTIL(state(SOLVER, AGENT_START_PROCESS_PROPERTY_NAME) != INDIGO_BUSY_STATE, timeout)) {
		fprintf(stderr, "%s did not finish in %g s\n", operation, timeout);
		dump_messages();
		return false;
	}
	if (state(SOLVER, AGENT_START_PROCESS_PROPERTY_NAME) != (int)expected) {
		fprintf(stderr, "%s finished in state %d, expected %d\n", operation, state(SOLVER, AGENT_START_PROCESS_PROPERTY_NAME), expected);
		dump_messages();
		return false;
	}
	return true;
}

static void print_wcs(const char *label) {
	printf("  %s: WCS RA %.5f h Dec %.4f° angle %.2f° scale %.3f\"/px parity %g index %g° size %.3f x %.3f°\n", label, wcs(AGENT_PLATESOLVER_WCS_RA_ITEM_NAME), wcs(AGENT_PLATESOLVER_WCS_DEC_ITEM_NAME), wcs(AGENT_PLATESOLVER_WCS_ANGLE_ITEM_NAME), wcs(AGENT_PLATESOLVER_WCS_SCALE_ITEM_NAME) * 3600, wcs(AGENT_PLATESOLVER_WCS_PARITY_ITEM_NAME), wcs(AGENT_PLATESOLVER_WCS_INDEX_ITEM_NAME), wcs(AGENT_PLATESOLVER_WCS_WIDTH_ITEM_NAME), wcs(AGENT_PLATESOLVER_WCS_HEIGHT_ITEM_NAME));
}

// The solution matches the given J2000 centre, scale (degrees per unbinned pixel), angle and frame size
static bool solution_matches(double ra, double dec, double scale, double angle, int width, int height, double epoch) {
	print_wcs("solution");
	REQUIRE(state(SOLVER, AGENT_PLATESOLVER_WCS_PROPERTY_NAME) == INDIGO_OK_STATE);
	REQUIRE(wcs(AGENT_PLATESOLVER_WCS_EPOCH_ITEM_NAME) == epoch);
	double error = distance(wcs(AGENT_PLATESOLVER_WCS_RA_ITEM_NAME), wcs(AGENT_PLATESOLVER_WCS_DEC_ITEM_NAME), ra, dec);
	printf("  expected RA %.5f h Dec %.4f° angle %.2f° scale %.3f\"/px, centre error %.1f\"\n", ra, dec, angle, scale * 3600, error * 3600);
	REQUIRE(error < CENTER_TOLERANCE);
	REQUIRE(fabs(wcs(AGENT_PLATESOLVER_WCS_SCALE_ITEM_NAME) / scale - 1) < SCALE_TOLERANCE);
	REQUIRE(fabs(remainder(wcs(AGENT_PLATESOLVER_WCS_ANGLE_ITEM_NAME) - angle, 360)) < ANGLE_TOLERANCE);
	REQUIRE(fabs(wcs(AGENT_PLATESOLVER_WCS_WIDTH_ITEM_NAME) / (width * scale) - 1) < SCALE_TOLERANCE);
	REQUIRE(fabs(wcs(AGENT_PLATESOLVER_WCS_HEIGHT_ITEM_NAME) / (height * scale) - 1) < SCALE_TOLERANCE);
	REQUIRE(wcs(AGENT_PLATESOLVER_WCS_STATE_ITEM_NAME) == INDIGO_SOLVER_STATE_IDLE);
	return true;
}

// Selects an index in AGENT_PLATESOLVER_USE_INDEX; an index missing in the persistent cache is first
// downloaded by the agent through X_AGENT_SOLVER_INDEX, which selects it, an index present there is never downloaded
// again
static bool install_index(const char *name) {
	REQUIRE(WAIT_UNTIL(exists(SOLVER, INDEX_PROPERTY) && exists(SOLVER, AGENT_PLATESOLVER_USE_INDEX_PROPERTY_NAME), 10));
	if (!has_item(SOLVER, AGENT_PLATESOLVER_USE_INDEX_PROPERTY_NAME, name)) {
		printf("  index %s is not in %s/solver, downloading it once\n", name, cache_base);
		REQUIRE(change_switch_and_wait(SOLVER, INDEX_PROPERTY, name, true, INDIGO_OK_STATE, 1800));
		REQUIRE(WAIT_UNTIL(has_item(SOLVER, AGENT_PLATESOLVER_USE_INDEX_PROPERTY_NAME, name), 10));
		// a newly downloaded index is selected for use
		REQUIRE(switch_value(SOLVER, AGENT_PLATESOLVER_USE_INDEX_PROPERTY_NAME, name));
	}
	if (!switch_value(SOLVER, AGENT_PLATESOLVER_USE_INDEX_PROPERTY_NAME, name)) {
		REQUIRE(change_switch_and_wait(SOLVER, AGENT_PLATESOLVER_USE_INDEX_PROPERTY_NAME, name, true, INDIGO_OK_STATE, 10));
	}
	return true;
}

static bool use_only_index(const char *name) {
	const char *other = strcmp(name, INDEX_2) ? INDEX_2 : INDEX_5;
	REQUIRE(change_switch_and_wait(SOLVER, AGENT_PLATESOLVER_USE_INDEX_PROPERTY_NAME, other, false, INDIGO_OK_STATE, 10));
	REQUIRE(switch_value(SOLVER, AGENT_PLATESOLVER_USE_INDEX_PROPERTY_NAME, name));
	return true;
}

static bool set_hints(double epoch, double downsample, double scale) {
	const char *items[] = { AGENT_PLATESOLVER_HINTS_EPOCH_ITEM_NAME, AGENT_PLATESOLVER_HINTS_DOWNSAMPLE_ITEM_NAME, AGENT_PLATESOLVER_HINTS_SCALE_ITEM_NAME, AGENT_PLATESOLVER_HINTS_RADIUS_ITEM_NAME };
	double values[] = { epoch, downsample, scale, 0 };
	return change_numbers(SOLVER, AGENT_PLATESOLVER_HINTS_PROPERTY_NAME, 4, items, values);
}

// Configures the guider simulator for the current combination and tells what it renders
static bool render_combination(const sweep_combination *c) {
	const char *items[] = { "RA", "DEC", "IMAGE_ROTATION_ANGLE", "SIDE_OF_PIER", "IMAGE_WIDTH", "IMAGE_HEIGHT", "MAGNITUDE_LIMIT", "EPOCH", "IMAGE_NOISE_VAR", "IMAGE_GRADIENT", "IMAGE_HOTPIXELS", "IMAGE_HOTCOL", "IMAGE_HOTROW", "PER_ERR_VAL", "ALT_POLAR_ERROR", "AZ_POLAR_ERROR" };
	double values[] = { c->ra, c->dec, c->rotation, c->pier, c->width, c->height, c->magnitude, c->epoch, c->noise, c->gradient, c->hotpixels, c->hotcol, c->hotrow, 0, 0, 0 };
	printf("  rendering RA %.2f h Dec %+.1f° rotation %g° pier %d %d x %d mag %.1f epoch %d noise %g gradient %g hot %d/%d/%d\n", c->ra, c->dec, c->rotation, c->pier, c->width, c->height, c->magnitude, c->epoch, c->noise, c->gradient, c->hotpixels, c->hotcol, c->hotrow);
	REQUIRE(change_numbers(GUIDER_CAMERA, SETUP, (int)ARRAY_SIZE(items), items, values));
	REQUIRE(WAIT_UNTIL(number(GUIDER_CAMERA, CCD_FRAME_PROPERTY_NAME, CCD_FRAME_WIDTH_ITEM_NAME) == c->width && number(GUIDER_CAMERA, CCD_FRAME_PROPERTY_NAME, CCD_FRAME_HEIGHT_ITEM_NAME) == c->height, 10));
	return true;
}

// J2000 centre and the angle the guider simulator renders for a combination. A field rendered in JNow is
// turned against north of J2000 by the precession of the pole, so the angle of the WCS, which refers to
// J2000, is the rendered rotation plus the position angle of JNow north seen from the centre in J2000. The guider
// simulator renders the mirror image of the sky (parity 1), whose astrometry.net orientation is counted in the
// sense of the rendered rotation.
static void rendered_field(const sweep_combination *c, double *ra, double *dec, double *angle) {
	double north_offset = 0;
	*ra = c->ra;
	*dec = c->dec;
	if (c->epoch == 0) {
		double north_ra = c->ra, north_dec = c->dec + 0.1;
		indigo_jnow_to_j2k(ra, dec);
		indigo_jnow_to_j2k(&north_ra, &north_dec);
		float xi, eta;
		if (indigo_radec_to_tangent(*ra * 15 * M_PI / 180, *dec * M_PI / 180, north_ra * 15 * M_PI / 180, north_dec * M_PI / 180, &xi, &eta)) {
			north_offset = atan2(xi, eta) * 180 / M_PI;
		}
	}
	*angle = c->rotation + (c->pier == 1 ? 0 : 180) + north_offset;
}

static bool setup(void) {
	indigo_set_log_level(getenv("INDIGO_TEST_DEBUG") ? INDIGO_LOG_DEBUG : INDIGO_LOG_ERROR);
	REQUIRE(indigo_start() == INDIGO_OK);
	bus_started = true;
	INDIGO_COPY_NAME(observer.name, "Solver simulator observer");
	observer.version = INDIGO_VERSION_CURRENT;
	observer.define_property = defined;
	observer.update_property = updated;
	observer.delete_property = deleted;
	observer.send_message = message_received;
	REQUIRE(indigo_attach_client(&observer) == INDIGO_OK);
	observer_attached = true;
	REQUIRE(indigo_ccd_simulator(INDIGO_DRIVER_INIT, NULL) == INDIGO_OK);
	ccd_started = true;
	REQUIRE(indigo_agent_imager(INDIGO_DRIVER_INIT, NULL) == INDIGO_OK);
	imager_started = true;
	REQUIRE(indigo_agent_guider(INDIGO_DRIVER_INIT, NULL) == INDIGO_OK);
	guider_started = true;
	REQUIRE(indigo_agent_solver(INDIGO_DRIVER_INIT, NULL) == INDIGO_OK);
	solver_started = true;
	if (current_kind == ROSETTA || current_kind == NARROW) {
		REQUIRE(change_switch_and_wait(IMAGER, FILTER_CCD_LIST_PROPERTY_NAME, IMAGER_CAMERA, true, INDIGO_OK_STATE, 20));
		REQUIRE(change_switch_and_wait(IMAGER, CCD_IMAGE_FORMAT_PROPERTY_NAME, CCD_IMAGE_FORMAT_RAW_ITEM_NAME, true, INDIGO_OK_STATE, 10));
		REQUIRE(relate(SOLVER, IMAGER));
	} else if (current_kind == SWEEP || current_kind == SWEEP_FITS || current_kind == SWEEP_HINT) {
		REQUIRE(change_switch_and_wait(IMAGER, FILTER_CCD_LIST_PROPERTY_NAME, GUIDER_CAMERA, true, INDIGO_OK_STATE, 20));
		REQUIRE(change_switch_and_wait(IMAGER, CCD_IMAGE_FORMAT_PROPERTY_NAME, current_kind == SWEEP_FITS ? CCD_IMAGE_FORMAT_FITS_ITEM_NAME : CCD_IMAGE_FORMAT_RAW_ITEM_NAME, true, INDIGO_OK_STATE, 10));
		REQUIRE(relate(SOLVER, IMAGER));
	} else {
		REQUIRE(change_switch_and_wait(GUIDER, FILTER_CCD_LIST_PROPERTY_NAME, GUIDER_CAMERA, true, INDIGO_OK_STATE, 20));
		REQUIRE(relate(SOLVER, GUIDER));
	}
	REQUIRE(install_index(INDEX_2));
	REQUIRE(install_index(INDEX_5));
	REQUIRE(change_number(SOLVER, AGENT_PLATESOLVER_EXPOSURE_SETTINGS_PROPERTY_NAME, AGENT_PLATESOLVER_EXPOSURE_SETTINGS_EXPOSURE_ITEM_NAME, 1));
	REQUIRE(set_hints(2000, 1, 0));
	return true;
}

static void cleanup(void) {
	if (solver_started) {
		indigo_agent_solver(INDIGO_DRIVER_SHUTDOWN, NULL);
	}
	if (guider_started) {
		indigo_agent_guider(INDIGO_DRIVER_SHUTDOWN, NULL);
	}
	if (imager_started) {
		indigo_agent_imager(INDIGO_DRIVER_SHUTDOWN, NULL);
	}
	if (ccd_started) {
		indigo_ccd_simulator(INDIGO_DRIVER_SHUTDOWN, NULL);
	}
	if (observer_attached) {
		indigo_detach_client(&observer);
	}
	if (bus_started) {
		indigo_stop();
	}
}

// ---- set 1: the Rosetta frame of the imager simulator

static void rosetta_full_resolution(void) {
	ASSERT_TRUE(run_process(AGENT_PLATESOLVER_START_SOLVE_ITEM_NAME, INDIGO_OK_STATE, 120));
	ASSERT_TRUE(solution_matches(ROSETTA_RA, ROSETTA_DEC, ROSETTA_SCALE, ROSETTA_ANGLE, ROSETTA_WIDTH, ROSETTA_HEIGHT, 2000));
	ASSERT_TRUE(wcs(AGENT_PLATESOLVER_WCS_INDEX_ITEM_NAME) == 2 || wcs(AGENT_PLATESOLVER_WCS_INDEX_ITEM_NAME) == 5);
}

// The frame captured as FITS and as JPEG by the Imager Agent is converted by the solver and solved like the RAW one
static void rosetta_fits(void) {
	ASSERT_TRUE(change_switch_and_wait(IMAGER, CCD_IMAGE_FORMAT_PROPERTY_NAME, CCD_IMAGE_FORMAT_FITS_ITEM_NAME, true, INDIGO_OK_STATE, 10));
	ASSERT_TRUE(run_process(AGENT_PLATESOLVER_START_SOLVE_ITEM_NAME, INDIGO_OK_STATE, 120));
	ASSERT_TRUE(solution_matches(ROSETTA_RA, ROSETTA_DEC, ROSETTA_SCALE, ROSETTA_ANGLE, ROSETTA_WIDTH, ROSETTA_HEIGHT, 2000));
}

static void rosetta_jpeg(void) {
	ASSERT_TRUE(change_switch_and_wait(IMAGER, CCD_IMAGE_FORMAT_PROPERTY_NAME, CCD_IMAGE_FORMAT_JPEG_ITEM_NAME, true, INDIGO_OK_STATE, 10));
	ASSERT_TRUE(run_process(AGENT_PLATESOLVER_START_SOLVE_ITEM_NAME, INDIGO_OK_STATE, 120));
	ASSERT_TRUE(solution_matches(ROSETTA_RA, ROSETTA_DEC, ROSETTA_SCALE, ROSETTA_ANGLE, ROSETTA_WIDTH, ROSETTA_HEIGHT, 2000));
}

static void rosetta_downsampled(void) {
	ASSERT_TRUE(set_hints(2000, 2, 0));
	ASSERT_TRUE(run_process(AGENT_PLATESOLVER_START_SOLVE_ITEM_NAME, INDIGO_OK_STATE, 120));
	ASSERT_TRUE(solution_matches(ROSETTA_RA, ROSETTA_DEC, ROSETTA_SCALE, ROSETTA_ANGLE, ROSETTA_WIDTH, ROSETTA_HEIGHT, 2000));
}

// The camera bins 2 x 2 (the simulator averages the bin block since version 45): the same centre, 800 x 600 binned
// pixels of twice the scale, so 8.44"/px per unbinned pixel and the same field
static void rosetta_camera_binned(void) {
	ASSERT_TRUE(change_numbers(IMAGER, CCD_BIN_PROPERTY_NAME, 2, (const char *[]){ CCD_BIN_HORIZONTAL_ITEM_NAME, CCD_BIN_VERTICAL_ITEM_NAME }, (double []){ 2, 2 }));
	ASSERT_TRUE(run_process(AGENT_PLATESOLVER_START_SOLVE_ITEM_NAME, INDIGO_OK_STATE, 120));
	ASSERT_TRUE(solution_matches(ROSETTA_RA, ROSETTA_DEC, ROSETTA_SCALE * 2, ROSETTA_ANGLE, ROSETTA_WIDTH / 2, ROSETTA_HEIGHT / 2, 2000));
}

// A centred 1000 x 750 sub-frame keeps the centre and the scale
static void rosetta_subframe(void) {
	ASSERT_TRUE(change_numbers(IMAGER, CCD_FRAME_PROPERTY_NAME, 4, (const char *[]){ CCD_FRAME_LEFT_ITEM_NAME, CCD_FRAME_TOP_ITEM_NAME, CCD_FRAME_WIDTH_ITEM_NAME, CCD_FRAME_HEIGHT_ITEM_NAME }, (double []){ 300, 225, 1000, 750 }));
	ASSERT_TRUE(run_process(AGENT_PLATESOLVER_START_SOLVE_ITEM_NAME, INDIGO_OK_STATE, 120));
	ASSERT_TRUE(solution_matches(ROSETTA_RA, ROSETTA_DEC, ROSETTA_SCALE, ROSETTA_ANGLE, 1000, 750, 2000));
}

static void rosetta_jnow(void) {
	double ra = ROSETTA_RA, dec = ROSETTA_DEC;
	indigo_j2k_to_jnow(&ra, &dec);
	ASSERT_TRUE(set_hints(0, 1, 0));
	ASSERT_TRUE(run_process(AGENT_PLATESOLVER_START_SOLVE_ITEM_NAME, INDIGO_OK_STATE, 120));
	ASSERT_TRUE(solution_matches(ra, dec, ROSETTA_SCALE, ROSETTA_ANGLE, ROSETTA_WIDTH, ROSETTA_HEIGHT, 0));
}

static void rosetta_index_2_only(void) {
	ASSERT_TRUE(use_only_index(INDEX_2));
	ASSERT_TRUE(run_process(AGENT_PLATESOLVER_START_SOLVE_ITEM_NAME, INDIGO_OK_STATE, 120));
	ASSERT_TRUE(solution_matches(ROSETTA_RA, ROSETTA_DEC, ROSETTA_SCALE, ROSETTA_ANGLE, ROSETTA_WIDTH, ROSETTA_HEIGHT, 2000));
	ASSERT_TRUE(wcs(AGENT_PLATESOLVER_WCS_INDEX_ITEM_NAME) == 2);
}

static void rosetta_index_5_only(void) {
	ASSERT_TRUE(use_only_index(INDEX_5));
	ASSERT_TRUE(run_process(AGENT_PLATESOLVER_START_SOLVE_ITEM_NAME, INDIGO_OK_STATE, 120));
	ASSERT_TRUE(solution_matches(ROSETTA_RA, ROSETTA_DEC, ROSETTA_SCALE, ROSETTA_ANGLE, ROSETTA_WIDTH, ROSETTA_HEIGHT, 2000));
	ASSERT_TRUE(wcs(AGENT_PLATESOLVER_WCS_INDEX_ITEM_NAME) == 5);
}

// A scale hint ten times too large only changes the order of the indexes tried
static void rosetta_wrong_scale_hint(void) {
	ASSERT_TRUE(set_hints(2000, 1, ROSETTA_SCALE * 10));
	ASSERT_TRUE(run_process(AGENT_PLATESOLVER_START_SOLVE_ITEM_NAME, INDIGO_OK_STATE, 120));
	ASSERT_TRUE(solution_matches(ROSETTA_RA, ROSETTA_DEC, ROSETTA_SCALE, ROSETTA_ANGLE, ROSETTA_WIDTH, ROSETTA_HEIGHT, 2000));
}

// Three solves in a row: the index loaded by the first one is reused by the others
static void rosetta_repeated(void) {
	for (int i = 0; i < 3; i++) {
		double started = indigo_monotonic_time();
		ASSERT_TRUE(run_process(AGENT_PLATESOLVER_START_SOLVE_ITEM_NAME, INDIGO_OK_STATE, 120));
		printf("  solve %d took %.2f s\n", i + 1, indigo_monotonic_time() - started);
		ASSERT_TRUE(solution_matches(ROSETTA_RA, ROSETTA_DEC, ROSETTA_SCALE, ROSETTA_ANGLE, ROSETTA_WIDTH, ROSETTA_HEIGHT, 2000));
	}
}

// ---- set 3: the Gaia indexes checked against fields rendered from their own stars

#define INDEX_0_2 "INDEX_00_2DEG_GAIA"
#define INDEX_0_5 "INDEX_00_5DEG_GAIA"
#define NARROW_WIDTH 1000
#define NARROW_HEIGHT 800
#define NARROW_ANGLE 30.0

// Uploads a frame to the solver and waits for the solve to end in OK or ALERT
static bool solve_upload(void *image, long size) {
	unsigned ok_before = state_count(SOLVER, AGENT_PLATESOLVER_WCS_PROPERTY_NAME, INDIGO_OK_STATE);
	unsigned alert_before = state_count(SOLVER, AGENT_PLATESOLVER_WCS_PROPERTY_NAME, INDIGO_ALERT_STATE);
	REQUIRE(indigo_change_blob_property_1(&observer, SOLVER, AGENT_PLATESOLVER_IMAGE_PROPERTY_NAME, AGENT_PLATESOLVER_IMAGE_ITEM_NAME, image, size, ".raw", "") == INDIGO_OK);
	REQUIRE(WAIT_UNTIL(state_count(SOLVER, AGENT_PLATESOLVER_WCS_PROPERTY_NAME, INDIGO_OK_STATE) > ok_before || state_count(SOLVER, AGENT_PLATESOLVER_WCS_PROPERTY_NAME, INDIGO_ALERT_STATE) > alert_before, 120));
	return true;
}

// Renders a frame of NARROW_WIDTH x NARROW_HEIGHT pixels of scale degrees per pixel from the index stars around the
// given position and solves it; returns the number of rendered stars and whether the solution matches the rendering
// and comes from the index of the given scale
static int solve_narrow_field(const indigo_solver_index_star *stars, uint32_t star_count, float fov, double scale, double ra_hours, double dec_degrees, bool *solved) {
	*solved = false;
	float ra0 = ra_hours * 15 * M_PI / 180, dec0 = dec_degrees * M_PI / 180;
	long size = sizeof(indigo_raw_header) + NARROW_WIDTH * NARROW_HEIGHT * 2;
	indigo_raw_header *image = calloc(1, size);
	image->signature = INDIGO_RAW_MONO16;
	image->width = NARROW_WIDTH;
	image->height = NARROW_HEIGHT;
	uint16_t *pixels = (uint16_t *)(image + 1);
	uint32_t seed = 20261027 + (uint32_t)(ra_hours * 1000);
	for (long i = 0; i < NARROW_WIDTH * NARROW_HEIGHT; i++) {
		seed = seed * 1664525u + 1013904223u;
		pixels[i] = 1000 + (seed >> 24) / 2;
	}
	int rendered = 0;
	for (uint32_t i = 0; i < star_count; i++) {
		if (indigo_angular_distance(ra0, dec0, stars[i].ra, stars[i].dec) > NARROW_WIDTH * scale * M_PI / 180) {
			continue;
		}
		float x, y;
		if (indigo_radec_to_xy(ra0, dec0, NARROW_ANGLE * M_PI / 180, scale * M_PI / 180, NARROW_WIDTH, NARROW_HEIGHT, -1, stars[i].ra, stars[i].dec, &x, &y) && x >= 0 && x < NARROW_WIDTH && y >= 0 && y < NARROW_HEIGHT) {
			float peak = 8000 + (i % 7) * 2000;
			for (int dy = -6; dy <= 6; dy++) {
				for (int dx = -6; dx <= 6; dx++) {
					int px = (int)rint(x) + dx, py = (int)rint(y) + dy;
					if (px >= 0 && px < NARROW_WIDTH && py >= 0 && py < NARROW_HEIGHT) {
						float r2 = (px - x) * (px - x) + (py - y) * (py - y);
						int value = pixels[py * NARROW_WIDTH + px] + (int)(peak * exp(-r2 / (2 * 1.5 * 1.5)));
						pixels[py * NARROW_WIDTH + px] = value > 65535 ? 65535 : value;
					}
				}
			}
			rendered++;
		}
	}
	printf("  field at RA %.5f h Dec %+.4f°: %d index stars\n", ra_hours, dec_degrees, rendered);
	bool sent = solve_upload(image, size);
	free(image);
	if (sent && state(SOLVER, AGENT_PLATESOLVER_WCS_PROPERTY_NAME) == INDIGO_OK_STATE) {
		*solved = solution_matches(ra0 * 180 / M_PI / 15, dec0 * 180 / M_PI, scale, NARROW_ANGLE, NARROW_WIDTH, NARROW_HEIGHT, 2000) && wcs(AGENT_PLATESOLVER_WCS_INDEX_ITEM_NAME) == fov && wcs(AGENT_PLATESOLVER_WCS_PARITY_ITEM_NAME) == -1;
	}
	return rendered;
}

// The CCD simulators render the Hipparcos catalogue only, too sparse for a field below 1 degree, so twelve fields
// spread over the sky are rendered from the index's own stars (gaussian images of a few brightnesses, noise)
// and solved with the Gaia index alone. The extract is not deep enough for every narrow field: every field with
// at least min_stars index stars must solve, and at least half of the fields must solve; the check is
// self-consistent, not independent of the index. The 0.2 degree index anchors few quads per star, so a field of
// 8 to 11 stars may hold too few of them: of the twelve fixed and 100 random fields every one with at least 12
// stars solved (43 of 43), 4 of 12 with 8 to 11 did not, so its threshold is 12.
#define NARROW_FIELDS 12

static const double narrow_fields[NARROW_FIELDS][2] = {
	{ 0.85, -27.1 }, { 1.50, 45 }, { 3.00, -30 }, { 4.50, 70 }, { 6.00, 20 }, { 7.50, -60 },
	{ 9.00, 40 }, { 12.85, 27.1 }, { 15.00, 10 }, { 17.76, -29 }, { 19.50, 30 }, { 22.50, 65 }
};

// INDIGO_SOLVER_NARROW_FIELDS=<n> replaces the twelve fixed fields by n pseudo-random positions over the sky
// (|Dec| < 85°) for a one-off long verification; the standard suite keeps the twelve
// INDIGO_SOLVER_NARROW_FIELD="ra_hours,dec_degrees" solves that single field, to reproduce one by hand
static int narrow_field_count(void) {
	const char *count = getenv("INDIGO_SOLVER_NARROW_FIELDS");
	if (getenv("INDIGO_SOLVER_NARROW_FIELD") != NULL) {
		return 1;
	}
	return count != NULL && atoi(count) > 0 ? atoi(count) : NARROW_FIELDS;
}

static void narrow_field(int k, double *ra_hours, double *dec_degrees) {
	const char *single = getenv("INDIGO_SOLVER_NARROW_FIELD");
	if (single != NULL && sscanf(single, "%lf,%lf", ra_hours, dec_degrees) == 2) {
		return;
	}
	if (getenv("INDIGO_SOLVER_NARROW_FIELDS") == NULL) {
		*ra_hours = narrow_fields[k][0];
		*dec_degrees = narrow_fields[k][1];
		return;
	}
	uint32_t seed = 20261027 + 7919 * (uint32_t)k;
	seed = seed * 1664525u + 1013904223u;
	*ra_hours = 24.0 * (seed >> 8) / (double)(1u << 24);
	seed = seed * 1664525u + 1013904223u;
	// uniform on the sphere: Dec from the arcsine of a uniform sine, limited to 85 degrees
	double sine = 2.0 * (seed >> 8) / (double)(1u << 24) - 1;
	*dec_degrees = asin(sine) * 180 / M_PI;
	if (*dec_degrees > 85) {
		*dec_degrees = 85;
	} else if (*dec_degrees < -85) {
		*dec_degrees = -85;
	}
}

// Solves the narrow fields with the index of the given item and scale alone, every other index unselected
static void narrow_self_consistency(const char *item, float fov, double scale, int min_stars) {
	ASSERT_TRUE(install_index(item));
	const char *indexes[] = { INDEX_0_2, INDEX_0_5, "INDEX_01DEG_TYC2", INDEX_2, INDEX_5, "INDEX_10DEG_TYC2", "INDEX_20DEG_TYC2" };
	for (int i = 0; i < (int)ARRAY_SIZE(indexes); i++) {
		if (strcmp(indexes[i], item) && switch_value(SOLVER, AGENT_PLATESOLVER_USE_INDEX_PROPERTY_NAME, indexes[i])) {
			ASSERT_TRUE(change_switch_and_wait(SOLVER, AGENT_PLATESOLVER_USE_INDEX_PROPERTY_NAME, indexes[i], false, INDIGO_OK_STATE, 10));
		}
	}
	ASSERT_TRUE(switch_value(SOLVER, AGENT_PLATESOLVER_USE_INDEX_PROPERTY_NAME, item));
	ASSERT_TRUE(set_hints(2000, 1, 0));
	char path[PATH_MAX], directory[PATH_MAX];
	snprintf(directory, sizeof(directory), "%s/solver", cache_base);
	indigo_solver_index_path(path, sizeof(path), directory, fov);
	indigo_solver_catalog catalog;
	ASSERT_TRUE(indigo_solver_load_index(path, &catalog) && catalog.fov == fov && catalog.star_count > 0);
	const indigo_solver_index_star *stars = catalog.stars;
	printf("  index: %u stars, %u quads%s\n", catalog.star_count, catalog.quad_count, catalog.mapping ? ", mapped" : "");
	int solved_count = 0, dense_count = 0, dense_solved = 0, field_count = narrow_field_count();
	for (int k = 0; k < field_count; k++) {
		bool solved;
		double ra_hours, dec_degrees;
		narrow_field(k, &ra_hours, &dec_degrees);
		int rendered = solve_narrow_field(stars, catalog.star_count, fov, scale, ra_hours, dec_degrees, &solved);
		printf("  %s\n", solved ? "solved" : "not solved");
		solved_count += solved;
		if (rendered >= min_stars) {
			dense_count++;
			dense_solved += solved;
		}
	}
	indigo_solver_free_catalog(&catalog);
	printf("  %d of %d fields solved, %d of %d fields with at least %d index stars solved\n", solved_count, field_count, dense_solved, dense_count, min_stars);
	ASSERT_TRUE(dense_solved == dense_count);
	ASSERT_TRUE(solved_count * 2 >= field_count);
}

static void index_0_5_self_consistency(void) {
	narrow_self_consistency(INDEX_0_5, 0.5f, 1.8 / 3600, 8);
}

static void index_0_2_self_consistency(void) {
	narrow_self_consistency(INDEX_0_2, 0.2f, 0.72 / 3600, 12);
}

// ---- set 2: the catalogue field of the guider simulator for many simulation setups

static const double positions[][2] = {
	{ 0.00, 0 }, { 1.50, 45 }, { 3.00, -30 }, { 4.50, 70 }, { 6.00, 20 }, { 7.50, -60 }, { 9.00, 40 }, { 10.50, -10 },
	{ 12.00, 80 }, { 12.85, 27.1 }, { 13.50, -45 }, { 15.00, 10 }, { 16.50, 55 }, { 17.76, -29 }, { 19.50, 30 }, { 20.50, 45 },
	{ 21.00, -5 }, { 22.50, 65 }, { 23.00, -40 }, { 5.50, -35 }, { 0.85, -27.1 }, { 2.00, 85 }, { 14.00, -85 }, { 18.84, 38.75 }
};
static const double rotations[] = { 0, 36, 90, 137, 270 };
static const int sizes[][2] = { { 1600, 1200 }, { 1200, 1200 }, { 1920, 1080 }, { 1024, 768 }, { 1600, 900 }, { 1280, 960 }, { 2000, 1500 } };
static const double magnitudes[] = { 8.5, 9.5, 9.0 };
static const double noises[] = { 100, 150, 250, 400 };
static const double gradients[] = { 0.2, 0, 0.5 };
static const int hot[][3] = { { 0, 0, 0 }, { 50, 0, 0 }, { 200, 600, 800 }, { 500, 0, 0 } };

#define SWEEP_COUNT 120
#define GUIDER_AGENT_EVERY 20
#define FITS_EVERY 15
#define HINT_EVERY 25

// INDIGO_SOLVER_SETUP="ra,dec,rotation,pier,width,height,magnitude,epoch,noise,gradient,hotpixels,hotcol,hotrow"
// replaces the first combination, to reproduce one setup by hand with the case filter "guider 001"
static sweep_combination combination(int i) {
	sweep_combination c;
	const char *setup = getenv("INDIGO_SOLVER_SETUP");
	if (i == 0 && setup != NULL && sscanf(setup, "%lf,%lf,%lf,%d,%d,%d,%lf,%d,%lf,%lf,%d,%d,%d", &c.ra, &c.dec, &c.rotation, &c.pier, &c.width, &c.height, &c.magnitude, &c.epoch, &c.noise, &c.gradient, &c.hotpixels, &c.hotcol, &c.hotrow) == 13) {
		return c;
	}
	c.ra = positions[i % ARRAY_SIZE(positions)][0];
	c.dec = positions[i % ARRAY_SIZE(positions)][1];
	c.rotation = rotations[i % ARRAY_SIZE(rotations)];
	c.pier = (i / ARRAY_SIZE(positions)) % 2;
	c.width = sizes[i % ARRAY_SIZE(sizes)][0];
	c.height = sizes[i % ARRAY_SIZE(sizes)][1];
	c.magnitude = magnitudes[(i / 3) % ARRAY_SIZE(magnitudes)];
	c.epoch = (i % 2) ? 0 : 2000;
	c.noise = noises[(i / 2) % ARRAY_SIZE(noises)];
	c.gradient = gradients[(i / 5) % ARRAY_SIZE(gradients)];
	c.hotpixels = hot[(i / 7) % ARRAY_SIZE(hot)][0];
	c.hotcol = hot[(i / 7) % ARRAY_SIZE(hot)][1];
	c.hotrow = hot[(i / 7) % ARRAY_SIZE(hot)][2];
	return c;
}

static void sweep_case(void) {
	double ra, dec, angle;
	ASSERT_TRUE(render_combination(&current));
	rendered_field(&current, &ra, &dec, &angle);
	if (current_kind == SWEEP_HINT) {
		// the position hint in the hints epoch (JNow for a JNow setup), 1 degree off the rendered centre
		const char *items[] = { AGENT_PLATESOLVER_HINTS_EPOCH_ITEM_NAME, AGENT_PLATESOLVER_HINTS_RADIUS_ITEM_NAME, AGENT_PLATESOLVER_HINTS_RA_ITEM_NAME, AGENT_PLATESOLVER_HINTS_DEC_ITEM_NAME };
		double values[] = { current.epoch, 3, current.ra + 1.0 / 15, current.dec > 80 ? current.dec - 1 : current.dec + 1 };
		ASSERT_TRUE(change_numbers(SOLVER, AGENT_PLATESOLVER_HINTS_PROPERTY_NAME, 4, items, values));
	}
	ASSERT_TRUE(run_process(AGENT_PLATESOLVER_START_SOLVE_ITEM_NAME, INDIGO_OK_STATE, 120));
	if (current_kind == SWEEP_HINT && current.epoch == 0) {
		// the solution follows the hints epoch: convert it to J2000 for the comparison
		double wcs_ra = wcs(AGENT_PLATESOLVER_WCS_RA_ITEM_NAME), wcs_dec = wcs(AGENT_PLATESOLVER_WCS_DEC_ITEM_NAME);
		ASSERT_TRUE(wcs(AGENT_PLATESOLVER_WCS_EPOCH_ITEM_NAME) == 0);
		indigo_jnow_to_j2k(&wcs_ra, &wcs_dec);
		printf("  solution converted from JNow: RA %.5f h Dec %.4f°, centre error %.1f\"\n", wcs_ra, wcs_dec, distance(wcs_ra, wcs_dec, ra, dec) * 3600);
		ASSERT_TRUE(distance(wcs_ra, wcs_dec, ra, dec) < CENTER_TOLERANCE);
		ASSERT_TRUE(fabs(wcs(AGENT_PLATESOLVER_WCS_SCALE_ITEM_NAME) / (GUIDER_FOV / current.height) - 1) < SCALE_TOLERANCE);
		// in JNow the angle refers to JNow north, the rendered rotation without the precession offset
		ASSERT_TRUE(fabs(remainder(wcs(AGENT_PLATESOLVER_WCS_ANGLE_ITEM_NAME) - (current.rotation + (current.pier == 1 ? 0 : 180)), 360)) < ANGLE_TOLERANCE);
	} else {
		ASSERT_TRUE(solution_matches(ra, dec, GUIDER_FOV / current.height, angle, current.width, current.height, 2000));
	}
}

static indigo_test_case rosetta_tests[] = {
	{ "rosetta full resolution", rosetta_full_resolution },
	{ "rosetta fits", rosetta_fits },
	{ "rosetta jpeg", rosetta_jpeg },
	{ "rosetta downsampled", rosetta_downsampled },
	{ "rosetta camera binned", rosetta_camera_binned },
	{ "rosetta subframe", rosetta_subframe },
	{ "rosetta jnow", rosetta_jnow },
	{ "rosetta index 2 only", rosetta_index_2_only },
	{ "rosetta index 5 only", rosetta_index_5_only },
	{ "rosetta wrong scale hint", rosetta_wrong_scale_hint },
	{ "rosetta repeated", rosetta_repeated },
	{ "index 0.5 self consistency", index_0_5_self_consistency },
	{ "index 0.2 self consistency", index_0_2_self_consistency },
};

int main(int argc, char **argv) {
	setvbuf(stdout, NULL, _IONBF, 0);
	const char *filter = argc > 1 ? argv[1] : getenv("INDIGO_TEST_CASE_FILTER");
	int count = (int)ARRAY_SIZE(rosetta_tests) + SWEEP_COUNT;
	indigo_test_case *tests = calloc(count, sizeof(indigo_test_case));
	case_kind *kinds = calloc(count, sizeof(case_kind));
	char (*names)[128] = calloc(count, sizeof(*names));
	for (int i = 0; i < (int)ARRAY_SIZE(rosetta_tests); i++) {
		tests[i] = rosetta_tests[i];
		kinds[i] = strstr(tests[i].name, "index 0.") ? NARROW : ROSETTA;
	}
	for (int i = 0; i < SWEEP_COUNT; i++) {
		sweep_combination c = combination(i);
		bool guider_agent = (i % GUIDER_AGENT_EVERY) == GUIDER_AGENT_EVERY - 1;
		bool fits = !guider_agent && (i % FITS_EVERY) == FITS_EVERY / 2;
		bool hint = !guider_agent && !fits && (i % HINT_EVERY) == HINT_EVERY / 2;
		int n = (int)ARRAY_SIZE(rosetta_tests) + i;
		snprintf(names[n], sizeof(names[n]), "guider %03d RA %.2f h Dec %+.1f rot %g pier %d %dx%d mag %.1f epoch %d noise %g grad %g hot %d/%d/%d%s", i + 1, c.ra, c.dec, c.rotation, c.pier, c.width, c.height, c.magnitude, c.epoch, c.noise, c.gradient, c.hotpixels, c.hotcol, c.hotrow, guider_agent ? " via guider agent" : fits ? " as fits" : hint ? " with hint" : "");
		tests[n].name = names[n];
		tests[n].function = sweep_case;
		kinds[n] = guider_agent ? SWEEP_GUIDER_AGENT : fits ? SWEEP_FITS : hint ? SWEEP_HINT : SWEEP;
	}
	int selected = 0;
	for (int i = 0; i < count; i++) {
		if (filter == NULL || strstr(tests[i].name, filter)) {
			selected++;
		}
	}
	indigo_test_plan(SUITE, selected, filter);
	if (system("command -v curl >/dev/null") != 0) {
		fprintf(stderr, "curl is not installed, the solver agent needs it to download its indexes\n");
		return 1;
	}
	// the persistent index cache of the real home, shared with the user's own solver agent
	static char persistent_cache[PATH_MAX];
	if (getenv("INDIGO_CACHE_BASE") == NULL) {
		const char *home = getenv("HOME");
		if (home == NULL || !*home) {
			fprintf(stderr, "HOME is not set\n");
			return 1;
		}
		snprintf(persistent_cache, sizeof(persistent_cache), "%s/.indigo", home);
		setenv("INDIGO_CACHE_BASE", persistent_cache, 1);
	}
	cache_base = getenv("INDIGO_CACHE_BASE");
	printf("index cache: %s/solver\n", cache_base);
	int result = 0, executed = 0, passed = 0;
	for (int i = 0; i < count; i++) {
		if (filter != NULL && !strstr(tests[i].name, filter)) {
			continue;
		}
		executed++;
		current_kind = kinds[i];
		if (kinds[i] != ROSETTA) {
			current = combination(i - (int)ARRAY_SIZE(rosetta_tests));
		}
		pid_t child = fork();
		if (child == 0) {
			alarm(2400);
			if (!indigo_test_use_private_home()) {
				exit(1);
			}
			bool ready = setup();
			int status = ready ? indigo_run_tests(SUITE, tests + i, 1) : 1;
			cleanup();
			indigo_test_remove_private_home();
			exit(status || indigo_test_failures ? 1 : 0);
		}
		int status = -1;
		if (child < 0 || waitpid(child, &status, 0) != child || !WIFEXITED(status) || WEXITSTATUS(status)) {
			fprintf(stderr, "Failed case: %s (status %d)\n", tests[i].name, status);
			result = 1;
		} else {
			passed++;
		}
	}
	indigo_test_plan_recorded = false;
	printf(SUITE ": %d/%d cases passed (including cleanup)\n", passed, executed);
	free(tests);
	free(kinds);
	free(names);
	return executed ? result : 2;
}
