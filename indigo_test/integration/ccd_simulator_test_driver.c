// Copyright (c) 2026 INDIGO initiative
// All rights reserved.
//
// You may use this software under the terms of 'INDIGO Astronomy
// open-source license' (see LICENSE.md).
//
// THIS SOFTWARE IS PROVIDED BY THE AUTHORS 'AS IS' AND ANY EXPRESS
// OR IMPLIED WARRANTIES, INCLUDING, BUT NOT LIMITED TO, THE IMPLIED
// WARRANTIES OF MERCHANTABILITY AND FITNESS FOR A PARTICULAR PURPOSE
// ARE DISCLAIMED. IN NO EVENT SHALL THE AUTHOR BE LIABLE FOR ANY
// DIRECT, INDIRECT, INCIDENTAL, SPECIAL, EXEMPLARY, OR CONSEQUENTIAL
// DAMAGES (INCLUDING, BUT NOT LIMITED TO, PROCUREMENT OF SUBSTITUTE
// GOODS OR SERVICES; LOSS OF USE, DATA, OR PROFITS; OR BUSINESS
// INTERRUPTION) HOWEVER CAUSED AND ON ANY THEORY OF LIABILITY,
// WHETHER IN CONTRACT, STRICT LIABILITY, OR TORT (INCLUDING
// NEGLIGENCE OR OTHERWISE) ARISING IN ANY WAY OUT OF THE USE OF THIS
// SOFTWARE, EVEN IF ADVISED OF THE POSSIBILITY OF SUCH DAMAGE.

// Code is generated by AI

// Include the production implementation so edge fixtures can seed private pixel locations without a driver API.
#include <indigo/indigo_driver.h>

static indigo_device *sim_test_imager;
static indigo_result sim_test_attach_device(indigo_device *device);

#define indigo_attach_device sim_test_attach_device
#include "../../indigo_drivers/ccd_simulator/indigo_ccd_simulator.c"
#undef indigo_attach_device

static indigo_result sim_test_attach_device(indigo_device *device) {
	if (!strcmp(device->name, "CCD Imager Simulator")) {
		sim_test_imager = device;
	}
	return indigo_attach_device(device);
}

indigo_device *sim_test_imager_device(void) {
	return sim_test_imager;
}

void sim_test_prepare_hotpixel_edges(indigo_device *device) {
	int bin = (int)CCD_BIN_HORIZONTAL_ITEM->number.value;
	int left = (int)CCD_FRAME_LEFT_ITEM->number.value;
	int top = (int)CCD_FRAME_TOP_ITEM->number.value;
	int width = (int)CCD_FRAME_WIDTH_ITEM->number.value / bin;
	int height = (int)CCD_FRAME_HEIGHT_ITEM->number.value / bin;
	const int points[][2] = { { 0, height }, { 1, height - 1 }, { 2, height }, { 3, height + 1 }, { 4, -1 }, { -1, 1 }, { width, 2 }, { 5, 0 }, { width - 1, height - 1 } };
	IMAGE_HOTPIXELS_ITEM->number.target = 8;
	IMAGE_HOTROW_ITEM->number.target = width;
	IMAGE_HOTCOL_ITEM->number.target = 0;
	for (int i = 0; i < 9; i++) {
		PRIVATE_DATA->hotpixel_x[i] = left + points[i][0] * bin;
		PRIVATE_DATA->hotpixel_y[i] = top + points[i][1] * bin;
	}
	uint16_t *raw = (uint16_t *)(PRIVATE_DATA->imager_image + FITS_HEADER_SIZE);
	for (int x = 0; x < width; x++) {
		raw[width * height + x] = 0x5A5A;
	}
}

bool sim_test_hotpixel_guard_intact(indigo_device *device) {
	int width = (int)CCD_FRAME_WIDTH_ITEM->number.value / (int)CCD_BIN_HORIZONTAL_ITEM->number.value;
	int height = (int)CCD_FRAME_HEIGHT_ITEM->number.value / (int)CCD_BIN_VERTICAL_ITEM->number.value;
	uint16_t *raw = (uint16_t *)(PRIVATE_DATA->imager_image + FITS_HEADER_SIZE);
	for (int x = 0; x < width; x++) {
		if (raw[width * height + x] != 0x5A5A) {
			fprintf(stderr, "hot pixel wrote beyond frame at guard column %d\n", x);
			return false;
		}
	}
	return true;
}
