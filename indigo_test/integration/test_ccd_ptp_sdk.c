// Copyright (c) 2026 INDIGO initiative
// All rights reserved.
//
// You may use this software under the terms of 'INDIGO Astronomy
// open-source license' (see LICENSE.md).
//
// THIS SOFTWARE IS PROVIDED BY THE AUTHORS 'AS IS' AND ANY EXPRESS
// OR IMPLIED WARRANTIES, INCLUDING, BUT NOT LIMITED TO, THE IMPLIED
// WARRANTIES OF MERCHANTABILITY AND FITNESS FOR A PARTICULAR PURPOSE
// ARE DISCLAIMED. IN NO EVENT SHALL THE AUTHOR BE LIABLE FOR ANY
// DIRECT, INDIRECT, INCIDENTAL, SPECIAL, EXEMPLARY, OR CONSEQUENTIAL
// DAMAGES (INCLUDING, BUT NOT LIMITED TO, PROCUREMENT OF SUBSTITUTE
// GOODS OR SERVICES; LOSS OF USE, DATA, OR PROFITS; OR BUSINESS
// INTERRUPTION) HOWEVER CAUSED AND ON ANY THEORY OF LIABILITY,
// WHETHER IN CONTRACT, STRICT LIABILITY, OR TORT (INCLUDING
// NEGLIGENCE OR OTHERWISE) ARISING IN ANY WAY OUT OF THE USE OF THIS
// SOFTWARE, EVEN IF ADVISED OF THE POSSIBILITY OF SUCH DAMAGE.

// Code is generated by AI



#include <stdio.h>
#include <stdatomic.h>
#include <jpeglib.h>
#include <indigo/indigo_tiff.h>
#include <indigo/indigo_usb_utils.h>
#include <indigo_drivers/ccd_ptp/indigo_ptp.h>
#include <indigo_drivers/ccd_ptp/indigo_ptp_canon.h>
#include <indigo_drivers/ccd_ptp/indigo_ptp_nikon.h>
#include <indigo_drivers/ccd_ptp/indigo_ptp_sony.h>
#include <indigo_drivers/ccd_ptp/indigo_ptp_fuji.h>
#include <indigo_drivers/ccd_ptp/indigo_ptp_olympus.h>
#include <indigo_drivers/ccd_ptp/indigo_ccd_ptp.h>
#include "simulator_test_common.h"
#include "ccd_test_noise.h"

#define FAKE_CAMERAS 6

typedef struct {
	uint16_t vendor, product;
	atomic_bool visible, opened, hold_image, hold_focus, af_held;
	bool af_event, hid_only;
	atomic_int refs, opens, closes, frames, releases, held_us;
	uint16_t properties[32];
	uint32_t values[32];
	ptp_container command;
	uint8_t input[0x200000 + 64];
	uint32_t input_size, input_offset;
	bool data_header_sent, response_sent, capturing, event_sent, bulb, transfer_requested;
	double pressed_at, closed_at;
	atomic_bool stuck_busy;
	uint16_t response, fuji_mode;
} fake_camera;

static fake_camera cameras[FAKE_CAMERAS];
static indigo_device *logical[FAKE_CAMERAS];
static libusb_hotplug_callback_fn callback;
static atomic_int attached, blobs, bad_blob, calls_after_close, bus_io, fail_register, fail_open, fail_claim, fail_attach;
static atomic_int fail_operation, malformed, offset_mode;
static pthread_t bus_thread;
static atomic_int connection_state, exposure_state, streaming_state, exposure_updates, streaming_updates, focus_state, focus_connection_state;
static atomic_int gate_operation, gate_entered, gate_open, fail_reply, bad_response;
static atomic_int command_count[65536];
static bool bulb_profile, dual_profile, hold_raw, autofocus_profile;
static bool nikon_dual_profile, nikon_raw_output, nikon_bad_jpeg;
static uint8_t *dng;
static size_t dng_size;
static uint8_t captured_raw[64 * 64 * 2 + sizeof(indigo_raw_header) + 64];
static size_t captured_raw_size;
static atomic_int histogram_blobs, saved_images, image_file_state, bad_preview, histogram_alerts;
static char saved_image_path[INDIGO_VALUE_SIZE];
static bool fuji_priority_profile, fuji_reject_bulb, fuji_af_error, fuji_reject_cancel;
static atomic_int fuji_shutter_readback, fuji_bulb_started, shutter_state;
static int fuji_action_profile;
static atomic_int fail_once_operation;
static int partial_profile, destination_profile, destination_failure;
static bool combined_transfer_profile;
static uint16_t canon_transfer_event, canon_transfer_format = 0xB108;
static const char *canon_transfer_filename = "IMG_778.CR3";
static int canon_transfer_fault;
static bool canon_transfer_large;
static atomic_int canon_transfer_received, canon_transfer_first_request, canon_transfer_protocol_errors;
static char canon_transfer_blob_format[16];
static atomic_int mirror_reject, mirror_writes, mirror_value;
static atomic_bool mirror_suppress_events;
static bool mirror_unknown_profile;
static bool olympus_native_events;
static int olympus_event_stage;
static int sony_dual_order, sony_memory_objects;
static atomic_int preview_blobs, countdown_value, sony_focus_value;
static atomic_int iso_state, bias_state, lock_state, zoom_state, af_state, host_time_state, destination_state;
static atomic_int command_argument[65536];
static int device_info_fault, descriptor_fault, canon_custom_func_fault, object_info_delta;
static bool sony_extension_fault, canon_info_ex_fault, object_info_short, canon_custom_func_profile, canon_custom_func_sent;
static uint8_t canon_text_payload[1024];
static bool sony_compression_profile;
static atomic_int sony_dropped_writes;
// ILCE-7RM4 after a reconnect: a number of full presses are acknowledged but never shoot.
static atomic_int sony_ignored_presses, sony_presses;
// ILCE-7RM4 reopened within milliseconds of CloseSession answers DeviceBusy to every control for the session.
static atomic_bool sony_fast_reopen_busy;
// A 1 s camera shutter, for the long exposure noise reduction case.
static bool sony_long_shutter;
// ILCE-7RM2: every accepted press queues one object reported later, also for an aborted exposure, and
// live view frames are refused with AccessDenied for a while after an object download.
static atomic_bool sony_object_queue;
static atomic_int sony_queued_objects;
static double sony_liveview_denial, sony_liveview_denied_until;
static atomic_int canon_text_size;
static uint8_t *jpeg;
static unsigned long jpeg_size;

static const simulator_driver_case ptp_case = {
	"PTP-over-USB Camera", "indigo_ccd_ptp", "Canon EOS 600D", indigo_ccd_ptp, true,
	base_properties_without_instances, ARRAY_SIZE(base_properties_without_instances), hidden_base_properties_without_instances, ARRAY_SIZE(hidden_base_properties_without_instances), NULL, 0, NULL, 0
};

// The property cache follows one device name; a case observing a Fujifilm X-T1 profile selects this.
static const simulator_driver_case fuji_case = {
	"PTP-over-USB Camera", "indigo_ccd_ptp", "Fujifilm X-T1", indigo_ccd_ptp, true,
	base_properties_without_instances, ARRAY_SIZE(base_properties_without_instances), hidden_base_properties_without_instances, ARRAY_SIZE(hidden_base_properties_without_instances), NULL, 0, NULL, 0
};
static const simulator_driver_case *profile_case;

static fake_camera *camera(void *token) {
	return token;
}

static void word16(uint8_t **p, uint16_t value) {
	memcpy(*p, &value, 2);
	*p += 2;
}

static void word32(uint8_t **p, uint32_t value) {
	memcpy(*p, &value, 4);
	*p += 4;
}

static void string(uint8_t **p, const char *value) {
	*(*p)++ = strlen(value) + 1;
	do {
		word16(p, *value);
	} while (*value++);
}

static void array16(uint8_t **p, const uint16_t *values, unsigned count) {
	word32(p, count);
	for (unsigned i = 0; i < count; i++) {
		word16(p, values[i]);
	}
}

// Canon event offsets are relative to the complete record, including its 8-byte header.
static uint8_t *canon_transfer_record(uint8_t *record, uint16_t code) {
	bool lfn = code == 0xC1B8;
	uint32_t size = lfn ? 0x25 : 0x1C + strlen(canon_transfer_filename) + 1;
	if (canon_transfer_fault == 1) {
		size = lfn ? 0x24 : 0x17;
	} else if (canon_transfer_fault == 3 && !lfn) {
		size = 0x1C + PTP_MAX_CHARS + 1;
	}
	memset(record, 0xA5, size);
	uint8_t *p = record;
	word32(&p, size);
	word32(&p, code);
	word32(&p, 1);
	word16(&p, canon_transfer_format);
	p = record + 0x14;
	word32(&p, canon_transfer_fault == 4 ? 0 : canon_transfer_large ? 0x200000 + 17 : jpeg_size);
	if (lfn && size > 0x24) {
		// There is no filename. A trailing zero is not a PTP Unicode string field.
		record[0x24] = 0;
	} else if (!lfn && canon_transfer_fault != 1) {
		if (canon_transfer_fault != 3) {
			memcpy(record + 0x1C, canon_transfer_filename, strlen(canon_transfer_filename));
		}
		if (canon_transfer_fault != 2) {
			record[size - 1] = 0;
		}
	}
	return record + size;
}

// CustomFuncEx PropValueChanged record: size, event, code, total size, group count and one group
// { id, size in bytes from the size field, item count, item { code, value size in words, value } }.
static void canon_custom_func_record(uint8_t **p) {
	uint32_t words[] = { 44, ptp_event_canon_PropValueChanged, ptp_property_canon_CustomFuncEx, 28, 1, 1, 20, 1, 0x0101, 1, 7 };
	switch (canon_custom_func_fault) {
		case 1:
			words[5] = 0;
			break;
		case 2:
			words[5] = 17;
			break;
		case 3:
			words[6] = 24;
			break;
		case 4:
			words[7] = 2;
			break;
		case 5:
			words[9] = 2;
			break;
		case 6:
			words[4] = 17;
			break;
	}
	for (unsigned i = 0; i < ARRAY_SIZE(words); i++) {
		word32(p, words[i]);
	}
}

static unsigned property_count(fake_camera *c) {
	unsigned count = 0;
	while (count < 32 && c->properties[count]) {
		count++;
	}
	return count;
}

static uint32_t *value(fake_camera *c, uint16_t code) {
	for (unsigned i = 0; i < property_count(c); i++) {
		if (c->properties[i] == code) {
			return c->values + i;
		}
	}
	return NULL;
}

static void make_dng(void) {
	indigo_tiff_memory_handle memory = { 0 };
	TIFF *tiff = TIFFClientOpen("noise.dng", "w", &memory, indigo_tiff_read, indigo_tiff_write, indigo_tiff_seek, indigo_tiff_close, indigo_tiff_size, NULL, NULL);
	uint8_t version[] = { 1, 4, 0, 0 }, pattern[] = { 0, 1, 1, 2 };
	uint16_t repeat[] = { 2, 2 };
	float matrix[] = { 1, 0, 0, 0, 1, 0, 0, 0, 1 }, neutral[] = { 1, 1, 1 };
	uint32_t white = 65535;
	TIFFSetField(tiff, TIFFTAG_IMAGEWIDTH, 64);
	TIFFSetField(tiff, TIFFTAG_IMAGELENGTH, 64);
	TIFFSetField(tiff, TIFFTAG_BITSPERSAMPLE, 16);
	TIFFSetField(tiff, TIFFTAG_SAMPLESPERPIXEL, 1);
	TIFFSetField(tiff, TIFFTAG_COMPRESSION, COMPRESSION_NONE);
	TIFFSetField(tiff, TIFFTAG_PHOTOMETRIC, PHOTOMETRIC_CFA);
	TIFFSetField(tiff, TIFFTAG_PLANARCONFIG, PLANARCONFIG_CONTIG);
	TIFFSetField(tiff, TIFFTAG_ROWSPERSTRIP, 64);
	TIFFSetField(tiff, TIFFTAG_DNGVERSION, version);
	TIFFSetField(tiff, TIFFTAG_DNGBACKWARDVERSION, version);
	TIFFSetField(tiff, TIFFTAG_UNIQUECAMERAMODEL, "INDIGO synthetic Bayer fixture");
	TIFFSetField(tiff, TIFFTAG_CFAREPEATPATTERNDIM, repeat);
	TIFFSetField(tiff, TIFFTAG_CFAPATTERN, pattern);
	TIFFSetField(tiff, TIFFTAG_COLORMATRIX1, 9, matrix);
	TIFFSetField(tiff, TIFFTAG_ASSHOTNEUTRAL, 3, neutral);
	TIFFSetField(tiff, TIFFTAG_CALIBRATIONILLUMINANT1, 21);
	TIFFSetField(tiff, TIFFTAG_WHITELEVEL, 1, &white);
	uint16_t row[64];
	for (unsigned y = 0; y < 64; y++) {
		for (unsigned x = 0; x < 64; x++) {
			row[x] = ccd_test_noise(y * 64 + x, 0);
		}
		TIFFWriteScanline(tiff, row, y, 0);
	}
	TIFFClose(tiff);
	dng = memory.data;
	dng_size = memory.file_length;
}

static void make_jpeg(void) {
	struct jpeg_compress_struct info = { 0 };
	struct jpeg_error_mgr errors;
	info.err = jpeg_std_error(&errors);
	jpeg_create_compress(&info);
	jpeg_mem_dest(&info, &jpeg, &jpeg_size);
	info.image_width = info.image_height = 32;
	info.input_components = 3;
	info.in_color_space = JCS_RGB;
	jpeg_set_defaults(&info);
	jpeg_set_quality(&info, 95, TRUE);
	jpeg_start_compress(&info, TRUE);
	uint8_t row[32 * 3];
	while (info.next_scanline < info.image_height) {
		for (unsigned i = 0; i < sizeof(row); i++) {
			row[i] = ccd_test_noise(info.next_scanline * 32 + i / 3, i % 3);
		}
		JSAMPROW rows[] = { row };
		jpeg_write_scanlines(&info, rows, 1);
	}
	jpeg_finish_compress(&info);
	jpeg_destroy_compress(&info);
	// APP0 is optional; Sony's transport searches for SOI followed by DQT.
	if (jpeg_size > 20 && jpeg[2] == 0xff && jpeg[3] == 0xe0) {
		memmove(jpeg + 2, jpeg + 20, jpeg_size - 20);
		jpeg_size -= 18;
	}
}

static void io_check(fake_camera *c) {
	if (pthread_equal(pthread_self(), bus_thread)) {
		atomic_fetch_add(&bus_io, 1);
	}
	if (!atomic_load(&c->opened)) {
		atomic_fetch_add(&calls_after_close, 1);
	}
}

static void device_info(fake_camera *c, uint8_t **p) {
	const uint16_t operations[] = {
		ptp_operation_GetDeviceInfo, ptp_operation_OpenSession, ptp_operation_CloseSession, ptp_operation_GetDevicePropDesc, ptp_operation_GetDevicePropValue, ptp_operation_SetDevicePropValue, ptp_operation_InitiateCapture, ptp_operation_GetObjectInfo, ptp_operation_GetObject, ptp_operation_DeleteObject,
		ptp_operation_canon_GetDeviceInfoEx, ptp_operation_canon_GetEvent, ptp_operation_canon_RemoteReleaseOn, ptp_operation_canon_RemoteReleaseOff, ptp_operation_canon_SetUILock, ptp_operation_canon_ResetUILock,
		ptp_operation_nikon_CheckEvent, ptp_operation_nikon_InitiateCaptureRecInMedia, ptp_operation_nikon_TerminateCapture, ptp_operation_nikon_MfDrive,
		ptp_operation_sony_GetSDIOGetExtDeviceInfo, ptp_operation_sony_GetAllDevicePropData, ptp_operation_olympus_ChangedProperties, ptp_operation_canon_DoAf, ptp_operation_canon_AfCancel
	};
	word16(p, 100);
	word32(p, 0);
	word16(p, 100);
	string(p, "fake PTP");
	word16(p, 0);
	uint16_t supported[ARRAY_SIZE(operations)];
	unsigned count = 0;
	for (unsigned i = 0; i < ARRAY_SIZE(operations); i++) {
		if (i < 10 || (c->vendor == 0x04a9 && ((i >= 10 && i < 16) || i >= 23)) || (c->vendor == 0x04b0 && i >= 16 && i < 20) || (c->vendor == 0x054c && i >= 20 && i < 22) || (c->vendor == 0x07b4 && i == 22)) {
			supported[count++] = operations[i];
		}
	}
	array16(p, supported, count);
	if (device_info_fault == 3) {
		// More event codes than the 1024-element destination holds.
		word32(p, 1100);
		for (unsigned i = 0; i < 1100; i++) {
			word16(p, 0x4800 + i);
		}
	} else {
		array16(p, NULL, 0);
	}
	if (device_info_fault == 2) {
		// The array announces more codes than the reply carries.
		word32(p, property_count(c));
		word16(p, c->properties[0]);
		return;
	}
	array16(p, c->properties, property_count(c));
	array16(p, NULL, 0);
	array16(p, NULL, 0);
	if (device_info_fault == 1) {
		return;
	}
	string(p, "INDIGO fake");
	string(p, "Queue test");
	string(p, "1");
	string(p, "1234");
}

static void prepare(fake_camera *c) {
	atomic_fetch_add(command_count + c->command.code, 1);
	atomic_store(command_argument + c->command.code, c->command.payload.params[0]);
	uint8_t *p = c->input;
	uint16_t code = c->command.code;
	uint32_t arg = c->command.payload.params[0];
	c->input_size = c->input_offset = 0;
	c->data_header_sent = c->response_sent = false;
	bool fail_once = atomic_load(&fail_once_operation) == code && atomic_exchange(&fail_once_operation, 0) == code;
	c->response = fail_once || atomic_load(&fail_operation) == code ? (atomic_load(&fail_reply) ? atomic_load(&fail_reply) : ptp_response_GeneralError) : ptp_response_OK;
	if (c->response != ptp_response_OK) {
		return;
	}
	if (code == ptp_operation_CloseSession) {
		c->closed_at = indigo_monotonic_time();
		atomic_store(&c->stuck_busy, false);
	} else if (code == ptp_operation_OpenSession) {
		atomic_store(&c->stuck_busy, atomic_load(&sony_fast_reopen_busy) && c->vendor == 0x054c && c->closed_at > 0 && indigo_monotonic_time() - c->closed_at < 0.5);
	} else if (atomic_load(&c->stuck_busy) && code == ptp_operation_sony_SetControlDeviceB) {
		c->response = ptp_response_DeviceBusy;
		return;
	} else if (code == ptp_operation_GetObject && arg == 0xffffc002 && c->vendor == 0x054c && indigo_monotonic_time() < sony_liveview_denied_until) {
		c->response = ptp_response_AccessDenied;
		return;
	}
	if (canon_transfer_event && code == ptp_operation_canon_TransferComplete && !combined_transfer_profile && atomic_load(&canon_transfer_received) != (int)(canon_transfer_large ? 0x200000 + 17 : jpeg_size)) {
		atomic_fetch_add(&canon_transfer_protocol_errors, 1);
	}
	if (code == ptp_operation_GetDeviceInfo) {
		device_info(c, &p);
	} else if (code == ptp_operation_GetDevicePropDesc) {
		uint32_t *v = value(c, arg);
		if (descriptor_fault && arg == ptp_property_WhiteBalance) {
			// 1: more enum values than the destination holds, 2: enum count beyond the reply.
			word16(&p, arg);
			word16(&p, ptp_uint16_type);
			*p++ = 1;
			word16(&p, 2);
			word16(&p, 2);
			*p++ = ptp_enum_form;
			word16(&p, descriptor_fault == 1 ? 1100 : 10);
			for (unsigned i = 0; i < (descriptor_fault == 1 ? 1100 : 4); i++) {
				word16(&p, i + 1);
			}
			c->input_size = p - c->input;
			return;
		}
		if (descriptor_fault && arg == ptp_property_ImageSize) {
			// More string enum values than the 16-element destination holds.
			word16(&p, arg);
			word16(&p, ptp_str_type);
			*p++ = 1;
			string(&p, "W00");
			string(&p, "W00");
			*p++ = ptp_enum_form;
			word16(&p, 20);
			for (unsigned i = 0; i < 20; i++) {
				char text[8];
				snprintf(text, sizeof(text), "W%02u", i);
				string(&p, text);
			}
			c->input_size = p - c->input;
			return;
		}
		if (c->vendor == 0x04cb && arg == ptp_property_fuji_AutoFocus) {
			if (fuji_action_profile == 3) {
				c->response = ptp_response_DevicePropNotSupported;
				return;
			}
			const uint16_t actions[] = { 0x0104, 0x0200, 0x0004, 0x0304, 0x0500, 0x000c };
			word16(&p, arg);
			word16(&p, ptp_uint16_type);
			*p++ = 1;
			word16(&p, 0x0304);
			word16(&p, 0x0304);
			*p++ = ptp_enum_form;
			unsigned count = fuji_action_profile == 1 ? 4 : fuji_action_profile == 2 ? 5 : 6;
			word16(&p, count);
			for (unsigned i = 0; i < count; i++) {
				word16(&p, actions[i]);
			}
			c->input_size = p - c->input;
			return;
		}
		if (!v) {
			c->response = ptp_response_DevicePropNotSupported;
			return;
		}
		word16(&p, arg);
		word16(&p, ptp_uint32_type);
		*p++ = 1;
		word32(&p, *v);
		word32(&p, *v);
		if (c->vendor == 0x04cb && arg == ptp_property_ExposureTime) {
			*p++ = ptp_enum_form;
			word16(&p, 3);
			word32(&p, 10000);
			word32(&p, 32000000);
			word32(&p, 0xffffffff);
		} else if (fuji_priority_profile && arg == ptp_property_fuji_ControlPriority) {
			*p++ = ptp_enum_form;
			word16(&p, 2);
			word32(&p, 1);
			word32(&p, 2);
		} else {
			*p++ = ptp_range_form;
			word32(&p, 0);
			word32(&p, 0xffffffff);
			word32(&p, 1);
		}
	} else if (code == ptp_operation_GetDevicePropValue) {
		if (arg == ptp_property_fuji_GetEvent) {
			if (c->capturing && !c->bulb && !atomic_load(&c->hold_image)) {
				word16(&p, 1);
				word16(&p, 0xd20e);
				word32(&p, 0x10);
			} else {
				word32(&p, 0);
			}
		} else if (arg == ptp_property_fuji_AutoFocusState) {
			word16(&p, atomic_load(&c->hold_focus) ? 1 : fuji_af_error ? 3 : 2);
		} else {
			uint32_t *v = value(c, arg);
			word32(&p, v ? *v : 1);
			if (fuji_priority_profile && arg == ptp_property_ExposureTime && v && *v == 32000000) {
				atomic_store(&fuji_shutter_readback, 1);
			}
		}
	} else if (code == ptp_operation_canon_GetDeviceInfoEx) {
		word32(&p, 0);
		if (canon_info_ex_fault) {
			// More event codes than the 1024-element destination holds.
			word32(&p, 1100);
			for (unsigned i = 0; i < 1100; i++) {
				word32(&p, 0xC800 + i);
			}
		} else {
			word32(&p, 0);
		}
		word32(&p, property_count(c));
		for (unsigned i = 0; i < property_count(c); i++) {
			word32(&p, c->properties[i]);
		}
	} else if (code == ptp_operation_canon_GetEvent) {
		for (unsigned i = 0; i < property_count(c); i++) {
			if (c->properties[i] == ptp_property_canon_MirrorUpSetting && atomic_load(&mirror_suppress_events)) {
				continue;
			}
			if (c->properties[i] == ptp_property_canon_CustomFuncEx) {
				// Sent once, so the polling thread does not rewrite the groups while the test reads them.
				if (!canon_custom_func_sent) {
					canon_custom_func_record(&p);
					canon_custom_func_sent = true;
				}
				continue;
			}
			if (c->properties[i] == ptp_property_canon_ImageFormat) {
				word32(&p, 48);
				word32(&p, ptp_event_canon_PropValueChanged);
				word32(&p, c->properties[i]);
				word32(&p, 2);
				for (unsigned j = 0; j < 2; j++) {
					word32(&p, 3);
					word32(&p, j ? 1 : 4);
					word32(&p, 0);
					word32(&p, 4);
				}
				continue;
			}
			word32(&p, 16);
			word32(&p, ptp_event_canon_PropValueChanged);
			word32(&p, c->properties[i]);
			word32(&p, c->values[i]);
		}
		if (destination_profile) {
			unsigned count = destination_profile == 1 ? 2 : 1;
			word32(&p, 20 + count * 4);
			word32(&p, ptp_event_canon_AvailListChanged);
			word32(&p, ptp_property_canon_CaptureDestination);
			word32(&p, 3);
			word32(&p, count);
			word32(&p, destination_profile == 2 ? 4 : 2);
			if (count == 2) {
				word32(&p, 4);
			}
		}
		if (c->capturing && !c->bulb && !c->event_sent && !atomic_load(&c->hold_image)) {
			uint8_t *record = p;
			memset(record, 0, 64);
			word32(&p, 64);
			word32(&p, ptp_event_canon_ObjectAddedEx);
			word32(&p, 1);
			p = record + 8 + 0x14;
			word32(&p, jpeg_size);
			strcpy((char *)record + 8 + 0x20, "FAKE.JPG");
			if ((partial_profile || canon_transfer_event) && !combined_transfer_profile) {
				p = canon_transfer_record(record, canon_transfer_event ? canon_transfer_event : 0xC1B8);
			} else {
				p = record + 64;
			}
			if (dual_profile && !hold_raw) {
				memcpy(p, record, 64);
				uint8_t *handle = p + 8;
				word32(&handle, 2);
				strcpy((char *)p + 8 + 0x20, "FAKE.CR2");
				p += 64;
			}
			if (combined_transfer_profile && !c->transfer_requested) {
				p = canon_transfer_record(record, canon_transfer_event ? canon_transfer_event : 0xC186);
				c->transfer_requested = true;
			} else if (combined_transfer_profile && atomic_load(command_count + ptp_operation_canon_TransferComplete) == 0) {
				p = record;
			} else {
				c->event_sent = true;
			}
		}
		word32(&p, 8);
		word32(&p, 0);
	} else if (code == ptp_operation_nikon_CheckEvent) {
		bool ready = c->capturing && !c->bulb && !c->event_sent && !atomic_load(&c->hold_image);
		word16(&p, ready ? (nikon_dual_profile ? 2 : 1) : 0);
		if (ready) {
			word16(&p, ptp_event_ObjectAdded);
			word32(&p, 1);
			if (nikon_dual_profile) {
				word16(&p, ptp_event_ObjectAdded);
				word32(&p, 2);
			}
			c->event_sent = true;
		}
	} else if (code == ptp_operation_sony_GetSDIOGetExtDeviceInfo) {
		if (sony_extension_fault) {
			// More operation codes than the 1024-element lists hold.
			for (unsigned i = 0; i < 1100; i++) {
				word16(&p, 0x1800 + i);
			}
		}
		for (unsigned i = 0; i < property_count(c); i++) {
			word16(&p, c->properties[i]);
		}
	} else if (code == ptp_operation_sony_GetAllDevicePropData) {
		word32(&p, property_count(c));
		word32(&p, 0);
		for (unsigned i = 0; i < property_count(c); i++) {
			word16(&p, c->properties[i]);
			if (c->properties[i] == ptp_property_sony_CompressionSetting) {
				// NEW_API enum: settable values, then all supported values.
				word16(&p, ptp_uint8_type);
				*p++ = 1;
				*p++ = 0;
				*p++ = c->values[i];
				*p++ = c->values[i];
				*p++ = ptp_enum_form;
				for (int list = 0; list < 2; list++) {
					word16(&p, 3);
					for (uint8_t value = 1; value <= 3; value++) {
						*p++ = value;
					}
				}
				continue;
			}
			word16(&p, ptp_uint32_type);
			*p++ = 1;
			*p++ = 0;
			word32(&p, c->values[i]);
			word32(&p, c->values[i]);
			*p++ = ptp_none_form;
		}
	} else if (code == ptp_operation_olympus_ChangedProperties) {
		memset(p, 0, 5000);
		p += 5000;
	} else if (code == ptp_operation_GetStorageIDs || code == ptp_operation_canon_GetStorageIDs) {
		word32(&p, 0);
	} else if (code == ptp_operation_GetObjectHandles) {
		word32(&p, 1);
		word32(&p, 1);
	} else if (code == ptp_operation_GetObjectInfo) {
		memset(p, 0, 52);
		uint8_t *size = p + 8;
		word32(&size, (nikon_dual_profile && arg == 2 ? dng_size : jpeg_size) + object_info_delta);
		p += 52;
		string(&p, nikon_dual_profile && arg == 2 ? "FAKE.DNG" : sony_dual_order && ((sony_memory_objects == 2) == (sony_dual_order == 1)) ? "FAKE.ARW" : "FAKE.JPG");
		if (object_info_short) {
			p = c->input + 20;
		}
	} else if (code == ptp_operation_GetObject || code == ptp_operation_canon_GetObject || code == ptp_operation_nikon_GetLiveViewImg || code == ptp_operation_canon_GetViewFinderData || code == ptp_operation_olympus_GetLiveViewImage) {
		if (code == ptp_operation_canon_GetViewFinderData) {
			word32(&p, atomic_load(&malformed) ? 3 : jpeg_size + 8);
			word32(&p, 1);
		} else if (code == ptp_operation_nikon_GetLiveViewImg) {
			unsigned offset = atomic_load(&offset_mode);
			memset(p, 0, offset);
			p += offset;
		}
		size_t payload_size = nikon_dual_profile && arg == 2 ? dng_size : jpeg_size;
		memcpy(p, nikon_dual_profile && arg == 2 ? dng : jpeg, payload_size);
		if (nikon_dual_profile && nikon_bad_jpeg && arg == 1) {
			p[0] = 0;
		}
		p += payload_size;
		atomic_fetch_add(&c->frames, 1);
		if (arg != 0xffffc002) {
			if (sony_dual_order && c->vendor == 0x054c) {
				sony_memory_objects--;
				c->values[3] = sony_memory_objects ? 0x8000 + sony_memory_objects : 0;
				c->capturing = sony_memory_objects > 0;
				c->event_sent = false;
			} else if (atomic_load(&sony_object_queue) && c->vendor == 0x054c) {
				c->capturing = atomic_fetch_sub(&sony_queued_objects, 1) > 1;
			} else {
				c->capturing = false;
			}
			if (c->vendor == 0x054c && sony_liveview_denial > 0) {
				sony_liveview_denied_until = indigo_monotonic_time() + sony_liveview_denial;
			}
		}
	}
	if (code == ptp_operation_canon_GetPartialObject && partial_profile != 2) {
		uint32_t offset = c->command.payload.params[1];
		uint32_t request = c->command.payload.params[2];
		uint32_t total = canon_transfer_large ? 0x200000 + 17 : jpeg_size;
		if (arg != 1 || offset != (uint32_t)atomic_load(&canon_transfer_received) || offset >= total || request != (total - offset > 0x200000 ? 0x200000 : total - offset)) {
			atomic_fetch_add(&canon_transfer_protocol_errors, 1);
			c->response = ptp_response_InvalidParameter;
			return;
		}
		if (offset == 0) {
			atomic_store(&canon_transfer_first_request, request);
		}
		if (canon_transfer_large) {
			for (uint32_t i = 0; i < request; i++) {
				p[i] = (offset + i) * 31 + 7;
			}
		} else {
			memcpy(p, jpeg + offset, request);
		}
		p += request;
		atomic_fetch_add(&canon_transfer_received, request);
		if (partial_profile == 3) {
			*p++ = 0;
		}
		atomic_fetch_add(&c->frames, 1);
	}
	if ((c->vendor == 0x04a9 && code == ptp_operation_canon_RemoteReleaseOn) || (c->vendor == 0x04b0 && code == ptp_operation_nikon_InitiateCaptureRecInMedia) || (code == ptp_operation_InitiateCapture && (c->vendor != 0x04cb || c->fuji_mode == 0x0500 || c->fuji_mode == 0x0304)) || (c->vendor == 0x07b4 && code == ptp_operation_olympus_Capture && arg == 3)) {
		atomic_store(&canon_transfer_received, 0);
		c->capturing = true;
		c->event_sent = false;
		c->pressed_at = indigo_monotonic_time();
		c->bulb = (c->vendor == 0x04a9 && c->values[0] == 0x0c) || (c->vendor == 0x04b0 && c->values[0] == 0xffffffff) || (c->vendor == 0x04cb && c->fuji_mode == 0x0500) || (c->vendor == 0x07b4 && bulb_profile);
	}
	if ((c->vendor == 0x04a9 && code == ptp_operation_canon_RemoteReleaseOff) || (c->vendor == 0x04b0 && code == ptp_operation_nikon_TerminateCapture) || (c->vendor == 0x07b4 && code == ptp_operation_olympus_Capture && arg == 6)) {
		atomic_store(&c->held_us, (indigo_monotonic_time() - c->pressed_at) * 1000000);
		c->bulb = false;
		atomic_fetch_add(&c->releases, 1);
	}
	c->input_size = p - c->input;
}

libusb_device *ptp_test_ref(libusb_device *dev) {
	atomic_fetch_add(&camera(dev)->refs, 1);
	return dev;
}

void ptp_test_unref(libusb_device *dev) {
	atomic_fetch_sub(&camera(dev)->refs, 1);
}

int ptp_test_descriptor(libusb_device *dev, struct libusb_device_descriptor *result) {
	fake_camera *c = camera(dev);
	*result = (struct libusb_device_descriptor) { .idVendor = c->vendor, .idProduct = c->product, .bNumConfigurations = 1 };
	return 0;
}

void ptp_test_usb_start(void) { }

int ptp_test_register(libusb_context *ctx, libusb_hotplug_event events, libusb_hotplug_flag flags, int vid, int pid, int cls, libusb_hotplug_callback_fn fn, void *data, libusb_hotplug_callback_handle *handle) {
	if (atomic_load(&fail_register)) {
		return LIBUSB_ERROR_OTHER;
	}
	callback = fn;
	*handle = 1;
	for (unsigned i = 0; i < FAKE_CAMERAS; i++) {
		if (atomic_load(&cameras[i].visible)) {
			fn(NULL, (libusb_device *)(cameras + i), LIBUSB_HOTPLUG_EVENT_DEVICE_ARRIVED, NULL);
		}
	}
	return 0;
}

int ptp_test_deregister(libusb_context *ctx, libusb_hotplug_callback_handle handle) {
	callback = NULL;
	return 0;
}

indigo_result ptp_test_path(libusb_device *dev, char *path) {
	snprintf(path, INDIGO_NAME_SIZE, "fake-%ld", camera(dev) - cameras);
	return INDIGO_OK;
}

indigo_result ptp_test_attach(indigo_device *device) {
	if (sony_dual_order && device->master_device == device) {
		INDIGO_COPY_NAME(device->name, "Sony dual fake camera");
	}
	if (atomic_load(&fail_attach)) {
		return INDIGO_FAILED;
	}
	indigo_result result = indigo_attach_device(device);
	if (result == INDIGO_OK && device->master_device == device) {
		fake_camera *c = camera(((ptp_private_data *)device->private_data)->dev);
		logical[c - cameras] = device;
		atomic_fetch_add(&attached, 1);
	}
	return result;
}

indigo_result ptp_test_detach(indigo_device *device) {
	indigo_result result = indigo_detach_device(device);
	for (unsigned i = 0; i < FAKE_CAMERAS; i++) {
		if (logical[i] == device) {
			logical[i] = NULL;
			atomic_fetch_sub(&attached, 1);
		}
	}
	return result;
}

int ptp_test_open(libusb_device *dev, libusb_device_handle **handle) {
	if (atomic_load(&fail_open)) {
		return LIBUSB_ERROR_OTHER;
	}
	fake_camera *c = camera(dev);
	atomic_store(&c->opened, true);
	atomic_fetch_add(&c->opens, 1);
	*handle = (libusb_device_handle *)dev;
	return 0;
}

void ptp_test_close(libusb_device_handle *handle) {
	fake_camera *c = camera(handle);
	if (!atomic_exchange(&c->opened, false)) {
		atomic_fetch_add(&calls_after_close, 1);
	}
	atomic_fetch_add(&c->closes, 1);
}

int ptp_test_kernel(libusb_device_handle *handle, int iface) {
	return 0;
}

int ptp_test_detach_kernel(libusb_device_handle *handle, int iface) {
	return 0;
}

int ptp_test_claim(libusb_device_handle *handle, int iface) {
	return atomic_load(&fail_claim) ? LIBUSB_ERROR_OTHER : 0;
}

int ptp_test_clear(libusb_device_handle *handle, unsigned char ep) {
	return 0;
}

int ptp_test_control(libusb_device_handle *handle, uint8_t type, uint8_t request, uint16_t v, uint16_t index, unsigned char *data, uint16_t size, unsigned timeout) {
	io_check(camera(handle));
	return 0;
}

static const struct libusb_endpoint_descriptor endpoints[] = {
	{ .bEndpointAddress = 0x81, .bmAttributes = LIBUSB_TRANSFER_TYPE_BULK },
	{ .bEndpointAddress = 0x02, .bmAttributes = LIBUSB_TRANSFER_TYPE_BULK },
	{ .bEndpointAddress = 0x83, .bmAttributes = LIBUSB_TRANSFER_TYPE_INTERRUPT }
};
static const struct libusb_interface_descriptor setting = { .bInterfaceNumber = 0, .bNumEndpoints = 3, .bInterfaceClass = 6, .bInterfaceSubClass = 1, .bInterfaceProtocol = 1, .endpoint = endpoints };
static const struct libusb_interface interface = { .altsetting = &setting, .num_altsetting = 1 };
// The ILCE-6000 in charging mode enumerates as 054c:0994 with a single HID interface.
static const struct libusb_interface_descriptor hid_setting = { .bInterfaceNumber = 0, .bNumEndpoints = 1, .bInterfaceClass = 3, .endpoint = endpoints + 2 };
static const struct libusb_interface hid_interface = { .altsetting = &hid_setting, .num_altsetting = 1 };

int ptp_test_config(libusb_device *dev, uint8_t index, struct libusb_config_descriptor **result) {
	*result = calloc(1, sizeof(**result));
	(*result)->bNumInterfaces = 1;
	(*result)->interface = camera(dev)->hid_only ? &hid_interface : &interface;
	return 0;
}

void ptp_test_free_config(struct libusb_config_descriptor *config) {
	free(config);
}

int ptp_test_bulk(libusb_device_handle *handle, unsigned char ep, unsigned char *data, int size, int *length, unsigned timeout) {
	fake_camera *c = camera(handle);
	io_check(c);
	*length = 0;
	if (ep == 0x02 && size >= PTP_CONTAINER_HDR_SIZE && ((ptp_container *)data)->type == ptp_container_command && ((ptp_container *)data)->code == atomic_load(&gate_operation)) {
		atomic_store(&gate_entered, 1);
		double deadline = indigo_monotonic_time() + 5;
		while (!atomic_load(&gate_open) && indigo_monotonic_time() < deadline) {
			indigo_usleep(1000);
		}
		if (!atomic_load(&gate_open)) {
			return LIBUSB_ERROR_TIMEOUT;
		}
	}
	if (ep == 0x83) {
		if (c->vendor == 0x054c && atomic_load(&c->af_held) && !c->af_event && !atomic_load(&c->hold_focus)) {
			ptp_container event = { .length = PTP_CONTAINER_COMMAND_SIZE(1), .type = ptp_container_event, .code = ptp_event_sony_PropertyChanged };
			event.payload.params[0] = ptp_property_sony_FocusStatus;
			memcpy(data, &event, event.length);
			*length = event.length;
			c->af_event = true;
			return 0;
		}
		if (sony_dual_order && c->vendor == 0x054c && c->capturing && !c->event_sent) {
			ptp_container event = { .length = PTP_CONTAINER_COMMAND_SIZE(1), .type = ptp_container_event, .code = ptp_event_sony_PropertyChanged };
			memcpy(data, &event, event.length);
			*length = event.length;
			c->event_sent = true;
			return 0;
		}
		if (!sony_dual_order && c->vendor == 0x054c && c->capturing && !atomic_load(&c->hold_image)) {
			ptp_container event = { .length = PTP_CONTAINER_COMMAND_SIZE(1), .type = ptp_container_event, .code = ptp_event_sony_ObjectAdded };
			event.payload.params[0] = 0xffffc001;
			memcpy(data, &event, event.length);
			*length = event.length;
			c->event_sent = true;
			return 0;
		}
		if (olympus_native_events && c->vendor == 0x07b4 && (c->capturing || olympus_event_stage > 0) && olympus_event_stage < 4 && !c->bulb) {
			const uint16_t codes[] = { ptp_event_olympus_CaptureComplete, ptp_event_olympus_ObjectAdded, ptp_event_olympus_ObjectAddedLegacy, ptp_event_olympus_DevicePropChanged };
			ptp_container event = { .length = PTP_CONTAINER_COMMAND_SIZE(1), .type = ptp_container_event, .code = codes[olympus_event_stage] };
			event.payload.params[0] = olympus_event_stage == 0 ? 99 : olympus_event_stage == 3 ? ptp_property_olympus_Shutterspeed : olympus_event_stage;
			olympus_event_stage++;
			memcpy(data, &event, event.length);
			*length = event.length;
			return 0;
		}
		if (c->vendor == 0x07b4 && c->capturing && !c->bulb && !c->event_sent && !atomic_load(&c->hold_image)) {
			ptp_container event = { .length = PTP_CONTAINER_COMMAND_SIZE(1), .type = ptp_container_event, .code = ptp_event_ObjectAdded };
			event.payload.params[0] = 1;
			memcpy(data, &event, event.length);
			*length = event.length;
			c->event_sent = true;
			return 0;
		}
		return LIBUSB_ERROR_TIMEOUT;
	}
	if (ep == 0x02) {
		ptp_container *packet = (ptp_container *)data;
		if (packet->type == ptp_container_command) {
			memcpy(&c->command, packet, size);
			prepare(c);
		} else if (packet->type == ptp_container_data && c->response == ptp_response_OK) {
			uint32_t code = c->command.payload.params[0], v = 0;
			if (c->command.code == ptp_operation_canon_SetDevicePropValueEx) {
				memcpy(&code, packet->payload.data + 4, 4);
				memcpy(&v, packet->payload.data + 8, 4);
			} else {
				memcpy(&v, packet->payload.data, size - PTP_CONTAINER_HDR_SIZE < 4 ? size - PTP_CONTAINER_HDR_SIZE : 4);
			}
			uint32_t *target = value(c, code);
			if (c->command.code == ptp_operation_canon_SetDevicePropValueEx && code == ptp_property_canon_Artist) {
				unsigned length = size - PTP_CONTAINER_HDR_SIZE;
				memcpy(canon_text_payload, packet->payload.data, length < sizeof(canon_text_payload) ? length : sizeof(canon_text_payload));
				atomic_store(&canon_text_size, length);
			}
			if (c->command.code == ptp_operation_canon_SetDevicePropValueEx && code == ptp_property_canon_MirrorUpSetting) {
				atomic_fetch_add(&mirror_writes, 1);
				if (atomic_load(&mirror_reject) == 2 || (atomic_load(&mirror_reject) == 1 && target && *target == v)) {
					c->response = ptp_response_DeviceBusy;
					*length = size;
					return LIBUSB_SUCCESS;
				}
				atomic_store(&mirror_value, v);
			}
			// The ILCE-7RM4 acknowledges a SetControlDeviceA it drops while busy after a capture.
			if (c->command.code == ptp_operation_sony_SetControlDeviceA && atomic_load(&sony_dropped_writes) > 0) {
				atomic_fetch_sub(&sony_dropped_writes, 1);
				target = NULL;
			}
			// The X-T1, whose d208 actions lack BULB start and stop, rejects a Bulb ExposureTime.
			if (c->vendor == 0x04cb && code == ptp_property_ExposureTime && v == 0xffffffff && (fuji_action_profile == 1 || fuji_action_profile == 2)) {
				c->response = ptp_response_InvalidDevicePropValue;
				*length = size;
				return LIBUSB_SUCCESS;
			}
			if (target) {
				*target = v;
			}
			if (c->vendor == 0x04cb && code == ptp_property_fuji_AutoFocus) {
				if ((v == 0x0500 && fuji_reject_bulb) || (v == 0x0004 && fuji_reject_cancel)) {
					c->response = ptp_response_InvalidDevicePropValue;
					*length = size;
					return LIBUSB_SUCCESS;
				}
				c->fuji_mode = v;
				if (v == 0x0200) {
					atomic_store(&c->af_held, true);
				} else if (v == 0x0004 || v == 0x0304 || v == 0x0500) {
					atomic_store(&c->af_held, false);
				}
				if (v == 0x0500) {
					atomic_store(&fuji_bulb_started, 1);
				}
				if (v == 0x000c) {
					atomic_store(&c->held_us, (indigo_monotonic_time() - c->pressed_at) * 1000000);
					c->bulb = false;
				}
			}
			if (fuji_priority_profile && code == ptp_property_fuji_ControlPriority && v == 2) {
				*value(c, ptp_property_ExposureTime) = 32000000;
			}
			if (c->command.code == ptp_operation_sony_SetControlDeviceB && code == ptp_property_sony_NearFar) {
				atomic_store(&sony_focus_value, (int16_t)v);
			}
			if (c->command.code == ptp_operation_sony_SetControlDeviceB && code == ptp_property_sony_Autofocus) {
				atomic_store(&c->af_held, v == 2);
				c->af_event = false;
			}
			if (c->command.code == ptp_operation_sony_SetControlDeviceB && code == ptp_property_sony_Capture) {
				if (v == 2) {
					atomic_fetch_add(&sony_presses, 1);
					c->pressed_at = indigo_monotonic_time();
					if (atomic_load(&sony_object_queue) && atomic_load(&sony_ignored_presses) == 0) {
						atomic_fetch_add(&sony_queued_objects, 1);
					}
				}
				if (v == 2 && atomic_load(&sony_ignored_presses) > 0) {
					atomic_fetch_sub(&sony_ignored_presses, 1);
				} else if (v == 2) {
					c->capturing = true;
					c->event_sent = false;
					c->bulb = c->values[0] == 0;
					if (sony_dual_order) {
						sony_memory_objects = 2;
						c->values[3] = 0x8002;
					}
				} else {
					atomic_store(&c->held_us, (indigo_monotonic_time() - c->pressed_at) * 1000000);
					c->bulb = false;
				}
			}
		}
		*length = size;
		return 0;
	}
	if ((c->input_size || c->command.code == ptp_operation_canon_GetPartialObject) && !c->data_header_sent) {
		ptp_container packet = { .length = c->input_size + PTP_CONTAINER_HDR_SIZE, .type = ptp_container_data, .code = c->command.code, .transaction_id = c->command.transaction_id };
		unsigned chunk = c->input_size < (unsigned)(size - PTP_CONTAINER_HDR_SIZE) ? c->input_size : size - PTP_CONTAINER_HDR_SIZE;
		memcpy(packet.payload.data, c->input, chunk);
		memcpy(data, &packet, chunk + PTP_CONTAINER_HDR_SIZE);
		*length = chunk + PTP_CONTAINER_HDR_SIZE;
		c->input_offset = chunk;
		c->data_header_sent = true;
		return 0;
	}
	if (c->input_offset < c->input_size) {
		unsigned chunk = c->input_size - c->input_offset;
		if (chunk > (unsigned)size) {
			chunk = size;
		}
		memcpy(data, c->input + c->input_offset, chunk);
		*length = chunk;
		c->input_offset += chunk;
		return 0;
	}
	ptp_container packet = { .length = PTP_CONTAINER_HDR_SIZE, .type = ptp_container_response, .code = c->response, .transaction_id = c->command.transaction_id };
	if (atomic_load(&bad_response) && (c->command.code == ptp_operation_GetObject || c->command.code == ptp_operation_canon_GetObject)) {
		packet.transaction_id++;
	}
	memcpy(data, &packet, packet.length);
	*length = packet.length;
	return 0;
}

static bool valid_preview(indigo_item *item, bool histogram) {
	struct jpeg_decompress_struct info = { 0 };
	struct jpeg_error_mgr errors;
	info.err = jpeg_std_error(&errors);
	jpeg_create_decompress(&info);
	jpeg_mem_src(&info, item->blob.value, item->blob.size);
	bool valid = jpeg_read_header(&info, TRUE) == JPEG_HEADER_OK;
	valid = valid && !strcmp(item->blob.format, ".jpeg") && info.image_width > 0 && info.image_height > 0;
	if (histogram) {
		valid = valid && info.image_width == 256 && info.image_height == 128;
	}
	info.out_color_space = JCS_RGB;
	jpeg_start_decompress(&info);
	JSAMPARRAY row = (*info.mem->alloc_sarray)((j_common_ptr)&info, JPOOL_IMAGE, info.output_width * 3, 1);
	unsigned long sum = 0;
	while (info.output_scanline < info.output_height) {
		jpeg_read_scanlines(&info, row, 1);
		for (unsigned i = 0; i < info.output_width * 3; i++) {
			sum += row[0][i];
		}
	}
	jpeg_finish_decompress(&info);
	jpeg_destroy_decompress(&info);
	return valid && sum > 0;
}

static indigo_result image_update(indigo_client *client, indigo_device *device, indigo_property *property, const char *message) {
	if (device && device->master_device != device && !strcmp(property->name, CONNECTION_PROPERTY_NAME)) {
		atomic_store(&focus_connection_state, property->state);
	}
	if (device && device->master_device != device && !strcmp(property->name, FOCUSER_STEPS_PROPERTY_NAME)) {
		atomic_store(&focus_state, property->state);
	}
	if (device && device->master_device == device) {
		if (!strcmp(property->name, DSLR_LOCK_PROPERTY_NAME)) {
			atomic_store(&lock_state, property->state);
		} else if (!strcmp(property->name, DSLR_ZOOM_PREVIEW_PROPERTY_NAME)) {
			atomic_store(&zoom_state, property->state);
		} else if (!strcmp(property->name, DSLR_AF_PROPERTY_NAME)) {
			atomic_store(&af_state, property->state);
		} else if (!strcmp(property->name, DSLR_SET_HOST_TIME_PROPERTY_NAME)) {
			atomic_store(&host_time_state, property->state);
		}
		if (!strcmp(property->name, DSLR_SHUTTER_PROPERTY_NAME)) {
			atomic_store(&shutter_state, property->state);
		} else if (!strcmp(property->name, DSLR_ISO_PROPERTY_NAME)) {
			atomic_store(&iso_state, property->state);
		} else if (!strcmp(property->name, DSLR_CAPTURE_DESTINATION_PROPERTY_NAME)) {
			atomic_store(&destination_state, property->state);
		} else if (!strcmp(property->name, DSLR_EXPOSURE_COMPENSATION_PROPERTY_NAME)) {
			atomic_store(&bias_state, property->state);
		}
		if (!strcmp(property->name, CONNECTION_PROPERTY_NAME)) {
			atomic_store(&connection_state, property->state);
		} else if (!strcmp(property->name, CCD_EXPOSURE_PROPERTY_NAME)) {
			atomic_store(&exposure_state, property->state);
			if (property->state == INDIGO_BUSY_STATE) {
				atomic_store(&countdown_value, property->items->number.value);
			}
			atomic_fetch_add(&exposure_updates, 1);
		} else if (!strcmp(property->name, CCD_STREAMING_PROPERTY_NAME)) {
			atomic_store(&streaming_state, property->state);
			atomic_fetch_add(&streaming_updates, 1);
		}
	}
	if (!strcmp(property->name, CCD_IMAGE_FILE_PROPERTY_NAME)) {
		if (property->state == INDIGO_OK_STATE && atomic_load(&image_file_state) == INDIGO_BUSY_STATE && property->items->text.value[0]) {
			INDIGO_COPY_VALUE(saved_image_path, property->items->text.value);
			atomic_fetch_add(&saved_images, 1);
		}
		atomic_store(&image_file_state, property->state);
	}
	if (!strcmp(property->name, CCD_PREVIEW_HISTOGRAM_PROPERTY_NAME) && property->state == INDIGO_ALERT_STATE) {
		atomic_fetch_add(&histogram_alerts, 1);
	}
	if (!strcmp(property->name, CCD_PREVIEW_HISTOGRAM_PROPERTY_NAME) && property->state == INDIGO_OK_STATE && property->count && property->items->blob.value) {
		if (nikon_dual_profile && !valid_preview(property->items, true)) {
			atomic_fetch_add(&bad_preview, 1);
		}
		atomic_fetch_add(&histogram_blobs, 1);
	}
	if (!strcmp(property->name, CCD_PREVIEW_IMAGE_PROPERTY_NAME) && property->state == INDIGO_OK_STATE && property->count && property->items->blob.value) {
		if (nikon_dual_profile && !nikon_bad_jpeg && (!valid_preview(property->items, false) || (!nikon_raw_output && (property->items->blob.size != jpeg_size || memcmp(property->items->blob.value, jpeg, jpeg_size))))) {
			atomic_fetch_add(&bad_preview, 1);
		}
		atomic_fetch_add(&preview_blobs, 1);
	}
	if (!strcmp(property->name, CCD_IMAGE_PROPERTY_NAME) && property->state == INDIGO_OK_STATE && property->count && property->items->blob.value) {
		atomic_fetch_add(&blobs, 1);
		if (canon_transfer_event) {
			snprintf(canon_transfer_blob_format, sizeof(canon_transfer_blob_format), "%s", property->items->blob.format);
			if (atomic_load(command_count + ptp_operation_canon_TransferComplete) < atomic_load(&blobs)) {
				atomic_fetch_add(&canon_transfer_protocol_errors, 1);
			}
		}
		if (canon_transfer_large) {
			if (property->items->blob.size != 0x200000 + 17) {
				atomic_fetch_add(&bad_blob, 1);
			} else {
				const uint8_t *bytes = property->items->blob.value;
				for (unsigned i = 0; i < 0x200000 + 17; i++) {
					if (bytes[i] != (uint8_t)(i * 31 + 7)) {
						atomic_fetch_add(&bad_blob, 1);
						break;
					}
				}
			}
		} else if (nikon_dual_profile && nikon_raw_output) {
			indigo_raw_header *header = property->items->blob.value;
			if (property->items->blob.size < 64 * 64 * 2 + sizeof(indigo_raw_header) || property->items->blob.size > sizeof(captured_raw) || header->signature != INDIGO_RAW_MONO16 || header->width != 64 || header->height != 64) {
				atomic_fetch_add(&bad_blob, 1);
			} else {
				captured_raw_size = property->items->blob.size;
				memcpy(captured_raw, header, captured_raw_size);
				uint16_t *pixels = (uint16_t *)(header + 1);
				uint64_t actual = 0, expected = 0;
				for (unsigned i = 0; i < 64 * 64; i++) {
					actual += pixels[i];
					expected += ccd_test_noise(i, 0);
				}
				if (actual != expected) {
					atomic_fetch_add(&bad_blob, 1);
				}
			}
		} else if (property->items->blob.size != (nikon_dual_profile ? dng_size : jpeg_size) || memcmp(property->items->blob.value, nikon_dual_profile ? dng : jpeg, nikon_dual_profile ? dng_size : jpeg_size)) {
			atomic_fetch_add(&bad_blob, 1);
		}
	}
	return INDIGO_OK;
}

static indigo_client image_client = { .name = "PTP image observer", .version = INDIGO_VERSION_CURRENT, .update_property = image_update, .define_property = image_update };

static void reset_fake(uint16_t vendor, uint16_t product) {
	olympus_native_events = false;
	olympus_event_stage = 0;
	atomic_store(&canon_transfer_received, 0);
	atomic_store(&canon_transfer_first_request, 0);
	atomic_store(&canon_transfer_protocol_errors, 0);
	canon_transfer_blob_format[0] = 0;
	atomic_store(&mirror_reject, 0);
	atomic_store(&mirror_writes, 0);
	atomic_store(&mirror_value, 0);
	atomic_store(&mirror_suppress_events, mirror_unknown_profile);
	memset(cameras, 0, sizeof(cameras));
	memset(logical, 0, sizeof(logical));
	atomic_store(&blobs, 0);
	atomic_store(&preview_blobs, 0);
	atomic_store(&histogram_blobs, 0);
	atomic_store(&bad_preview, 0);
	atomic_store(&histogram_alerts, 0);
	atomic_store(&saved_images, 0);
	atomic_store(&image_file_state, INDIGO_OK_STATE);
	saved_image_path[0] = 0;
	atomic_store(&bad_blob, 0);
	atomic_store(&bus_io, 0);
	atomic_store(&calls_after_close, 0);
	atomic_store(&fail_operation, 0);
	atomic_store(&fail_once_operation, 0);
	atomic_store(&malformed, 0);
	atomic_store(&fail_reply, 0);
	atomic_store(&bad_response, 0);
	atomic_store(&gate_operation, 0);
	atomic_store(&gate_entered, 0);
	atomic_store(&gate_open, 0);
	memset(command_count, 0, sizeof(command_count));
	atomic_store(&offset_mode, 64);
	atomic_store(&canon_text_size, 0);
	canon_custom_func_sent = false;
	cameras[0].vendor = vendor;
	cameras[0].product = product;
	atomic_store(&cameras[0].visible, true);
	const uint16_t standard[] = { ptp_property_ExposureTime, ptp_property_ExposureIndex, ptp_property_ExposureBiasCompensation };
	const uint16_t canon[] = { ptp_property_canon_ShutterSpeed, ptp_property_canon_ISOSpeed, ptp_property_canon_AutoExposureMode, ptp_property_canon_DriveMode, ptp_property_canon_MirrorUpSetting, ptp_property_canon_CameraTime };
	const uint16_t fuji[] = { ptp_property_ExposureTime, ptp_property_ExposureIndex, ptp_property_ExposureBiasCompensation, ptp_property_fuji_ControlPriority };
	const uint16_t sony[] = { ptp_property_sony_ShutterSpeed, ptp_property_sony_FocusStatus, ptp_property_FocusMode, ptp_property_sony_ObjectInMemory };
	if (vendor == 0x04a9) {
		memcpy(cameras[0].properties, canon, sizeof(canon));
		cameras[0].values[0] = bulb_profile ? 0x0c : 0x60;
		cameras[0].values[2] = bulb_profile ? 4 : 0;
		cameras[0].values[1] = 0x48;
		if (destination_profile) {
			cameras[0].properties[7] = 0;
			cameras[0].properties[6] = ptp_property_canon_CaptureDestination;
			cameras[0].values[6] = 6;
			atomic_store(&fail_operation, destination_failure);
		}
		if (dual_profile) {
			cameras[0].properties[6] = ptp_property_canon_ImageFormat;
		}
		if (canon_custom_func_profile) {
			cameras[0].properties[6] = ptp_property_canon_CustomFuncEx;
		}
	} else if (vendor == 0x04cb) {
		memcpy(cameras[0].properties, fuji, sizeof(fuji));
		cameras[0].values[0] = bulb_profile ? 0xffffffff : 10000;
		cameras[0].values[1] = 100;
		cameras[0].values[3] = fuji_priority_profile ? 1 : 0;
		atomic_store(&fuji_shutter_readback, 0);
		atomic_store(&fuji_bulb_started, 0);
	} else if (vendor == 0x054c) {
		memcpy(cameras[0].properties, sony, sizeof(sony));
		cameras[0].values[0] = bulb_profile ? 0 : sony_long_shutter ? 0x10001 : 0x10064;
		cameras[0].values[1] = 2;
		cameras[0].values[2] = autofocus_profile ? 2 : 1;
		if (sony_dual_order) {
			cameras[0].properties[4] = ptp_property_sony_CompressionSetting;
			cameras[0].values[4] = 2;
		}
		if (sony_compression_profile) {
			cameras[0].properties[4] = ptp_property_sony_CompressionSetting;
			cameras[0].values[4] = 3;
		}
	} else {
		memcpy(cameras[0].properties, standard, sizeof(standard));
		cameras[0].values[0] = bulb_profile ? 0xffffffff : 10000;
		cameras[0].values[1] = 100;
		if (nikon_dual_profile) {
			cameras[0].properties[3] = ptp_property_CompressionSetting;
			cameras[0].values[3] = 7;
		}
		if (descriptor_fault) {
			cameras[0].properties[3] = ptp_property_WhiteBalance;
			cameras[0].properties[4] = ptp_property_ImageSize;
		}
		if (vendor == 0x07b4 && bulb_profile) {
			cameras[0].properties[3] = ptp_property_olympus_Shutterspeed;
			cameras[0].values[3] = 0xffffffff;
		}
	}
}

static bool wait_value(atomic_int *value, int expected) {
	double deadline = indigo_monotonic_time() + 5;
	while (atomic_load(value) != expected && indigo_monotonic_time() < deadline) {
		indigo_usleep(10000);
	}
	return atomic_load(value) == expected;
}

static bool wait_value_long(atomic_int *value, int expected) {
	return wait_value(value, expected) || wait_value(value, expected);
}

#define PTP_CHECK(condition) do { if (!(condition)) { fprintf(stderr, "%s:%d: %s\n", __FILE__, __LINE__, #condition); indigo_test_failures++; goto cleanup; } } while (0)

static bool begin_profile(uint16_t vendor, uint16_t product) {
	reset_fake(vendor, product);
	bus_thread = pthread_self();
	reset_simulator_context(profile_case ? profile_case : &ptp_case);
	atomic_store(&connection_state, INDIGO_OK_STATE);
	atomic_store(&exposure_state, INDIGO_OK_STATE);
	atomic_store(&streaming_state, INDIGO_OK_STATE);
	atomic_store(&exposure_updates, 0);
	atomic_store(&streaming_updates, 0);
	if (indigo_start() != INDIGO_OK) {
		return false;
	}
	indigo_attach_client(&simulator_test_client);
	indigo_attach_client(&image_client);
	if (indigo_ccd_ptp(INDIGO_DRIVER_INIT, NULL) != INDIGO_OK || !wait_value(&attached, 1)) {
		return false;
	}
	indigo_change_switch_property_1(&simulator_test_client, logical[0]->name, CONNECTION_PROPERTY_NAME, CONNECTION_CONNECTED_ITEM_NAME, true);
	return wait_value(&connection_state, INDIGO_OK_STATE);
}

static void end_profile(void) {
	profile_case = NULL;
	mirror_unknown_profile = false;
	bulb_profile = false;
	sony_long_shutter = false;
	atomic_store(&sony_object_queue, false);
	atomic_store(&sony_queued_objects, 0);
	sony_liveview_denial = sony_liveview_denied_until = 0;
	fuji_priority_profile = fuji_reject_bulb = fuji_af_error = fuji_reject_cancel = false;
	fuji_action_profile = 0;
	dual_profile = false;
	nikon_dual_profile = nikon_raw_output = nikon_bad_jpeg = false;
	sony_dual_order = sony_memory_objects = 0;
	hold_raw = false;
	autofocus_profile = false;
	partial_profile = 0;
	destination_profile = destination_failure = 0;
	combined_transfer_profile = false;
	canon_transfer_event = 0;
	canon_transfer_format = 0xB108;
	canon_transfer_filename = "IMG_778.CR3";
	canon_transfer_fault = 0;
	canon_transfer_large = false;
	device_info_fault = descriptor_fault = canon_custom_func_fault = object_info_delta = 0;
	sony_extension_fault = canon_info_ex_fault = object_info_short = canon_custom_func_profile = sony_compression_profile = false;
	atomic_store(&sony_dropped_writes, 0);
	atomic_store(&sony_ignored_presses, 0);
	atomic_store(&sony_presses, 0);
	atomic_store(&sony_fast_reopen_busy, false);
	for (int i = 0; i < FAKE_CAMERAS; i++) {
		cameras[i].closed_at = 0;
		atomic_store(&cameras[i].stuck_busy, false);
	}
	atomic_store(&gate_open, 1);
	atomic_store(&gate_operation, 0);
	atomic_store(&fail_register, 0);
	atomic_store(&fail_open, 0);
	atomic_store(&fail_claim, 0);
	atomic_store(&fail_attach, 0);
	atomic_store(&fail_operation, 0);
	for (unsigned i = 0; i < FAKE_CAMERAS; i++) {
		atomic_store(&cameras[i].hold_image, false);
		atomic_store(&cameras[i].hold_focus, false);
		if (callback && logical[i]) {
			callback(NULL, (libusb_device *)(cameras + i), LIBUSB_HOTPLUG_EVENT_DEVICE_LEFT, NULL);
		}
	}
	wait_value(&attached, 0);
	indigo_ccd_ptp(INDIGO_DRIVER_SHUTDOWN, NULL);
	indigo_detach_client(&image_client);
	indigo_detach_client(&simulator_test_client);
	indigo_stop();
	release_cached_properties();
}

static void profile(uint16_t vendor, uint16_t product) {
	PTP_CHECK(begin_profile(vendor, product));
	indigo_change_number_property_1(&simulator_test_client, logical[0]->name, CCD_EXPOSURE_PROPERTY_NAME, CCD_EXPOSURE_ITEM_NAME, 0.02);
	PTP_CHECK(wait_value(&exposure_state, INDIGO_OK_STATE));
	fprintf(stderr, "profile %04x: blobs=%d state=%d frames=%d\n", vendor, atomic_load(&blobs), atomic_load(&exposure_state), atomic_load(&cameras[0].frames));
	PTP_CHECK(atomic_load(&blobs) == 1);
	PTP_CHECK(atomic_load(&bad_blob) == 0);
	indigo_change_switch_property_1(&simulator_test_client, logical[0]->name, CONNECTION_PROPERTY_NAME, CONNECTION_DISCONNECTED_ITEM_NAME, true);
	PTP_CHECK(wait_value(&connection_state, INDIGO_OK_STATE));
cleanup:
	end_profile();
	ASSERT_EQ_INT(atomic_load(&cameras[0].opens), atomic_load(&cameras[0].closes));
	ASSERT_EQ_INT(0, atomic_load(&cameras[0].refs));
	ASSERT_EQ_INT(0, atomic_load(&bus_io));
	ASSERT_EQ_INT(0, atomic_load(&calls_after_close));
}

static void canon_exposure(void) {
	profile(0x04a9, 0x3218);
}

static void nikon_exposure(void) {
	profile(0x04b0, 0x0421);
}

static void fuji_exposure(void) {
	profile(0x04cb, 0x02bf);
}

static void sony_exposure(void) {
	profile(0x054c, 0x0d18);
}

static void olympus_exposure(void) {
	profile(0x07b4, 0x0136);
}

enum { SC_STREAM, SC_ABORT, SC_START_ERROR, SC_TIMEOUT, SC_RECONNECT, SC_BAD_RESPONSE, SC_UNPLUG, SC_DISCONNECT, SC_STREAM_ERROR, SC_STREAM_BAD };

static void exercise(uint16_t vendor, uint16_t product, int scenario) {
	fprintf(stderr, "exercise vendor=%04x scenario=%d\n", vendor, scenario);
	PTP_CHECK(begin_profile(vendor, product));
	if (scenario == SC_STREAM_ERROR || scenario == SC_STREAM_BAD) {
		uint16_t op = vendor == 0x04a9 ? ptp_operation_canon_GetViewFinderData : vendor == 0x04b0 ? ptp_operation_nikon_GetLiveViewImg : vendor == 0x07b4 ? ptp_operation_olympus_GetLiveViewImage : ptp_operation_GetObject;
		if (scenario == SC_STREAM_BAD) {
			atomic_store(&malformed, 1);
		} else {
			atomic_store(&fail_operation, op);
		}
		indigo_change_number_property_1(&simulator_test_client, logical[0]->name, CCD_STREAMING_PROPERTY_NAME, CCD_STREAMING_COUNT_ITEM_NAME, 1);
		PTP_CHECK(wait_value(&streaming_state, INDIGO_ALERT_STATE) || (vendor == 0x07b4 && wait_value(&streaming_state, INDIGO_ALERT_STATE)));
		atomic_store(&fail_operation, 0);
		atomic_store(&malformed, 0);
		indigo_change_number_property_1(&simulator_test_client, logical[0]->name, CCD_STREAMING_PROPERTY_NAME, CCD_STREAMING_COUNT_ITEM_NAME, 1);
		PTP_CHECK(wait_value(&streaming_state, INDIGO_OK_STATE));
		PTP_CHECK(atomic_load(&bad_blob) == 0);
	} else if (scenario == SC_STREAM) {
		indigo_change_number_property_1(&simulator_test_client, logical[0]->name, CCD_STREAMING_SETTINGS_PROPERTY_NAME, CCD_STREAMING_SETTINGS_UPDATE_LIMIT_ITEM_NAME, 0);
		indigo_change_number_property_1(&simulator_test_client, logical[0]->name, CCD_STREAMING_PROPERTY_NAME, CCD_STREAMING_COUNT_ITEM_NAME, 3);
		PTP_CHECK(wait_value(&streaming_state, INDIGO_OK_STATE));
		PTP_CHECK(atomic_load(&blobs) == 3);
		PTP_CHECK(atomic_load(&bad_blob) == 0);
		indigo_change_number_property_1(&simulator_test_client, logical[0]->name, CCD_STREAMING_PROPERTY_NAME, CCD_STREAMING_COUNT_ITEM_NAME, -1);
		PTP_CHECK(wait_value(&streaming_state, INDIGO_BUSY_STATE));
		indigo_change_switch_property_1(&simulator_test_client, logical[0]->name, CCD_ABORT_EXPOSURE_PROPERTY_NAME, CCD_ABORT_EXPOSURE_ITEM_NAME, true);
		PTP_CHECK(wait_value(&streaming_state, INDIGO_OK_STATE));
		indigo_change_number_property_1(&simulator_test_client, logical[0]->name, CCD_STREAMING_PROPERTY_NAME, CCD_STREAMING_COUNT_ITEM_NAME, 1);
		PTP_CHECK(wait_value(&streaming_state, INDIGO_OK_STATE));
	} else {
		if (scenario == SC_ABORT || scenario == SC_TIMEOUT || scenario == SC_UNPLUG || scenario == SC_DISCONNECT) {
			atomic_store(&cameras[0].hold_image, true);
		}
		if (scenario == SC_START_ERROR) {
			atomic_store(&fail_operation, vendor == 0x04a9 ? ptp_operation_canon_RemoteReleaseOn : vendor == 0x04b0 ? ptp_operation_nikon_InitiateCaptureRecInMedia : vendor == 0x04cb ? ptp_operation_InitiateCapture : vendor == 0x054c ? ptp_operation_sony_SetControlDeviceB : ptp_operation_olympus_Capture);
		}
		if (scenario == SC_BAD_RESPONSE) {
			atomic_store(&bad_response, 1);
		}
		indigo_change_number_property_1(&simulator_test_client, logical[0]->name, CCD_EXPOSURE_PROPERTY_NAME, CCD_EXPOSURE_ITEM_NAME, 0.02);
		if (scenario == SC_UNPLUG || scenario == SC_DISCONNECT) {
			PTP_CHECK(wait_value(&exposure_state, INDIGO_BUSY_STATE));
			if (scenario == SC_UNPLUG) {
				callback(NULL, (libusb_device *)cameras, LIBUSB_HOTPLUG_EVENT_DEVICE_LEFT, NULL);
				PTP_CHECK(wait_value(&attached, 0));
				goto cleanup;
			}
			indigo_change_switch_property_1(&simulator_test_client, logical[0]->name, CONNECTION_PROPERTY_NAME, CONNECTION_DISCONNECTED_ITEM_NAME, true);
			PTP_CHECK(wait_value(&connection_state, INDIGO_OK_STATE));
			atomic_store(&cameras[0].hold_image, false);
			indigo_change_switch_property_1(&simulator_test_client, logical[0]->name, CONNECTION_PROPERTY_NAME, CONNECTION_CONNECTED_ITEM_NAME, true);
			PTP_CHECK(wait_value(&connection_state, INDIGO_OK_STATE));
		}
		if (scenario == SC_ABORT) {
			PTP_CHECK(wait_value(&exposure_state, INDIGO_BUSY_STATE));
			PTP_CHECK(indigo_ccd_ptp(INDIGO_DRIVER_SHUTDOWN, NULL) == INDIGO_BUSY);
			indigo_change_number_property_1(&simulator_test_client, logical[0]->name, CCD_EXPOSURE_PROPERTY_NAME, CCD_EXPOSURE_ITEM_NAME, 0.5);
			indigo_change_number_property_1(&simulator_test_client, logical[0]->name, CCD_STREAMING_PROPERTY_NAME, CCD_STREAMING_COUNT_ITEM_NAME, 3);
			indigo_change_switch_property_1(&simulator_test_client, logical[0]->name, CCD_ABORT_EXPOSURE_PROPERTY_NAME, CCD_ABORT_EXPOSURE_ITEM_NAME, true);
			// NEW_API Sony must be allowed to receive and drain its object.
			if (vendor == 0x054c) {
				atomic_store(&cameras[0].hold_image, false);
			}
		}
		if (scenario != SC_DISCONNECT) {
			PTP_CHECK(wait_value(&exposure_state, scenario == SC_RECONNECT ? INDIGO_OK_STATE : INDIGO_ALERT_STATE));
		}
		if (scenario == SC_RECONNECT) {
			indigo_change_switch_property_1(&simulator_test_client, logical[0]->name, CONNECTION_PROPERTY_NAME, CONNECTION_DISCONNECTED_ITEM_NAME, true);
			PTP_CHECK(wait_value(&connection_state, INDIGO_OK_STATE));
			indigo_change_switch_property_1(&simulator_test_client, logical[0]->name, CONNECTION_PROPERTY_NAME, CONNECTION_CONNECTED_ITEM_NAME, true);
			PTP_CHECK(wait_value(&connection_state, INDIGO_OK_STATE));
		}
		atomic_store(&fail_operation, 0);
		atomic_store(&bad_response, 0);
		atomic_store(&cameras[0].hold_image, false);
		indigo_change_number_property_1(&simulator_test_client, logical[0]->name, CCD_EXPOSURE_PROPERTY_NAME, CCD_EXPOSURE_ITEM_NAME, 0.02);
		PTP_CHECK(wait_value(&exposure_state, INDIGO_OK_STATE));
	}
cleanup:
	end_profile();
	ASSERT_EQ_INT(0, atomic_load(&bus_io));
	ASSERT_EQ_INT(0, atomic_load(&calls_after_close));
	ASSERT_EQ_INT(atomic_load(&cameras[0].opens), atomic_load(&cameras[0].closes));
	ASSERT_EQ_INT(0, atomic_load(&cameras[0].refs));
}

static void canon_stream(void) {
	exercise(1193, 12824, SC_STREAM);
}

static void canon_abort(void) {
	exercise(1193, 12824, SC_ABORT);
}

static void canon_start_error(void) {
	exercise(1193, 12824, SC_START_ERROR);
}

static void canon_timeout(void) {
	exercise(1193, 12824, SC_TIMEOUT);
}

static void canon_reconnect(void) {
	exercise(1193, 12824, SC_RECONNECT);
}

static void nikon_stream(void) {
	exercise(1200, 1057, SC_STREAM);
}

static void nikon_abort(void) {
	exercise(1200, 1057, SC_ABORT);
}

static void nikon_start_error(void) {
	exercise(1200, 1057, SC_START_ERROR);
}

static void nikon_timeout(void) {
	exercise(1200, 1057, SC_TIMEOUT);
}

static void nikon_reconnect(void) {
	exercise(1200, 1057, SC_RECONNECT);
}

static void fuji_stream(void) {
	exercise(1227, 703, SC_STREAM);
}

static void fuji_abort(void) {
	exercise(1227, 703, SC_ABORT);
}

static void fuji_start_error(void) {
	exercise(1227, 703, SC_START_ERROR);
}

static void fuji_timeout(void) {
	exercise(1227, 703, SC_TIMEOUT);
}

static void fuji_reconnect(void) {
	exercise(1227, 703, SC_RECONNECT);
}

static void sony_stream(void) {
	exercise(1356, 3352, SC_STREAM);
}

static void sony_abort(void) {
	exercise(1356, 3352, SC_ABORT);
}

static void sony_start_error(void) {
	exercise(1356, 3352, SC_START_ERROR);
}

static void sony_timeout(void) {
	exercise(1356, 3352, SC_TIMEOUT);
}

static void sony_reconnect(void) {
	exercise(1356, 3352, SC_RECONNECT);
}

static void olympus_stream(void) {
	exercise(1972, 310, SC_STREAM);
}

static void olympus_abort(void) {
	exercise(1972, 310, SC_ABORT);
}

static void olympus_start_error(void) {
	exercise(1972, 310, SC_START_ERROR);
}

static void olympus_timeout(void) {
	exercise(1972, 310, SC_TIMEOUT);
}

static void olympus_reconnect(void) {
	exercise(1972, 310, SC_RECONNECT);
}

static void canon_bad_response(void) {
	exercise(1193, 12824, SC_BAD_RESPONSE);
}

static void canon_active_unplug(void) {
	exercise(1193, 12824, SC_UNPLUG);
}

static void canon_active_disconnect(void) {
	exercise(1193, 12824, SC_DISCONNECT);
}

static void nikon_bad_response(void) {
	exercise(1200, 1057, SC_BAD_RESPONSE);
}

static void nikon_active_unplug(void) {
	exercise(1200, 1057, SC_UNPLUG);
}

static void nikon_active_disconnect(void) {
	exercise(1200, 1057, SC_DISCONNECT);
}

static void fuji_bad_response(void) {
	exercise(1227, 703, SC_BAD_RESPONSE);
}

static void fuji_active_unplug(void) {
	exercise(1227, 703, SC_UNPLUG);
}

static void fuji_active_disconnect(void) {
	exercise(1227, 703, SC_DISCONNECT);
}

static void sony_bad_response(void) {
	exercise(1356, 3352, SC_BAD_RESPONSE);
}

static void sony_active_unplug(void) {
	exercise(1356, 3352, SC_UNPLUG);
}

static void sony_active_disconnect(void) {
	exercise(1356, 3352, SC_DISCONNECT);
}

static void olympus_bad_response(void) {
	exercise(1972, 310, SC_BAD_RESPONSE);
}

static void olympus_active_unplug(void) {
	exercise(1972, 310, SC_UNPLUG);
}

static void olympus_active_disconnect(void) {
	exercise(1972, 310, SC_DISCONNECT);
}

static void canon_bulb_timing(void) {
	bulb_profile = true;
	PTP_CHECK(begin_profile(0x04a9, 0x3218));
	const double durations[] = { 0.02, 1.25 };
	for (unsigned i = 0; i < ARRAY_SIZE(durations); i++) {
		int unlocks = atomic_load(command_count + ptp_operation_canon_ResetUILock);
		indigo_change_number_property_1(&simulator_test_client, logical[0]->name, CCD_EXPOSURE_PROPERTY_NAME, CCD_EXPOSURE_ITEM_NAME, durations[i]);
		PTP_CHECK(wait_value(&exposure_state, INDIGO_OK_STATE));
		double measured = atomic_load(&cameras[0].held_us) / 1000000.0;
		fprintf(stderr, "Canon fake shutter: requested %.3f measured %.6f s\n", durations[i], measured);
		PTP_CHECK(measured >= durations[i] - 0.005 && measured < durations[i] + 0.15);
		PTP_CHECK(atomic_load(command_count + ptp_operation_canon_ResetUILock) == unlocks + 1);
	}
	indigo_change_number_property_1(&simulator_test_client, logical[0]->name, CCD_EXPOSURE_PROPERTY_NAME, CCD_EXPOSURE_ITEM_NAME, 1.25);
	PTP_CHECK(wait_value(&exposure_state, INDIGO_BUSY_STATE));
	indigo_change_switch_property_1(&simulator_test_client, logical[0]->name, CCD_ABORT_EXPOSURE_PROPERTY_NAME, CCD_ABORT_EXPOSURE_ITEM_NAME, true);
	PTP_CHECK(wait_value(&exposure_state, INDIGO_ALERT_STATE));
	indigo_change_number_property_1(&simulator_test_client, logical[0]->name, CCD_EXPOSURE_PROPERTY_NAME, CCD_EXPOSURE_ITEM_NAME, 0.02);
	PTP_CHECK(wait_value(&exposure_state, INDIGO_OK_STATE));
cleanup:
	end_profile();
	ASSERT_EQ_INT(0, atomic_load(&bus_io));
	ASSERT_EQ_INT(0, atomic_load(&calls_after_close));
	ASSERT_EQ_INT(0, atomic_load(&cameras[0].refs));
}

static void focus_profile(uint16_t vendor, uint16_t product) {
	PTP_CHECK(begin_profile(vendor, product));
	indigo_device *focuser = ((ptp_private_data *)logical[0]->private_data)->focuser;
	PTP_CHECK(focuser != NULL);
	atomic_store(&focus_connection_state, INDIGO_OK_STATE);
	indigo_change_switch_property_1(&simulator_test_client, focuser->name, CONNECTION_PROPERTY_NAME, CONNECTION_CONNECTED_ITEM_NAME, true);
	PTP_CHECK(wait_value(&focus_connection_state, INDIGO_OK_STATE));
	const char *directions[] = { FOCUSER_DIRECTION_MOVE_INWARD_ITEM_NAME, FOCUSER_DIRECTION_MOVE_OUTWARD_ITEM_NAME };
	for (unsigned i = 0; i < ARRAY_SIZE(directions); i++) {
		indigo_change_switch_property_1(&simulator_test_client, focuser->name, FOCUSER_DIRECTION_PROPERTY_NAME, directions[i], true);
		indigo_change_number_property_1(&simulator_test_client, focuser->name, FOCUSER_STEPS_PROPERTY_NAME, FOCUSER_STEPS_ITEM_NAME, 3);
		PTP_CHECK(wait_value(&focus_state, INDIGO_OK_STATE));
		if (vendor == 0x04a9) {
			PTP_CHECK(atomic_load(command_argument + ptp_operation_canon_DriveLens) == (i ? 0x8001 : 1));
		} else if (vendor == 0x04b0) {
			PTP_CHECK(atomic_load(command_argument + ptp_operation_nikon_MfDrive) == (i ? 1 : 2));
		} else if (vendor == 0x07b4) {
			PTP_CHECK(atomic_load(command_argument + ptp_operation_olympus_MFDrive) == (i ? 2 : 1));
		} else {
			PTP_CHECK(atomic_load(&sony_focus_value) == (i ? 1 : -1));
		}
	}
	if (vendor == 0x04a9 || vendor == 0x054c) {
		indigo_change_number_property_1(&simulator_test_client, focuser->name, FOCUSER_STEPS_PROPERTY_NAME, FOCUSER_STEPS_ITEM_NAME, 100);
		PTP_CHECK(wait_value(&focus_state, INDIGO_BUSY_STATE));
		indigo_change_switch_property_1(&simulator_test_client, focuser->name, FOCUSER_ABORT_MOTION_PROPERTY_NAME, FOCUSER_ABORT_MOTION_ITEM_NAME, true);
		PTP_CHECK(wait_value(&focus_state, INDIGO_OK_STATE));
		indigo_change_number_property_1(&simulator_test_client, focuser->name, FOCUSER_STEPS_PROPERTY_NAME, FOCUSER_STEPS_ITEM_NAME, 100);
		PTP_CHECK(wait_value(&focus_state, INDIGO_BUSY_STATE));
		indigo_change_switch_property_1(&simulator_test_client, focuser->name, CONNECTION_PROPERTY_NAME, CONNECTION_DISCONNECTED_ITEM_NAME, true);
		PTP_CHECK(wait_value(&focus_connection_state, INDIGO_OK_STATE));
		PTP_CHECK(wait_value(&focus_state, INDIGO_ALERT_STATE));
	}
cleanup:
	end_profile();
	ASSERT_EQ_INT(0, atomic_load(&bus_io));
	ASSERT_EQ_INT(0, atomic_load(&calls_after_close));
	ASSERT_EQ_INT(0, atomic_load(&cameras[0].refs));
}

static void canon_focus(void) {
	focus_profile(1193, 12824);
}

static void nikon_focus(void) {
	focus_profile(1200, 1057);
}

static void sony_focus(void) {
	focus_profile(1356, 3352);
}

static void olympus_focus(void) {
	focus_profile(1972, 310);
}

static void discovery_capacity(void) {
	PTP_CHECK(begin_profile(0x04a9, 0x3218));
	callback(NULL, (libusb_device *)cameras, LIBUSB_HOTPLUG_EVENT_DEVICE_ARRIVED, NULL);
	PTP_CHECK(wait_value(&cameras[0].refs, 1));
	PTP_CHECK(atomic_load(&attached) == 1);
	for (unsigned i = 1; i < FAKE_CAMERAS; i++) {
		cameras[i].vendor = 0x04a9;
		cameras[i].product = 0x3218;
		callback(NULL, (libusb_device *)(cameras + i), LIBUSB_HOTPLUG_EVENT_DEVICE_ARRIVED, NULL);
		PTP_CHECK(wait_value(&cameras[i].refs, i < 4 ? 1 : 0));
	}
	PTP_CHECK(wait_value(&attached, 4));
cleanup:
	end_profile();
	for (unsigned i = 0; i < FAKE_CAMERAS; i++) {
		ASSERT_EQ_INT(0, atomic_load(&cameras[i].refs));
		ASSERT_EQ_INT(atomic_load(&cameras[i].opens), atomic_load(&cameras[i].closes));
	}
	ASSERT_EQ_INT(0, atomic_load(&calls_after_close));
}

static void discovery_reject_and_retry(void) {
	PTP_CHECK(begin_profile(0x04a9, 0x3218));
	cameras[1].vendor = 0xffff;
	cameras[1].product = 1;
	callback(NULL, (libusb_device *)(cameras + 1), LIBUSB_HOTPLUG_EVENT_DEVICE_ARRIVED, NULL);
	PTP_CHECK(wait_value(&cameras[1].refs, 0));
	PTP_CHECK(atomic_load(&attached) == 1);
	cameras[1].vendor = 0x04a9;
	cameras[1].product = 0x3218;
	atomic_store(&fail_attach, 1);
	callback(NULL, (libusb_device *)(cameras + 1), LIBUSB_HOTPLUG_EVENT_DEVICE_ARRIVED, NULL);
	PTP_CHECK(wait_value(&cameras[1].refs, 0));
	PTP_CHECK(atomic_load(&attached) == 1);
	atomic_store(&fail_attach, 0);
	callback(NULL, (libusb_device *)(cameras + 1), LIBUSB_HOTPLUG_EVENT_DEVICE_ARRIVED, NULL);
	PTP_CHECK(wait_value(&attached, 2));
cleanup:
	end_profile();
	ASSERT_EQ_INT(0, atomic_load(&cameras[0].refs));
	ASSERT_EQ_INT(0, atomic_load(&cameras[1].refs));
	ASSERT_EQ_INT(0, atomic_load(&calls_after_close));
}

static void canon_destination_check(int profile, int failure) {
	destination_profile = profile;
	destination_failure = failure;
	bool connected = begin_profile(0x04a9, 0x3218);
	if (failure) {
		PTP_CHECK(!connected);
		PTP_CHECK(wait_value(&connection_state, INDIGO_ALERT_STATE));
		PTP_CHECK(!atomic_load(&cameras[0].opened));
	} else {
		PTP_CHECK(connected);
		indigo_property *property = find_cached_property(DSLR_CAPTURE_DESTINATION_PROPERTY_NAME);
		PTP_CHECK(property != NULL);
		int selected = 0;
		for (int i = 0; i < property->count; i++) {
			selected += property->items[i].sw.value;
		}
		PTP_CHECK(selected == 1);
		PTP_CHECK(*value(cameras, ptp_property_canon_CaptureDestination) == (profile == 3 ? 2 : 4));
		PTP_CHECK(find_cached_item(DSLR_CAPTURE_DESTINATION_PROPERTY_NAME, profile == 3 ? "2" : "4")->sw.value);
	}
cleanup:
	end_profile();
}

static void canon_destination_prefers_ram(void) {
	canon_destination_check(1, 0);
}

static void canon_destination_ram_only(void) {
	canon_destination_check(2, 0);
}

static void canon_destination_card_only(void) {
	canon_destination_check(3, 0);
}

static void canon_destination_write_error(void) {
	canon_destination_check(1, ptp_operation_canon_SetDevicePropValueEx);
}

static void canon_destination_capacity_error(void) {
	canon_destination_check(1, ptp_operation_canon_PCHDDCapacity);
}

static void canon_destination_change_check(bool fail_capacity) {
	destination_profile = 1;
	PTP_CHECK(begin_profile(0x04a9, 0x3218));
	int capacity = atomic_load(command_count + ptp_operation_canon_PCHDDCapacity);
	PTP_CHECK(capacity == 1);
	atomic_store(&destination_state, INDIGO_IDLE_STATE);
	indigo_change_switch_property_1(&simulator_test_client, logical[0]->name, DSLR_CAPTURE_DESTINATION_PROPERTY_NAME, "2", true);
	PTP_CHECK(wait_value(&destination_state, INDIGO_OK_STATE));
	PTP_CHECK(*value(cameras, ptp_property_canon_CaptureDestination) == 2);
	PTP_CHECK(atomic_load(command_count + ptp_operation_canon_PCHDDCapacity) == capacity);
	if (fail_capacity) {
		atomic_store(&fail_operation, ptp_operation_canon_PCHDDCapacity);
	}
	atomic_store(&destination_state, INDIGO_IDLE_STATE);
	indigo_change_switch_property_1(&simulator_test_client, logical[0]->name, DSLR_CAPTURE_DESTINATION_PROPERTY_NAME, "4", true);
	PTP_CHECK(wait_value(&destination_state, fail_capacity ? INDIGO_ALERT_STATE : INDIGO_OK_STATE));
	PTP_CHECK(atomic_load(command_count + ptp_operation_canon_PCHDDCapacity) == capacity + 1);
	PTP_CHECK(*value(cameras, ptp_property_canon_CaptureDestination) == 4);
	if (fail_capacity) {
		atomic_store(&fail_operation, 0);
		atomic_store(&destination_state, INDIGO_IDLE_STATE);
		indigo_change_switch_property_1(&simulator_test_client, logical[0]->name, DSLR_CAPTURE_DESTINATION_PROPERTY_NAME, "4", true);
		PTP_CHECK(wait_value(&destination_state, INDIGO_OK_STATE));
		PTP_CHECK(atomic_load(command_count + ptp_operation_canon_PCHDDCapacity) == capacity + 2);
	}
	indigo_change_number_property_1(&simulator_test_client, logical[0]->name, CCD_EXPOSURE_PROPERTY_NAME, CCD_EXPOSURE_ITEM_NAME, 0.02);
	PTP_CHECK(wait_value(&exposure_state, INDIGO_OK_STATE));
cleanup:
	end_profile();
}

static void canon_destination_change_capacity(void) {
	canon_destination_change_check(false);
}

static void canon_destination_change_capacity_recovery(void) {
	canon_destination_change_check(true);
}

static void canon_stream_not_ready(void) {
	PTP_CHECK(begin_profile(0x04a9, 0x3218));
	atomic_store(&fail_reply, ptp_response_canon_NotReady);
	atomic_store(&fail_once_operation, ptp_operation_canon_GetViewFinderData);
	indigo_change_number_property_1(&simulator_test_client, logical[0]->name, CCD_STREAMING_SETTINGS_PROPERTY_NAME, CCD_STREAMING_SETTINGS_UPDATE_LIMIT_ITEM_NAME, 0);
	indigo_change_number_property_1(&simulator_test_client, logical[0]->name, CCD_STREAMING_PROPERTY_NAME, CCD_STREAMING_COUNT_ITEM_NAME, 3);
	PTP_CHECK(wait_value(&streaming_state, INDIGO_OK_STATE));
	PTP_CHECK(atomic_load(&blobs) == 3);
	PTP_CHECK(atomic_load(command_count + ptp_operation_canon_GetViewFinderData) == 4);
	PTP_CHECK(((ptp_private_data *)logical[0]->private_data)->stream_retries == 0);
cleanup:
	end_profile();
}

static void canon_stream_not_ready_recovery(void) {
	PTP_CHECK(begin_profile(0x04a9, 0x3218));
	atomic_store(&fail_reply, ptp_response_canon_NotReady);
	atomic_store(&fail_operation, ptp_operation_canon_GetViewFinderData);
	indigo_change_number_property_1(&simulator_test_client, logical[0]->name, CCD_STREAMING_PROPERTY_NAME, CCD_STREAMING_COUNT_ITEM_NAME, 1);
	PTP_CHECK(wait_value(&streaming_state, INDIGO_ALERT_STATE) || wait_value(&streaming_state, INDIGO_ALERT_STATE));
	PTP_CHECK(atomic_load(command_count + ptp_operation_canon_GetViewFinderData) == 101);
	int calls = atomic_load(command_count + ptp_operation_canon_GetViewFinderData);
	indigo_change_number_property_1(&simulator_test_client, logical[0]->name, CCD_STREAMING_PROPERTY_NAME, CCD_STREAMING_COUNT_ITEM_NAME, -1);
	PTP_CHECK(wait_value(command_count + ptp_operation_canon_GetViewFinderData, calls + 1));
	indigo_change_switch_property_1(&simulator_test_client, logical[0]->name, CCD_ABORT_EXPOSURE_PROPERTY_NAME, CCD_ABORT_EXPOSURE_ITEM_NAME, true);
	PTP_CHECK(wait_value(&streaming_state, INDIGO_OK_STATE));
	atomic_store(&fail_operation, 0);
	indigo_change_number_property_1(&simulator_test_client, logical[0]->name, CCD_STREAMING_PROPERTY_NAME, CCD_STREAMING_COUNT_ITEM_NAME, 1);
	PTP_CHECK(wait_value(&streaming_state, INDIGO_OK_STATE));
	PTP_CHECK(atomic_load(&blobs) == 1);
cleanup:
	end_profile();
}

static void initialization_retry(void) {
	reset_fake(0x04a9, 0x3218);
	bus_thread = pthread_self();
	reset_simulator_context(&ptp_case);
	indigo_start();
	indigo_attach_client(&simulator_test_client);
	indigo_attach_client(&image_client);
	atomic_store(&fail_register, 1);
	PTP_CHECK(indigo_ccd_ptp(INDIGO_DRIVER_INIT, NULL) == INDIGO_FAILED);
	PTP_CHECK(atomic_load(&attached) == 0);
	atomic_store(&fail_register, 0);
	PTP_CHECK(indigo_ccd_ptp(INDIGO_DRIVER_INIT, NULL) == INDIGO_OK);
	PTP_CHECK(wait_value(&attached, 1));
cleanup:
	end_profile();
	ASSERT_EQ_INT(0, atomic_load(&cameras[0].refs));
}

static void connection_rollback(bool claim) {
	PTP_CHECK(begin_profile(0x04a9, 0x3218));
	indigo_change_switch_property_1(&simulator_test_client, logical[0]->name, CONNECTION_PROPERTY_NAME, CONNECTION_DISCONNECTED_ITEM_NAME, true);
	PTP_CHECK(wait_value(&connection_state, INDIGO_OK_STATE));
	atomic_store(claim ? &fail_claim : &fail_open, 1);
	indigo_change_switch_property_1(&simulator_test_client, logical[0]->name, CONNECTION_PROPERTY_NAME, CONNECTION_CONNECTED_ITEM_NAME, true);
	PTP_CHECK(wait_value(&connection_state, INDIGO_ALERT_STATE));
	atomic_store(claim ? &fail_claim : &fail_open, 0);
	indigo_change_switch_property_1(&simulator_test_client, logical[0]->name, CONNECTION_PROPERTY_NAME, CONNECTION_CONNECTED_ITEM_NAME, true);
	PTP_CHECK(wait_value(&connection_state, INDIGO_OK_STATE));
	indigo_change_number_property_1(&simulator_test_client, logical[0]->name, CCD_EXPOSURE_PROPERTY_NAME, CCD_EXPOSURE_ITEM_NAME, 0.02);
	PTP_CHECK(wait_value(&exposure_state, INDIGO_OK_STATE));
cleanup:
	end_profile();
	ASSERT_EQ_INT(atomic_load(&cameras[0].opens), atomic_load(&cameras[0].closes));
	ASSERT_EQ_INT(0, atomic_load(&cameras[0].refs));
	ASSERT_EQ_INT(0, atomic_load(&calls_after_close));
}

static void open_failure_recovery(void) {
	connection_rollback(false);
}

static void claim_failure_recovery(void) {
	connection_rollback(true);
}

static void immutable_property_requests(void) {
	PTP_CHECK(begin_profile(0x04b0, 0x0421));
	atomic_store(&gate_operation, ptp_operation_SetDevicePropValue);
	indigo_change_number_property_1(&simulator_test_client, logical[0]->name, DSLR_ISO_PROPERTY_NAME, "VALUE", 200);
	PTP_CHECK(wait_value(&gate_entered, 1));
	indigo_change_number_property_1(&simulator_test_client, logical[0]->name, DSLR_EXPOSURE_COMPENSATION_PROPERTY_NAME, "VALUE", 333);
	indigo_change_number_property_1(&simulator_test_client, logical[0]->name, DSLR_ISO_PROPERTY_NAME, "VALUE", 400);
	atomic_store(&gate_open, 1);
	PTP_CHECK(wait_value(&iso_state, INDIGO_OK_STATE));
	PTP_CHECK(wait_value(&bias_state, INDIGO_OK_STATE));
	PTP_CHECK(*value(cameras, ptp_property_ExposureIndex) == 200);
	PTP_CHECK(*value(cameras, ptp_property_ExposureBiasCompensation) == 333);
cleanup:
	end_profile();
	ASSERT_EQ_INT(0, atomic_load(&bus_io));
	ASSERT_EQ_INT(0, atomic_load(&calls_after_close));
}

static void property_error_recovery(void) {
	PTP_CHECK(begin_profile(0x04b0, 0x0421));
	atomic_store(&fail_operation, ptp_operation_SetDevicePropValue);
	indigo_change_number_property_1(&simulator_test_client, logical[0]->name, DSLR_ISO_PROPERTY_NAME, "VALUE", 200);
	PTP_CHECK(wait_value(&iso_state, INDIGO_ALERT_STATE));
	PTP_CHECK(*value(cameras, ptp_property_ExposureIndex) == 100);
	atomic_store(&fail_operation, 0);
	indigo_change_number_property_1(&simulator_test_client, logical[0]->name, DSLR_ISO_PROPERTY_NAME, "VALUE", 200);
	PTP_CHECK(wait_value(&iso_state, INDIGO_OK_STATE));
	PTP_CHECK(*value(cameras, ptp_property_ExposureIndex) == 200);
cleanup:
	end_profile();
	ASSERT_EQ_INT(0, atomic_load(&bus_io));
	ASSERT_EQ_INT(0, atomic_load(&calls_after_close));
}

static void canon_stream_error(void) {
	exercise(1193, 12824, SC_STREAM_ERROR);
}

static void nikon_stream_error(void) {
	exercise(1200, 1057, SC_STREAM_ERROR);
}

static void fuji_stream_error(void) {
	exercise(1227, 703, SC_STREAM_ERROR);
}

static void sony_stream_error(void) {
	exercise(1356, 3352, SC_STREAM_ERROR);
}

static void olympus_native_capture_events(void) {
	PTP_CHECK(begin_profile(0x07b4, 0x0136));
	olympus_native_events = true;
	int infos = atomic_load(command_count + ptp_operation_GetObjectInfo);
	int objects = atomic_load(command_count + ptp_operation_GetObject);
	indigo_change_number_property_1(&simulator_test_client, logical[0]->name, CCD_EXPOSURE_PROPERTY_NAME, CCD_EXPOSURE_ITEM_NAME, 0.02);
	PTP_CHECK(wait_value(&exposure_state, INDIGO_OK_STATE));
	PTP_CHECK(olympus_event_stage == 4);
	PTP_CHECK(atomic_load(&blobs) == 1);
	PTP_CHECK(atomic_load(&bad_blob) == 0);
	PTP_CHECK(atomic_load(command_count + ptp_operation_GetObjectInfo) == infos + 3);
	PTP_CHECK(atomic_load(command_count + ptp_operation_GetObject) == objects + 1);
cleanup:
	end_profile();
}

static void olympus_stream_transient_error(void) {
	PTP_CHECK(begin_profile(0x07b4, 0x0136));
	atomic_store(&fail_reply, ptp_response_GeneralError);
	atomic_store(&fail_once_operation, ptp_operation_olympus_GetLiveViewImage);
	indigo_change_number_property_1(&simulator_test_client, logical[0]->name, CCD_STREAMING_SETTINGS_PROPERTY_NAME, CCD_STREAMING_SETTINGS_UPDATE_LIMIT_ITEM_NAME, 0);
	indigo_change_number_property_1(&simulator_test_client, logical[0]->name, CCD_STREAMING_PROPERTY_NAME, CCD_STREAMING_COUNT_ITEM_NAME, 3);
	PTP_CHECK(wait_value(&streaming_state, INDIGO_OK_STATE));
	PTP_CHECK(atomic_load(&blobs) == 3);
	PTP_CHECK(atomic_load(command_count + ptp_operation_olympus_GetLiveViewImage) == 4);
cleanup:
	end_profile();
}

static void olympus_stream_error(void) {
	exercise(1972, 310, SC_STREAM_ERROR);
}

static void canon_malformed_stream(void) {
	exercise(1193, 12824, SC_STREAM_BAD);
}

static void canon_mirror_redundant_off(void) {
	PTP_CHECK(begin_profile(0x04a9, 0x3218));
	// Issue #778: the camera rejects writing the already-disabled setting.
	atomic_store(&mirror_reject, 1);
	for (int i = 0; i < 2; i++) {
		indigo_change_number_property_1(&simulator_test_client, logical[0]->name, CCD_EXPOSURE_PROPERTY_NAME, CCD_EXPOSURE_ITEM_NAME, 0.02);
		PTP_CHECK(wait_value(&exposure_state, INDIGO_OK_STATE));
		PTP_CHECK(atomic_load(&blobs) == i + 1);
	}
	PTP_CHECK(atomic_load(&mirror_writes) == 0);
	PTP_CHECK(atomic_load(command_count + ptp_operation_canon_RemoteReleaseOn) == 2);
cleanup:
	end_profile();
}

static void canon_mirror_unknown_value(void) {
	// Advertisement alone must not be treated as a readback of Off.
	mirror_unknown_profile = true;
	PTP_CHECK(begin_profile(0x04a9, 0x3218));
	atomic_store(&mirror_reject, 2);
	indigo_change_number_property_1(&simulator_test_client, logical[0]->name, CCD_EXPOSURE_PROPERTY_NAME, CCD_EXPOSURE_ITEM_NAME, 0.02);
	PTP_CHECK(wait_value(&exposure_state, INDIGO_ALERT_STATE));
	PTP_CHECK(atomic_load(&mirror_writes) == 1);
	PTP_CHECK(atomic_load(command_count + ptp_operation_canon_RemoteReleaseOn) == 0);
	atomic_store(&mirror_reject, 0);
	for (int i = 0; i < 2; i++) {
		indigo_change_number_property_1(&simulator_test_client, logical[0]->name, CCD_EXPOSURE_PROPERTY_NAME, CCD_EXPOSURE_ITEM_NAME, 0.02);
		PTP_CHECK(wait_value(&exposure_state, INDIGO_OK_STATE));
		PTP_CHECK(atomic_load(&blobs) == i + 1);
		PTP_CHECK(atomic_load(&mirror_writes) == 2);
	}
cleanup:
	end_profile();
}

static void canon_mirror_transitions(void) {
	PTP_CHECK(begin_profile(0x04a9, 0x3218));
	// Successful writes may not be echoed in the next GetEvent response.
	atomic_store(&mirror_suppress_events, true);
	atomic_store(&mirror_reject, 1);
	for (int i = 0; i < 4; i++) {
		bool enabled = i < 2;
		indigo_change_switch_property_1(&simulator_test_client, logical[0]->name, DSLR_MIRROR_LOCKUP_PROPERTY_NAME, enabled ? DSLR_MIRROR_LOCKUP_LOCK_ITEM_NAME : DSLR_MIRROR_LOCKUP_UNLOCK_ITEM_NAME, true);
		indigo_change_number_property_1(&simulator_test_client, logical[0]->name, CCD_EXPOSURE_PROPERTY_NAME, CCD_EXPOSURE_ITEM_NAME, 0.02);
		PTP_CHECK(wait_value(&exposure_state, INDIGO_OK_STATE));
		PTP_CHECK(atomic_load(&blobs) == i + 1);
		PTP_CHECK(atomic_load(&mirror_value) == enabled);
		PTP_CHECK(atomic_load(&mirror_writes) == (enabled ? 1 : 2));
	}
cleanup:
	end_profile();
}

static void canon_mirror_write_recovery(void) {
	PTP_CHECK(begin_profile(0x04a9, 0x3218));
	atomic_store(&mirror_suppress_events, true);
	for (int i = 0; i < 2; i++) {
		bool enabled = i == 0;
		indigo_change_switch_property_1(&simulator_test_client, logical[0]->name, DSLR_MIRROR_LOCKUP_PROPERTY_NAME, enabled ? DSLR_MIRROR_LOCKUP_LOCK_ITEM_NAME : DSLR_MIRROR_LOCKUP_UNLOCK_ITEM_NAME, true);
		atomic_store(&mirror_reject, 2);
		indigo_change_number_property_1(&simulator_test_client, logical[0]->name, CCD_EXPOSURE_PROPERTY_NAME, CCD_EXPOSURE_ITEM_NAME, 0.02);
		PTP_CHECK(wait_value(&exposure_state, INDIGO_ALERT_STATE));
		PTP_CHECK(atomic_load(command_count + ptp_operation_canon_RemoteReleaseOn) == i);
		PTP_CHECK(atomic_load(&blobs) == i);
		atomic_store(&mirror_reject, 0);
		indigo_change_number_property_1(&simulator_test_client, logical[0]->name, CCD_EXPOSURE_PROPERTY_NAME, CCD_EXPOSURE_ITEM_NAME, 0.02);
		PTP_CHECK(wait_value(&exposure_state, INDIGO_OK_STATE));
		PTP_CHECK(atomic_load(&mirror_value) == enabled);
		PTP_CHECK(atomic_load(&blobs) == i + 1);
		PTP_CHECK(atomic_load(&mirror_writes) == 2 * (i + 1));
	}
cleanup:
	end_profile();
}

static void canon_controls(void) {
	PTP_CHECK(begin_profile(0x04a9, 0x3218));
	int locks = atomic_load(command_count + ptp_operation_canon_SetUILock);
	indigo_change_switch_property_1(&simulator_test_client, logical[0]->name, DSLR_LOCK_PROPERTY_NAME, DSLR_LOCK_ITEM_NAME, true);
	PTP_CHECK(wait_value(&lock_state, INDIGO_OK_STATE));
	PTP_CHECK(atomic_load(command_count + ptp_operation_canon_SetUILock) == locks + 1);
	indigo_change_switch_property_1(&simulator_test_client, logical[0]->name, DSLR_LOCK_PROPERTY_NAME, DSLR_UNLOCK_ITEM_NAME, true);
	PTP_CHECK(wait_value(&lock_state, INDIGO_OK_STATE));
	indigo_change_switch_property_1(&simulator_test_client, logical[0]->name, DSLR_ZOOM_PREVIEW_PROPERTY_NAME, DSLR_ZOOM_PREVIEW_ON_ITEM_NAME, true);
	PTP_CHECK(wait_value(&zoom_state, INDIGO_OK_STATE));
	PTP_CHECK(atomic_load(command_argument + ptp_operation_canon_Zoom) == 5);
	indigo_change_switch_property_1(&simulator_test_client, logical[0]->name, DSLR_ZOOM_PREVIEW_PROPERTY_NAME, DSLR_ZOOM_PREVIEW_OFF_ITEM_NAME, true);
	PTP_CHECK(wait_value(&zoom_state, INDIGO_OK_STATE));
	PTP_CHECK(atomic_load(command_argument + ptp_operation_canon_Zoom) == 1);
	indigo_change_switch_property_1(&simulator_test_client, logical[0]->name, DSLR_AF_PROPERTY_NAME, DSLR_AF_ITEM_NAME, true);
	PTP_CHECK(wait_value(&af_state, INDIGO_OK_STATE));
	PTP_CHECK(atomic_load(command_count + ptp_operation_canon_DoAf) == 1);
	PTP_CHECK(atomic_load(command_count + ptp_operation_canon_AfCancel) == 1);
	indigo_change_switch_property_1(&simulator_test_client, logical[0]->name, DSLR_SET_HOST_TIME_PROPERTY_NAME, DSLR_SET_HOST_TIME_ITEM_NAME, true);
	PTP_CHECK(wait_value(&host_time_state, INDIGO_OK_STATE));
	PTP_CHECK(*value(cameras, ptp_property_canon_CameraTime) > 1700000000);
	atomic_store(&fail_operation, ptp_operation_canon_SetUILock);
	indigo_change_switch_property_1(&simulator_test_client, logical[0]->name, DSLR_LOCK_PROPERTY_NAME, DSLR_LOCK_ITEM_NAME, true);
	PTP_CHECK(wait_value(&lock_state, INDIGO_ALERT_STATE));
	atomic_store(&fail_operation, 0);
	indigo_change_switch_property_1(&simulator_test_client, logical[0]->name, DSLR_LOCK_PROPERTY_NAME, DSLR_UNLOCK_ITEM_NAME, true);
	PTP_CHECK(wait_value(&lock_state, INDIGO_OK_STATE));
cleanup:
	end_profile();
	ASSERT_EQ_INT(0, atomic_load(&bus_io));
	ASSERT_EQ_INT(0, atomic_load(&calls_after_close));
}

static void nikon_dual_preview_comparison(bool histogram, bool convert_raw) {
	char directory[] = "/tmp/indigo-ptp-preview-XXXXXX";
	FILE *file = NULL;
	uint8_t *contents = NULL;
	nikon_dual_profile = true;
	nikon_raw_output = convert_raw;
	PTP_CHECK(mkdtemp(directory) != NULL);
	PTP_CHECK(begin_profile(0x04b0, 0x042f));
	indigo_change_switch_property_1(&simulator_test_client, logical[0]->name, CCD_IMAGE_FORMAT_PROPERTY_NAME, convert_raw ? CCD_IMAGE_FORMAT_RAW_ITEM_NAME : CCD_IMAGE_FORMAT_NATIVE_ITEM_NAME, true);
	indigo_change_text_property_1(&simulator_test_client, logical[0]->name, CCD_LOCAL_MODE_PROPERTY_NAME, CCD_LOCAL_MODE_DIR_ITEM_NAME, directory);
	indigo_change_switch_property_1(&simulator_test_client, logical[0]->name, CCD_UPLOAD_MODE_PROPERTY_NAME, CCD_UPLOAD_MODE_BOTH_ITEM_NAME, true);
	indigo_change_switch_property_1(&simulator_test_client, logical[0]->name, CCD_PREVIEW_PROPERTY_NAME, histogram ? CCD_PREVIEW_ENABLED_WITH_HISTOGRAM_ITEM_NAME : CCD_PREVIEW_ENABLED_ITEM_NAME, true);
	for (int shot = 1; shot <= 2; shot++) {
		int updates = atomic_load(&exposure_updates);
		indigo_change_number_property_1(&simulator_test_client, logical[0]->name, CCD_EXPOSURE_PROPERTY_NAME, CCD_EXPOSURE_ITEM_NAME, 0.02);
		bool complete = wait_value(&exposure_state, INDIGO_OK_STATE);
		fprintf(stderr, "Nikon RAW+JPEG %s output=%s shot=%d capture=%d main=%d saved=%d file_state=%d preview=%d histogram=%d downloads=%d\n", histogram ? "ENABLED_WITH_HISTOGRAM" : "ENABLED", convert_raw ? "RAW" : "NATIVE", shot, atomic_load(&exposure_state), atomic_load(&blobs), atomic_load(&saved_images), atomic_load(&image_file_state), atomic_load(&preview_blobs), atomic_load(&histogram_blobs), atomic_load(&cameras[0].frames));
		PTP_CHECK(complete && atomic_load(&exposure_updates) >= updates + 2);
		PTP_CHECK(atomic_load(&blobs) == shot && atomic_load(&bad_blob) == 0);
		PTP_CHECK(atomic_load(&saved_images) == shot && atomic_load(&image_file_state) == INDIGO_OK_STATE);
		PTP_CHECK(atomic_load(&cameras[0].frames) == 2 * shot);
		file = fopen(saved_image_path, "rb");
		PTP_CHECK(file != NULL);
		size_t expected_size = convert_raw ? captured_raw_size : dng_size;
		contents = malloc(expected_size);
		PTP_CHECK(contents != NULL && fread(contents, 1, expected_size, file) == expected_size);
		PTP_CHECK(fgetc(file) == EOF && memcmp(contents, convert_raw ? captured_raw : dng, expected_size) == 0);
		fclose(file);
		file = NULL;
		free(contents);
		contents = NULL;
		unlink(saved_image_path);
		saved_image_path[0] = 0;
		PTP_CHECK(atomic_load(&preview_blobs) == shot * (convert_raw ? 2 : 1));
		PTP_CHECK(atomic_load(&bad_preview) == 0);
		PTP_CHECK(atomic_load(&histogram_alerts) == (nikon_bad_jpeg ? shot : 0));
		PTP_CHECK(atomic_load(&histogram_blobs) == (histogram && !nikon_bad_jpeg ? shot * (convert_raw ? 2 : 1) : 0));
	}
cleanup:
	if (file) {
		fclose(file);
	}
	free(contents);
	if (saved_image_path[0]) {
		unlink(saved_image_path);
	}
	end_profile();
	rmdir(directory);
	ASSERT_EQ_INT(0, atomic_load(&calls_after_close));
	ASSERT_EQ_INT(0, atomic_load(&cameras[0].refs));
}

static void nikon_dual_preview_corrupt_jpeg(void) {
	nikon_bad_jpeg = true;
	nikon_dual_preview_comparison(true, false);
}

static void nikon_dual_preview_enabled(void) {
	nikon_dual_preview_comparison(false, false);
}

static void nikon_dual_preview_histogram(void) {
	nikon_dual_preview_comparison(true, false);
}

static void nikon_dual_preview_raw_enabled(void) {
	nikon_dual_preview_comparison(false, true);
}

static void nikon_dual_preview_raw_histogram(void) {
	nikon_dual_preview_comparison(true, true);
}

static void dual_capture(bool missing_raw) {
	dual_profile = true;
	hold_raw = missing_raw;
	PTP_CHECK(begin_profile(0x04a9, 0x3218));
	indigo_change_switch_property_1(&simulator_test_client, logical[0]->name, CCD_PREVIEW_PROPERTY_NAME, CCD_PREVIEW_ENABLED_ITEM_NAME, true);
	indigo_change_number_property_1(&simulator_test_client, logical[0]->name, CCD_EXPOSURE_PROPERTY_NAME, CCD_EXPOSURE_ITEM_NAME, 0.02);
	bool complete = wait_value(&exposure_state, missing_raw ? INDIGO_ALERT_STATE : INDIGO_OK_STATE);
	fprintf(stderr, "dual missing=%d state=%d blobs=%d preview=%d frames=%d complete=%d\n", missing_raw, atomic_load(&exposure_state), atomic_load(&blobs), atomic_load(&preview_blobs), atomic_load(&cameras[0].frames), complete);
	PTP_CHECK(complete);
	PTP_CHECK(atomic_load(&preview_blobs) == 1);
	PTP_CHECK(atomic_load(&blobs) == (missing_raw ? 0 : 1));
	PTP_CHECK(atomic_load(&bad_blob) == 0);
cleanup:
	end_profile();
	ASSERT_EQ_INT(0, atomic_load(&calls_after_close));
	ASSERT_EQ_INT(0, atomic_load(&cameras[0].refs));
}

static void canon_dual_native_preview(void) {
	dual_capture(false);
}

static void canon_missing_dual_native(void) {
	dual_capture(true);
}

static void sony_dual_memory(int order, bool preview) {
	sony_dual_order = order;
	PTP_CHECK(begin_profile(0x054c, 0x0ccc));
	indigo_change_switch_property_1(&simulator_test_client, logical[0]->name, CCD_PREVIEW_PROPERTY_NAME, preview ? CCD_PREVIEW_ENABLED_ITEM_NAME : CCD_PREVIEW_DISABLED_ITEM_NAME, true);
	for (int i = 1; i <= 2; i++) {
		indigo_change_number_property_1(&simulator_test_client, logical[0]->name, CCD_EXPOSURE_PROPERTY_NAME, CCD_EXPOSURE_ITEM_NAME, 0.02);
		PTP_CHECK(wait_value(&exposure_state, INDIGO_OK_STATE));
		PTP_CHECK(atomic_load(&blobs) == i);
		PTP_CHECK(atomic_load(&preview_blobs) == (preview ? i : 0));
		PTP_CHECK(sony_memory_objects == 0);
	}
	PTP_CHECK(atomic_load(&bad_blob) == 0);
cleanup:
	end_profile();
	ASSERT_EQ_INT(0, atomic_load(&calls_after_close));
}

static void sony_dual_raw_first(void) {
	sony_dual_memory(1, true);
}

static void sony_dual_jpeg_first(void) {
	sony_dual_memory(2, true);
}

static void sony_dual_preview_disabled(void) {
	sony_dual_memory(1, false);
}

// ILCE-7RM4 hardware run 2026-10-25: after a reconnect the camera acknowledged the full press, refocused and
// never shot, so the exposure stayed BUSY until the capture timeout.
static void sony_ignored_press(void) {
	PTP_CHECK(begin_profile(0x054c, 0x0ccc));
	atomic_store(&sony_ignored_presses, 1);
	indigo_change_number_property_1(&simulator_test_client, logical[0]->name, CCD_EXPOSURE_PROPERTY_NAME, CCD_EXPOSURE_ITEM_NAME, 0.02);
	PTP_CHECK(wait_value(&exposure_state, INDIGO_OK_STATE));
	PTP_CHECK(atomic_load(&blobs) == 1);
	PTP_CHECK(atomic_load(&sony_presses) == 2);
	PTP_CHECK(atomic_load(&sony_ignored_presses) == 0);
	atomic_store(&sony_ignored_presses, 10);
	indigo_change_number_property_1(&simulator_test_client, logical[0]->name, CCD_EXPOSURE_PROPERTY_NAME, CCD_EXPOSURE_ITEM_NAME, 0.02);
	// Three presses, each after the 1 s manual focus settling time.
	PTP_CHECK(wait_value_long(&exposure_state, INDIGO_ALERT_STATE));
	PTP_CHECK(atomic_load(&sony_presses) == 5);
	PTP_CHECK(atomic_load(&blobs) == 1);
	atomic_store(&sony_ignored_presses, 0);
	indigo_change_number_property_1(&simulator_test_client, logical[0]->name, CCD_EXPOSURE_PROPERTY_NAME, CCD_EXPOSURE_ITEM_NAME, 0.02);
	PTP_CHECK(wait_value(&exposure_state, INDIGO_OK_STATE));
	PTP_CHECK(atomic_load(&blobs) == 2);
	PTP_CHECK(atomic_load(&sony_presses) == 6);
	PTP_CHECK(atomic_load(&bad_blob) == 0);
cleanup:
	end_profile();
	ASSERT_EQ_INT(0, atomic_load(&calls_after_close));
}

// With long exposure noise reduction the camera reports the object only after a dark frame as long as the
// exposure; that must not be taken for an ignored press.
static void sony_long_exposure_noise_reduction(void) {
	sony_long_shutter = true;
	PTP_CHECK(begin_profile(0x054c, 0x0ccc));
	atomic_store(&cameras[0].hold_image, true);
	indigo_change_number_property_1(&simulator_test_client, logical[0]->name, CCD_EXPOSURE_PROPERTY_NAME, CCD_EXPOSURE_ITEM_NAME, 1);
	PTP_CHECK(wait_value(&sony_presses, 1));
	// The object arrives after twice the shutter time, past shutter + confirm time.
	double pressed = indigo_monotonic_time();
	while (indigo_monotonic_time() < pressed + 1.5) {
		indigo_usleep(10000);
	}
	atomic_store(&cameras[0].hold_image, false);
	PTP_CHECK(wait_value(&exposure_state, INDIGO_OK_STATE));
	PTP_CHECK(atomic_load(&blobs) == 1);
	PTP_CHECK(atomic_load(&sony_presses) == 1);
cleanup:
	end_profile();
	ASSERT_EQ_INT(0, atomic_load(&calls_after_close));
}

// ILCE-7RM2 hardware run 2026-10-25: the timed shot of an aborted exposure was reported about 9 s after
// its press, during the next exposure, and was published as that exposure's image; the real image then
// arrived during live view.
static void sony_old_api_aborted_shot(void) {
	atomic_store(&sony_object_queue, true);
	PTP_CHECK(begin_profile(0x054c, 0x0a6b));
	atomic_store(&cameras[0].hold_image, true);
	indigo_change_number_property_1(&simulator_test_client, logical[0]->name, CCD_EXPOSURE_PROPERTY_NAME, CCD_EXPOSURE_ITEM_NAME, 0.02);
	PTP_CHECK(wait_value(&sony_presses, 1));
	indigo_change_switch_property_1(&simulator_test_client, logical[0]->name, CCD_ABORT_EXPOSURE_PROPERTY_NAME, CCD_ABORT_EXPOSURE_ITEM_NAME, true);
	PTP_CHECK(wait_value(&exposure_state, INDIGO_ALERT_STATE));
	indigo_change_number_property_1(&simulator_test_client, logical[0]->name, CCD_EXPOSURE_PROPERTY_NAME, CCD_EXPOSURE_ITEM_NAME, 0.02);
	PTP_CHECK(wait_value(&sony_presses, 2));
	atomic_store(&cameras[0].hold_image, false);
	PTP_CHECK(wait_value(&exposure_state, INDIGO_OK_STATE));
	PTP_CHECK(wait_value(&sony_queued_objects, 0));
	indigo_usleep(300000);
	PTP_CHECK(atomic_load(&blobs) == 1);
	PTP_CHECK(atomic_load(&bad_blob) == 0);
cleanup:
	end_profile();
	ASSERT_EQ_INT(0, atomic_load(&calls_after_close));
}

// The object of an aborted exposure that arrives before the next exposure is not published either.
static void sony_old_api_aborted_shot_idle(void) {
	atomic_store(&sony_object_queue, true);
	PTP_CHECK(begin_profile(0x054c, 0x0a6b));
	atomic_store(&cameras[0].hold_image, true);
	indigo_change_number_property_1(&simulator_test_client, logical[0]->name, CCD_EXPOSURE_PROPERTY_NAME, CCD_EXPOSURE_ITEM_NAME, 0.02);
	PTP_CHECK(wait_value(&sony_presses, 1));
	indigo_change_switch_property_1(&simulator_test_client, logical[0]->name, CCD_ABORT_EXPOSURE_PROPERTY_NAME, CCD_ABORT_EXPOSURE_ITEM_NAME, true);
	PTP_CHECK(wait_value(&exposure_state, INDIGO_ALERT_STATE));
	atomic_store(&cameras[0].hold_image, false);
	PTP_CHECK(wait_value(&sony_queued_objects, 0));
	indigo_usleep(300000);
	PTP_CHECK(atomic_load(&blobs) == 0);
	indigo_change_number_property_1(&simulator_test_client, logical[0]->name, CCD_EXPOSURE_PROPERTY_NAME, CCD_EXPOSURE_ITEM_NAME, 0.02);
	PTP_CHECK(wait_value(&exposure_state, INDIGO_OK_STATE));
	PTP_CHECK(atomic_load(&blobs) == 1);
cleanup:
	end_profile();
	ASSERT_EQ_INT(0, atomic_load(&calls_after_close));
}

// A press the camera never turned into a picture expires (SONY_STALE_SHOT_TIME, 2 s in this build), so
// the next exposure keeps its own image.
static void sony_old_api_lost_shot_expires(void) {
	atomic_store(&sony_object_queue, true);
	PTP_CHECK(begin_profile(0x054c, 0x0a6b));
	atomic_store(&sony_ignored_presses, 1);
	indigo_change_number_property_1(&simulator_test_client, logical[0]->name, CCD_EXPOSURE_PROPERTY_NAME, CCD_EXPOSURE_ITEM_NAME, 0.02);
	PTP_CHECK(wait_value(&exposure_state, INDIGO_ALERT_STATE));
	indigo_usleep(2000000);
	indigo_change_number_property_1(&simulator_test_client, logical[0]->name, CCD_EXPOSURE_PROPERTY_NAME, CCD_EXPOSURE_ITEM_NAME, 0.02);
	PTP_CHECK(wait_value(&exposure_state, INDIGO_OK_STATE));
	PTP_CHECK(atomic_load(&blobs) == 1);
cleanup:
	end_profile();
	ASSERT_EQ_INT(0, atomic_load(&calls_after_close));
}

// ILCE-7RM2 hardware run 2026-10-25: live view right after a capture was refused with AccessDenied for
// about 9 s, longer than the 100 polls the driver used to allow.
static void sony_liveview_after_capture(void) {
	atomic_store(&sony_object_queue, true);
	sony_liveview_denial = 7;
	PTP_CHECK(begin_profile(0x054c, 0x0a6b));
	indigo_change_number_property_1(&simulator_test_client, logical[0]->name, CCD_EXPOSURE_PROPERTY_NAME, CCD_EXPOSURE_ITEM_NAME, 0.02);
	PTP_CHECK(wait_value(&exposure_state, INDIGO_OK_STATE));
	PTP_CHECK(atomic_load(&blobs) == 1);
	indigo_change_number_property_1(&simulator_test_client, logical[0]->name, CCD_STREAMING_PROPERTY_NAME, CCD_STREAMING_COUNT_ITEM_NAME, 3);
	PTP_CHECK(wait_value(&streaming_state, INDIGO_BUSY_STATE));
	PTP_CHECK(wait_value(&streaming_state, INDIGO_OK_STATE) || wait_value_long(&streaming_state, INDIGO_OK_STATE));
	PTP_CHECK(atomic_load(&blobs) == 4);
cleanup:
	end_profile();
	ASSERT_EQ_INT(0, atomic_load(&calls_after_close));
}

// ILCE-7RM4 hardware run 2026-10-25: a reconnect that reopened the session 7 ms after CloseSession left the
// camera answering DeviceBusy for the whole session; the driver waits before reopening.
static void sony_fast_reopen(void) {
	PTP_CHECK(begin_profile(0x054c, 0x0ccc));
	atomic_store(&sony_fast_reopen_busy, true);
	for (int i = 1; i <= 2; i++) {
		indigo_change_switch_property_1(&simulator_test_client, logical[0]->name, CONNECTION_PROPERTY_NAME, CONNECTION_DISCONNECTED_ITEM_NAME, true);
		PTP_CHECK(wait_value(&connection_state, INDIGO_OK_STATE));
		indigo_change_switch_property_1(&simulator_test_client, logical[0]->name, CONNECTION_PROPERTY_NAME, CONNECTION_CONNECTED_ITEM_NAME, true);
		PTP_CHECK(wait_value(&connection_state, INDIGO_OK_STATE));
		PTP_CHECK(!atomic_load(&cameras[0].stuck_busy));
		indigo_change_number_property_1(&simulator_test_client, logical[0]->name, CCD_EXPOSURE_PROPERTY_NAME, CCD_EXPOSURE_ITEM_NAME, 0.02);
		PTP_CHECK(wait_value(&exposure_state, INDIGO_OK_STATE));
		PTP_CHECK(atomic_load(&blobs) == i);
	}
cleanup:
	end_profile();
	ASSERT_EQ_INT(0, atomic_load(&calls_after_close));
}

static void sony_autofocus(bool disconnect) {
	autofocus_profile = true;
	PTP_CHECK(begin_profile(0x054c, 0x0d18));
	atomic_store(&cameras[0].hold_focus, disconnect);
	indigo_change_switch_property_1(&simulator_test_client, logical[0]->name, DSLR_AF_PROPERTY_NAME, DSLR_AF_ITEM_NAME, true);
	if (disconnect) {
		PTP_CHECK(wait_value(command_count + ptp_operation_sony_SetControlDeviceB, 1));
		indigo_change_switch_property_1(&simulator_test_client, logical[0]->name, CONNECTION_PROPERTY_NAME, CONNECTION_DISCONNECTED_ITEM_NAME, true);
		PTP_CHECK(wait_value(&connection_state, INDIGO_OK_STATE));
		PTP_CHECK(wait_value(&af_state, INDIGO_ALERT_STATE));
	} else {
		PTP_CHECK(wait_value(&af_state, INDIGO_OK_STATE));
	}
	PTP_CHECK(!atomic_load(&cameras[0].af_held));
cleanup:
	end_profile();
	ASSERT_EQ_INT(0, atomic_load(&bus_io));
	ASSERT_EQ_INT(0, atomic_load(&calls_after_close));
}

static void sony_af_completion(void) {
	sony_autofocus(false);
}

static void sony_af_disconnect(void) {
	sony_autofocus(true);
}

static void canon_shutter_stop_recovery(void) {
	bulb_profile = true;
	PTP_CHECK(begin_profile(0x04a9, 0x3218));
	indigo_change_number_property_1(&simulator_test_client, logical[0]->name, CCD_EXPOSURE_PROPERTY_NAME, CCD_EXPOSURE_ITEM_NAME, 1.25);
	PTP_CHECK(wait_value(command_count + ptp_operation_canon_RemoteReleaseOn, 1));
	atomic_store(&fail_once_operation, ptp_operation_canon_RemoteReleaseOff);
	indigo_change_switch_property_1(&simulator_test_client, logical[0]->name, CCD_ABORT_EXPOSURE_PROPERTY_NAME, CCD_ABORT_EXPOSURE_ITEM_NAME, true);
	PTP_CHECK(wait_value(&exposure_state, INDIGO_ALERT_STATE));
	PTP_CHECK(!cameras[0].bulb);
	PTP_CHECK(atomic_load(&cameras[0].releases) == 1);
	PTP_CHECK(atomic_load(command_count + ptp_operation_canon_RemoteReleaseOff) == 2);
	indigo_change_number_property_1(&simulator_test_client, logical[0]->name, CCD_EXPOSURE_PROPERTY_NAME, CCD_EXPOSURE_ITEM_NAME, 0.02);
	PTP_CHECK(wait_value(&exposure_state, INDIGO_OK_STATE));
cleanup:
	end_profile();
	ASSERT_EQ_INT(0, atomic_load(&calls_after_close));
	ASSERT_EQ_INT(0, atomic_load(&cameras[0].refs));
}

static void canon_property_contract(void) {
	PTP_CHECK(begin_profile(0x04a9, 0x3218));
	assert_device_interface(INDIGO_INTERFACE_CCD);
	assert_property_has_item(CCD_INFO_PROPERTY_NAME, CCD_INFO_WIDTH_ITEM_NAME);
	assert_property_has_item(CCD_INFO_PROPERTY_NAME, CCD_INFO_HEIGHT_ITEM_NAME);
	assert_property_has_item(CCD_EXPOSURE_PROPERTY_NAME, CCD_EXPOSURE_ITEM_NAME);
	assert_property_has_item(CCD_STREAMING_PROPERTY_NAME, CCD_STREAMING_COUNT_ITEM_NAME);
	assert_property_has_item(CCD_UPLOAD_MODE_PROPERTY_NAME, CCD_UPLOAD_MODE_CLIENT_ITEM_NAME);
	assert_property_has_item(CCD_IMAGE_FORMAT_PROPERTY_NAME, CCD_IMAGE_FORMAT_NATIVE_ITEM_NAME);
	assert_property_has_item(CCD_PREVIEW_PROPERTY_NAME, CCD_PREVIEW_ENABLED_ITEM_NAME);
	assert_property_has_item(CCD_BIN_PROPERTY_NAME, CCD_BIN_HORIZONTAL_ITEM_NAME);
	assert_property_has_item(CCD_BIN_PROPERTY_NAME, CCD_BIN_VERTICAL_ITEM_NAME);
	assert_not_defined_property(CCD_COOLER_PROPERTY_NAME);
	assert_not_defined_property(CCD_TEMPERATURE_PROPERTY_NAME);
	indigo_property *frame = find_cached_property(CCD_FRAME_PROPERTY_NAME);
	PTP_CHECK(frame && frame->perm == INDIGO_RO_PERM);
	PTP_CHECK(find_cached_property(CCD_INFO_PROPERTY_NAME)->items[0].number.value == 5184);
	indigo_change_switch_property_1(&simulator_test_client, logical[0]->name, CONNECTION_PROPERTY_NAME, CONNECTION_DISCONNECTED_ITEM_NAME, true);
	PTP_CHECK(wait_value(&connection_state, INDIGO_OK_STATE));
	PTP_CHECK(find_cached_property(CCD_EXPOSURE_PROPERTY_NAME) == NULL);
	PTP_CHECK(find_cached_property(DSLR_ISO_PROPERTY_NAME) == NULL);
cleanup:
	end_profile();
	ASSERT_EQ_INT(0, atomic_load(&cameras[0].refs));
}

static void generic_unsupported_capture(void) {
	PTP_CHECK(begin_profile(0x045e, 0x0a00));
	PTP_CHECK(((ptp_private_data *)logical[0]->private_data)->focuser == NULL);
	indigo_change_number_property_1(&simulator_test_client, logical[0]->name, CCD_EXPOSURE_PROPERTY_NAME, CCD_EXPOSURE_ITEM_NAME, 0.02);
	PTP_CHECK(wait_value(&exposure_state, INDIGO_ALERT_STATE));
	PTP_CHECK(atomic_load(command_count + ptp_operation_InitiateCapture) == 0);
cleanup:
	end_profile();
	ASSERT_EQ_INT(0, atomic_load(&cameras[0].refs));
	ASSERT_EQ_INT(0, atomic_load(&calls_after_close));
}

static void canon_countdown_with_occupied_queue(void) {
	bulb_profile = true;
	PTP_CHECK(begin_profile(0x04a9, 0x3218));
	indigo_change_number_property_1(&simulator_test_client, logical[0]->name, CCD_EXPOSURE_PROPERTY_NAME, CCD_EXPOSURE_ITEM_NAME, 2.25);
	PTP_CHECK(wait_value(command_count + ptp_operation_canon_RemoteReleaseOn, 1));
	atomic_store(&gate_operation, ptp_operation_canon_GetEvent);
	PTP_CHECK(wait_value(&gate_entered, 1));
	PTP_CHECK(wait_value(&countdown_value, 1));
	PTP_CHECK(atomic_load(&gate_open) == 0);
	PTP_CHECK(find_cached_property(CCD_EXPOSURE_PROPERTY_NAME)->items->number.target == 2.25);
	atomic_store(&gate_open, 1);
	PTP_CHECK(wait_value(&exposure_state, INDIGO_OK_STATE));
	double measured = atomic_load(&cameras[0].held_us) / 1000000.0;
	PTP_CHECK(measured >= 2.245 && measured < 2.40);
cleanup:
	end_profile();
	ASSERT_EQ_INT(0, atomic_load(&calls_after_close));
	ASSERT_EQ_INT(0, atomic_load(&cameras[0].refs));
}

static void vendor_bulb(uint16_t vendor, uint16_t product) {
	bulb_profile = true;
	PTP_CHECK(begin_profile(vendor, product));
	const double durations[] = { 0.02, 1.25 };
	for (unsigned i = 0; i < ARRAY_SIZE(durations); i++) {
		indigo_change_number_property_1(&simulator_test_client, logical[0]->name, CCD_EXPOSURE_PROPERTY_NAME, CCD_EXPOSURE_ITEM_NAME, durations[i]);
		PTP_CHECK(wait_value(&exposure_state, INDIGO_OK_STATE));
		double measured = atomic_load(&cameras[0].held_us) / 1000000.0;
		fprintf(stderr, "Vendor %04x fake shutter: requested %.3f measured %.6f s\n", vendor, durations[i], measured);
		PTP_CHECK(measured >= durations[i] - 0.005 && measured < durations[i] + 0.15);
	}
cleanup:
	end_profile();
	ASSERT_EQ_INT(0, atomic_load(&bus_io));
	ASSERT_EQ_INT(0, atomic_load(&calls_after_close));
	ASSERT_EQ_INT(0, atomic_load(&cameras[0].refs));
}

static void nikon_bulb_timing(void) {
	vendor_bulb(1200, 1057);
}

static void nikon_bulb_stop_retry(void) {
	bulb_profile = true;
	PTP_CHECK(begin_profile(0x04b0, 0x0421));
	atomic_store(&fail_reply, ptp_response_AccessDenied);
	atomic_store(&fail_once_operation, ptp_operation_nikon_TerminateCapture);
	indigo_change_number_property_1(&simulator_test_client, logical[0]->name, CCD_EXPOSURE_PROPERTY_NAME, CCD_EXPOSURE_ITEM_NAME, 0.02);
	PTP_CHECK(wait_value(&exposure_state, INDIGO_OK_STATE));
	PTP_CHECK(!cameras[0].bulb);
	PTP_CHECK(atomic_load(&cameras[0].releases) == 1);
	PTP_CHECK(atomic_load(command_count + ptp_operation_nikon_TerminateCapture) == 2);
cleanup:
	end_profile();
	ASSERT_EQ_INT(0, atomic_load(&bus_io));
	ASSERT_EQ_INT(0, atomic_load(&calls_after_close));
	ASSERT_EQ_INT(0, atomic_load(&cameras[0].refs));
}

static void nikon_bulb_stop_timeout(void) {
	bulb_profile = true;
	PTP_CHECK(begin_profile(0x04b0, 0x0421));
	atomic_store(&fail_reply, ptp_response_AccessDenied);
	atomic_store(&fail_operation, ptp_operation_nikon_TerminateCapture);
	indigo_change_number_property_1(&simulator_test_client, logical[0]->name, CCD_EXPOSURE_PROPERTY_NAME, CCD_EXPOSURE_ITEM_NAME, 0.02);
	PTP_CHECK(wait_value(&exposure_state, INDIGO_ALERT_STATE));
	PTP_CHECK(cameras[0].bulb);
	PTP_CHECK(atomic_load(command_count + ptp_operation_nikon_TerminateCapture) == PTP_STOP_RETRY_LIMIT + 2);
cleanup:
	end_profile();
	ASSERT_EQ_INT(0, atomic_load(&bus_io));
	ASSERT_EQ_INT(0, atomic_load(&calls_after_close));
	ASSERT_EQ_INT(0, atomic_load(&cameras[0].refs));
}

static void fuji_bulb_timing(void) {
	vendor_bulb(1227, 703);
}

static void fuji_bulb_priority_change(bool abort) {
	bulb_profile = fuji_priority_profile = true;
	PTP_CHECK(begin_profile(1227, 703));
	atomic_store(&cameras[0].hold_focus, true);
	indigo_change_number_property_1(&simulator_test_client, logical[0]->name, CCD_EXPOSURE_PROPERTY_NAME, CCD_EXPOSURE_ITEM_NAME, abort ? 10 : 0.02);
	PTP_CHECK(wait_value(&fuji_shutter_readback, 1));
	atomic_store(&cameras[0].hold_focus, false);
	PTP_CHECK(wait_value(&fuji_bulb_started, 1));
	if (abort) {
		indigo_change_switch_property_1(&simulator_test_client, logical[0]->name, CCD_ABORT_EXPOSURE_PROPERTY_NAME, CCD_ABORT_EXPOSURE_ITEM_NAME, true);
		PTP_CHECK(wait_value(&exposure_state, INDIGO_ALERT_STATE));
	} else {
		PTP_CHECK(wait_value(&exposure_state, INDIGO_OK_STATE));
	}
	PTP_CHECK(atomic_load(&cameras[0].held_us) > 0);
	PTP_CHECK(atomic_load(&cameras[0].held_us) < 200000);
	PTP_CHECK(atomic_load(command_count + ptp_operation_InitiateCapture) == 3);
cleanup:
	end_profile();
	ASSERT_EQ_INT(0, atomic_load(&bus_io));
	ASSERT_EQ_INT(0, atomic_load(&calls_after_close));
	ASSERT_EQ_INT(0, atomic_load(&cameras[0].refs));
}

static void fuji_bulb_priority_timing(void) {
	fuji_bulb_priority_change(false);
}

static void fuji_bulb_priority_abort(void) {
	fuji_bulb_priority_change(true);
}

static void fuji_bulb_rejected_recovery(void) {
	bulb_profile = fuji_priority_profile = fuji_reject_bulb = true;
	PTP_CHECK(begin_profile(1227, 703));
	indigo_change_number_property_1(&simulator_test_client, logical[0]->name, CCD_EXPOSURE_PROPERTY_NAME, CCD_EXPOSURE_ITEM_NAME, 1.25);
	PTP_CHECK(wait_value(&exposure_state, INDIGO_ALERT_STATE));
	PTP_CHECK(atomic_load(&fuji_bulb_started) == 0);
	PTP_CHECK(!atomic_load(&cameras[0].af_held));
	PTP_CHECK(cameras[0].fuji_mode == 0x0004);
	PTP_CHECK(atomic_load(command_count + ptp_operation_InitiateCapture) == 2);
	PTP_CHECK(atomic_load(&blobs) == 0);
	PTP_CHECK(!cameras[0].bulb);
	// Select a fixed shutter through the bus; its normal preparation takes PC priority.
	atomic_store(&shutter_state, -1);
	indigo_change_switch_property_1(&simulator_test_client, logical[0]->name, DSLR_SHUTTER_PROPERTY_NAME, "2710", true);
	PTP_CHECK(wait_value(&shutter_state, INDIGO_OK_STATE));
	atomic_store(&exposure_state, -1);
	indigo_change_number_property_1(&simulator_test_client, logical[0]->name, CCD_EXPOSURE_PROPERTY_NAME, CCD_EXPOSURE_ITEM_NAME, 0.125);
	PTP_CHECK(wait_value(&exposure_state, INDIGO_OK_STATE));
	PTP_CHECK(atomic_load(&blobs) == 1);
	PTP_CHECK(atomic_load(command_count + ptp_operation_InitiateCapture) == 4);
cleanup:
	end_profile();
	ASSERT_EQ_INT(0, atomic_load(&bus_io));
	ASSERT_EQ_INT(0, atomic_load(&calls_after_close));
	ASSERT_EQ_INT(0, atomic_load(&cameras[0].refs));
}

static void fuji_af_failure_cleanup(void) {
	fuji_af_error = true;
	PTP_CHECK(begin_profile(1227, 703));
	indigo_change_number_property_1(&simulator_test_client, logical[0]->name, CCD_EXPOSURE_PROPERTY_NAME, CCD_EXPOSURE_ITEM_NAME, 0.125);
	PTP_CHECK(wait_value(&exposure_state, INDIGO_ALERT_STATE));
	PTP_CHECK(!atomic_load(&cameras[0].af_held));
	PTP_CHECK(cameras[0].fuji_mode == 0x0004);
	PTP_CHECK(atomic_load(&blobs) == 0);
	fuji_af_error = false;
	atomic_store(&exposure_state, -1);
	indigo_change_number_property_1(&simulator_test_client, logical[0]->name, CCD_EXPOSURE_PROPERTY_NAME, CCD_EXPOSURE_ITEM_NAME, 0.125);
	PTP_CHECK(wait_value(&exposure_state, INDIGO_OK_STATE));
cleanup:
	end_profile();
	ASSERT_EQ_INT(0, atomic_load(&calls_after_close));
	ASSERT_EQ_INT(0, atomic_load(&cameras[0].refs));
}

static void fuji_af_abort_cleanup(void) {
	PTP_CHECK(begin_profile(1227, 703));
	atomic_store(&cameras[0].hold_focus, true);
	indigo_change_number_property_1(&simulator_test_client, logical[0]->name, CCD_EXPOSURE_PROPERTY_NAME, CCD_EXPOSURE_ITEM_NAME, 0.125);
	PTP_CHECK(wait_value(command_count + ptp_operation_InitiateCapture, 1));
	indigo_change_switch_property_1(&simulator_test_client, logical[0]->name, CCD_ABORT_EXPOSURE_PROPERTY_NAME, CCD_ABORT_EXPOSURE_ITEM_NAME, true);
	PTP_CHECK(wait_value(&exposure_state, INDIGO_ALERT_STATE));
	PTP_CHECK(!atomic_load(&cameras[0].af_held));
	PTP_CHECK(cameras[0].fuji_mode == 0x0004);
cleanup:
	end_profile();
	ASSERT_EQ_INT(0, atomic_load(&calls_after_close));
	ASSERT_EQ_INT(0, atomic_load(&cameras[0].refs));
}

static void fuji_af_cancel_error_recovery(void) {
	fuji_af_error = fuji_reject_cancel = true;
	PTP_CHECK(begin_profile(1227, 703));
	indigo_change_number_property_1(&simulator_test_client, logical[0]->name, CCD_EXPOSURE_PROPERTY_NAME, CCD_EXPOSURE_ITEM_NAME, 0.125);
	PTP_CHECK(wait_value(&exposure_state, INDIGO_ALERT_STATE));
	PTP_CHECK(atomic_load(&cameras[0].af_held));
	PTP_CHECK(atomic_load(command_count + ptp_operation_InitiateCapture) == 1);
	atomic_store(&exposure_state, -1);
	indigo_change_number_property_1(&simulator_test_client, logical[0]->name, CCD_EXPOSURE_PROPERTY_NAME, CCD_EXPOSURE_ITEM_NAME, 0.125);
	PTP_CHECK(wait_value(&exposure_state, INDIGO_ALERT_STATE));
	PTP_CHECK(atomic_load(command_count + ptp_operation_InitiateCapture) == 1);
	fuji_af_error = fuji_reject_cancel = false;
	atomic_store(&exposure_state, -1);
	indigo_change_number_property_1(&simulator_test_client, logical[0]->name, CCD_EXPOSURE_PROPERTY_NAME, CCD_EXPOSURE_ITEM_NAME, 0.125);
	PTP_CHECK(wait_value(&exposure_state, INDIGO_OK_STATE));
	PTP_CHECK(!atomic_load(&cameras[0].af_held));
	PTP_CHECK(atomic_load(command_count + ptp_operation_InitiateCapture) == 4);
cleanup:
	end_profile();
	ASSERT_EQ_INT(0, atomic_load(&bus_io));
	ASSERT_EQ_INT(0, atomic_load(&calls_after_close));
	ASSERT_EQ_INT(0, atomic_load(&cameras[0].refs));
}

static void fuji_af_disconnect_cleanup(void) {
	PTP_CHECK(begin_profile(1227, 703));
	atomic_store(&cameras[0].hold_focus, true);
	indigo_change_number_property_1(&simulator_test_client, logical[0]->name, CCD_EXPOSURE_PROPERTY_NAME, CCD_EXPOSURE_ITEM_NAME, 0.125);
	PTP_CHECK(wait_value(command_count + ptp_operation_InitiateCapture, 1));
	atomic_store(&connection_state, -1);
	indigo_change_switch_property_1(&simulator_test_client, logical[0]->name, CONNECTION_PROPERTY_NAME, CONNECTION_DISCONNECTED_ITEM_NAME, true);
	PTP_CHECK(wait_value(&connection_state, INDIGO_OK_STATE));
	PTP_CHECK(!atomic_load(&cameras[0].af_held));
	PTP_CHECK(cameras[0].fuji_mode == 0x0004);
cleanup:
	end_profile();
	ASSERT_EQ_INT(0, atomic_load(&bus_io));
	ASSERT_EQ_INT(0, atomic_load(&calls_after_close));
	ASSERT_EQ_INT(0, atomic_load(&cameras[0].refs));
}

static void fuji_bulb_declared_unsupported(int action_profile) {
	bulb_profile = fuji_priority_profile = true;
	fuji_action_profile = action_profile;
	PTP_CHECK(begin_profile(1227, 703));
	indigo_change_number_property_1(&simulator_test_client, logical[0]->name, CCD_EXPOSURE_PROPERTY_NAME, CCD_EXPOSURE_ITEM_NAME, 1.25);
	PTP_CHECK(wait_value(&exposure_state, INDIGO_ALERT_STATE));
	PTP_CHECK(atomic_load(command_count + ptp_operation_InitiateCapture) == 0);
	PTP_CHECK(!atomic_load(&cameras[0].af_held));
	PTP_CHECK(atomic_load(&blobs) == 0);
	PTP_CHECK(*value(cameras, ptp_property_fuji_ControlPriority) == 1);
	PTP_CHECK(*value(cameras, ptp_property_ExposureTime) == 0xffffffff);
	atomic_store(&shutter_state, -1);
	indigo_change_switch_property_1(&simulator_test_client, logical[0]->name, DSLR_SHUTTER_PROPERTY_NAME, "2710", true);
	PTP_CHECK(wait_value(&shutter_state, INDIGO_OK_STATE));
	atomic_store(&exposure_state, -1);
	indigo_change_number_property_1(&simulator_test_client, logical[0]->name, CCD_EXPOSURE_PROPERTY_NAME, CCD_EXPOSURE_ITEM_NAME, 0.125);
	PTP_CHECK(wait_value(&exposure_state, INDIGO_OK_STATE));
	PTP_CHECK(atomic_load(&blobs) == 1);
cleanup:
	end_profile();
	ASSERT_EQ_INT(0, atomic_load(&bus_io));
	ASSERT_EQ_INT(0, atomic_load(&calls_after_close));
	ASSERT_EQ_INT(0, atomic_load(&cameras[0].refs));
}

static bool cached_item_present(const char *property_name, const char *item_name, bool present) {
	double deadline = indigo_monotonic_time() + 5;
	while ((find_cached_item(property_name, item_name) != NULL) != present && indigo_monotonic_time() < deadline) {
		indigo_usleep(10000);
	}
	return (find_cached_item(property_name, item_name) != NULL) == present;
}

static bool cached_item_selected(const char *property_name, const char *item_name) {
	indigo_item *item = find_cached_item(property_name, item_name);
	return item != NULL && item->sw.value;
}

// X-T1 hardware run: Bulb was offered although the camera declares no USB BULB, and its write was
// rejected. Bulb stays only while the camera reports it.
static void fuji_bulb_not_offered(void) {
	fuji_priority_profile = true;
	fuji_action_profile = 1;
	profile_case = &fuji_case;
	PTP_CHECK(begin_profile(1227, 703));
	PTP_CHECK(cached_item_present(DSLR_SHUTTER_PROPERTY_NAME, "2710", true));
	PTP_CHECK(cached_item_present(DSLR_SHUTTER_PROPERTY_NAME, "1e84800", true));
	PTP_CHECK(cached_item_present(DSLR_SHUTTER_PROPERTY_NAME, "ffffffff", false));
	end_profile();
	bulb_profile = fuji_priority_profile = true;
	fuji_action_profile = 1;
	profile_case = &fuji_case;
	PTP_CHECK(begin_profile(1227, 703));
	PTP_CHECK(cached_item_present(DSLR_SHUTTER_PROPERTY_NAME, "ffffffff", true));
	PTP_CHECK(cached_item_selected(DSLR_SHUTTER_PROPERTY_NAME, "ffffffff"));
	atomic_store(&shutter_state, -1);
	indigo_change_switch_property_1(&simulator_test_client, logical[0]->name, DSLR_SHUTTER_PROPERTY_NAME, "2710", true);
	PTP_CHECK(wait_value(&shutter_state, INDIGO_OK_STATE));
	// Gone with the completed write, before the next value poll could remove it.
	PTP_CHECK(find_cached_item(DSLR_SHUTTER_PROPERTY_NAME, "ffffffff") == NULL);
	PTP_CHECK(cached_item_selected(DSLR_SHUTTER_PROPERTY_NAME, "2710"));
cleanup:
	end_profile();
	ASSERT_EQ_INT(0, atomic_load(&bus_io));
	ASSERT_EQ_INT(0, atomic_load(&calls_after_close));
	ASSERT_EQ_INT(0, atomic_load(&cameras[0].refs));
}

// X-T1 hardware run: after a rejected write DSLR_SHUTTER stayed on the rejected value, and so did the
// value the next exposure used.
static void rejected_setting_readback(void) {
	profile_case = &fuji_case;
	PTP_CHECK(begin_profile(1227, 703));
	PTP_CHECK(cached_item_selected(DSLR_SHUTTER_PROPERTY_NAME, "2710"));
	atomic_store(&fail_operation, ptp_operation_SetDevicePropValue);
	atomic_store(&shutter_state, -1);
	indigo_change_switch_property_1(&simulator_test_client, logical[0]->name, DSLR_SHUTTER_PROPERTY_NAME, "1e84800", true);
	PTP_CHECK(wait_value(&shutter_state, INDIGO_ALERT_STATE));
	atomic_store(&fail_operation, 0);
	PTP_CHECK(*value(cameras, ptp_property_ExposureTime) == 10000);
	PTP_CHECK(cached_item_selected(DSLR_SHUTTER_PROPERTY_NAME, "2710"));
	PTP_CHECK(!cached_item_selected(DSLR_SHUTTER_PROPERTY_NAME, "1e84800"));
cleanup:
	end_profile();
	ASSERT_EQ_INT(0, atomic_load(&bus_io));
	ASSERT_EQ_INT(0, atomic_load(&calls_after_close));
	ASSERT_EQ_INT(0, atomic_load(&cameras[0].refs));
}

// Hardware run: an ILCE-6000 charging over USB (054c:0994, HID only) was attached as "Sony Camera"
// through the Sony vendor wildcard and failed to connect.
static void sony_charger_not_attached(void) {
	PTP_CHECK(begin_profile(1356, 3352));
	cameras[1].vendor = 0x054c;
	cameras[1].product = 0x0994;
	cameras[1].hid_only = true;
	atomic_store(&cameras[1].visible, true);
	callback(NULL, (libusb_device *)(cameras + 1), LIBUSB_HOTPLUG_EVENT_DEVICE_ARRIVED, NULL);
	// Hot-plug events are serialized, so once the camera's removal is processed so is the charger.
	callback(NULL, (libusb_device *)cameras, LIBUSB_HOTPLUG_EVENT_DEVICE_LEFT, NULL);
	PTP_CHECK(wait_value(&attached, 0));
	PTP_CHECK(logical[1] == NULL);
cleanup:
	end_profile();
	ASSERT_EQ_INT(0, atomic_load(&bus_io));
	ASSERT_EQ_INT(0, atomic_load(&calls_after_close));
	ASSERT_EQ_INT(0, atomic_load(&cameras[1].refs));
}

static void fuji_bulb_missing_actions(void) {
	fuji_bulb_declared_unsupported(1);
}

static void fuji_bulb_missing_stop(void) {
	fuji_bulb_declared_unsupported(2);
}

static void fuji_bulb_unknown_actions(void) {
	fuji_action_profile = 3;
	vendor_bulb(1227, 703);
}

static void sony_bulb_timing(void) {
	vendor_bulb(1356, 3352);
}

static void olympus_bulb_timing(void) {
	vendor_bulb(1972, 310);
}

static void stream_stop_failure(uint16_t vendor, uint16_t product) {
	PTP_CHECK(begin_profile(vendor, product));
	uint16_t frame_op = vendor == 0x04a9 ? ptp_operation_canon_GetViewFinderData : vendor == 0x04b0 ? ptp_operation_nikon_GetLiveViewImg : vendor == 0x07b4 ? ptp_operation_olympus_GetLiveViewImage : ptp_operation_GetObject;
	uint16_t stop_op = vendor == 0x04a9 ? ptp_operation_canon_SetDevicePropValueEx : vendor == 0x04b0 ? ptp_operation_nikon_EndLiveView : vendor == 0x04cb ? ptp_operation_TerminateOpenCapture : ptp_operation_SetDevicePropValue;
	atomic_store(&gate_operation, frame_op);
	indigo_change_number_property_1(&simulator_test_client, logical[0]->name, CCD_STREAMING_PROPERTY_NAME, CCD_STREAMING_COUNT_ITEM_NAME, 1);
	PTP_CHECK(wait_value(&gate_entered, 1));
	atomic_store(&fail_operation, stop_op);
	atomic_store(&gate_open, 1);
	PTP_CHECK(wait_value(&streaming_state, INDIGO_ALERT_STATE));
	atomic_store(&fail_operation, 0);
	indigo_change_number_property_1(&simulator_test_client, logical[0]->name, CCD_STREAMING_PROPERTY_NAME, CCD_STREAMING_COUNT_ITEM_NAME, 1);
	PTP_CHECK(wait_value(&streaming_state, INDIGO_OK_STATE));
cleanup:
	end_profile();
	ASSERT_EQ_INT(0, atomic_load(&bus_io));
	ASSERT_EQ_INT(0, atomic_load(&calls_after_close));
	ASSERT_EQ_INT(0, atomic_load(&cameras[0].refs));
}

static void canon_stream_stop_failure(void) {
	stream_stop_failure(1193, 12824);
}

static void nikon_stream_stop_failure(void) {
	stream_stop_failure(1200, 1057);
}

static void nikon_stream_stop_retry(void) {
	PTP_CHECK(begin_profile(0x04b0, 0x0421));
	atomic_store(&gate_operation, ptp_operation_nikon_GetLiveViewImg);
	indigo_change_number_property_1(&simulator_test_client, logical[0]->name, CCD_STREAMING_PROPERTY_NAME, CCD_STREAMING_COUNT_ITEM_NAME, 1);
	PTP_CHECK(wait_value(&gate_entered, 1));
	atomic_store(&fail_reply, ptp_response_DeviceBusy);
	atomic_store(&fail_once_operation, ptp_operation_nikon_EndLiveView);
	atomic_store(&gate_open, 1);
	PTP_CHECK(wait_value(&streaming_state, INDIGO_OK_STATE));
	PTP_CHECK(atomic_load(command_count + ptp_operation_nikon_EndLiveView) == 2);
cleanup:
	end_profile();
	ASSERT_EQ_INT(0, atomic_load(&bus_io));
	ASSERT_EQ_INT(0, atomic_load(&calls_after_close));
	ASSERT_EQ_INT(0, atomic_load(&cameras[0].refs));
}

static void nikon_stream_stop_timeout(void) {
	PTP_CHECK(begin_profile(0x04b0, 0x0421));
	atomic_store(&gate_operation, ptp_operation_nikon_GetLiveViewImg);
	indigo_change_number_property_1(&simulator_test_client, logical[0]->name, CCD_STREAMING_PROPERTY_NAME, CCD_STREAMING_COUNT_ITEM_NAME, 1);
	PTP_CHECK(wait_value(&gate_entered, 1));
	atomic_store(&fail_reply, ptp_response_DeviceBusy);
	atomic_store(&fail_operation, ptp_operation_nikon_EndLiveView);
	atomic_store(&gate_open, 1);
	PTP_CHECK(wait_value(&streaming_state, INDIGO_ALERT_STATE));
	PTP_CHECK(atomic_load(command_count + ptp_operation_nikon_EndLiveView) == PTP_STOP_RETRY_LIMIT + 1);
cleanup:
	end_profile();
	ASSERT_EQ_INT(0, atomic_load(&bus_io));
	ASSERT_EQ_INT(0, atomic_load(&calls_after_close));
	ASSERT_EQ_INT(0, atomic_load(&cameras[0].refs));
}

static void fuji_stream_stop_failure(void) {
	stream_stop_failure(1227, 703);
}

static void olympus_stream_stop_failure(void) {
	stream_stop_failure(1972, 310);
}

static void partial_object(int mode) {
	partial_profile = mode;
	PTP_CHECK(begin_profile(0x04a9, 0x3218));
	indigo_change_number_property_1(&simulator_test_client, logical[0]->name, CCD_EXPOSURE_PROPERTY_NAME, CCD_EXPOSURE_ITEM_NAME, 0.02);
	PTP_CHECK(wait_value(&exposure_state, mode == 1 ? INDIGO_OK_STATE : INDIGO_ALERT_STATE));
	PTP_CHECK(atomic_load(&blobs) == (mode == 1 ? 1 : 0));
	PTP_CHECK(atomic_load(&bad_blob) == 0);
	PTP_CHECK(atomic_load(command_count + ptp_operation_canon_GetPartialObject) == 1);
cleanup:
	end_profile();
	ASSERT_EQ_INT(0, atomic_load(&calls_after_close));
	ASSERT_EQ_INT(0, atomic_load(&cameras[0].refs));
}

static void canon_combined_transfer_handshake(void) {
	combined_transfer_profile = true;
	canon_transfer_filename = "C2";
	PTP_CHECK(begin_profile(0x04a9, 0x3218));
	((canon_private_data *)((ptp_private_data *)logical[0]->private_data)->vendor_private_data)->use_ram = false;
	indigo_change_number_property_1(&simulator_test_client, logical[0]->name, CCD_EXPOSURE_PROPERTY_NAME, CCD_EXPOSURE_ITEM_NAME, 0.02);
	PTP_CHECK(wait_value(&exposure_state, INDIGO_OK_STATE));
	PTP_CHECK(atomic_load(command_count + ptp_operation_canon_TransferComplete) == 1);
	PTP_CHECK(atomic_load(command_count + ptp_operation_canon_GetObject) == 1);
	PTP_CHECK(atomic_load(&blobs) == 1);
cleanup:
	end_profile();
}

static void canon_transfer_layout(uint16_t event, uint16_t format, const char *name, const char *extension, bool large) {
	canon_transfer_event = event;
	canon_transfer_format = format;
	canon_transfer_filename = name;
	canon_transfer_large = large;
	PTP_CHECK(begin_profile(0x04a9, 0x3218));
	for (int i = 0; i < 2; i++) {
		indigo_change_number_property_1(&simulator_test_client, logical[0]->name, CCD_EXPOSURE_PROPERTY_NAME, CCD_EXPOSURE_ITEM_NAME, 0.02);
		PTP_CHECK(wait_value(&exposure_state, INDIGO_OK_STATE));
		PTP_CHECK(atomic_load(&blobs) == i + 1);
		PTP_CHECK(atomic_load(&bad_blob) == 0);
		PTP_CHECK(!strcasecmp(canon_transfer_blob_format, extension));
		PTP_CHECK(atomic_load(command_count + ptp_operation_canon_GetPartialObject) == (i + 1) * (large ? 2 : 1));
		PTP_CHECK(atomic_load(command_count + ptp_operation_canon_TransferComplete) == i + 1);
		PTP_CHECK(atomic_load(command_count + ptp_operation_GetPartialObject) == 0);
		PTP_CHECK(atomic_load(&canon_transfer_first_request) == (int)(large ? 0x200000 : jpeg_size));
		PTP_CHECK(atomic_load(&canon_transfer_protocol_errors) == 0);
	}
cleanup:
	end_profile();
	ASSERT_EQ_INT(0, atomic_load(&calls_after_close));
	ASSERT_EQ_INT(0, atomic_load(&bus_io));
	ASSERT_EQ_INT(0, atomic_load(&cameras[0].refs));
}

static void canon_transfer_ascii(void) {
	canon_transfer_layout(0xC186, 0xB108, "IMG_778.CR3", ".cr3", false);
}

static void canon_transfer64_ascii(void) {
	canon_transfer_layout(0xC1A9, 0xB108, "IMG_779.CR3", ".cr3", false);
}

static void canon_transfer_filename_boundary(void) {
	char filename[PTP_MAX_CHARS];
	memset(filename, 'A', sizeof(filename));
	memcpy(filename + sizeof(filename) - 5, ".CR3", 5);
	canon_transfer_layout(0xC186, 0xB108, filename, ".cr3", false);
	canon_transfer_layout(0xC1A9, 0xB108, filename, ".cr3", false);
}

static void canon_transfer_lfn_formats(void) {
	const uint16_t formats[] = { 0x3801, 0xB101, 0xB103, 0xB108 };
	const char *extensions[] = { ".jpeg", ".cr2", ".cr2", ".cr3" };
	for (unsigned i = 0; i < ARRAY_SIZE(formats); i++) {
		canon_transfer_layout(0xC1B8, formats[i], "", extensions[i], false);
	}
}

static void canon_transfer_empty_filename(void) {
	canon_transfer_layout(0xC186, 0xB108, "", ".cr3", false);
	canon_transfer_layout(0xC1A9, 0xB108, "", ".cr3", false);
}

static void canon_transfer_large_blocks(void) {
	canon_transfer_layout(0xC1A9, 0xB108, "LARGE.CR3", ".cr3", true);
}

static void canon_transfer_combined_events(void) {
	const uint16_t codes[] = { 0xC186, 0xC1A9, 0xC1B8 };
	for (unsigned i = 0; i < ARRAY_SIZE(codes); i++) {
		canon_transfer_event = codes[i];
		combined_transfer_profile = true;
		canon_transfer_filename = "C2";
		PTP_CHECK(begin_profile(0x04a9, 0x3218));
		((canon_private_data *)((ptp_private_data *)logical[0]->private_data)->vendor_private_data)->use_ram = false;
		indigo_change_number_property_1(&simulator_test_client, logical[0]->name, CCD_EXPOSURE_PROPERTY_NAME, CCD_EXPOSURE_ITEM_NAME, 0.02);
		PTP_CHECK(wait_value(&exposure_state, INDIGO_OK_STATE));
		PTP_CHECK(atomic_load(&blobs) == 1);
		PTP_CHECK(atomic_load(&bad_blob) == 0);
		PTP_CHECK(atomic_load(command_count + ptp_operation_canon_TransferComplete) == 1);
		PTP_CHECK(atomic_load(command_count + ptp_operation_canon_GetObject) == 1);
		PTP_CHECK(atomic_load(command_count + ptp_operation_canon_GetPartialObject) == 0);
		end_profile();
	}
	return;
cleanup:
	end_profile();
}

static void canon_transfer_failure_recovery(uint16_t event, uint16_t operation) {
	canon_transfer_event = event;
	PTP_CHECK(begin_profile(0x04a9, 0x3218));
	atomic_store(&fail_operation, operation);
	atomic_store(&fail_reply, ptp_response_DeviceBusy);
	indigo_change_number_property_1(&simulator_test_client, logical[0]->name, CCD_EXPOSURE_PROPERTY_NAME, CCD_EXPOSURE_ITEM_NAME, 0.02);
	PTP_CHECK(wait_value(&exposure_state, INDIGO_ALERT_STATE));
	PTP_CHECK(atomic_load(&blobs) == 0);
	PTP_CHECK(atomic_load(command_count + ptp_operation_canon_DeleteObject) == 0);
	atomic_store(&fail_operation, 0);
	atomic_store(&fail_reply, 0);
	indigo_change_number_property_1(&simulator_test_client, logical[0]->name, CCD_EXPOSURE_PROPERTY_NAME, CCD_EXPOSURE_ITEM_NAME, 0.02);
	PTP_CHECK(wait_value(&exposure_state, INDIGO_OK_STATE));
	PTP_CHECK(atomic_load(&blobs) == 1);
	PTP_CHECK(atomic_load(&bad_blob) == 0);
	PTP_CHECK(atomic_load(command_count + ptp_operation_canon_TransferComplete) == 2);
cleanup:
	end_profile();
}

static void canon_transfer_errors(void) {
	const uint16_t codes[] = { 0xC186, 0xC1A9, 0xC1B8 };
	for (unsigned i = 0; i < ARRAY_SIZE(codes); i++) {
		canon_transfer_failure_recovery(codes[i], ptp_operation_canon_GetPartialObject);
		canon_transfer_failure_recovery(codes[i], ptp_operation_canon_TransferComplete);
	}
}

static void canon_transfer_malformed(void) {
	const uint16_t codes[] = { 0xC186, 0xC1A9, 0xC1B8 };
	for (unsigned i = 0; i < ARRAY_SIZE(codes); i++) {
		canon_transfer_event = codes[i];
		PTP_CHECK(begin_profile(0x04a9, 0x3218));
		for (int fault = 1; fault <= 4; fault++) {
			if (codes[i] == 0xC1B8 && (fault == 2 || fault == 3)) {
				continue;
			}
			canon_transfer_fault = fault;
			int reads = atomic_load(command_count + ptp_operation_canon_GetPartialObject);
			int acks = atomic_load(command_count + ptp_operation_canon_TransferComplete);
			int images = atomic_load(&blobs);
			indigo_change_number_property_1(&simulator_test_client, logical[0]->name, CCD_EXPOSURE_PROPERTY_NAME, CCD_EXPOSURE_ITEM_NAME, 0.02);
			PTP_CHECK(wait_value(&exposure_state, INDIGO_ALERT_STATE));
			PTP_CHECK(atomic_load(&blobs) == images);
			PTP_CHECK(atomic_load(command_count + ptp_operation_canon_GetPartialObject) == reads);
			PTP_CHECK(atomic_load(command_count + ptp_operation_canon_TransferComplete) == acks);
			canon_transfer_fault = 0;
			indigo_change_number_property_1(&simulator_test_client, logical[0]->name, CCD_EXPOSURE_PROPERTY_NAME, CCD_EXPOSURE_ITEM_NAME, 0.02);
			PTP_CHECK(wait_value(&exposure_state, INDIGO_OK_STATE));
			PTP_CHECK(atomic_load(&blobs) == images + 1);
		}
		end_profile();
	}
	return;
cleanup:
	end_profile();
}

static void canon_partial_default_timeout(void) {
	partial_profile = 1;
	PTP_CHECK(begin_profile(0x04a9, 0x3218));
	// Native ICA does not initialize the libusb transaction timeout.
	((ptp_private_data *)logical[0]->private_data)->transaction_timeout = 0;
	indigo_change_number_property_1(&simulator_test_client, logical[0]->name, CCD_EXPOSURE_PROPERTY_NAME, CCD_EXPOSURE_ITEM_NAME, 0.02);
	PTP_CHECK(wait_value(&exposure_state, INDIGO_OK_STATE));
	PTP_CHECK(atomic_load(&blobs) == 1);
	PTP_CHECK(atomic_load(command_count + ptp_operation_canon_GetPartialObject) == 1);
cleanup:
	end_profile();
}

static void canon_partial_native(void) {
	partial_object(1);
}

static void canon_partial_zero(void) {
	partial_object(2);
}

static void canon_partial_oversized(void) {
	partial_object(3);
}

static void canon_transfer_completion_error(void) {
	partial_profile = 1;
	PTP_CHECK(begin_profile(0x04a9, 0x3218));
	atomic_store(&fail_operation, ptp_operation_canon_TransferComplete);
	atomic_store(&fail_reply, ptp_response_DeviceBusy);
	indigo_change_number_property_1(&simulator_test_client, logical[0]->name, CCD_EXPOSURE_PROPERTY_NAME, CCD_EXPOSURE_ITEM_NAME, 0.02);
	PTP_CHECK(wait_value(&exposure_state, INDIGO_ALERT_STATE));
	PTP_CHECK(atomic_load(&blobs) == 0);
	PTP_CHECK(atomic_load(command_count + ptp_operation_canon_TransferComplete) == 1);
	PTP_CHECK(atomic_load(command_count + ptp_operation_canon_DeleteObject) == 0);
	atomic_store(&fail_operation, 0);
	atomic_store(&fail_reply, 0);
	indigo_change_number_property_1(&simulator_test_client, logical[0]->name, CCD_EXPOSURE_PROPERTY_NAME, CCD_EXPOSURE_ITEM_NAME, 0.02);
	PTP_CHECK(wait_value(&exposure_state, INDIGO_OK_STATE));
	PTP_CHECK(atomic_load(&blobs) == 1);
	PTP_CHECK(atomic_load(command_count + ptp_operation_canon_TransferComplete) == 2);
cleanup:
	end_profile();
	ASSERT_EQ_INT(0, atomic_load(&calls_after_close));
	ASSERT_EQ_INT(0, atomic_load(&cameras[0].refs));
}

static void focus_error_profile(uint16_t vendor, uint16_t product, uint16_t operation) {
	PTP_CHECK(begin_profile(vendor, product));
	indigo_device *focuser = ((ptp_private_data *)logical[0]->private_data)->focuser;
	PTP_CHECK(focuser != NULL);
	indigo_change_switch_property_1(&simulator_test_client, focuser->name, CONNECTION_PROPERTY_NAME, CONNECTION_CONNECTED_ITEM_NAME, true);
	PTP_CHECK(wait_value(&focus_connection_state, INDIGO_OK_STATE));
	atomic_store(&fail_operation, operation);
	indigo_change_number_property_1(&simulator_test_client, focuser->name, FOCUSER_STEPS_PROPERTY_NAME, FOCUSER_STEPS_ITEM_NAME, 3);
	PTP_CHECK(wait_value(&focus_state, INDIGO_ALERT_STATE));
	atomic_store(&fail_operation, 0);
	indigo_change_number_property_1(&simulator_test_client, focuser->name, FOCUSER_STEPS_PROPERTY_NAME, FOCUSER_STEPS_ITEM_NAME, 3);
	PTP_CHECK(wait_value(&focus_state, INDIGO_OK_STATE));
cleanup:
	end_profile();
	ASSERT_EQ_INT(0, atomic_load(&bus_io));
	ASSERT_EQ_INT(0, atomic_load(&calls_after_close));
	ASSERT_EQ_INT(0, atomic_load(&cameras[0].refs));
}

static void canon_focus_error(void) {
	focus_error_profile(1193, 12824, ptp_operation_canon_DriveLens);
}

static void nikon_focus_error(void) {
	focus_error_profile(1200, 1057, ptp_operation_nikon_MfDrive);
}

static void nikon_focus_stop_retry(void) {
	PTP_CHECK(begin_profile(1200, 1057));
	indigo_device *focuser = ((ptp_private_data *)logical[0]->private_data)->focuser;
	PTP_CHECK(focuser != NULL);
	indigo_change_switch_property_1(&simulator_test_client, focuser->name, CONNECTION_PROPERTY_NAME, CONNECTION_CONNECTED_ITEM_NAME, true);
	PTP_CHECK(wait_value(&focus_connection_state, INDIGO_OK_STATE));
	atomic_store(&fail_reply, ptp_response_DeviceBusy);
	atomic_store(&fail_once_operation, ptp_operation_nikon_EndLiveView);
	indigo_change_number_property_1(&simulator_test_client, focuser->name, FOCUSER_STEPS_PROPERTY_NAME, FOCUSER_STEPS_ITEM_NAME, 3);
	PTP_CHECK(wait_value(&focus_state, INDIGO_OK_STATE));
	PTP_CHECK(atomic_load(command_count + ptp_operation_nikon_EndLiveView) == 2);
cleanup:
	end_profile();
	ASSERT_EQ_INT(0, atomic_load(&bus_io));
	ASSERT_EQ_INT(0, atomic_load(&calls_after_close));
	ASSERT_EQ_INT(0, atomic_load(&cameras[0].refs));
}

static void nikon_focus_not_liveview_retry(void) {
	PTP_CHECK(begin_profile(1200, 1057));
	indigo_device *focuser = ((ptp_private_data *)logical[0]->private_data)->focuser;
	PTP_CHECK(focuser != NULL);
	indigo_change_switch_property_1(&simulator_test_client, focuser->name, CONNECTION_PROPERTY_NAME, CONNECTION_CONNECTED_ITEM_NAME, true);
	PTP_CHECK(wait_value(&focus_connection_state, INDIGO_OK_STATE));
	atomic_store(&fail_reply, ptp_response_nikon_NotLiveView);
	atomic_store(&fail_once_operation, ptp_operation_nikon_MfDrive);
	indigo_change_number_property_1(&simulator_test_client, focuser->name, FOCUSER_STEPS_PROPERTY_NAME, FOCUSER_STEPS_ITEM_NAME, 3);
	PTP_CHECK(wait_value(&focus_state, INDIGO_OK_STATE));
	PTP_CHECK(atomic_load(command_count + ptp_operation_nikon_MfDrive) == 2);
cleanup:
	end_profile();
	ASSERT_EQ_INT(0, atomic_load(&bus_io));
	ASSERT_EQ_INT(0, atomic_load(&calls_after_close));
	ASSERT_EQ_INT(0, atomic_load(&cameras[0].refs));
}

static void nikon_focus_stop_timeout(void) {
	PTP_CHECK(begin_profile(1200, 1057));
	indigo_device *focuser = ((ptp_private_data *)logical[0]->private_data)->focuser;
	PTP_CHECK(focuser != NULL);
	indigo_change_switch_property_1(&simulator_test_client, focuser->name, CONNECTION_PROPERTY_NAME, CONNECTION_CONNECTED_ITEM_NAME, true);
	PTP_CHECK(wait_value(&focus_connection_state, INDIGO_OK_STATE));
	atomic_store(&fail_reply, ptp_response_DeviceBusy);
	atomic_store(&fail_operation, ptp_operation_nikon_EndLiveView);
	indigo_change_number_property_1(&simulator_test_client, focuser->name, FOCUSER_STEPS_PROPERTY_NAME, FOCUSER_STEPS_ITEM_NAME, 3);
	PTP_CHECK(wait_value(&focus_state, INDIGO_ALERT_STATE));
	PTP_CHECK(atomic_load(command_count + ptp_operation_nikon_EndLiveView) == PTP_STOP_RETRY_LIMIT + 1);
	atomic_store(&fail_operation, 0);
	atomic_store(&fail_reply, 0);
	indigo_change_number_property_1(&simulator_test_client, focuser->name, FOCUSER_STEPS_PROPERTY_NAME, FOCUSER_STEPS_ITEM_NAME, 3);
	PTP_CHECK(wait_value(&focus_state, INDIGO_OK_STATE));
cleanup:
	end_profile();
	ASSERT_EQ_INT(0, atomic_load(&bus_io));
	ASSERT_EQ_INT(0, atomic_load(&calls_after_close));
	ASSERT_EQ_INT(0, atomic_load(&cameras[0].refs));
}

static void sony_focus_error(void) {
	focus_error_profile(1356, 3352, ptp_operation_sony_SetControlDeviceB);
}

static void olympus_focus_error(void) {
	focus_error_profile(1972, 310, ptp_operation_olympus_MFDrive);
}

static ptp_private_data *ptp_data(void) {
	return (ptp_private_data *)logical[0]->private_data;
}

static unsigned code_count(const uint16_t *codes) {
	unsigned count = 0;
	while (count < PTP_MAX_ELEMENTS && codes[count]) {
		count++;
	}
	return count;
}

static bool wait_not_busy(atomic_int *state) {
	double deadline = indigo_monotonic_time() + 10;
	while (atomic_load(state) == INDIGO_BUSY_STATE && indigo_monotonic_time() < deadline) {
		indigo_usleep(10000);
	}
	return atomic_load(state) != INDIGO_BUSY_STATE;
}

static bool capture_once(void) {
	int before = atomic_load(&blobs);
	indigo_change_number_property_1(&simulator_test_client, logical[0]->name, CCD_EXPOSURE_PROPERTY_NAME, CCD_EXPOSURE_ITEM_NAME, 0.02);
	return wait_value(&exposure_state, INDIGO_OK_STATE) && atomic_load(&blobs) == before + 1 && atomic_load(&bad_blob) == 0;
}

static void finish_bounds_case(void) {
	end_profile();
	ASSERT_EQ_INT(0, atomic_load(&bus_io));
	ASSERT_EQ_INT(0, atomic_load(&calls_after_close));
	ASSERT_EQ_INT(atomic_load(&cameras[0].opens), atomic_load(&cameras[0].closes));
	ASSERT_EQ_INT(0, atomic_load(&cameras[0].refs));
}

static void device_info_truncated(void) {
	device_info_fault = 1;
	PTP_CHECK(begin_profile(0x04b0, 0x0421));
	PTP_CHECK(ptp_data()->info_manufacturer[0] == 0 && ptp_data()->info_model[0] == 0 && ptp_data()->info_device_version[0] == 0 && ptp_data()->info_serial_number[0] == 0);
	PTP_CHECK(ptp_operation_supported(logical[0], ptp_operation_GetObject));
	PTP_CHECK(ptp_property_supported(logical[0], ptp_property_ExposureTime) != NULL);
	PTP_CHECK(capture_once());
cleanup:
	finish_bounds_case();
}

// ICA delivers exactly the received bytes, without the USB transport padding; ASan sees any read past them.
static void device_info_exact_buffer(void) {
	uint8_t scratch[4096], *p = scratch;
	reset_fake(0x04b0, 0x0421);
	for (int fault = 1; fault <= 2; fault++) {
		p = scratch;
		device_info_fault = fault;
		device_info(cameras, &p);
		device_info_fault = 0;
		uint32_t size = (uint32_t)(p - scratch);
		uint8_t *buffer = malloc(size);
		memcpy(buffer, scratch, size);
		ptp_private_data *private_data = indigo_safe_malloc(sizeof(ptp_private_data));
		strcpy(private_data->info_model, "stale");
		indigo_device device = { .private_data = private_data };
		ASSERT_TRUE(ptp_decode_device_info(buffer, size, &device) == NULL);
		ASSERT_TRUE(private_data->info_model[0] == 0);
		ASSERT_EQ_INT(fault == 1 ? 3 : 0, code_count(private_data->info_properties_supported));
		ASSERT_TRUE(code_count(private_data->info_operations_supported) > 0);
		free(private_data);
		free(buffer);
	}
}

static void device_info_short_array(void) {
	device_info_fault = 2;
	PTP_CHECK(begin_profile(0x04b0, 0x0421));
	PTP_CHECK(ptp_operation_supported(logical[0], ptp_operation_GetObject));
	PTP_CHECK(ptp_property_supported(logical[0], ptp_property_ExposureTime) == NULL);
	PTP_CHECK(ptp_data()->info_manufacturer[0] == 0 && ptp_data()->info_model[0] == 0);
cleanup:
	finish_bounds_case();
}

static void device_info_oversized_array(void) {
	device_info_fault = 3;
	PTP_CHECK(begin_profile(0x04b0, 0x0421));
	PTP_CHECK(code_count(ptp_data()->info_events_supported) == PTP_MAX_ELEMENTS - 1);
	PTP_CHECK(ptp_data()->info_events_supported[PTP_MAX_ELEMENTS - 2] == 0x4800 + PTP_MAX_ELEMENTS - 2);
	PTP_CHECK(ptp_property_supported(logical[0], ptp_property_ExposureTime) != NULL);
	PTP_CHECK(!strcmp(ptp_data()->info_model, "Queue test") && !strcmp(ptp_data()->info_serial_number, "1234"));
	PTP_CHECK(capture_once());
cleanup:
	finish_bounds_case();
}

static void descriptor_oversized_enum(void) {
	descriptor_fault = 1;
	PTP_CHECK(begin_profile(0x04b0, 0x0421));
	ptp_property *balance = ptp_property_supported(logical[0], ptp_property_WhiteBalance);
	PTP_CHECK(balance != NULL && balance->count == PTP_MAX_ELEMENTS && balance->value.sw.values[PTP_MAX_ELEMENTS - 1] == PTP_MAX_ELEMENTS);
	PTP_CHECK(balance->property != NULL && balance->property->count == PTP_MAX_ELEMENTS);
	ptp_property *size = ptp_property_supported(logical[0], ptp_property_ImageSize);
	PTP_CHECK(size != NULL && size->count == 16 && !strcmp(size->value.sw_str.values[15], "W15") && !strcmp(size->value.sw_str.value, "W00"));
	PTP_CHECK(size->property != NULL && size->property->count == 16);
	PTP_CHECK(capture_once());
cleanup:
	finish_bounds_case();
}

static void descriptor_truncated_enum(void) {
	descriptor_fault = 2;
	PTP_CHECK(begin_profile(0x04b0, 0x0421));
	ptp_property *balance = ptp_property_supported(logical[0], ptp_property_WhiteBalance);
	PTP_CHECK(balance != NULL && balance->count == 4 && balance->value.sw.values[3] == 4);
	PTP_CHECK(balance->property != NULL && balance->property->count == 4);
	PTP_CHECK(capture_once());
cleanup:
	finish_bounds_case();
}

static void sony_oversized_extension_info(void) {
	sony_extension_fault = true;
	PTP_CHECK(begin_profile(0x054c, 0x0d18));
	PTP_CHECK(code_count(ptp_data()->info_operations_supported) == PTP_MAX_ELEMENTS - 1);
	PTP_CHECK(ptp_property_supported(logical[0], ptp_property_sony_ShutterSpeed) != NULL);
	PTP_CHECK(capture_once());
cleanup:
	finish_bounds_case();
}

static void canon_oversized_device_info_ex(void) {
	canon_info_ex_fault = true;
	PTP_CHECK(begin_profile(0x04a9, 0x3218));
	PTP_CHECK(code_count(ptp_data()->info_events_supported) == PTP_MAX_ELEMENTS - 1);
	PTP_CHECK(ptp_property_supported(logical[0], ptp_property_canon_ShutterSpeed) != NULL);
	PTP_CHECK(capture_once());
cleanup:
	finish_bounds_case();
}

static void canon_custom_func_case(int fault) {
	fprintf(stderr, "custom function fault %d\n", fault);
	canon_custom_func_profile = true;
	canon_custom_func_fault = fault;
	PTP_CHECK(begin_profile(0x04a9, 0x3218));
	canon_private_data *canon = ptp_data()->vendor_private_data;
	ptp_property *item = ptp_property_supported(logical[0], 0x8101);
	if (fault == 0) {
		PTP_CHECK(canon->ex_func_group[0][0] == 32 && canon->ex_func_group[0][2] == 1 && canon->ex_func_group[0][3] == 20 && canon->ex_func_group[0][4] == 1);
		PTP_CHECK(item != NULL && item->value.sw.value == 7);
	} else {
		for (unsigned i = 0; i < 16; i++) {
			PTP_CHECK(canon->ex_func_group[i][0] == 0);
		}
		PTP_CHECK(item == NULL);
	}
	PTP_CHECK(capture_once());
cleanup:
	finish_bounds_case();
}

static void canon_custom_func_ex_bounds(void) {
	for (int fault = 0; fault <= 6; fault++) {
		canon_custom_func_case(fault);
	}
}

static void object_size_case(uint16_t vendor, uint16_t product, int delta, bool short_info) {
	fprintf(stderr, "object size vendor=%04x delta=%d short=%d\n", vendor, delta, short_info);
	object_info_delta = delta;
	object_info_short = short_info;
	PTP_CHECK(begin_profile(vendor, product));
	if (short_info) {
		indigo_change_number_property_1(&simulator_test_client, logical[0]->name, CCD_EXPOSURE_PROPERTY_NAME, CCD_EXPOSURE_ITEM_NAME, 0.02);
		PTP_CHECK(wait_not_busy(&exposure_state));
		PTP_CHECK(atomic_load(&blobs) == 0);
		PTP_CHECK(atomic_load(command_count + ptp_operation_GetObjectInfo) > 0);
		PTP_CHECK(atomic_load(command_count + ptp_operation_GetObject) == 0);
		object_info_short = false;
		// Sony still holds the rejected object and may deliver it together with the next one.
		indigo_change_number_property_1(&simulator_test_client, logical[0]->name, CCD_EXPOSURE_PROPERTY_NAME, CCD_EXPOSURE_ITEM_NAME, 0.02);
		PTP_CHECK(wait_value(&exposure_state, INDIGO_OK_STATE));
		PTP_CHECK(atomic_load(&blobs) >= 1 && atomic_load(&bad_blob) == 0);
	} else {
		PTP_CHECK(capture_once());
	}
cleanup:
	finish_bounds_case();
}

static void object_size_mismatch(uint16_t vendor, uint16_t product) {
	object_size_case(vendor, product, 4096, false);
	object_size_case(vendor, product, -100, false);
	object_size_case(vendor, product, 0, true);
}

static void object_size_mismatch_nikon(void) {
	object_size_mismatch(0x04b0, 0x0421);
}

static void object_size_mismatch_sony(void) {
	object_size_mismatch(0x054c, 0x0d18);
}

static void object_size_mismatch_fuji(void) {
	object_size_mismatch(0x04cb, 0x02bf);
}

static bool canon_text_write(const char *value) {
	indigo_property *property = indigo_init_text_property(NULL, logical[0]->name, "TEST_TEXT", "Test", "Test", INDIGO_OK_STATE, INDIGO_RW_PERM, 1);
	indigo_init_text_item(property->items, "VALUE", "Value", value);
	ptp_property target = { .code = ptp_property_canon_Artist, .type = ptp_str_type, .property = property };
	atomic_store(&canon_text_size, 0);
	// The write runs on the test thread by design; it is not bus-callback I/O.
	int io = atomic_load(&bus_io);
	bool result = ptp_canon_set_property(logical[0], &target);
	atomic_store(&bus_io, io);
	indigo_release_property(property);
	return result;
}

// ILCE-7RM4 answers DeviceBusy to the first AF command shortly after a session opens (seen on
// hardware after a reconnect); the exposure retries it instead of failing, and still fails once
// the camera stays busy past the settling window.
static void sony_busy_after_connect(void) {
	PTP_CHECK(begin_profile(0x054c, 0x0d18));
	atomic_store(&fail_reply, ptp_response_DeviceBusy);
	atomic_store(&fail_once_operation, ptp_operation_sony_SetControlDeviceB);
	PTP_CHECK(capture_once());
	atomic_store(&fail_operation, ptp_operation_sony_SetControlDeviceB);
	indigo_change_number_property_1(&simulator_test_client, logical[0]->name, CCD_EXPOSURE_PROPERTY_NAME, CCD_EXPOSURE_ITEM_NAME, 0.02);
	PTP_CHECK(wait_not_busy(&exposure_state) || wait_not_busy(&exposure_state));
	PTP_CHECK(atomic_load(&exposure_state) == INDIGO_ALERT_STATE);
	atomic_store(&fail_operation, 0);
	atomic_store(&fail_reply, 0);
cleanup:
	finish_bounds_case();
}

static indigo_property_state wait_setting(ptp_property *setting) {
	double deadline = indigo_monotonic_time() + 10;
	while (setting->property->state == INDIGO_BUSY_STATE && indigo_monotonic_time() < deadline) {
		indigo_usleep(10000);
	}
	return setting->property->state;
}

// A write the camera acknowledges but drops stays BUSY, is rewritten and confirmed from the camera's
// own report (ILCE-7RM4, seen on hardware right after captures); one it never applies ends ALERT
// showing the camera's value.
static void sony_dropped_setting_write(void) {
	sony_compression_profile = true;
	PTP_CHECK(begin_profile(0x054c, 0x0d18));
	ptp_property *setting = ptp_property_supported(logical[0], ptp_property_sony_CompressionSetting);
	PTP_CHECK(setting != NULL && setting->property != NULL && setting->property->type == INDIGO_SWITCH_VECTOR);
	// One dropped write leaves a full rewrite period inside the 3 s confirmation window.
	for (int dropped = 0; dropped <= 1; dropped++) {
		const char *item = dropped == 1 ? "3" : "1";
		int writes = atomic_load(command_count + ptp_operation_sony_SetControlDeviceA);
		atomic_store(&sony_dropped_writes, dropped);
		indigo_change_switch_property_1(&simulator_test_client, logical[0]->name, DSLR_COMPRESSION_PROPERTY_NAME, item, true);
		PTP_CHECK(wait_setting(setting) == INDIGO_OK_STATE);
		PTP_CHECK(*value(cameras, ptp_property_sony_CompressionSetting) == (uint32_t)strtol(item, NULL, 16));
		PTP_CHECK(indigo_get_switch(setting->property, item));
		PTP_CHECK(atomic_load(command_count + ptp_operation_sony_SetControlDeviceA) == writes + dropped + 1);
	}
	atomic_store(&sony_dropped_writes, 100);
	indigo_change_switch_property_1(&simulator_test_client, logical[0]->name, DSLR_COMPRESSION_PROPERTY_NAME, "2", true);
	PTP_CHECK(wait_setting(setting) == INDIGO_ALERT_STATE);
	PTP_CHECK(*value(cameras, ptp_property_sony_CompressionSetting) == 3);
	PTP_CHECK(indigo_get_switch(setting->property, "3"));
	atomic_store(&sony_dropped_writes, 0);
cleanup:
	finish_bounds_case();
}

// The camera identity from DeviceInfo is published in INFO once connected.
static void device_identity_published(void) {
	PTP_CHECK(begin_profile(0x04a9, 0x3218));
	indigo_item *model = find_cached_item(INFO_PROPERTY_NAME, INFO_DEVICE_MODEL_ITEM_NAME);
	indigo_item *firmware = find_cached_item(INFO_PROPERTY_NAME, INFO_DEVICE_FW_REVISION_ITEM_NAME);
	indigo_item *serial = find_cached_item(INFO_PROPERTY_NAME, INFO_DEVICE_SERIAL_NUM_ITEM_NAME);
	PTP_CHECK(model != NULL && firmware != NULL && serial != NULL);
	PTP_CHECK(!strcmp(model->text.value, "Queue test") && !strcmp(firmware->text.value, "1") && !strcmp(serial->text.value, "1234"));
cleanup:
	finish_bounds_case();
}

static void canon_long_text_property(void) {
	char value[301];
	for (unsigned i = 0; i < 300; i++) {
		value[i] = 'A' + i % 26;
	}
	value[300] = 0;
	uint32_t length = 0;
	PTP_CHECK(begin_profile(0x04a9, 0x3218));
	PTP_CHECK(canon_text_write(value));
	PTP_CHECK(atomic_load(&canon_text_size) == 8 + PTP_MAX_CHARS);
	memcpy(&length, canon_text_payload, sizeof(length));
	PTP_CHECK(length == 8 + PTP_MAX_CHARS);
	PTP_CHECK(!memcmp(canon_text_payload + 8, value, PTP_MAX_CHARS - 1) && canon_text_payload[8 + PTP_MAX_CHARS - 1] == 0);
	PTP_CHECK(canon_text_write("INDIGO"));
	PTP_CHECK(atomic_load(&canon_text_size) == 8 + 7);
	PTP_CHECK(!memcmp(canon_text_payload + 8, "INDIGO", 7));
cleanup:
	finish_bounds_case();
}

int main(void) {
	indigo_test_use_private_home();
	make_jpeg();
	make_dng();
	if (getenv("PTP_TEST_DEBUG")) {
		indigo_set_log_level(INDIGO_LOG_DEBUG);
	}
	const indigo_test_case tests[] = {
		{ "device_info_truncated", device_info_truncated },
		{ "device_info_exact_buffer", device_info_exact_buffer },
		{ "device_info_short_array", device_info_short_array },
		{ "device_info_oversized_array", device_info_oversized_array },
		{ "descriptor_oversized_enum", descriptor_oversized_enum },
		{ "descriptor_truncated_enum", descriptor_truncated_enum },
		{ "sony_oversized_extension_info", sony_oversized_extension_info },
		{ "canon_oversized_device_info_ex", canon_oversized_device_info_ex },
		{ "canon_custom_func_ex_bounds", canon_custom_func_ex_bounds },
		{ "object_size_mismatch_nikon", object_size_mismatch_nikon },
		{ "object_size_mismatch_sony", object_size_mismatch_sony },
		{ "object_size_mismatch_fuji", object_size_mismatch_fuji },
		{ "canon_long_text_property", canon_long_text_property },
		{ "device_identity_published", device_identity_published },
		{ "sony_busy_after_connect", sony_busy_after_connect },
		{ "sony_dropped_setting_write", sony_dropped_setting_write },
		{ "canon_focus_error", canon_focus_error },
		{ "nikon_focus_error", nikon_focus_error },
		{ "nikon_focus_stop_retry", nikon_focus_stop_retry },
		{ "nikon_focus_not_liveview_retry", nikon_focus_not_liveview_retry },
		{ "nikon_focus_stop_timeout", nikon_focus_stop_timeout },
		{ "sony_focus_error", sony_focus_error },
		{ "olympus_focus_error", olympus_focus_error },
		{ "canon_partial_native", canon_partial_native },
		{ "canon_transfer_ascii", canon_transfer_ascii },
		{ "canon_transfer64_ascii", canon_transfer64_ascii },
		{ "canon_transfer_filename_boundary", canon_transfer_filename_boundary },
		{ "canon_transfer_lfn_formats", canon_transfer_lfn_formats },
		{ "canon_transfer_empty_filename", canon_transfer_empty_filename },
		{ "canon_transfer_large_blocks", canon_transfer_large_blocks },
		{ "canon_transfer_combined_events", canon_transfer_combined_events },
		{ "canon_transfer_errors", canon_transfer_errors },
		{ "canon_transfer_malformed", canon_transfer_malformed },
		{ "canon_combined_transfer_handshake", canon_combined_transfer_handshake },
		{ "canon_partial_default_timeout", canon_partial_default_timeout },
		{ "canon_transfer_completion_error", canon_transfer_completion_error },
		{ "canon_destination_prefers_ram", canon_destination_prefers_ram },
		{ "canon_destination_ram_only", canon_destination_ram_only },
		{ "canon_destination_card_only", canon_destination_card_only },
		{ "canon_destination_write_error", canon_destination_write_error },
		{ "canon_destination_capacity_error", canon_destination_capacity_error },
		{ "canon_destination_change_capacity", canon_destination_change_capacity },
		{ "canon_destination_change_capacity_recovery", canon_destination_change_capacity_recovery },
		{ "canon_stream_not_ready", canon_stream_not_ready },
		{ "canon_stream_not_ready_recovery", canon_stream_not_ready_recovery },
		{ "canon_partial_zero", canon_partial_zero },
		{ "canon_partial_oversized", canon_partial_oversized },
		{ "canon_stream_stop_failure", canon_stream_stop_failure },
		{ "nikon_stream_stop_failure", nikon_stream_stop_failure },
		{ "nikon_stream_stop_retry", nikon_stream_stop_retry },
		{ "nikon_stream_stop_timeout", nikon_stream_stop_timeout },
		{ "fuji_stream_stop_failure", fuji_stream_stop_failure },
		{ "olympus_stream_stop_failure", olympus_stream_stop_failure },
		{ "nikon_bulb_timing", nikon_bulb_timing },
		{ "nikon_bulb_stop_retry", nikon_bulb_stop_retry },
		{ "nikon_bulb_stop_timeout", nikon_bulb_stop_timeout },
		{ "fuji_bulb_timing", fuji_bulb_timing },
		{ "fuji_bulb_priority_timing", fuji_bulb_priority_timing },
		{ "fuji_bulb_priority_abort", fuji_bulb_priority_abort },
		{ "fuji_bulb_rejected_recovery", fuji_bulb_rejected_recovery },
		{ "fuji_bulb_missing_actions", fuji_bulb_missing_actions },
		{ "fuji_bulb_not_offered", fuji_bulb_not_offered },
		{ "rejected_setting_readback", rejected_setting_readback },
		{ "sony_charger_not_attached", sony_charger_not_attached },
		{ "fuji_bulb_missing_stop", fuji_bulb_missing_stop },
		{ "fuji_bulb_unknown_actions", fuji_bulb_unknown_actions },
		{ "fuji_af_failure_cleanup", fuji_af_failure_cleanup },
		{ "fuji_af_abort_cleanup", fuji_af_abort_cleanup },
		{ "fuji_af_cancel_error_recovery", fuji_af_cancel_error_recovery },
		{ "fuji_af_disconnect_cleanup", fuji_af_disconnect_cleanup },
		{ "sony_bulb_timing", sony_bulb_timing },
		{ "olympus_bulb_timing", olympus_bulb_timing },
		{ "canon_countdown_with_occupied_queue", canon_countdown_with_occupied_queue },
		{ "canon_property_contract", canon_property_contract },
		{ "generic_unsupported_capture", generic_unsupported_capture },
		{ "sony_af_completion", sony_af_completion },
		{ "sony_dual_raw_first", sony_dual_raw_first },
		{ "sony_dual_jpeg_first", sony_dual_jpeg_first },
		{ "sony_dual_preview_disabled", sony_dual_preview_disabled },
		{ "sony_ignored_press", sony_ignored_press },
		{ "sony_fast_reopen", sony_fast_reopen },
		{ "sony_long_exposure_noise_reduction", sony_long_exposure_noise_reduction },
		{ "sony_old_api_aborted_shot", sony_old_api_aborted_shot },
		{ "sony_old_api_aborted_shot_idle", sony_old_api_aborted_shot_idle },
		{ "sony_old_api_lost_shot_expires", sony_old_api_lost_shot_expires },
		{ "sony_liveview_after_capture", sony_liveview_after_capture },
		{ "sony_af_disconnect", sony_af_disconnect },
		{ "canon_shutter_stop_recovery", canon_shutter_stop_recovery },
		{ "nikon_dual_preview_corrupt_jpeg", nikon_dual_preview_corrupt_jpeg },
		{ "nikon_dual_preview_raw_enabled", nikon_dual_preview_raw_enabled },
		{ "nikon_dual_preview_raw_histogram", nikon_dual_preview_raw_histogram },
		{ "nikon_dual_preview_enabled", nikon_dual_preview_enabled },
		{ "nikon_dual_preview_histogram", nikon_dual_preview_histogram },
		{ "canon_dual_native_preview", canon_dual_native_preview },
		{ "canon_missing_dual_native", canon_missing_dual_native },
		{ "canon_controls", canon_controls },
		{ "canon_mirror_redundant_off", canon_mirror_redundant_off },
		{ "canon_mirror_unknown_value", canon_mirror_unknown_value },
		{ "canon_mirror_transitions", canon_mirror_transitions },
		{ "canon_mirror_write_recovery", canon_mirror_write_recovery },
		{ "canon_stream_error", canon_stream_error },
		{ "nikon_stream_error", nikon_stream_error },
		{ "fuji_stream_error", fuji_stream_error },
		{ "sony_stream_error", sony_stream_error },
		{ "olympus_stream_error", olympus_stream_error },
		{ "olympus_stream_transient_error", olympus_stream_transient_error },
		{ "olympus_native_capture_events", olympus_native_capture_events },
		{ "canon_malformed_stream", canon_malformed_stream },
		{ "immutable_property_requests", immutable_property_requests },
		{ "property_error_recovery", property_error_recovery },
		{ "discovery_capacity", discovery_capacity },
		{ "discovery_reject_and_retry", discovery_reject_and_retry },
		{ "initialization_retry", initialization_retry },
		{ "open_failure_recovery", open_failure_recovery },
		{ "claim_failure_recovery", claim_failure_recovery },
		{ "canon_bulb_timing", canon_bulb_timing },
		{ "canon_focus", canon_focus },
		{ "nikon_focus", nikon_focus },
		{ "sony_focus", sony_focus },
		{ "olympus_focus", olympus_focus },
		{ "canon_bad_response", canon_bad_response },
		{ "canon_active_unplug", canon_active_unplug },
		{ "canon_active_disconnect", canon_active_disconnect },
		{ "nikon_bad_response", nikon_bad_response },
		{ "nikon_active_unplug", nikon_active_unplug },
		{ "nikon_active_disconnect", nikon_active_disconnect },
		{ "fuji_bad_response", fuji_bad_response },
		{ "fuji_active_unplug", fuji_active_unplug },
		{ "fuji_active_disconnect", fuji_active_disconnect },
		{ "sony_bad_response", sony_bad_response },
		{ "sony_active_unplug", sony_active_unplug },
		{ "sony_active_disconnect", sony_active_disconnect },
		{ "olympus_bad_response", olympus_bad_response },
		{ "olympus_active_unplug", olympus_active_unplug },
		{ "olympus_active_disconnect", olympus_active_disconnect },
		{ "canon_exposure", canon_exposure },
		{ "nikon_exposure", nikon_exposure },
		{ "fuji_exposure", fuji_exposure },
		{ "sony_exposure", sony_exposure },
		{ "olympus_exposure", olympus_exposure },
		{ "canon_stream", canon_stream },
		{ "canon_abort", canon_abort },
		{ "canon_start_error", canon_start_error },
		{ "canon_timeout", canon_timeout },
		{ "canon_reconnect", canon_reconnect },
		{ "nikon_stream", nikon_stream },
		{ "nikon_abort", nikon_abort },
		{ "nikon_start_error", nikon_start_error },
		{ "nikon_timeout", nikon_timeout },
		{ "nikon_reconnect", nikon_reconnect },
		{ "fuji_stream", fuji_stream },
		{ "fuji_abort", fuji_abort },
		{ "fuji_start_error", fuji_start_error },
		{ "fuji_timeout", fuji_timeout },
		{ "fuji_reconnect", fuji_reconnect },
		{ "sony_stream", sony_stream },
		{ "sony_abort", sony_abort },
		{ "sony_start_error", sony_start_error },
		{ "sony_timeout", sony_timeout },
		{ "sony_reconnect", sony_reconnect },
		{ "olympus_stream", olympus_stream },
		{ "olympus_abort", olympus_abort },
		{ "olympus_start_error", olympus_start_error },
		{ "olympus_timeout", olympus_timeout },
		{ "olympus_reconnect", olympus_reconnect }
	};
	indigo_test_case selected[ARRAY_SIZE(tests)];
	unsigned count = 0;
	const char *filter = getenv("PTP_TEST_FILTER");
	for (unsigned i = 0; i < ARRAY_SIZE(tests); i++) {
		if (!filter || strstr(tests[i].name, filter)) {
			selected[count++] = tests[i];
		}
	}
	int result = count ? indigo_run_tests("PTP fake USB", selected, count) : 1;
	free(jpeg);
	free(dng);
	indigo_test_remove_private_home();
	return result;
}
