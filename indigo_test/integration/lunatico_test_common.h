// Copyright (c) 2026 INDIGO initiative
// All rights reserved.
//
// You may use this software under the terms of 'INDIGO Astronomy
// open-source license' (see LICENSE.md).
//
// THIS SOFTWARE IS PROVIDED BY THE AUTHORS 'AS IS' AND ANY EXPRESS
// OR IMPLIED WARRANTIES, INCLUDING, BUT NOT LIMITED TO, THE IMPLIED
// WARRANTIES OF MERCHANTABILITY AND FITNESS FOR A PARTICULAR PURPOSE
// ARE DISCLAIMED. IN NO EVENT SHALL THE AUTHOR BE LIABLE FOR ANY
// DIRECT, INDIRECT, INCIDENTAL, SPECIAL, EXEMPLARY, OR CONSEQUENTIAL
// DAMAGES (INCLUDING, BUT NOT LIMITED TO, PROCUREMENT OF SUBSTITUTE
// GOODS OR SERVICES; LOSS OF USE, DATA, OR PROFITS; OR BUSINESS
// INTERRUPTION) HOWEVER CAUSED AND ON ANY THEORY OF LIABILITY,
// WHETHER IN CONTRACT, STRICT LIABILITY, OR TORT (INCLUDING
// NEGLIGENCE OR OTHERWISE) ARISING IN ANY WAY OUT OF THE USE OF THIS
// SOFTWARE, EVEN IF ADVISED OF THE POSSIBILITY OF SUCH DAMAGE.

// Code is generated by AI

// Helpers shared by test_focuser_lunatico_simulator.c and
// test_rotator_lunatico_simulator.c. Both drive the same Lunatico controller
// simulator, so the transport helpers, the out-of-band control channel and the
// recorded command log are common; only the exercised device classes differ.
//
// Include after serial_simulator_test_common.h and aux_test_isolation.h.

#ifndef LUNATICO_TEST_COMMON_H
#define LUNATICO_TEST_COMMON_H

// Driver-specific property names. The pre-migration driver published one set of
// LA_* names on both device classes; the migration renames them to the mandatory
// X_ prefix and qualifies them by class, because the generator needs a distinct
// handle per logical device. The scenarios themselves are unchanged; see
// indigo_drivers/focuser_lunatico/REFACTOR.md, defect LU-04.
#define X_FOCUSER_STEP_MODE_PROPERTY_NAME          "X_FOCUSER_STEP_MODE"
#define X_FOCUSER_POWER_CONTROL_PROPERTY_NAME      "X_FOCUSER_POWER_CONTROL"
#define X_FOCUSER_TEMPERATURE_SENSOR_PROPERTY_NAME "X_FOCUSER_TEMPERATURE_SENSOR"
#define X_FOCUSER_MOTOR_WIRING_PROPERTY_NAME       "X_FOCUSER_MOTOR_WIRING"
#define X_FOCUSER_MOTOR_TYPE_PROPERTY_NAME         "X_FOCUSER_MOTOR_TYPE"
#define X_ROTATOR_STEP_MODE_PROPERTY_NAME          "X_ROTATOR_STEP_MODE"
#define X_ROTATOR_POWER_CONTROL_PROPERTY_NAME      "X_ROTATOR_POWER_CONTROL"
#define X_ROTATOR_MOTOR_WIRING_PROPERTY_NAME       "X_ROTATOR_MOTOR_WIRING"
#define X_ROTATOR_MOTOR_TYPE_PROPERTY_NAME         "X_ROTATOR_MOTOR_TYPE"

// The driver selects UDP from the lunatico:// scheme in DEVICE_PORT, so the
// simulator's udp:// port has to be rewritten for the UDP build of the suite.
static void lunatico_url(char *url, size_t size) {
	if (!strncmp(aux_simulator.port, "udp://", 6)) {
		snprintf(url, size, "lunatico://%s", aux_simulator.port + 6);
	} else {
		snprintf(url, size, "%s", aux_simulator.port);
	}
}

// Out-of-band state injection. The simulator applies one line per dispatch and
// removes the file, so a scenario waits until it has been consumed.
static bool lunatico_control(const char *value) {
	char path[PATH_MAX];
	char final_path[PATH_MAX];
	snprintf(path, sizeof(path), "%s.control.tmp", aux_simulator.ready_file);
	snprintf(final_path, sizeof(final_path), "%s.control", aux_simulator.ready_file);
	FILE *file = fopen(path, "w");
	if (file == NULL) {
		return false;
	}
	fprintf(file, "%s\n", value);
	if (fclose(file) != 0 || rename(path, final_path) != 0) {
		unlink(path);
		return false;
	}
	for (int i = 0; i < 100; i++) {
		if (access(final_path, F_OK)) {
			return true;
		}
		indigo_usleep(50000);
	}
	return false;
}

// Every request the simulator received, in order. This is the only way to
// assert the exact command and arguments the driver produced: the Lunatico
// protocol has no readback for its settings or for the digital outputs.
static int lunatico_command_count(const char *command) {
	char path[PATH_MAX];
	snprintf(path, sizeof(path), "%s.events", aux_simulator.ready_file);
	FILE *file = fopen(path, "r");
	if (file == NULL) {
		return 0;
	}
	char line[256];
	int count = 0;
	while (fgets(line, sizeof(line), file)) {
		line[strcspn(line, "\r\n")] = 0;
		if (!strcmp(line, command)) {
			count++;
		}
	}
	fclose(file);
	return count;
}

static bool lunatico_sent(const char *command) {
	if (lunatico_command_count(command) > 0) {
		return true;
	}
	fprintf(stderr, "command '%s' was never sent to the controller\n", command);
	return false;
}

static bool lunatico_not_sent(const char *command) {
	int count = lunatico_command_count(command);
	if (count == 0) {
		return true;
	}
	fprintf(stderr, "command '%s' was sent %d time(s) and should not have been\n", command, count);
	return false;
}

// Wait until a command shows up, for commands a poll or a finalizer issues
// asynchronously.
static bool lunatico_wait_for_command(const char *command) {
	for (int i = 0; i < 200; i++) {
		if (lunatico_command_count(command) > 0) {
			return true;
		}
		indigo_usleep(50000);
	}
	fprintf(stderr, "command '%s' did not arrive\n", command);
	return false;
}

// Drop the recorded history, so a scenario can assert what happened after a
// specific point without the connect sequence getting in the way.
static void lunatico_forget_commands(void) {
	char path[PATH_MAX];
	snprintf(path, sizeof(path), "%s.events", aux_simulator.ready_file);
	unlink(path);
}

// Raw !read temps values of the simulator, converted by the driver with
// ((raw - 261) * 1.8 - 250) / 10 for the internal sensor and
// ((raw - 192) * 1.7) / 10 for the external one.
#define LUNATICO_RAW_INTERNAL_20C   511
#define LUNATICO_RAW_EXTERNAL_20C   310
#define LUNATICO_RAW_ABSENT         0

static double lunatico_internal_celsius(int raw) {
	return ((raw - 261) * 1.8 - 250) / 10;
}

static double lunatico_external_celsius(int raw) {
	return ((raw - 192) * 1.7) / 10;
}

// A change request that arrives while the property is still BUSY is dropped by
// the framework, so every scenario has to let one request settle before the
// next one (TEST-011).
static bool lunatico_set_number(const simulator_driver_case *device, const char *property, const char *item, double value, indigo_property_state state) {
	unsigned int revision = property_revision(property);
	if (indigo_change_number_property_1(&simulator_test_client, device->device_name, property, item, value) != INDIGO_OK) {
		fprintf(stderr, "change of %s.%s was rejected by the bus\n", property, item);
		return false;
	}
	if (wait_for_property_state_after(property, state, revision)) {
		return true;
	}
	fprintf(stderr, "%s did not reach state %d, it is %d\n", property, state, find_cached_property(property) ? find_cached_property(property)->state : -1);
	return false;
}

static bool lunatico_set_switch(const simulator_driver_case *device, const char *property, const char *item, indigo_property_state state) {
	unsigned int revision = property_revision(property);
	if (indigo_change_switch_property_1(&simulator_test_client, device->device_name, property, item, true) != INDIGO_OK) {
		fprintf(stderr, "change of %s.%s was rejected by the bus\n", property, item);
		return false;
	}
	if (wait_for_property_state_after(property, state, revision)) {
		return true;
	}
	fprintf(stderr, "%s did not reach state %d, it is %d\n", property, state, find_cached_property(property) ? find_cached_property(property)->state : -1);
	return false;
}

static bool lunatico_set_text(const simulator_driver_case *device, const char *property, const char *item, const char *value, indigo_property_state state) {
	unsigned int revision = property_revision(property);
	if (indigo_change_text_property_1_raw(&simulator_test_client, device->device_name, property, item, value) != INDIGO_OK) {
		fprintf(stderr, "change of %s.%s was rejected by the bus\n", property, item);
		return false;
	}
	return wait_for_property_state_after(property, state, revision);
}

#endif /* LUNATICO_TEST_COMMON_H */
