// Copyright (c) 2026 INDIGO initiative
// All rights reserved.
//
// You may use this software under the terms of 'INDIGO Astronomy
// open-source license' (see LICENSE.md).
//
// THIS SOFTWARE IS PROVIDED BY THE AUTHORS 'AS IS' AND ANY EXPRESS
// OR IMPLIED WARRANTIES, INCLUDING, BUT NOT LIMITED TO, THE IMPLIED
// WARRANTIES OF MERCHANTABILITY AND FITNESS FOR A PARTICULAR PURPOSE
// ARE DISCLAIMED. IN NO EVENT SHALL THE AUTHOR BE LIABLE FOR ANY
// DIRECT, INDIRECT, INCIDENTAL, SPECIAL, EXEMPLARY, OR CONSEQUENTIAL
// DAMAGES (INCLUDING, BUT NOT LIMITED TO, PROCUREMENT OF SUBSTITUTE
// GOODS OR SERVICES; LOSS OF USE, DATA, OR PROFITS; OR BUSINESS
// INTERRUPTION) HOWEVER CAUSED AND ON ANY THEORY OF LIABILITY,
// WHETHER IN CONTRACT, STRICT LIABILITY, OR TORT (INCLUDING
// NEGLIGENCE OR OTHERWISE) ARISING IN ANY WAY OUT OF THE USE OF THIS
// SOFTWARE, EVEN IF ADVISED OF THE POSSIBILITY OF SUCH DAMAGE.

// Code is generated by AI

// Compliance suite for the Shoestring GPUSB guider. The relay interface is an
// explicit ON/OFF mask, so every scenario asserts the mask the driver wrote and
// the time each direction was held, not just the published property states.

#include <stdatomic.h>
#include <stdint.h>

#include <indigo/indigo_driver.h>
#include <indigo/indigo_usb_utils.h>
#include <libgpusb.h>
#include <indigo_drivers/guider_gpusb/indigo_guider_gpusb.h>

#include "serial_simulator_test_common.h"

#define GPUSB_DEVICE_NAME "GPUSB test"

static const simulator_driver_case guider = { "Shoestring GPUSB guider", "indigo_guider_gpusb", GPUSB_DEVICE_NAME, indigo_guider_gpusb, false, NULL, 0, NULL, 0, NULL, 0, NULL, 0 };

// ----------------------------------------------------------------- fake relays

#define MASK_HISTORY 64

static atomic_int opened, closed, calls, calls_after_close, references, attached;
static atomic_int fail_open, fail_set, fail_nth_set, relay_mask;
static atomic_int history_count;
static int history[MASK_HISTORY];
static double history_time[MASK_HISTORY];
static libusb_hotplug_callback_fn hotplug;
static indigo_queue *driver_queue;
static atomic_int fail_queue, fail_register, fail_attach;
static libgpusb_device_context context_handle;
void (*libgpusb_debug)(const char *);

static void reset_fake(void) {
	atomic_store(&opened, 0);
	atomic_store(&closed, 0);
	atomic_store(&calls, 0);
	atomic_store(&calls_after_close, 0);
	atomic_store(&references, 0);
	atomic_store(&attached, 0);
	atomic_store(&fail_open, 0);
	atomic_store(&fail_set, 0);
	atomic_store(&fail_nth_set, 0);
	atomic_store(&relay_mask, 0);
	atomic_store(&history_count, 0);
	atomic_store(&fail_queue, 0);
	atomic_store(&fail_register, 0);
	atomic_store(&fail_attach, 0);
	hotplug = NULL;
}

static double now_seconds(void) {
	struct timeval tv;
	gettimeofday(&tv, NULL);
	return tv.tv_sec + tv.tv_usec / 1e6;
}

bool libgpusb_guider(libusb_device *device, const char **name) {
	*name = GPUSB_DEVICE_NAME;
	return true;
}

bool libgpusb_open(libusb_device *device, libgpusb_device_context **context) {
	*context = &context_handle;
	if (atomic_exchange(&fail_open, 0)) {
		return false;
	}
	atomic_fetch_add(&opened, 1);
	return true;
}

void libgpusb_close(libgpusb_device_context *context) {
	atomic_fetch_add(&closed, 1);
}

bool libgpusb_set(libgpusb_device_context *context, int mask) {
	atomic_fetch_add(&calls, 1);
	if (atomic_load(&opened) == atomic_load(&closed)) {
		atomic_fetch_add(&calls_after_close, 1);
		return false;
	}
	if (atomic_exchange(&fail_set, 0)) {
		return false;
	}
	if (atomic_load(&fail_nth_set) > 0 && atomic_fetch_sub(&fail_nth_set, 1) == 1) {
		return false;
	}
	int index = atomic_fetch_add(&history_count, 1);
	if (index < MASK_HISTORY) {
		history[index] = mask;
		history_time[index] = now_seconds();
	}
	atomic_store(&relay_mask, mask);
	return true;
}

bool libgpusb_led_green(libgpusb_device_context *context) { return true; }
bool libgpusb_led_red(libgpusb_device_context *context) { return true; }
bool libgpusb_led_off(libgpusb_device_context *context) { return true; }

// ----------------------------------------------------------------- fake boundary

indigo_queue *gpusb_queue_create(indigo_device *device) {
	if (atomic_exchange(&fail_queue, 0)) {
		return NULL;
	}
	return driver_queue = indigo_queue_create(device);
}

void gpusb_usb_start(void) { }

int LIBUSB_CALL gpusb_usb_register(libusb_context *ctx, int events, int flags, int vid, int pid, int cls, libusb_hotplug_callback_fn fn, void *data, libusb_hotplug_callback_handle *registration) {
	if (atomic_exchange(&fail_register, 0)) {
		return LIBUSB_ERROR_OTHER;
	}
	hotplug = fn;
	*registration = 1;
	fn(NULL, (libusb_device *)(uintptr_t)1, LIBUSB_HOTPLUG_EVENT_DEVICE_ARRIVED, NULL);
	return 0;
}

void LIBUSB_CALL gpusb_usb_deregister(libusb_context *ctx, libusb_hotplug_callback_handle registration) {
	hotplug = NULL;
}

int gpusb_usb_register_sim(libusb_context *ctx, libusb_hotplug_event events, libusb_hotplug_flag flags, int vid, int pid, int cls, libusb_hotplug_callback_fn fn, void *data, libusb_hotplug_callback_handle *registration) {
	return gpusb_usb_register(ctx, events, flags, vid, pid, cls, fn, data, registration);
}

int gpusb_usb_deregister_poll(libusb_context *ctx, libusb_hotplug_callback_handle registration) {
	gpusb_usb_deregister(ctx, registration);
	return 0;
}

libusb_device * LIBUSB_CALL gpusb_usb_ref(libusb_device *device) {
	atomic_fetch_add(&references, 1);
	return device;
}

void LIBUSB_CALL gpusb_usb_unref(libusb_device *device) {
	atomic_fetch_sub(&references, 1);
}

indigo_result gpusb_usb_path(libusb_device *device, char *path) {
	strcpy(path, "1");
	return INDIGO_OK;
}

indigo_result gpusb_attach_device(indigo_device *device) {
	if (atomic_exchange(&fail_attach, 0)) {
		return INDIGO_FAILED;
	}
	indigo_result result = indigo_attach_device(device);
	if (result == INDIGO_OK) {
		atomic_fetch_add(&attached, 1);
	}
	return result;
}

indigo_result gpusb_detach_device(indigo_device *device) {
	indigo_result result = indigo_detach_device(device);
	atomic_fetch_sub(&attached, 1);
	return result;
}

// ----------------------------------------------------------------- helpers

static bool wait_for_mask(int mask) {
	for (int i = 0; i < 400; i++) {
		if (atomic_load(&relay_mask) == mask) {
			return true;
		}
		indigo_usleep(10000);
	}
	fprintf(stderr, "Relay mask never became 0x%02x, last mask is 0x%02x\n", mask, atomic_load(&relay_mask));
	return false;
}

// Seconds between the write that switched a direction on and the one that
// switched it off again, which is the pulse the mount really saw.
static double held_seconds(int direction) {
	double start = 0;
	int count = atomic_load(&history_count);
	if (count > MASK_HISTORY) {
		count = MASK_HISTORY;
	}
	for (int i = 0; i < count; i++) {
		if ((history[i] & direction) != 0) {
			if (start == 0) {
				start = history_time[i];
			}
		} else if (start != 0) {
			return history_time[i] - start;
		}
	}
	return -1;
}

static bool state_seen(const char *property, indigo_property_state state, unsigned int revision) {
	if (wait_for_property_state_seen_after(property, state, revision)) {
		return true;
	}
	indigo_property *cached = find_cached_property(property);
	fprintf(stderr, "%s never published state %d (current %d)\n", property, state, cached == NULL ? -1 : cached->state);
	return false;
}

static bool pulse(const char *property, const char *item, double milliseconds, indigo_property_state state) {
	unsigned int revision = property_state_revision(property, state);
	return indigo_change_number_property_1(&simulator_test_client, guider.device_name, property, item, milliseconds) == INDIGO_OK && state_seen(property, state, revision);
}

// A complete pulse: it starts, the axis is held, and the finalizer releases the
// relays again. Waiting only for an idle mask would pass before the pulse even
// started, and the disconnect that follows would then race the finalizer.
static bool pulse_completes(const char *property, const char *item, double milliseconds) {
	unsigned int done = property_state_revision(property, INDIGO_OK_STATE);
	if (!pulse(property, item, milliseconds, INDIGO_BUSY_STATE) || !state_seen(property, INDIGO_OK_STATE, done)) {
		return false;
	}
	if (atomic_load(&relay_mask) != 0) {
		fprintf(stderr, "Relays left at 0x%02x after the pulse\n", atomic_load(&relay_mask));
		return false;
	}
	return true;
}

static bool driver_up(void) {
	reset_fake();
	if (!bring_up_serial_driver(&guider)) {
		return false;
	}
	indigo_queue_drain(driver_queue);
	return true;
}

static bool connect_guider(void) {
	return connect_serial_device(&guider, NULL);
}

static bool driver_start(void) {
	return driver_up() && connect_guider();
}

static void driver_stop(void) {
	if (context.connected) {
		disconnect_serial_device(&guider);
	}
	tear_down_serial_driver(&guider);
	ASSERT_EQ_INT(0, attached);
	ASSERT_EQ_INT(0, references);
	ASSERT_EQ_INT(opened, closed);
	ASSERT_EQ_INT(0, calls_after_close);
}

static void plug(void) {
	hotplug(NULL, (libusb_device *)(uintptr_t)1, LIBUSB_HOTPLUG_EVENT_DEVICE_ARRIVED, NULL);
	indigo_queue_drain(driver_queue);
}

static void unplug(void) {
	hotplug(NULL, (libusb_device *)(uintptr_t)1, LIBUSB_HOTPLUG_EVENT_DEVICE_LEFT, NULL);
	indigo_queue_drain(driver_queue);
}

// ----------------------------------------------------------------- identity and lifecycle

static void metadata(void) {
	assert_simulator_driver_info(&guider);
	SERIAL_CHECK_TRUE(driver_start());
	SERIAL_CHECK_TRUE(context.connected && context.last_connection_state == INDIGO_OK_STATE);
	assert_device_interface(INDIGO_INTERFACE_GUIDER);
	SERIAL_CHECK_EQ_INT(1, attached);
	SERIAL_CHECK_EQ_INT(1, opened);
cleanup:
	driver_stop();
}

static void property_contract(void) {
	SERIAL_CHECK_TRUE(driver_up());
	reset_simulator_context(&guider);
	enumerate_simulator_device();
	SERIAL_CHECK_TRUE(!has_defined_property(GUIDER_GUIDE_RA_PROPERTY_NAME));
	SERIAL_CHECK_TRUE(connect_guider());
	assert_property_has_item(GUIDER_GUIDE_RA_PROPERTY_NAME, GUIDER_GUIDE_EAST_ITEM_NAME);
	assert_property_has_item(GUIDER_GUIDE_RA_PROPERTY_NAME, GUIDER_GUIDE_WEST_ITEM_NAME);
	assert_property_has_item(GUIDER_GUIDE_DEC_PROPERTY_NAME, GUIDER_GUIDE_NORTH_ITEM_NAME);
	assert_property_has_item(GUIDER_GUIDE_DEC_PROPERTY_NAME, GUIDER_GUIDE_SOUTH_ITEM_NAME);
	// The relays have no adjustable rate of their own.
	SERIAL_CHECK_TRUE(!has_defined_property(GUIDER_RATE_PROPERTY_NAME));
	disconnect_serial_device(&guider);
	for (int i = 0; i < 50 && find_cached_property(GUIDER_GUIDE_RA_PROPERTY_NAME) != NULL; i++) {
		indigo_usleep(100000);
	}
	SERIAL_CHECK_TRUE(find_cached_property(GUIDER_GUIDE_RA_PROPERTY_NAME) == NULL);
cleanup:
	driver_stop();
}

static void open_failure(void) {
	SERIAL_CHECK_TRUE(driver_up());
	atomic_store(&fail_open, 1);
	SERIAL_CHECK_TRUE(!connect_guider());
	SERIAL_CHECK_TRUE(!context.connected);
	SERIAL_CHECK_EQ_INT(0, opened);
	SERIAL_CHECK_TRUE(connect_guider());
	SERIAL_CHECK_EQ_INT(1, opened);
	SERIAL_CHECK_TRUE(pulse_completes(GUIDER_GUIDE_RA_PROPERTY_NAME, GUIDER_GUIDE_EAST_ITEM_NAME, 200));
cleanup:
	driver_stop();
}

static void repeated_init_shutdown(void) {
	for (int i = 0; i < 3; i++) {
		SERIAL_CHECK_TRUE(driver_start());
		disconnect_serial_device(&guider);
		SERIAL_CHECK_TRUE(!context.connected);
		tear_down_serial_driver(&guider);
		SERIAL_CHECK_EQ_INT(0, attached);
		SERIAL_CHECK_EQ_INT(0, references);
		SERIAL_CHECK_EQ_INT(opened, closed);
	}
	return;
cleanup:
	driver_stop();
}

static void shutdown_rejected_while_connected(void) {
	SERIAL_CHECK_TRUE(driver_start());
	SERIAL_CHECK_EQ_INT(INDIGO_BUSY, guider.entry(INDIGO_DRIVER_SHUTDOWN, NULL));
	SERIAL_CHECK_TRUE(pulse_completes(GUIDER_GUIDE_DEC_PROPERTY_NAME, GUIDER_GUIDE_NORTH_ITEM_NAME, 200));
cleanup:
	driver_stop();
}

static void hotplug_events(void) {
	SERIAL_CHECK_TRUE(driver_start());
	SERIAL_CHECK_EQ_INT(1, attached);
	// A repeated arrival for the same guider must not attach it twice.
	plug();
	SERIAL_CHECK_EQ_INT(1, attached);
	disconnect_serial_device(&guider);
	unplug();
	SERIAL_CHECK_EQ_INT(0, attached);
	SERIAL_CHECK_EQ_INT(opened, closed);
	unplug();
	SERIAL_CHECK_EQ_INT(0, attached);
	plug();
	SERIAL_CHECK_EQ_INT(1, attached);
	SERIAL_CHECK_TRUE(connect_guider());
	SERIAL_CHECK_TRUE(pulse_completes(GUIDER_GUIDE_RA_PROPERTY_NAME, GUIDER_GUIDE_WEST_ITEM_NAME, 200));
cleanup:
	driver_stop();
}

// Unplugging a guider that is pulsing has to release it without another relay
// write.
static void removal_during_pulse(void) {
	SERIAL_CHECK_TRUE(driver_start());
	SERIAL_CHECK_TRUE(pulse(GUIDER_GUIDE_RA_PROPERTY_NAME, GUIDER_GUIDE_EAST_ITEM_NAME, 3000, INDIGO_BUSY_STATE));
	SERIAL_CHECK_TRUE(wait_for_mask(GPUSB_RA_EAST));
	unplug();
	SERIAL_CHECK_EQ_INT(0, attached);
	SERIAL_CHECK_EQ_INT(opened, closed);
	int writes = atomic_load(&calls);
	indigo_usleep(3500000);
	SERIAL_CHECK_EQ_INT(writes, atomic_load(&calls));
	SERIAL_CHECK_EQ_INT(0, calls_after_close);
	plug();
	SERIAL_CHECK_TRUE(connect_guider());
	SERIAL_CHECK_TRUE(pulse_completes(GUIDER_GUIDE_RA_PROPERTY_NAME, GUIDER_GUIDE_EAST_ITEM_NAME, 200));
cleanup:
	driver_stop();
}

static void init_rollback(void) {
	reset_fake();
	atomic_store(&fail_queue, 1);
	SERIAL_CHECK_TRUE(!bring_up_serial_driver(&guider));
	SERIAL_CHECK_EQ_INT(0, attached);
	SERIAL_CHECK_TRUE(hotplug == NULL);
	atomic_store(&fail_register, 1);
	SERIAL_CHECK_TRUE(!bring_up_serial_driver(&guider));
	SERIAL_CHECK_EQ_INT(0, attached);
	SERIAL_CHECK_EQ_INT(0, references);
	atomic_store(&fail_attach, 1);
	SERIAL_CHECK_TRUE(bring_up_serial_driver(&guider));
	indigo_queue_drain(driver_queue);
	SERIAL_CHECK_EQ_INT(0, attached);
	SERIAL_CHECK_EQ_INT(0, references);
	plug();
	SERIAL_CHECK_EQ_INT(1, attached);
	SERIAL_CHECK_TRUE(connect_guider());
cleanup:
	driver_stop();
}

// ----------------------------------------------------------------- pulses

// Every direction drives its own relay and releases it again.
static void directions(void) {
	static const struct { const char *property; const char *item; int mask; } directions[] = {
		{ GUIDER_GUIDE_RA_PROPERTY_NAME, GUIDER_GUIDE_EAST_ITEM_NAME, GPUSB_RA_EAST },
		{ GUIDER_GUIDE_RA_PROPERTY_NAME, GUIDER_GUIDE_WEST_ITEM_NAME, GPUSB_RA_WEST },
		{ GUIDER_GUIDE_DEC_PROPERTY_NAME, GUIDER_GUIDE_NORTH_ITEM_NAME, GPUSB_DEC_NORTH },
		{ GUIDER_GUIDE_DEC_PROPERTY_NAME, GUIDER_GUIDE_SOUTH_ITEM_NAME, GPUSB_DEC_SOUTH }
	};
	SERIAL_CHECK_TRUE(driver_start());
	for (int i = 0; i < ARRAY_SIZE(directions); i++) {
		unsigned int done = property_state_revision(directions[i].property, INDIGO_OK_STATE);
		SERIAL_CHECK_TRUE(pulse(directions[i].property, directions[i].item, 300, INDIGO_BUSY_STATE));
		SERIAL_CHECK_TRUE(wait_for_mask(directions[i].mask));
		SERIAL_CHECK_TRUE(state_seen(directions[i].property, INDIGO_OK_STATE, done));
		SERIAL_CHECK_TRUE(wait_for_mask(0));
		// The pulse the mount saw is the requested one.
		double held = held_seconds(directions[i].mask);
		printf("%s held for %.3f s\n", directions[i].item, held);
		SERIAL_CHECK_TRUE(held > .25 && held < .6);
		SERIAL_CHECK_TRUE(wait_for_number_item_value(directions[i].property, directions[i].item, 0, 0));
		atomic_store(&history_count, 0);
	}
cleanup:
	driver_stop();
}

// Both axes can be driven at once, and finishing one must not release the other.
static void simultaneous_axes(void) {
	SERIAL_CHECK_TRUE(driver_start());
	SERIAL_CHECK_TRUE(pulse(GUIDER_GUIDE_DEC_PROPERTY_NAME, GUIDER_GUIDE_NORTH_ITEM_NAME, 3000, INDIGO_BUSY_STATE));
	SERIAL_CHECK_TRUE(wait_for_mask(GPUSB_DEC_NORTH));
	unsigned int ra_done = property_state_revision(GUIDER_GUIDE_RA_PROPERTY_NAME, INDIGO_OK_STATE);
	SERIAL_CHECK_TRUE(pulse(GUIDER_GUIDE_RA_PROPERTY_NAME, GUIDER_GUIDE_EAST_ITEM_NAME, 300, INDIGO_BUSY_STATE));
	SERIAL_CHECK_TRUE(wait_for_mask(GPUSB_DEC_NORTH | GPUSB_RA_EAST));
	// The right ascension pulse expires first and leaves declination running.
	SERIAL_CHECK_TRUE(state_seen(GUIDER_GUIDE_RA_PROPERTY_NAME, INDIGO_OK_STATE, ra_done));
	SERIAL_CHECK_TRUE(wait_for_mask(GPUSB_DEC_NORTH));
	SERIAL_CHECK_TRUE(find_cached_property(GUIDER_GUIDE_DEC_PROPERTY_NAME)->state == INDIGO_BUSY_STATE);
	SERIAL_CHECK_TRUE(wait_for_mask(0));
	SERIAL_CHECK_TRUE(wait_for_property_state(GUIDER_GUIDE_DEC_PROPERTY_NAME, INDIGO_OK_STATE));
cleanup:
	driver_stop();
}

// A new request on the same axis replaces the running pulse, and the stale
// completion of the replaced one must not clear the new one.
static void same_axis_replacement(void) {
	SERIAL_CHECK_TRUE(driver_start());
	SERIAL_CHECK_TRUE(pulse(GUIDER_GUIDE_RA_PROPERTY_NAME, GUIDER_GUIDE_EAST_ITEM_NAME, 3000, INDIGO_BUSY_STATE));
	SERIAL_CHECK_TRUE(wait_for_mask(GPUSB_RA_EAST));
	SERIAL_CHECK_TRUE(pulse(GUIDER_GUIDE_RA_PROPERTY_NAME, GUIDER_GUIDE_WEST_ITEM_NAME, 3000, INDIGO_BUSY_STATE));
	SERIAL_CHECK_TRUE(wait_for_mask(GPUSB_RA_WEST));
	// The replaced pulse would have expired by now; the new one has to survive.
	indigo_usleep(1000000);
	SERIAL_CHECK_EQ_INT(GPUSB_RA_WEST, atomic_load(&relay_mask));
	SERIAL_CHECK_TRUE(find_cached_property(GUIDER_GUIDE_RA_PROPERTY_NAME)->state == INDIGO_BUSY_STATE);
	SERIAL_CHECK_TRUE(wait_for_mask(0));
	SERIAL_CHECK_TRUE(wait_for_property_state(GUIDER_GUIDE_RA_PROPERTY_NAME, INDIGO_OK_STATE));
cleanup:
	driver_stop();
}

// A zero request releases the axis at once instead of starting a pulse.
static void zero_request_stops(void) {
	SERIAL_CHECK_TRUE(driver_start());
	SERIAL_CHECK_TRUE(pulse(GUIDER_GUIDE_DEC_PROPERTY_NAME, GUIDER_GUIDE_SOUTH_ITEM_NAME, 3000, INDIGO_BUSY_STATE));
	SERIAL_CHECK_TRUE(wait_for_mask(GPUSB_DEC_SOUTH));
	SERIAL_CHECK_TRUE(pulse(GUIDER_GUIDE_DEC_PROPERTY_NAME, GUIDER_GUIDE_SOUTH_ITEM_NAME, 0, INDIGO_OK_STATE));
	SERIAL_CHECK_TRUE(wait_for_mask(0));
	int writes = atomic_load(&calls);
	indigo_usleep(1000000);
	SERIAL_CHECK_EQ_INT(writes, atomic_load(&calls));
	SERIAL_CHECK_TRUE(pulse_completes(GUIDER_GUIDE_DEC_PROPERTY_NAME, GUIDER_GUIDE_NORTH_ITEM_NAME, 200));
cleanup:
	driver_stop();
}

// A relay write the device refuses must be reported, and the guider has to stay
// usable afterwards.
static void relay_write_failure(void) {
	SERIAL_CHECK_TRUE(driver_start());
	atomic_store(&fail_set, 1);
	SERIAL_CHECK_TRUE(pulse(GUIDER_GUIDE_RA_PROPERTY_NAME, GUIDER_GUIDE_EAST_ITEM_NAME, 200, INDIGO_ALERT_STATE));
	SERIAL_CHECK_EQ_INT(0, atomic_load(&relay_mask));
	SERIAL_CHECK_TRUE(pulse_completes(GUIDER_GUIDE_RA_PROPERTY_NAME, GUIDER_GUIDE_EAST_ITEM_NAME, 200));
cleanup:
	driver_stop();
}

// A release the device refuses at the end of a pulse must be reported rather
// than published as a completed pulse.
static void relay_release_failure(void) {
	SERIAL_CHECK_TRUE(driver_start());
	unsigned int alerts = property_state_revision(GUIDER_GUIDE_DEC_PROPERTY_NAME, INDIGO_ALERT_STATE);
	// The first write starts the pulse, the second one releases it.
	atomic_store(&fail_nth_set, 2);
	SERIAL_CHECK_TRUE(pulse(GUIDER_GUIDE_DEC_PROPERTY_NAME, GUIDER_GUIDE_NORTH_ITEM_NAME, 200, INDIGO_BUSY_STATE));
	SERIAL_CHECK_TRUE(state_seen(GUIDER_GUIDE_DEC_PROPERTY_NAME, INDIGO_ALERT_STATE, alerts));
	SERIAL_CHECK_TRUE(pulse_completes(GUIDER_GUIDE_DEC_PROPERTY_NAME, GUIDER_GUIDE_NORTH_ITEM_NAME, 200));
cleanup:
	driver_stop();
}

// Disconnecting while a pulse is running releases the relays and stops the
// pending completion.
static void disconnect_during_pulse(void) {
	SERIAL_CHECK_TRUE(driver_start());
	SERIAL_CHECK_TRUE(pulse(GUIDER_GUIDE_RA_PROPERTY_NAME, GUIDER_GUIDE_WEST_ITEM_NAME, 3000, INDIGO_BUSY_STATE));
	SERIAL_CHECK_TRUE(wait_for_mask(GPUSB_RA_WEST));
	disconnect_serial_device(&guider);
	SERIAL_CHECK_TRUE(!context.connected);
	// Closing the guider switches every relay off.
	SERIAL_CHECK_EQ_INT(0, atomic_load(&relay_mask));
	SERIAL_CHECK_EQ_INT(opened, closed);
	int writes = atomic_load(&calls);
	indigo_usleep(3500000);
	SERIAL_CHECK_EQ_INT(writes, atomic_load(&calls));
	SERIAL_CHECK_EQ_INT(0, calls_after_close);
	SERIAL_CHECK_TRUE(connect_guider());
	SERIAL_CHECK_TRUE(pulse_completes(GUIDER_GUIDE_RA_PROPERTY_NAME, GUIDER_GUIDE_WEST_ITEM_NAME, 200));
cleanup:
	driver_stop();
}

// ----------------------------------------------------------------- runner

int main(void) {
	setvbuf(stdout, NULL, _IONBF, 0);
	alarm(300);
	const indigo_test_case tests[] = {
		{ "metadata", metadata },
		{ "property_contract", property_contract },
		{ "open_failure", open_failure },
		{ "repeated_init_shutdown", repeated_init_shutdown },
		{ "shutdown_rejected_while_connected", shutdown_rejected_while_connected },
		{ "hotplug_events", hotplug_events },
		{ "removal_during_pulse", removal_during_pulse },
		{ "init_rollback", init_rollback },
		{ "directions", directions },
		{ "simultaneous_axes", simultaneous_axes },
		{ "same_axis_replacement", same_axis_replacement },
		{ "zero_request_stops", zero_request_stops },
		{ "relay_write_failure", relay_write_failure },
		{ "relay_release_failure", relay_release_failure },
		{ "disconnect_during_pulse", disconnect_during_pulse }
	};
	return indigo_run_tests("Shoestring GPUSB guider", tests, ARRAY_SIZE(tests));
}
