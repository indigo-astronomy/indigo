// Copyright (c) 2026 INDIGO initiative
// All rights reserved.
//
// You may use this software under the terms of 'INDIGO Astronomy
// open-source license' (see LICENSE.md).
//
// THIS SOFTWARE IS PROVIDED BY THE AUTHORS 'AS IS' AND ANY EXPRESS
// OR IMPLIED WARRANTIES, INCLUDING, BUT NOT LIMITED TO, THE IMPLIED
// WARRANTIES OF MERCHANTABILITY AND FITNESS FOR A PARTICULAR PURPOSE
// ARE DISCLAIMED. IN NO EVENT SHALL THE AUTHOR BE LIABLE FOR ANY
// DIRECT, INDIRECT, INCIDENTAL, SPECIAL, EXEMPLARY, OR CONSEQUENTIAL
// DAMAGES (INCLUDING, BUT NOT LIMITED TO, PROCUREMENT OF SUBSTITUTE
// GOODS OR SERVICES; LOSS OF USE, DATA, OR PROFITS; OR BUSINESS
// INTERRUPTION) HOWEVER CAUSED AND ON ANY THEORY OF LIABILITY,
// WHETHER IN CONTRACT, STRICT LIABILITY, OR TORT (INCLUDING
// NEGLIGENCE OR OTHERWISE) ARISING IN ANY WAY OUT OF THE USE OF THIS
// SOFTWARE, EVEN IF ADVISED OF THE POSSIBILITY OF SUCH DAMAGE.

// Code is generated by AI

// Deterministic fake-bridge coverage for the production libcamera CCD driver. The fake implements
// the C bridge interface (indigo_ccd_libcamera_bridge.h) that the driver uses instead of libcamera,
// so the generated driver runs unchanged with the real framework, queues and image processing.

#include <stdatomic.h>
#include <pthread.h>
#include <indigo/indigo_ccd_driver.h>
#include <indigo_linux_drivers/ccd_libcamera/indigo_ccd_libcamera.h>
#include <indigo_linux_drivers/ccd_libcamera/indigo_ccd_libcamera_bridge.h>
#include "simulator_test_common.h"

#define FAKE_CAMERAS		LCAM_MAX_CAMERAS

typedef struct {
	char id[LCAM_ID_SIZE];
	char model[LCAM_MODEL_SIZE];
	lcam_properties properties;
} fake_profile;

typedef struct {
	bool open, capturing, streaming;
	int mode;
	double exposure, gain, started;
	int frames;
} fake_state;

struct lcam_camera {
	int index;
};

static fake_profile profiles[FAKE_CAMERAS];
static int profile_count;
static fake_state states[FAKE_CAMERAS];
static struct lcam_camera handles[FAKE_CAMERAS];
static pthread_mutex_t fake_mutex = PTHREAD_MUTEX_INITIALIZER;
static atomic_int initialize_count, terminate_count, open_count, close_count, start_count, stop_count, calls_after_close;
static atomic_int fail_initialize, fail_open, fail_start, read_error, short_frame, hold_frames;
static atomic_int attached, blobs, bad_blob;
static char attached_names[FAKE_CAMERAS][INDIGO_NAME_SIZE];
static uint16_t first_pixels[4];
static unsigned blob_width, blob_height;
static atomic_int bayer_keyword;

static char device_name[INDIGO_NAME_SIZE] = "OV5647";

static simulator_driver_case libcamera_case = {
	"libcamera Camera", "indigo_ccd_libcamera", device_name, indigo_ccd_libcamera, true,
	base_properties_without_instances, ARRAY_SIZE(base_properties_without_instances), hidden_base_properties_without_instances, ARRAY_SIZE(hidden_base_properties_without_instances), NULL, 0, NULL, 0
};

// Pixel value of the full-frame coordinate (x, y) in the given mode; ROI tests compare against it.
static uint16_t pattern(int mode, unsigned x, unsigned y, unsigned bit_depth) {
	return (uint16_t)((x * 3 + y * 5 + 17 * mode) & ((1u << bit_depth) - 1));
}

static void set_profile(int index, const char *id, const char *model, bool color) {
	fake_profile *profile = profiles + index;
	memset(profile, 0, sizeof(*profile));
	snprintf(profile->id, sizeof(profile->id), "%s", id);
	snprintf(profile->model, sizeof(profile->model), "%s", model);
	lcam_properties *properties = &profile->properties;
	// Values of an OV5647 (Raspberry Pi Camera v1) scaled down to keep frames small.
	properties->pixel_array_width = 64;
	properties->pixel_array_height = 48;
	properties->pixel_width = properties->pixel_height = 1.4;
	snprintf(properties->bayer, sizeof(properties->bayer), "%s", color ? "GBRG" : "");
	properties->exposure_min = 0.000130;
	properties->exposure_max = 3.066;
	properties->gain_min = 1;
	properties->gain_max = 63.9375;
	properties->gain_default = 1;
	properties->mode_count = 3;
	// Per-mode limits measured on an OV5647: libcamera reports them only after configuring the mode.
	properties->modes[0] = (lcam_mode) { 64, 48, 10, 1, 0.000130, 3.066 };
	properties->modes[1] = (lcam_mode) { 32, 24, 10, 2, 0.000126, 4.600 };
	properties->modes[2] = (lcam_mode) { 20, 16, 8, 1, 0.000130, 3.066 };
}

static fake_state *checked_state(lcam_camera *camera) {
	if (camera == NULL || camera->index < 0 || camera->index >= FAKE_CAMERAS || !states[camera->index].open) {
		atomic_fetch_add(&calls_after_close, 1);
		return NULL;
	}
	return states + camera->index;
}

bool lcam_initialize(void) {
	atomic_fetch_add(&initialize_count, 1);
	return !atomic_load(&fail_initialize);
}

void lcam_terminate(void) {
	atomic_fetch_add(&terminate_count, 1);
}

int lcam_list(lcam_camera_info *list, int size) {
	int count = 0;
	for (int i = 0; i < profile_count && count < size; i++, count++) {
		snprintf(list[count].id, sizeof(list[count].id), "%s", profiles[i].id);
		snprintf(list[count].model, sizeof(list[count].model), "%s", profiles[i].model);
	}
	return count;
}

lcam_camera *lcam_open(const char *id, lcam_properties *properties, char *error, size_t error_size) {
	if (atomic_load(&fail_open)) {
		snprintf(error, error_size, "Camera is used by another application");
		return NULL;
	}
	for (int i = 0; i < profile_count; i++) {
		if (!strcmp(profiles[i].id, id)) {
			pthread_mutex_lock(&fake_mutex);
			if (states[i].open) {
				pthread_mutex_unlock(&fake_mutex);
				snprintf(error, error_size, "Camera is used by another application");
				return NULL;
			}
			memset(states + i, 0, sizeof(fake_state));
			states[i].open = true;
			pthread_mutex_unlock(&fake_mutex);
			*properties = profiles[i].properties;
			handles[i].index = i;
			atomic_fetch_add(&open_count, 1);
			return handles + i;
		}
	}
	snprintf(error, error_size, "Camera not found");
	return NULL;
}

void lcam_close(lcam_camera *camera) {
	pthread_mutex_lock(&fake_mutex);
	fake_state *state = checked_state(camera);
	if (state) {
		state->open = state->capturing = false;
		atomic_fetch_add(&close_count, 1);
	}
	pthread_mutex_unlock(&fake_mutex);
}

bool lcam_start(lcam_camera *camera, int mode, double exposure, double gain, bool streaming, char *error, size_t error_size) {
	pthread_mutex_lock(&fake_mutex);
	fake_state *state = checked_state(camera);
	bool result = state && !atomic_load(&fail_start) && mode >= 0 && mode < profiles[camera->index].properties.mode_count;
	if (result) {
		state->capturing = true;
		state->streaming = streaming;
		state->mode = mode;
		state->exposure = exposure;
		state->gain = gain;
		state->started = indigo_monotonic_time();
		state->frames = 0;
		atomic_fetch_add(&start_count, 1);
	} else {
		snprintf(error, error_size, "Camera start failed");
	}
	pthread_mutex_unlock(&fake_mutex);
	return result;
}

int lcam_read(lcam_camera *camera, uint16_t *buffer, size_t buffer_size, unsigned left, unsigned top, unsigned width, unsigned height, lcam_frame *frame, char *error, size_t error_size) {
	pthread_mutex_lock(&fake_mutex);
	fake_state *state = checked_state(camera);
	if (state == NULL || !state->capturing) {
		pthread_mutex_unlock(&fake_mutex);
		snprintf(error, error_size, "Capture is not running");
		return -1;
	}
	if (atomic_load(&hold_frames) || indigo_monotonic_time() < state->started + state->exposure * (state->frames + 1)) {
		pthread_mutex_unlock(&fake_mutex);
		return 0;
	}
	if (atomic_load(&read_error)) {
		pthread_mutex_unlock(&fake_mutex);
		snprintf(error, error_size, "Frame capture failed");
		return -1;
	}
	lcam_mode *mode = profiles[camera->index].properties.modes + state->mode;
	if (left + width > mode->width || top + height > mode->height || (size_t)width * height > buffer_size / 2) {
		pthread_mutex_unlock(&fake_mutex);
		snprintf(error, error_size, "Invalid frame rectangle");
		return -1;
	}
	for (unsigned y = 0; y < height; y++) {
		for (unsigned x = 0; x < width; x++) {
			buffer[y * width + x] = pattern(state->mode, left + x, top + y, mode->bit_depth);
		}
	}
	frame->width = atomic_load(&short_frame) ? width - 1 : width;
	frame->height = height;
	frame->bit_depth = mode->bit_depth;
	frame->exposure = state->exposure;
	frame->gain = state->gain;
	state->frames++;
	pthread_mutex_unlock(&fake_mutex);
	return 1;
}

void lcam_stop(lcam_camera *camera) {
	pthread_mutex_lock(&fake_mutex);
	fake_state *state = checked_state(camera);
	if (state) {
		state->capturing = false;
		atomic_fetch_add(&stop_count, 1);
	}
	pthread_mutex_unlock(&fake_mutex);
}

indigo_result lcam_test_attach(indigo_device *device) {
	indigo_result result = indigo_attach_device(device);
	if (result == INDIGO_OK) {
		int index = atomic_fetch_add(&attached, 1);
		if (index < FAKE_CAMERAS) {
			snprintf(attached_names[index], INDIGO_NAME_SIZE, "%s", device->name);
		}
	}
	return result;
}

indigo_result lcam_test_detach(indigo_device *device) {
	indigo_result result = indigo_detach_device(device);
	atomic_fetch_sub(&attached, 1);
	return result;
}

static indigo_result observe_blob(indigo_client *client, indigo_device *device, indigo_property *property, const char *message) {
	if (!strcmp(property->device, device_name) && !strcmp(property->name, CCD_IMAGE_PROPERTY_NAME) && property->state == INDIGO_OK_STATE && property->items[0].blob.size > 0) {
		const char *data = property->items[0].blob.value;
		long size = property->items[0].blob.size;
		if (!strncmp(data, "SIMPLE", 6)) {
			for (long i = 0; i + 30 < size && i < 2880 * 4; i += 80) {
				if (!strncmp(data + i, "BAYERPAT", 8)) {
					atomic_store(&bayer_keyword, strstr(data + i, "'GBRG") != NULL && strstr(data + i, "'GBRG") < data + i + 80 ? 1 : -1);
				}
			}
		} else {
			indigo_raw_header header = { 0 };
			memcpy(&header, data, sizeof(header));
			if (header.signature != INDIGO_RAW_MONO16 || header.width == 0 || header.height == 0 || (long)(sizeof(header) + header.width * header.height * 2) > size) {
				atomic_fetch_add(&bad_blob, 1);
			} else {
				blob_width = header.width;
				blob_height = header.height;
				memcpy(first_pixels, data + sizeof(header), sizeof(first_pixels));
			}
		}
		atomic_fetch_add(&blobs, 1);
	}
	return simulator_client_update_property(client, device, property, message);
}

static bool wait_atomic(atomic_int *value, int expected) {
	for (int i = 0; i < 300; i++) {
		if (atomic_load(value) == expected) {
			return true;
		}
		indigo_usleep(10000);
	}
	return false;
}

// The exposure property turns BUSY before its queued handler starts the camera.
static bool wait_capturing(bool expected) {
	for (int i = 0; i < 300; i++) {
		pthread_mutex_lock(&fake_mutex);
		bool capturing = states[0].capturing;
		pthread_mutex_unlock(&fake_mutex);
		if (capturing == expected) {
			return true;
		}
		indigo_usleep(10000);
	}
	return false;
}

static indigo_result change_numbers(const char *property_name, int count, const char **items, const double *values) {
	indigo_property *cached = find_cached_property(property_name);
	if (!cached) {
		return INDIGO_FAILED;
	}
	indigo_property *request = indigo_copy_property(NULL, cached);
	if (!request) {
		return INDIGO_FAILED;
	}
	for (int i = 0; i < count; i++) {
		for (int j = 0; j < request->count; j++) {
			if (!strcmp(request->items[j].name, items[i])) {
				request->items[j].number.value = request->items[j].number.target = values[i];
			}
		}
	}
	indigo_result result = indigo_change_property(&simulator_test_client, request);
	indigo_release_property(request);
	return result;
}

static void reset_fake(int cameras, bool color) {
	memset(profiles, 0, sizeof(profiles));
	memset(states, 0, sizeof(states));
	memset(attached_names, 0, sizeof(attached_names));
	memset(first_pixels, 0, sizeof(first_pixels));
	blob_width = blob_height = 0;
	profile_count = cameras;
	for (int i = 0; i < cameras; i++) {
		char id[64];
		snprintf(id, sizeof(id), "/base/soc/i2c0mux/i2c@%d/ov5647@36", i);
		set_profile(i, id, "ov5647", color);
	}
	snprintf(device_name, sizeof(device_name), "OV5647");
	atomic_store(&initialize_count, 0); atomic_store(&terminate_count, 0); atomic_store(&open_count, 0); atomic_store(&close_count, 0); atomic_store(&start_count, 0); atomic_store(&stop_count, 0); atomic_store(&calls_after_close, 0);
	atomic_store(&fail_initialize, 0); atomic_store(&fail_open, 0); atomic_store(&fail_start, 0); atomic_store(&read_error, 0); atomic_store(&short_frame, 0); atomic_store(&hold_frames, 0);
	atomic_store(&attached, 0); atomic_store(&blobs, 0); atomic_store(&bad_blob, 0); atomic_store(&bayer_keyword, 0);
}

static bool start_driver(int expected_devices) {
	reset_simulator_context(&libcamera_case);
	simulator_test_client.update_property = observe_blob;
	if (indigo_start() != INDIGO_OK || indigo_attach_client(&simulator_test_client) != INDIGO_OK || indigo_ccd_libcamera(INDIGO_DRIVER_INIT, NULL) != INDIGO_OK || !wait_atomic(&attached, expected_devices)) {
		return false;
	}
	enumerate_simulator_device();
	return true;
}

static bool connect_device(void) {
	indigo_change_switch_property_1(&simulator_test_client, device_name, CONNECTION_PROPERTY_NAME, CONNECTION_CONNECTED_ITEM_NAME, true);
	return wait_for_simulator_connection_state(true);
}

static bool begin(bool connect, bool color) {
	reset_fake(1, color);
	if (!start_driver(1)) {
		return false;
	}
	return connect ? connect_device() : true;
}

static void end(void) {
	if (context.connected) {
		indigo_change_switch_property_1(&simulator_test_client, device_name, CONNECTION_PROPERTY_NAME, CONNECTION_DISCONNECTED_ITEM_NAME, true);
		wait_for_simulator_connection_state(false);
	}
	indigo_ccd_libcamera(INDIGO_DRIVER_SHUTDOWN, NULL);
	indigo_detach_client(&simulator_test_client);
	indigo_stop();
	release_cached_properties();
}

static bool expose(double exposure) {
	unsigned revision = property_revision(CCD_EXPOSURE_PROPERTY_NAME);
	if (indigo_change_number_property_1(&simulator_test_client, device_name, CCD_EXPOSURE_PROPERTY_NAME, CCD_EXPOSURE_ITEM_NAME, exposure) != INDIGO_OK) {
		return false;
	}
	return wait_for_property_state_seen_after(CCD_EXPOSURE_PROPERTY_NAME, INDIGO_BUSY_STATE, revision) && wait_for_property_state_after(CCD_EXPOSURE_PROPERTY_NAME, INDIGO_OK_STATE, revision);
}

static bool expose_and_fail(double exposure) {
	unsigned revision = property_revision(CCD_EXPOSURE_PROPERTY_NAME);
	if (indigo_change_number_property_1(&simulator_test_client, device_name, CCD_EXPOSURE_PROPERTY_NAME, CCD_EXPOSURE_ITEM_NAME, exposure) != INDIGO_OK) {
		return false;
	}
	return wait_for_property_state_after(CCD_EXPOSURE_PROPERTY_NAME, INDIGO_ALERT_STATE, revision);
}

static void select_raw_format(void) {
	ASSERT_EQ_INT(INDIGO_OK, indigo_change_switch_property_1(&simulator_test_client, device_name, CCD_IMAGE_FORMAT_PROPERTY_NAME, CCD_IMAGE_FORMAT_RAW_ITEM_NAME, true));
	ASSERT_TRUE(wait_for_property_state(CCD_IMAGE_FORMAT_PROPERTY_NAME, INDIGO_OK_STATE));
}

static void metadata_and_property_contract(void) {
	assert_simulator_driver_info(&libcamera_case);
	ASSERT_TRUE(begin(false, false));
	ASSERT_TRUE(find_cached_property(CCD_INFO_PROPERTY_NAME) == NULL);
	ASSERT_TRUE(connect_device());
	assert_device_interface(INDIGO_INTERFACE_CCD);
	ASSERT_STREQ("ov5647", find_cached_item(INFO_PROPERTY_NAME, INFO_DEVICE_MODEL_ITEM_NAME)->text.value);
	ASSERT_STREQ("/base/soc/i2c0mux/i2c@0/ov5647@36", find_cached_item(INFO_PROPERTY_NAME, INFO_DEVICE_SERIAL_NUM_ITEM_NAME)->text.value);
	ASSERT_NEAR(64, cached_number_value(CCD_INFO_PROPERTY_NAME, CCD_INFO_WIDTH_ITEM_NAME), 0);
	ASSERT_NEAR(48, cached_number_value(CCD_INFO_PROPERTY_NAME, CCD_INFO_HEIGHT_ITEM_NAME), 0);
	ASSERT_NEAR(16, cached_number_value(CCD_INFO_PROPERTY_NAME, CCD_INFO_BITS_PER_PIXEL_ITEM_NAME), 0);
	ASSERT_NEAR(1.4, cached_number_value(CCD_INFO_PROPERTY_NAME, CCD_INFO_PIXEL_SIZE_ITEM_NAME), 1e-9);
	assert_property_has_item(CCD_EXPOSURE_PROPERTY_NAME, CCD_EXPOSURE_ITEM_NAME);
	assert_property_has_item(CCD_ABORT_EXPOSURE_PROPERTY_NAME, CCD_ABORT_EXPOSURE_ITEM_NAME);
	assert_property_has_item(CCD_FRAME_PROPERTY_NAME, CCD_FRAME_WIDTH_ITEM_NAME);
	assert_property_has_item(CCD_FRAME_PROPERTY_NAME, CCD_FRAME_HEIGHT_ITEM_NAME);
	assert_property_has_item(CCD_IMAGE_FORMAT_PROPERTY_NAME, CCD_IMAGE_FORMAT_RAW_ITEM_NAME);
	assert_property_has_item(CCD_UPLOAD_MODE_PROPERTY_NAME, CCD_UPLOAD_MODE_CLIENT_ITEM_NAME);
	assert_property_has_item(CCD_STREAMING_PROPERTY_NAME, CCD_STREAMING_COUNT_ITEM_NAME);
	assert_property_has_item(CCD_IMAGE_PROPERTY_NAME, CCD_IMAGE_ITEM_NAME);
	ASSERT_TRUE(find_cached_property(CCD_BIN_PROPERTY_NAME) == NULL);
	ASSERT_TRUE(find_cached_property(CCD_TEMPERATURE_PROPERTY_NAME) == NULL);
	ASSERT_TRUE(find_cached_property(CCD_COOLER_PROPERTY_NAME) == NULL);
	indigo_item *exposure = find_cached_item(CCD_EXPOSURE_PROPERTY_NAME, CCD_EXPOSURE_ITEM_NAME);
	ASSERT_NEAR(0.000130, exposure->number.min, 1e-9);
	ASSERT_NEAR(3.066, exposure->number.max, 1e-9);
	indigo_item *gain = find_cached_item(CCD_GAIN_PROPERTY_NAME, CCD_GAIN_ITEM_NAME);
	ASSERT_TRUE(gain != NULL);
	ASSERT_NEAR(1, gain->number.min, 1e-9);
	ASSERT_NEAR(63.9375, gain->number.max, 1e-9);
	indigo_property *mode = find_cached_property(CCD_MODE_PROPERTY_NAME);
	ASSERT_EQ_INT(3, mode->count);
	ASSERT_EQ_INT(INDIGO_RW_PERM, mode->perm);
	ASSERT_STREQ("RAW 10 64x48", mode->items[0].label);
	ASSERT_STREQ("RAW 10 32x24 (bin 2x2)", mode->items[1].label);
	ASSERT_STREQ("RAW 8 20x16", mode->items[2].label);
	ASSERT_TRUE(mode->items[0].sw.value);
	ASSERT_NEAR(64, cached_number_value(CCD_FRAME_PROPERTY_NAME, CCD_FRAME_WIDTH_ITEM_NAME), 0);
	ASSERT_NEAR(16, cached_number_value(CCD_FRAME_PROPERTY_NAME, CCD_FRAME_BITS_PER_PIXEL_ITEM_NAME), 0);
	ASSERT_EQ_INT(1, open_count);
	indigo_change_switch_property_1(&simulator_test_client, device_name, CONNECTION_PROPERTY_NAME, CONNECTION_DISCONNECTED_ITEM_NAME, true);
	ASSERT_TRUE(wait_for_simulator_connection_state(false));
	ASSERT_EQ_INT(1, close_count);
	ASSERT_TRUE(find_cached_property(CCD_INFO_PROPERTY_NAME) == NULL);
	end();
	ASSERT_EQ_INT(0, calls_after_close);
}

// A camera that reports no gain range must not publish CCD_GAIN and captures with its default gain;
// the exposure limits fall back to the framework defaults when the camera reports none.
static void capability_profile_without_gain(void) {
	reset_fake(1, false);
	profiles[0].properties.gain_min = profiles[0].properties.gain_max = 0;
	profiles[0].properties.exposure_min = profiles[0].properties.exposure_max = 0;
	for (int i = 0; i < profiles[0].properties.mode_count; i++) {
		profiles[0].properties.modes[i].exposure_min = profiles[0].properties.modes[i].exposure_max = 0;
	}
	ASSERT_TRUE(start_driver(1));
	ASSERT_TRUE(connect_device());
	ASSERT_TRUE(find_cached_property(CCD_GAIN_PROPERTY_NAME) == NULL);
	indigo_item *exposure = find_cached_item(CCD_EXPOSURE_PROPERTY_NAME, CCD_EXPOSURE_ITEM_NAME);
	ASSERT_TRUE(exposure->number.max > exposure->number.min);
	select_raw_format();
	ASSERT_TRUE(expose(0.01));
	ASSERT_NEAR(profiles[0].properties.gain_default, states[0].gain, 1e-9);
	end();
}

static void discovery_names_and_duplicates(void) {
	reset_fake(4, false);
	set_profile(1, "/base/axi/pcie@120000/rp1/i2c@88000/imx477@1a", "imx477", true);
	set_profile(2, "/base/axi/pcie@120000/rp1/i2c@80000/imx477@1a", "imx477", true);
	set_profile(3, "/base/soc/unknown@10", "", false);
	ASSERT_TRUE(start_driver(4));
	ASSERT_EQ_INT(1, initialize_count);
	ASSERT_STREQ("OV5647", attached_names[0]);
	ASSERT_STREQ("IMX477", attached_names[1]);
	ASSERT_STREQ("IMX477 #1", attached_names[2]);
	ASSERT_STREQ("libcamera Camera", attached_names[3]);
	// Each device opens its own camera: the duplicate name addresses the second libcamera id.
	snprintf(device_name, sizeof(device_name), "IMX477 #1");
	reset_simulator_context(&libcamera_case);
	enumerate_simulator_device();
	ASSERT_TRUE(connect_device());
	ASSERT_STREQ("/base/axi/pcie@120000/rp1/i2c@80000/imx477@1a", find_cached_item(INFO_PROPERTY_NAME, INFO_DEVICE_SERIAL_NUM_ITEM_NAME)->text.value);
	ASSERT_TRUE(states[2].open);
	ASSERT_TRUE(!states[1].open);
	end();
	ASSERT_EQ_INT(0, attached);
	ASSERT_EQ_INT(1, terminate_count);
}

static void discovery_capacity(void) {
	reset_fake(FAKE_CAMERAS, false);
	ASSERT_TRUE(start_driver(5));
	indigo_usleep(100000);
	ASSERT_EQ_INT(5, attached);
	ASSERT_STREQ("OV5647 #4", attached_names[4]);
	end();
	ASSERT_EQ_INT(0, attached);
}

static void no_cameras_and_unavailable_library(void) {
	reset_fake(0, false);
	ASSERT_TRUE(start_driver(0));
	ASSERT_TRUE(wait_atomic(&initialize_count, 1));
	ASSERT_EQ_INT(0, attached);
	end();
	reset_fake(1, false);
	atomic_store(&fail_initialize, 1);
	ASSERT_TRUE(start_driver(0));
	ASSERT_TRUE(wait_atomic(&initialize_count, 1));
	ASSERT_EQ_INT(0, attached);
	end();
	ASSERT_EQ_INT(1, terminate_count);
}

static void repeated_init_and_shutdown(void) {
	reset_fake(1, false);
	reset_simulator_context(&libcamera_case);
	ASSERT_EQ_INT(INDIGO_OK, indigo_start());
	for (int i = 0; i < 3; i++) {
		ASSERT_EQ_INT(INDIGO_OK, indigo_ccd_libcamera(INDIGO_DRIVER_INIT, NULL));
		ASSERT_TRUE(wait_atomic(&attached, 1));
		ASSERT_EQ_INT(INDIGO_OK, indigo_ccd_libcamera(INDIGO_DRIVER_SHUTDOWN, NULL));
		ASSERT_EQ_INT(0, attached);
	}
	ASSERT_EQ_INT(3, initialize_count);
	ASSERT_EQ_INT(3, terminate_count);
	indigo_stop();
}

static void open_failure_and_recovery(void) {
	ASSERT_TRUE(begin(false, false));
	atomic_store(&fail_open, 1);
	indigo_change_switch_property_1(&simulator_test_client, device_name, CONNECTION_PROPERTY_NAME, CONNECTION_CONNECTED_ITEM_NAME, true);
	ASSERT_TRUE(wait_for_property_state(CONNECTION_PROPERTY_NAME, INDIGO_ALERT_STATE));
	ASSERT_EQ_INT(0, open_count);
	ASSERT_EQ_INT(0, close_count);
	ASSERT_TRUE(find_cached_property(CCD_INFO_PROPERTY_NAME) == NULL);
	atomic_store(&fail_open, 0);
	ASSERT_TRUE(connect_device());
	ASSERT_EQ_INT(1, open_count);
	end();
	ASSERT_EQ_INT(1, close_count);
	ASSERT_EQ_INT(0, calls_after_close);
}

static void exposure_and_image_contract(void) {
	ASSERT_TRUE(begin(true, false));
	select_raw_format();
	ASSERT_EQ_INT(INDIGO_OK, indigo_change_number_property_1(&simulator_test_client, device_name, CCD_GAIN_PROPERTY_NAME, CCD_GAIN_ITEM_NAME, 4));
	ASSERT_TRUE(wait_for_property_state(CCD_GAIN_PROPERTY_NAME, INDIGO_OK_STATE));
	ASSERT_EQ_INT(0, start_count);
	ASSERT_TRUE(expose(0.02));
	ASSERT_EQ_INT(1, start_count);
	ASSERT_EQ_INT(0, states[0].mode);
	ASSERT_NEAR(0.02, states[0].exposure, 1e-9);
	ASSERT_NEAR(4, states[0].gain, 1e-9);
	ASSERT_TRUE(!states[0].streaming);
	ASSERT_TRUE(!states[0].capturing);
	ASSERT_EQ_INT(1, blobs);
	ASSERT_EQ_INT(0, bad_blob);
	ASSERT_EQ_INT(64, blob_width);
	ASSERT_EQ_INT(48, blob_height);
	for (int x = 0; x < 4; x++) {
		ASSERT_EQ_INT(pattern(0, x, 0, 10), first_pixels[x]);
	}
	ASSERT_NEAR(0, cached_number_value(CCD_EXPOSURE_PROPERTY_NAME, CCD_EXPOSURE_ITEM_NAME), 0);
	// A bias frame uses the shortest exposure the camera reports, whatever was requested.
	ASSERT_EQ_INT(INDIGO_OK, indigo_change_switch_property_1(&simulator_test_client, device_name, CCD_FRAME_TYPE_PROPERTY_NAME, CCD_FRAME_TYPE_BIAS_ITEM_NAME, true));
	ASSERT_TRUE(wait_for_property_state(CCD_FRAME_TYPE_PROPERTY_NAME, INDIGO_OK_STATE));
	ASSERT_TRUE(expose(1));
	ASSERT_NEAR(0.000130, states[0].exposure, 1e-9);
	ASSERT_EQ_INT(2, blobs);
	end();
	ASSERT_EQ_INT(0, calls_after_close);
}

static void color_subframe_mode_and_bayer(void) {
	ASSERT_TRUE(begin(true, true));
	select_raw_format();
	const char *frame_items[] = { CCD_FRAME_LEFT_ITEM_NAME, CCD_FRAME_TOP_ITEM_NAME, CCD_FRAME_WIDTH_ITEM_NAME, CCD_FRAME_HEIGHT_ITEM_NAME };
	const double frame_values[] = { 9, 5, 21, 13 };
	ASSERT_EQ_INT(INDIGO_OK, change_numbers(CCD_FRAME_PROPERTY_NAME, 4, frame_items, frame_values));
	ASSERT_TRUE(wait_for_property_state(CCD_FRAME_PROPERTY_NAME, INDIGO_OK_STATE));
	ASSERT_NEAR(8, cached_number_value(CCD_FRAME_PROPERTY_NAME, CCD_FRAME_LEFT_ITEM_NAME), 0);
	ASSERT_NEAR(4, cached_number_value(CCD_FRAME_PROPERTY_NAME, CCD_FRAME_TOP_ITEM_NAME), 0);
	ASSERT_NEAR(20, cached_number_value(CCD_FRAME_PROPERTY_NAME, CCD_FRAME_WIDTH_ITEM_NAME), 0);
	ASSERT_NEAR(12, cached_number_value(CCD_FRAME_PROPERTY_NAME, CCD_FRAME_HEIGHT_ITEM_NAME), 0);
	ASSERT_TRUE(expose(0.01));
	ASSERT_EQ_INT(20, blob_width);
	ASSERT_EQ_INT(12, blob_height);
	ASSERT_EQ_INT(pattern(0, 8, 4, 10), first_pixels[0]);
	ASSERT_EQ_INT(pattern(0, 9, 4, 10), first_pixels[1]);
	// A subframe reaching past the right edge is trimmed to the sensor, keeping the Bayer alignment.
	const double edge_values[] = { 50, 40, 64, 48 };
	ASSERT_EQ_INT(INDIGO_OK, change_numbers(CCD_FRAME_PROPERTY_NAME, 4, frame_items, edge_values));
	ASSERT_TRUE(wait_for_property_state(CCD_FRAME_PROPERTY_NAME, INDIGO_OK_STATE));
	ASSERT_NEAR(14, cached_number_value(CCD_FRAME_PROPERTY_NAME, CCD_FRAME_WIDTH_ITEM_NAME), 0);
	ASSERT_NEAR(8, cached_number_value(CCD_FRAME_PROPERTY_NAME, CCD_FRAME_HEIGHT_ITEM_NAME), 0);
	// Selecting another sensor mode resets the frame to the whole mode and captures in that mode.
	ASSERT_EQ_INT(INDIGO_OK, indigo_change_switch_property_1(&simulator_test_client, device_name, CCD_MODE_PROPERTY_NAME, "MODE_1", true));
	ASSERT_TRUE(wait_for_property_state(CCD_MODE_PROPERTY_NAME, INDIGO_OK_STATE));
	ASSERT_NEAR(0, cached_number_value(CCD_FRAME_PROPERTY_NAME, CCD_FRAME_LEFT_ITEM_NAME), 0);
	ASSERT_NEAR(32, cached_number_value(CCD_FRAME_PROPERTY_NAME, CCD_FRAME_WIDTH_ITEM_NAME), 0);
	// The binned mode allows longer exposures; the new limits reach the client with a new definition.
	ASSERT_NEAR(4.6, find_cached_item(CCD_EXPOSURE_PROPERTY_NAME, CCD_EXPOSURE_ITEM_NAME)->number.max, 1e-9);
	ASSERT_NEAR(4.6, find_cached_item(CCD_STREAMING_PROPERTY_NAME, CCD_STREAMING_EXPOSURE_ITEM_NAME)->number.max, 1e-9);
	ASSERT_TRUE(expose(3.2));
	ASSERT_NEAR(3.2, states[0].exposure, 1e-9);
	ASSERT_NEAR(24, cached_number_value(CCD_FRAME_PROPERTY_NAME, CCD_FRAME_HEIGHT_ITEM_NAME), 0);
	ASSERT_TRUE(expose(0.01));
	ASSERT_EQ_INT(1, states[0].mode);
	ASSERT_EQ_INT(32, blob_width);
	ASSERT_EQ_INT(pattern(1, 1, 0, 10), first_pixels[1]);
	// The FITS header of a colour sensor names its Bayer pattern.
	ASSERT_EQ_INT(INDIGO_OK, indigo_change_switch_property_1(&simulator_test_client, device_name, CCD_IMAGE_FORMAT_PROPERTY_NAME, CCD_IMAGE_FORMAT_FITS_ITEM_NAME, true));
	ASSERT_TRUE(wait_for_property_state(CCD_IMAGE_FORMAT_PROPERTY_NAME, INDIGO_OK_STATE));
	ASSERT_TRUE(expose(0.01));
	ASSERT_EQ_INT(1, bayer_keyword);
	end();
}

// A mono sensor accepts any subframe offset and carries no Bayer keyword.
static void mono_subframe_without_bayer(void) {
	ASSERT_TRUE(begin(true, false));
	const char *frame_items[] = { CCD_FRAME_LEFT_ITEM_NAME, CCD_FRAME_TOP_ITEM_NAME, CCD_FRAME_WIDTH_ITEM_NAME, CCD_FRAME_HEIGHT_ITEM_NAME };
	const double frame_values[] = { 9, 5, 21, 13 };
	ASSERT_EQ_INT(INDIGO_OK, change_numbers(CCD_FRAME_PROPERTY_NAME, 4, frame_items, frame_values));
	ASSERT_TRUE(wait_for_property_state(CCD_FRAME_PROPERTY_NAME, INDIGO_OK_STATE));
	ASSERT_NEAR(9, cached_number_value(CCD_FRAME_PROPERTY_NAME, CCD_FRAME_LEFT_ITEM_NAME), 0);
	ASSERT_NEAR(21, cached_number_value(CCD_FRAME_PROPERTY_NAME, CCD_FRAME_WIDTH_ITEM_NAME), 0);
	ASSERT_EQ_INT(INDIGO_OK, indigo_change_switch_property_1(&simulator_test_client, device_name, CCD_IMAGE_FORMAT_PROPERTY_NAME, CCD_IMAGE_FORMAT_FITS_ITEM_NAME, true));
	ASSERT_TRUE(wait_for_property_state(CCD_IMAGE_FORMAT_PROPERTY_NAME, INDIGO_OK_STATE));
	ASSERT_TRUE(expose(0.01));
	ASSERT_EQ_INT(0, bayer_keyword);
	select_raw_format();
	ASSERT_TRUE(expose(0.01));
	ASSERT_EQ_INT(21, blob_width);
	ASSERT_EQ_INT(pattern(0, 9, 5, 10), first_pixels[0]);
	end();
}

static void abort_and_reacquire(void) {
	ASSERT_TRUE(begin(true, false));
	select_raw_format();
	atomic_store(&hold_frames, 1);
	unsigned revision = property_revision(CCD_EXPOSURE_PROPERTY_NAME);
	ASSERT_EQ_INT(INDIGO_OK, indigo_change_number_property_1(&simulator_test_client, device_name, CCD_EXPOSURE_PROPERTY_NAME, CCD_EXPOSURE_ITEM_NAME, 1));
	ASSERT_TRUE(wait_for_property_state_after(CCD_EXPOSURE_PROPERTY_NAME, INDIGO_BUSY_STATE, revision));
	ASSERT_TRUE(wait_capturing(true));
	ASSERT_EQ_INT(INDIGO_OK, indigo_change_switch_property_1(&simulator_test_client, device_name, CCD_ABORT_EXPOSURE_PROPERTY_NAME, CCD_ABORT_EXPOSURE_ITEM_NAME, true));
	ASSERT_TRUE(wait_for_property_not_busy(CCD_EXPOSURE_PROPERTY_NAME));
	ASSERT_TRUE(!states[0].capturing);
	ASSERT_EQ_INT(0, blobs);
	atomic_store(&hold_frames, 0);
	indigo_usleep(50000);
	ASSERT_EQ_INT(0, blobs);
	ASSERT_TRUE(expose(0.01));
	ASSERT_EQ_INT(1, blobs);
	ASSERT_EQ_INT(2, start_count);
	end();
	ASSERT_EQ_INT(0, calls_after_close);
}

static void finite_and_aborted_streaming(void) {
	ASSERT_TRUE(begin(true, false));
	select_raw_format();
	const char *stream_items[] = { CCD_STREAMING_EXPOSURE_ITEM_NAME, CCD_STREAMING_COUNT_ITEM_NAME };
	const double finite_values[] = { 0.01, 3 };
	unsigned revision = property_revision(CCD_STREAMING_PROPERTY_NAME);
	ASSERT_EQ_INT(INDIGO_OK, change_numbers(CCD_STREAMING_PROPERTY_NAME, 2, stream_items, finite_values));
	ASSERT_TRUE(wait_for_property_state_after(CCD_STREAMING_PROPERTY_NAME, INDIGO_OK_STATE, revision));
	ASSERT_EQ_INT(3, blobs);
	ASSERT_EQ_INT(1, start_count);
	ASSERT_TRUE(states[0].streaming);
	ASSERT_TRUE(!states[0].capturing);
	ASSERT_NEAR(0.01, states[0].exposure, 1e-9);
	const double indefinite_values[] = { 0.01, -1 };
	revision = property_revision(CCD_STREAMING_PROPERTY_NAME);
	ASSERT_EQ_INT(INDIGO_OK, change_numbers(CCD_STREAMING_PROPERTY_NAME, 2, stream_items, indefinite_values));
	ASSERT_TRUE(wait_for_property_state_after(CCD_STREAMING_PROPERTY_NAME, INDIGO_BUSY_STATE, revision));
	ASSERT_TRUE(wait_atomic(&blobs, 6) || atomic_load(&blobs) > 6);
	ASSERT_EQ_INT(INDIGO_OK, indigo_change_switch_property_1(&simulator_test_client, device_name, CCD_ABORT_EXPOSURE_PROPERTY_NAME, CCD_ABORT_EXPOSURE_ITEM_NAME, true));
	ASSERT_TRUE(wait_for_property_not_busy(CCD_STREAMING_PROPERTY_NAME));
	ASSERT_TRUE(!states[0].capturing);
	int after_abort = atomic_load(&blobs);
	indigo_usleep(50000);
	ASSERT_EQ_INT(after_abort, blobs);
	ASSERT_TRUE(expose(0.01));
	end();
	ASSERT_EQ_INT(0, calls_after_close);
}

static void bridge_failures_and_recovery(void) {
	ASSERT_TRUE(begin(true, false));
	select_raw_format();
	atomic_store(&fail_start, 1);
	ASSERT_TRUE(expose_and_fail(0.01));
	ASSERT_EQ_INT(0, start_count);
	atomic_store(&fail_start, 0);
	ASSERT_TRUE(expose(0.01));
	atomic_store(&read_error, 1);
	ASSERT_TRUE(expose_and_fail(0.01));
	ASSERT_TRUE(!states[0].capturing);
	atomic_store(&read_error, 0);
	atomic_store(&short_frame, 1);
	ASSERT_TRUE(expose_and_fail(0.01));
	atomic_store(&short_frame, 0);
	// The camera never delivers: the exposure ends in ALERT once the readout timeout expires.
	atomic_store(&hold_frames, 1);
	ASSERT_TRUE(expose_and_fail(0.01));
	ASSERT_TRUE(!states[0].capturing);
	atomic_store(&hold_frames, 0);
	int before = atomic_load(&blobs);
	ASSERT_TRUE(expose(0.01));
	ASSERT_EQ_INT(before + 1, blobs);
	atomic_store(&fail_start, 1);
	const char *stream_items[] = { CCD_STREAMING_EXPOSURE_ITEM_NAME, CCD_STREAMING_COUNT_ITEM_NAME };
	const double values[] = { 0.01, 3 };
	unsigned revision = property_revision(CCD_STREAMING_PROPERTY_NAME);
	ASSERT_EQ_INT(INDIGO_OK, change_numbers(CCD_STREAMING_PROPERTY_NAME, 2, stream_items, values));
	ASSERT_TRUE(wait_for_property_state_after(CCD_STREAMING_PROPERTY_NAME, INDIGO_ALERT_STATE, revision));
	atomic_store(&fail_start, 0);
	atomic_store(&read_error, 1);
	revision = property_revision(CCD_STREAMING_PROPERTY_NAME);
	ASSERT_EQ_INT(INDIGO_OK, change_numbers(CCD_STREAMING_PROPERTY_NAME, 2, stream_items, values));
	ASSERT_TRUE(wait_for_property_state_after(CCD_STREAMING_PROPERTY_NAME, INDIGO_ALERT_STATE, revision));
	atomic_store(&read_error, 0);
	revision = property_revision(CCD_STREAMING_PROPERTY_NAME);
	ASSERT_EQ_INT(INDIGO_OK, change_numbers(CCD_STREAMING_PROPERTY_NAME, 2, stream_items, values));
	ASSERT_TRUE(wait_for_property_state_after(CCD_STREAMING_PROPERTY_NAME, INDIGO_OK_STATE, revision));
	end();
	ASSERT_EQ_INT(0, calls_after_close);
}

static void busy_rejection_and_overlap(void) {
	ASSERT_TRUE(begin(true, true));
	select_raw_format();
	atomic_store(&hold_frames, 1);
	unsigned revision = property_revision(CCD_EXPOSURE_PROPERTY_NAME);
	ASSERT_EQ_INT(INDIGO_OK, indigo_change_number_property_1(&simulator_test_client, device_name, CCD_EXPOSURE_PROPERTY_NAME, CCD_EXPOSURE_ITEM_NAME, 1));
	ASSERT_TRUE(wait_for_property_state_after(CCD_EXPOSURE_PROPERTY_NAME, INDIGO_BUSY_STATE, revision));
	ASSERT_TRUE(wait_capturing(true));
	ASSERT_TRUE(assert_rejected_number_change_on(device_name, CCD_FRAME_PROPERTY_NAME, CCD_FRAME_WIDTH_ITEM_NAME, 20));
	ASSERT_TRUE(assert_rejected_switch_change_on(device_name, CCD_MODE_PROPERTY_NAME, "MODE_1"));
	ASSERT_NEAR(64, cached_number_value(CCD_FRAME_PROPERTY_NAME, CCD_FRAME_WIDTH_ITEM_NAME), 0);
	// A stream requested during an exposure is refused with an answer and does not restart the camera.
	ASSERT_TRUE(assert_rejected_number_change_on(device_name, CCD_STREAMING_PROPERTY_NAME, CCD_STREAMING_COUNT_ITEM_NAME, 3));
	ASSERT_EQ_INT(1, start_count);
	ASSERT_EQ_INT(0, states[0].mode);
	atomic_store(&hold_frames, 0);
	ASSERT_TRUE(wait_for_property_state_after(CCD_EXPOSURE_PROPERTY_NAME, INDIGO_OK_STATE, revision));
	ASSERT_EQ_INT(1, blobs);
	ASSERT_EQ_INT(64, blob_width);
	end();
}

static void disconnect_during_exposure_and_shutdown(void) {
	ASSERT_TRUE(begin(true, false));
	select_raw_format();
	ASSERT_EQ_INT(INDIGO_BUSY, indigo_ccd_libcamera(INDIGO_DRIVER_SHUTDOWN, NULL));
	ASSERT_TRUE(expose(0.01));
	atomic_store(&hold_frames, 1);
	unsigned revision = property_revision(CCD_EXPOSURE_PROPERTY_NAME);
	ASSERT_EQ_INT(INDIGO_OK, indigo_change_number_property_1(&simulator_test_client, device_name, CCD_EXPOSURE_PROPERTY_NAME, CCD_EXPOSURE_ITEM_NAME, 1));
	ASSERT_TRUE(wait_for_property_state_after(CCD_EXPOSURE_PROPERTY_NAME, INDIGO_BUSY_STATE, revision));
	ASSERT_TRUE(wait_capturing(true));
	indigo_change_switch_property_1(&simulator_test_client, device_name, CONNECTION_PROPERTY_NAME, CONNECTION_DISCONNECTED_ITEM_NAME, true);
	ASSERT_TRUE(wait_for_simulator_connection_state(false));
	ASSERT_TRUE(!states[0].open);
	ASSERT_EQ_INT(1, close_count);
	atomic_store(&hold_frames, 0);
	indigo_usleep(100000);
	ASSERT_EQ_INT(0, calls_after_close);
	ASSERT_EQ_INT(1, blobs);
	ASSERT_TRUE(connect_device());
	ASSERT_EQ_INT(INDIGO_OK_STATE, find_cached_property(CCD_EXPOSURE_PROPERTY_NAME)->state);
	select_raw_format();
	ASSERT_TRUE(expose(0.01));
	ASSERT_EQ_INT(2, blobs);
	// Disconnecting a running SER stream finalizes the video file and leaves no image property BUSY for the next session.
	ASSERT_EQ_INT(INDIGO_OK, indigo_change_switch_property_1(&simulator_test_client, device_name, CCD_UPLOAD_MODE_PROPERTY_NAME, CCD_UPLOAD_MODE_LOCAL_ITEM_NAME, true));
	ASSERT_TRUE(wait_for_property_state(CCD_UPLOAD_MODE_PROPERTY_NAME, INDIGO_OK_STATE));
	ASSERT_EQ_INT(INDIGO_OK, indigo_change_switch_property_1(&simulator_test_client, device_name, CCD_IMAGE_FORMAT_PROPERTY_NAME, CCD_IMAGE_FORMAT_RAW_SER_ITEM_NAME, true));
	ASSERT_TRUE(wait_for_property_state(CCD_IMAGE_FORMAT_PROPERTY_NAME, INDIGO_OK_STATE));
	const char *stream_items[] = { CCD_STREAMING_EXPOSURE_ITEM_NAME, CCD_STREAMING_COUNT_ITEM_NAME };
	const double values[] = { 0.01, -1 };
	revision = property_revision(CCD_STREAMING_PROPERTY_NAME);
	ASSERT_EQ_INT(INDIGO_OK, change_numbers(CCD_STREAMING_PROPERTY_NAME, 2, stream_items, values));
	ASSERT_TRUE(wait_for_property_state_after(CCD_STREAMING_PROPERTY_NAME, INDIGO_BUSY_STATE, revision));
	ASSERT_TRUE(wait_capturing(true));
	indigo_usleep(100000);
	char ser_path[INDIGO_VALUE_SIZE];
	snprintf(ser_path, sizeof(ser_path), "%s", find_cached_item(CCD_IMAGE_FILE_PROPERTY_NAME, CCD_IMAGE_FILE_ITEM_NAME)->text.value);
	ASSERT_TRUE(strstr(ser_path, ".ser") != NULL);
	indigo_change_switch_property_1(&simulator_test_client, device_name, CONNECTION_PROPERTY_NAME, CONNECTION_DISCONNECTED_ITEM_NAME, true);
	ASSERT_TRUE(wait_for_simulator_connection_state(false));
	ASSERT_TRUE(!states[0].open);
	// indigo_ser_close() writes the frame count into the header (offset 38); an abandoned stream leaves it 0.
	FILE *ser = fopen(ser_path, "rb");
	ASSERT_TRUE(ser != NULL);
	uint32_t ser_frames = 0;
	ASSERT_TRUE(fseek(ser, 38, SEEK_SET) == 0 && fread(&ser_frames, sizeof(ser_frames), 1, ser) == 1);
	fclose(ser);
	unlink(ser_path);
	ASSERT_TRUE(ser_frames > 0);
	ASSERT_TRUE(connect_device());
	ASSERT_TRUE(find_cached_property(CCD_STREAMING_PROPERTY_NAME)->state != INDIGO_BUSY_STATE);
	ASSERT_TRUE(find_cached_property(CCD_IMAGE_FILE_PROPERTY_NAME)->state != INDIGO_BUSY_STATE);
	ASSERT_EQ_INT(INDIGO_OK, indigo_change_switch_property_1(&simulator_test_client, device_name, CCD_UPLOAD_MODE_PROPERTY_NAME, CCD_UPLOAD_MODE_CLIENT_ITEM_NAME, true));
	ASSERT_TRUE(wait_for_property_state(CCD_UPLOAD_MODE_PROPERTY_NAME, INDIGO_OK_STATE));
	select_raw_format();
	ASSERT_TRUE(expose(0.01));
	end();
	ASSERT_EQ_INT(3, close_count);
	ASSERT_EQ_INT(0, calls_after_close);
}

int main(int argc, char **argv) {
	setvbuf(stdout, NULL, _IONBF, 0);
	indigo_test_use_private_home();
	const indigo_test_case tests[] = {
		{ "Metadata and property contract", metadata_and_property_contract },
		{ "Capability profile without gain", capability_profile_without_gain },
		{ "Discovery names and duplicates", discovery_names_and_duplicates },
		{ "Discovery capacity", discovery_capacity },
		{ "No cameras and unavailable library", no_cameras_and_unavailable_library },
		{ "Repeated INIT and SHUTDOWN", repeated_init_and_shutdown },
		{ "Open failure and recovery", open_failure_and_recovery },
		{ "Exposure and image contract", exposure_and_image_contract },
		{ "Colour subframe, mode and Bayer", color_subframe_mode_and_bayer },
		{ "Mono subframe without Bayer", mono_subframe_without_bayer },
		{ "Abort and reacquire", abort_and_reacquire },
		{ "Finite and aborted streaming", finite_and_aborted_streaming },
		{ "Bridge failures and recovery", bridge_failures_and_recovery },
		{ "Busy rejection and overlap", busy_rejection_and_overlap },
		{ "Disconnect during exposure and shutdown", disconnect_during_exposure_and_shutdown }
	};
	int result = 0, matched = 0;
	for (int i = 0; i < ARRAY_SIZE(tests); i++) {
		if (argc < 2 || strstr(tests[i].name, argv[1])) {
			matched++;
			result |= indigo_run_tests("libcamera fake bridge", tests + i, 1);
		}
	}
	indigo_test_remove_private_home();
	return matched ? result : 1;
}
