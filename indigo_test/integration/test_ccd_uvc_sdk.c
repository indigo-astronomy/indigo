// Copyright (c) 2026 INDIGO initiative
// All rights reserved.
//
// You may use this software under the terms of 'INDIGO Astronomy
// open-source license' (see LICENSE.md).
//
// THIS SOFTWARE IS PROVIDED BY THE AUTHORS 'AS IS' AND ANY EXPRESS
// OR IMPLIED WARRANTIES, INCLUDING, BUT NOT LIMITED TO, THE IMPLIED
// WARRANTIES OF MERCHANTABILITY AND FITNESS FOR A PARTICULAR PURPOSE
// ARE DISCLAIMED. IN NO EVENT SHALL THE AUTHOR BE LIABLE FOR ANY
// DIRECT, INDIRECT, INCIDENTAL, SPECIAL, EXEMPLARY, OR CONSEQUENTIAL
// DAMAGES (INCLUDING, BUT NOT LIMITED TO, PROCUREMENT OF SUBSTITUTE
// GOODS OR SERVICES; LOSS OF USE, DATA, OR PROFITS; OR BUSINESS
// INTERRUPTION) HOWEVER CAUSED AND ON ANY THEORY OF LIABILITY,
// WHETHER IN CONTRACT, STRICT LIABILITY, OR TORT (INCLUDING
// NEGLIGENCE OR OTHERWISE) ARISING IN ANY WAY OUT OF THE USE OF THIS
// SOFTWARE, EVEN IF ADVISED OF THE POSSIBILITY OF SUCH DAMAGE.

// Code is generated by AI

#include <stdatomic.h>
#include <stdarg.h>
#include <pthread.h>
#include <libusb-1.0/libusb.h>
#include <indigo/indigo_ccd_driver.h>
#include <indigo_drivers/ccd_uvc/indigo_ccd_uvc.h>
#include <indigo_drivers/ccd_uvc/libuvc.h>
#include "ccd_test_noise.h"
#include "simulator_test_common.h"

#define CAMERAS 12
#define TRACE_SIZE 65536
#define FRAME_BYTES (64 * 48 * 3)
#define TEST_UVC_CTRL_FLAG_GET_CUR (1 << 1)

#ifndef UVC_REFERENCE_TRACE_PATH
#define UVC_REFERENCE_TRACE_PATH "fixtures/ccd_uvc/original_reference_trace.txt"
#endif

typedef struct {
	bool visible;
	uint8_t bus, address;
	char manufacturer[32], product[32];
	atomic_bool opened, stream_open, streaming;
	atomic_int opens, closes, stream_opens, stream_starts, stream_closes, frames, timeouts;
	atomic_int gain, gamma, exposure;
	enum uvc_frame_format format;
	int width, height;
	uvc_format_desc_t formats[4];
	uvc_frame_desc_t frame_descs[4];
	uvc_frame_t frame;
	unsigned char pixels[FRAME_BYTES];
} fake_camera;

typedef struct {
	fake_camera *camera;
} fake_stream;

static fake_camera cameras[CAMERAS];
static int usb_tokens[CAMERAS];
static fake_stream streams[CAMERAS];
static indigo_device *logical[CAMERAS];
static libusb_hotplug_callback_fn usb_callback;
static pthread_mutex_t trace_mutex = PTHREAD_MUTEX_INITIALIZER;
static char trace_buffer[TRACE_SIZE];
static size_t trace_length;
static atomic_int attached, blobs, bad_blobs, allocated_frames, freed_frames, calls_after_close;
static atomic_int usb_refs, uvc_refs, descriptor_allocations, descriptor_frees;
static atomic_int fail_init, fail_queue, fail_register, fail_list, fail_descriptor, fail_attach, hold_frames, empty_frames, conversion_error, malformed_frame, control_flags;
static _Atomic(double) clock_advance;
static _Atomic(const char *) fail_call;
static const char *device_name = "SVBONY SV205";

static const simulator_driver_case uvc_case = {
	"UVC Camera", "indigo_ccd_uvc", "SVBONY SV205", indigo_ccd_uvc, true,
	base_properties_without_instances, ARRAY_SIZE(base_properties_without_instances), hidden_base_properties_without_instances, ARRAY_SIZE(hidden_base_properties_without_instances), NULL, 0, NULL, 0
};

static void trace(const char *format, ...) {
	char entry[256];
	va_list args;
	va_start(args, format);
	vsnprintf(entry, sizeof(entry), format, args);
	va_end(args);
	pthread_mutex_lock(&trace_mutex);
	if (trace_length < sizeof(trace_buffer) - 1) {
		int written = snprintf(trace_buffer + trace_length, sizeof(trace_buffer) - trace_length, "%s%s", trace_length ? "\n" : "", entry);
		if (written > 0) {
			trace_length += (size_t)written;
			if (trace_length >= sizeof(trace_buffer)) {
				trace_length = sizeof(trace_buffer) - 1;
			}
		}
	}
	pthread_mutex_unlock(&trace_mutex);
}

static int camera_index(const void *pointer) {
	for (int i = 0; i < CAMERAS; i++) {
		if (pointer == (void *)(usb_tokens + i) || pointer == (void *)(cameras + i)) {
			return i;
		}
	}
	return -1;
}

static fake_camera *camera_from_handle(uvc_device_handle_t *handle) {
	int index = camera_index(handle);
	if (index < 0) {
		atomic_fetch_add(&calls_after_close, 1);
		return cameras;
	}
	if (!atomic_load(&cameras[index].opened)) {
		atomic_fetch_add(&calls_after_close, 1);
	}
	return cameras + index;
}

static bool should_fail(const char *name) {
	const char *failure = atomic_load(&fail_call);
	return failure && !strcmp(failure, name);
}

static void initialize_formats(fake_camera *camera) {
	static const char fourcc[4][4] = { { 'Y', 'U', 'Y', '2' }, { 'Y', '8', '0', '0' }, { 'Y', '1', '6', ' ' }, { 'R', 'G', 'G', 'B' } };
	static const enum uvc_frame_format formats[4] = { UVC_FRAME_FORMAT_YUYV, UVC_FRAME_FORMAT_GRAY8, UVC_FRAME_FORMAT_GRAY16, UVC_FRAME_FORMAT_SRGGB8 };
	static const int widths[4] = { 64, 32, 16, 8 };
	static const int heights[4] = { 48, 24, 12, 6 };
	memset(camera->formats, 0, sizeof(camera->formats));
	memset(camera->frame_descs, 0, sizeof(camera->frame_descs));
	for (int i = 0; i < 4; i++) {
		camera->formats[i].bDescriptorSubtype = UVC_VS_FORMAT_UNCOMPRESSED;
		memcpy(camera->formats[i].fourccFormat, fourcc[i], 4);
		camera->formats[i].frame_descs = camera->frame_descs + i;
		camera->formats[i].next = i < 3 ? camera->formats + i + 1 : NULL;
		camera->frame_descs[i].wWidth = widths[i];
		camera->frame_descs[i].wHeight = heights[i];
		camera->frame_descs[i].parent = camera->formats + i;
	}
	camera->format = formats[0];
	camera->width = widths[0];
	camera->height = heights[0];
}

static void reset_fake(void) {
	memset(cameras, 0, sizeof(cameras));
	memset(streams, 0, sizeof(streams));
	memset(logical, 0, sizeof(logical));
	for (int i = 0; i < CAMERAS; i++) {
		cameras[i].bus = i / 8 + 1;
		cameras[i].address = i % 8 + 1;
		snprintf(cameras[i].manufacturer, sizeof(cameras[i].manufacturer), "%s", i == 0 ? "SVBONY" : "UVC");
		snprintf(cameras[i].product, sizeof(cameras[i].product), "%s%d", i == 0 ? "SV205" : "fake ", i == 0 ? 0 : i);
		initialize_formats(cameras + i);
		atomic_store(&cameras[i].gain, 10);
		atomic_store(&cameras[i].gamma, 100);
		atomic_store(&cameras[i].exposure, 100);
	}
	snprintf(cameras[0].product, sizeof(cameras[0].product), "SV205");
	cameras[0].visible = true;
	trace_buffer[0] = 0;
	trace_length = 0;
	atomic_store(&attached, 0);
	atomic_store(&blobs, 0);
	atomic_store(&bad_blobs, 0);
	atomic_store(&allocated_frames, 0);
	atomic_store(&freed_frames, 0);
	atomic_store(&calls_after_close, 0);
	atomic_store(&usb_refs, 0);
	atomic_store(&uvc_refs, 0);
	atomic_store(&descriptor_allocations, 0);
	atomic_store(&descriptor_frees, 0);
	atomic_store(&fail_init, 0);
	atomic_store(&fail_queue, 0);
	atomic_store(&fail_register, 0);
	atomic_store(&fail_list, 0);
	atomic_store(&fail_descriptor, 0);
	atomic_store(&fail_attach, 0);
	atomic_store(&hold_frames, 0);
	atomic_store(&empty_frames, 0);
	atomic_store(&conversion_error, 0);
	atomic_store(&malformed_frame, 0);
	atomic_store(&control_flags, 3);
	atomic_store(&clock_advance, 0);
	atomic_store(&fail_call, NULL);
	usb_callback = NULL;
}

uvc_error_t uvc_init(uvc_context_t **context, struct libusb_context *usb_context) {
	trace("uvc_init");
	if (atomic_load(&fail_init)) {
		return UVC_ERROR_OTHER;
	}
	*context = (uvc_context_t *)cameras;
	return UVC_SUCCESS;
}

void uvc_exit(uvc_context_t *context) {
	trace("uvc_exit");
}

uvc_error_t uvc_get_device_list(uvc_context_t *context, uvc_device_t ***result) {
	trace("uvc_get_device_list");
	if (atomic_load(&fail_list)) {
		return UVC_ERROR_IO;
	}
	uvc_device_t **list = calloc(CAMERAS + 1, sizeof(*list));
	int count = 0;
	for (int i = 0; i < CAMERAS; i++) {
		if (cameras[i].visible) {
			list[count++] = (uvc_device_t *)(cameras + i);
			atomic_fetch_add(&uvc_refs, 1);
		}
	}
	*result = list;
	return UVC_SUCCESS;
}

void uvc_free_device_list(uvc_device_t **list, uint8_t unref_devices) {
	trace("uvc_free_device_list unref=%u", unref_devices);
	free(list);
}

uvc_error_t uvc_get_device_descriptor(uvc_device_t *device, uvc_device_descriptor_t **result) {
	int index = camera_index(device);
	trace("uvc_get_device_descriptor camera=%d", index);
	if (atomic_load(&fail_descriptor) || index < 0) {
		uvc_device_descriptor_t *rejected = calloc(1, sizeof(*rejected));
		atomic_fetch_add(&descriptor_allocations, 1);
		rejected->manufacturer = "REJECTED";
		rejected->product = "DESCRIPTOR";
		*result = rejected;
		return UVC_ERROR_IO;
	}
	uvc_device_descriptor_t *descriptor = calloc(1, sizeof(*descriptor));
	atomic_fetch_add(&descriptor_allocations, 1);
	descriptor->idVendor = 0x1908;
	descriptor->idProduct = 0x2311 + index;
	descriptor->manufacturer = cameras[index].manufacturer;
	descriptor->product = cameras[index].product;
	*result = descriptor;
	return UVC_SUCCESS;
}

void uvc_free_device_descriptor(uvc_device_descriptor_t *descriptor) {
	trace("uvc_free_device_descriptor");
	free(descriptor);
	atomic_fetch_add(&descriptor_frees, 1);
}

uint8_t uvc_get_bus_number(uvc_device_t *device) {
	int index = camera_index(device);
	return index < 0 ? 0 : cameras[index].bus;
}

uint8_t uvc_get_device_address(uvc_device_t *device) {
	int index = camera_index(device);
	return index < 0 ? 0 : cameras[index].address;
}

void uvc_unref_device(uvc_device_t *device) {
	trace("uvc_unref_device camera=%d", camera_index(device));
	atomic_fetch_sub(&uvc_refs, 1);
}

uvc_error_t uvc_open(uvc_device_t *device, uvc_device_handle_t **handle) {
	int index = camera_index(device);
	trace("uvc_open camera=%d", index);
	if (should_fail("open") || index < 0) {
		return UVC_ERROR_ACCESS;
	}
	atomic_store(&cameras[index].opened, true);
	atomic_fetch_add(&cameras[index].opens, 1);
	*handle = (uvc_device_handle_t *)(cameras + index);
	return UVC_SUCCESS;
}

uvc_error_t uvc_sdk_open(uvc_device_t *device, uvc_device_handle_t **handle) {
	return uvc_open(device, handle);
}

void uvc_close(uvc_device_handle_t *handle) {
	int index = camera_index(handle);
	trace("uvc_close camera=%d", index);
	if (index >= 0) {
		atomic_store(&cameras[index].opened, false);
		atomic_fetch_add(&cameras[index].closes, 1);
	}
}

void uvc_sdk_close(uvc_device_handle_t *handle) {
	uvc_close(handle);
}

void uvc_print_diag(uvc_device_handle_t *handle, FILE *stream) {
	trace("uvc_print_diag");
}

const uvc_format_desc_t *uvc_get_format_descs(uvc_device_handle_t *handle) {
	trace("uvc_get_format_descs");
	if (should_fail("formats")) {
		return NULL;
	}
	return camera_from_handle(handle)->formats;
}

uvc_error_t uvc_get_stream_ctrl_format_size(uvc_device_handle_t *handle, uvc_stream_ctrl_t *control, enum uvc_frame_format format, int width, int height, int fps) {
	fake_camera *camera = camera_from_handle(handle);
	trace("uvc_get_stream_ctrl format=%d width=%d height=%d fps=%d", format, width, height, fps);
	if (should_fail("stream_ctrl")) {
		return UVC_ERROR_INVALID_MODE;
	}
	camera->format = format;
	camera->width = width;
	camera->height = height;
	memset(control, 0, sizeof(*control));
	control->dwMaxVideoFrameSize = (uint32_t)(width * height * 3);
	return UVC_SUCCESS;
}

uvc_error_t uvc_set_ae_mode(uvc_device_handle_t *handle, uint8_t mode) {
	camera_from_handle(handle);
	trace("uvc_set_ae_mode value=%u", mode);
	return should_fail("ae") ? UVC_ERROR_IO : UVC_SUCCESS;
}

uvc_error_t uvc_get_exposure_abs(uvc_device_handle_t *handle, uint32_t *value, enum uvc_req_code request) {
	fake_camera *camera = camera_from_handle(handle);
	trace("uvc_get_exposure request=%d", request);
	if (should_fail("get_exposure")) {
		return UVC_ERROR_IO;
	}
	*value = request == UVC_GET_MIN ? 10 : request == UVC_GET_MAX ? 100000 : (uint32_t)atomic_load(&camera->exposure);
	return UVC_SUCCESS;
}

uvc_error_t uvc_set_exposure_abs(uvc_device_handle_t *handle, uint32_t value) {
	fake_camera *camera = camera_from_handle(handle);
	trace("uvc_set_exposure value=%u", value);
	if (should_fail("exposure")) {
		return UVC_ERROR_IO;
	}
	atomic_store(&camera->exposure, (int)value);
	return UVC_SUCCESS;
}

static uvc_error_t get_control(uvc_device_handle_t *handle, uint16_t *value, enum uvc_req_code request, bool gamma) {
	fake_camera *camera = camera_from_handle(handle);
	const char *name = gamma ? "gamma" : "gain";
	trace("uvc_get_%s request=%d", name, request);
	if (should_fail(gamma ? "get_gamma" : "get_gain")) {
		return UVC_ERROR_IO;
	}
	if (request == UVC_GET_INFO) {
		*value = (uint16_t)atomic_load(&control_flags);
	} else if (request == UVC_GET_MIN) {
		*value = gamma ? 50 : 0;
	} else if (request == UVC_GET_MAX) {
		*value = gamma ? 300 : 100;
	} else {
		*value = (uint16_t)atomic_load(gamma ? &camera->gamma : &camera->gain);
	}
	return UVC_SUCCESS;
}

uvc_error_t uvc_get_gain(uvc_device_handle_t *handle, uint16_t *value, enum uvc_req_code request) {
	return get_control(handle, value, request, false);
}

uvc_error_t uvc_get_gamma(uvc_device_handle_t *handle, uint16_t *value, enum uvc_req_code request) {
	return get_control(handle, value, request, true);
}

uvc_error_t uvc_set_gain(uvc_device_handle_t *handle, uint16_t value) {
	fake_camera *camera = camera_from_handle(handle);
	trace("uvc_set_gain value=%u", value);
	if (should_fail("gain")) {
		return UVC_ERROR_IO;
	}
	atomic_store(&camera->gain, value);
	return UVC_SUCCESS;
}

uvc_error_t uvc_set_gamma(uvc_device_handle_t *handle, uint16_t value) {
	fake_camera *camera = camera_from_handle(handle);
	trace("uvc_set_gamma value=%u", value);
	if (should_fail("gamma")) {
		return UVC_ERROR_IO;
	}
	atomic_store(&camera->gamma, value);
	return UVC_SUCCESS;
}

uvc_error_t uvc_stream_open_ctrl(uvc_device_handle_t *handle, uvc_stream_handle_t **stream, uvc_stream_ctrl_t *control) {
	fake_camera *camera = camera_from_handle(handle);
	int index = (int)(camera - cameras);
	trace("uvc_stream_open camera=%d size=%u", index, control->dwMaxVideoFrameSize);
	if (should_fail("stream_open")) {
		return UVC_ERROR_IO;
	}
	streams[index].camera = camera;
	atomic_store(&camera->stream_open, true);
	atomic_fetch_add(&camera->stream_opens, 1);
	*stream = (uvc_stream_handle_t *)(streams + index);
	return UVC_SUCCESS;
}

uvc_error_t uvc_stream_start(uvc_stream_handle_t *stream, uvc_frame_callback_t *callback, void *data, uint8_t flags) {
	fake_stream *fake = (fake_stream *)stream;
	trace("uvc_stream_start flags=%u", flags);
	if (should_fail("stream_start")) {
		return UVC_ERROR_IO;
	}
	atomic_store(&fake->camera->streaming, true);
	atomic_fetch_add(&fake->camera->stream_starts, 1);
	return UVC_SUCCESS;
}

static void fill_frame(fake_camera *camera) {
	int pixels = camera->width * camera->height;
	if (camera->format == UVC_FRAME_FORMAT_GRAY16) {
		for (int i = 0; i < pixels; i++) {
			uint16_t value = ccd_test_noise(i, 0);
			memcpy(camera->pixels + 2 * i, &value, sizeof(value));
		}
		camera->frame.data_bytes = (size_t)pixels * 2;
	} else if (camera->format == UVC_FRAME_FORMAT_YUYV || camera->format == UVC_FRAME_FORMAT_UYVY) {
		for (int i = 0; i < pixels * 2; i++) {
			camera->pixels[i] = (unsigned char)(i * 17 + 3);
		}
		camera->frame.data_bytes = (size_t)pixels * 2;
	} else if (camera->format == UVC_FRAME_FORMAT_RGB) {
		for (int i = 0; i < pixels * 3; i++) {
			camera->pixels[i] = (unsigned char)(i * 17 + 3);
		}
		camera->frame.data_bytes = (size_t)pixels * 3;
	} else {
		for (int i = 0; i < pixels; i++) {
			camera->pixels[i] = (unsigned char)(ccd_test_noise(i, 0) >> 8);
		}
		camera->frame.data_bytes = (size_t)pixels;
	}
	camera->frame.data = camera->pixels;
	camera->frame.width = (uint32_t)camera->width;
	camera->frame.height = (uint32_t)camera->height;
	camera->frame.frame_format = camera->format;
	int malformed = atomic_load(&malformed_frame);
	if (malformed != 0) {
		if (malformed > 0) {
			atomic_fetch_sub(&malformed_frame, 1);
		}
		camera->frame.data_bytes = 1;
	}
}

uvc_error_t uvc_stream_get_frame(uvc_stream_handle_t *stream, uvc_frame_t **frame, int32_t timeout) {
	fake_stream *fake = (fake_stream *)stream;
	trace("uvc_stream_get_frame timeout=%d", timeout);
	if (!fake || !fake->camera || !atomic_load(&fake->camera->streaming)) {
		return UVC_ERROR_INVALID_PARAM;
	}
	if (should_fail("frame")) {
		*frame = NULL;
		return UVC_ERROR_IO;
	}
	if (atomic_load(&hold_frames)) {
		*frame = NULL;
		indigo_usleep(1000);
		return UVC_ERROR_TIMEOUT;
	}
	if (atomic_load(&empty_frames) > 0) {
		atomic_fetch_sub(&empty_frames, 1);
		*frame = NULL;
		return UVC_SUCCESS;
	}
	if (atomic_fetch_add(&fake->camera->timeouts, 1) % 2 == 0) {
		*frame = NULL;
		return UVC_ERROR_TIMEOUT;
	}
	fill_frame(fake->camera);
	*frame = &fake->camera->frame;
	atomic_fetch_add(&fake->camera->frames, 1);
	return UVC_SUCCESS;
}

void uvc_stream_close(uvc_stream_handle_t *stream) {
	fake_stream *fake = (fake_stream *)stream;
	trace("uvc_stream_close");
	if (fake && fake->camera) {
		atomic_store(&fake->camera->streaming, false);
		atomic_store(&fake->camera->stream_open, false);
		atomic_fetch_add(&fake->camera->stream_closes, 1);
	}
}

uvc_frame_t *uvc_allocate_frame(size_t bytes) {
	trace("uvc_allocate_frame bytes=%zu", bytes);
	uvc_frame_t *frame = calloc(1, sizeof(*frame));
	frame->data = malloc(bytes);
	frame->data_bytes = bytes;
	frame->library_owns_data = 1;
	atomic_fetch_add(&allocated_frames, 1);
	return frame;
}

void uvc_free_frame(uvc_frame_t *frame) {
	trace("uvc_free_frame");
	if (frame) {
		free(frame->data);
		free(frame);
		atomic_fetch_add(&freed_frames, 1);
	}
}

uvc_error_t uvc_any2rgb(uvc_frame_t *input, uvc_frame_t *output) {
	trace("uvc_any2rgb");
	if (atomic_load(&conversion_error)) {
		return UVC_ERROR_IO;
	}
	output->width = input->width;
	output->height = input->height;
	output->frame_format = UVC_FRAME_FORMAT_RGB;
	for (uint32_t i = 0; i < input->width * input->height; i++) {
		((unsigned char *)output->data)[3 * i] = (unsigned char)(i + 1);
		((unsigned char *)output->data)[3 * i + 1] = (unsigned char)(i + 2);
		((unsigned char *)output->data)[3 * i + 2] = (unsigned char)(i + 3);
	}
	return UVC_SUCCESS;
}

const char *uvc_strerror(uvc_error_t error) {
	return error == UVC_SUCCESS ? "Success" : "Fake error";
}

double uvc_test_monotonic_time(void) {
	return indigo_monotonic_time() + atomic_load(&clock_advance);
}

indigo_queue *uvc_test_queue_create(indigo_device *device) {
	return atomic_load(&fail_queue) ? NULL : indigo_queue_create(device);
}

void uvc_test_usb_start(void) {
	trace("indigo_start_usb_event_handler");
}

uint8_t LIBUSB_CALL uvc_test_usb_bus(libusb_device *device) {
	int index = camera_index(device);
	return index < 0 ? 0 : cameras[index].bus;
}

uint8_t LIBUSB_CALL uvc_test_usb_address(libusb_device *device) {
	int index = camera_index(device);
	return index < 0 ? 0 : cameras[index].address;
}

int LIBUSB_CALL uvc_test_usb_descriptor(libusb_device *device, struct libusb_device_descriptor *descriptor) {
	int index = camera_index(device);
	if (index < 0) {
		return LIBUSB_ERROR_NO_DEVICE;
	}
	memset(descriptor, 0, sizeof(*descriptor));
	descriptor->idVendor = 0x1908;
	descriptor->idProduct = (uint16_t)(0x2311 + index);
	return LIBUSB_SUCCESS;
}

libusb_device *LIBUSB_CALL uvc_test_usb_ref(libusb_device *device) {
	atomic_fetch_add(&usb_refs, 1);
	return device;
}

void LIBUSB_CALL uvc_test_usb_unref(libusb_device *device) {
	atomic_fetch_sub(&usb_refs, 1);
}

indigo_result uvc_test_usb_path(libusb_device *device, char *path) {
	int index = camera_index(device);
	snprintf(path, INDIGO_NAME_SIZE, "%u-%u", cameras[index].bus, cameras[index].address);
	return INDIGO_OK;
}

int LIBUSB_CALL uvc_test_usb_register(libusb_context *context, libusb_hotplug_event events, libusb_hotplug_flag flags, int vendor, int product, int device_class, libusb_hotplug_callback_fn callback, void *data, libusb_hotplug_callback_handle *handle) {
	trace("libusb_hotplug_register");
	if (atomic_load(&fail_register)) {
		return LIBUSB_ERROR_OTHER;
	}
	usb_callback = callback;
	*handle = 1;
	for (int i = 0; i < CAMERAS; i++) {
		if (cameras[i].visible) {
			callback(NULL, (libusb_device *)(usb_tokens + i), LIBUSB_HOTPLUG_EVENT_DEVICE_ARRIVED, NULL);
		}
	}
	return LIBUSB_SUCCESS;
}

int uvc_test_usb_register_sim(libusb_context *context, libusb_hotplug_event events, libusb_hotplug_flag flags, int vendor, int product, int device_class, libusb_hotplug_callback_fn callback, void *data, libusb_hotplug_callback_handle *handle) {
	return uvc_test_usb_register(context, events, flags, vendor, product, device_class, callback, data, handle);
}

void LIBUSB_CALL uvc_test_usb_deregister(libusb_context *context, libusb_hotplug_callback_handle handle) {
	trace("libusb_hotplug_deregister");
	usb_callback = NULL;
}

int uvc_test_usb_deregister_poll(libusb_context *context, libusb_hotplug_callback_handle handle) {
	uvc_test_usb_deregister(context, handle);
	return 0;
}

indigo_result uvc_test_attach(indigo_device *device) {
	if (atomic_load(&fail_attach)) {
		return INDIGO_FAILED;
	}
	indigo_result result = indigo_attach_device(device);
	if (result == INDIGO_OK) {
		for (int i = 0; i < CAMERAS; i++) {
			if (!logical[i]) {
				logical[i] = device;
				break;
			}
		}
		atomic_fetch_add(&attached, 1);
		trace("indigo_attach_device name=%s", device->name);
	}
	return result;
}

indigo_result uvc_test_detach(indigo_device *device) {
	trace("indigo_detach_device name=%s", device->name);
	indigo_result result = indigo_detach_device(device);
	for (int i = 0; i < CAMERAS; i++) {
		if (logical[i] == device) {
			logical[i] = NULL;
			break;
		}
	}
	atomic_fetch_sub(&attached, 1);
	return result;
}

static indigo_result observe_image(indigo_client *client, indigo_device *device, indigo_property *property, const char *message) {
	if ((!strcmp(property->name, CCD_EXPOSURE_PROPERTY_NAME) || !strcmp(property->name, CCD_STREAMING_PROPERTY_NAME) || !strcmp(property->name, CONNECTION_PROPERTY_NAME)) && property->state != INDIGO_IDLE_STATE) {
		trace("property %s state=%d", property->name, property->state);
	}
	if (!strcmp(property->name, CCD_IMAGE_PROPERTY_NAME) && property->state == INDIGO_OK_STATE && property->items[0].blob.size > 0) {
		bool valid = property->items[0].blob.value != NULL && !strcmp(property->items[0].blob.format, ".raw") && property->items[0].blob.size >= (long)sizeof(indigo_raw_header);
		if (valid) {
			indigo_raw_header header = { 0 };
			memcpy(&header, property->items[0].blob.value, sizeof(header));
			valid = header.width > 0 && header.height > 0 && (header.signature == INDIGO_RAW_MONO8 || header.signature == INDIGO_RAW_MONO16 || header.signature == INDIGO_RAW_RGB24);
		}
		atomic_fetch_add(&blobs, 1);
		if (!valid) {
			atomic_fetch_add(&bad_blobs, 1);
		}
	}
	return simulator_client_update_property(client, device, property, message);
}

static bool wait_atomic(atomic_int *value, int expected) {
	for (int i = 0; i < 500; i++) {
		if (atomic_load(value) == expected) {
			return true;
		}
		indigo_usleep(10000);
	}
	return false;
}

static indigo_result change_stream(double exposure, double count) {
	indigo_property *cached = find_cached_property(CCD_STREAMING_PROPERTY_NAME);
	if (!cached) {
		return INDIGO_FAILED;
	}
	indigo_property *request = indigo_copy_property(NULL, cached);
	for (int i = 0; i < request->count; i++) {
		if (!strcmp(request->items[i].name, CCD_STREAMING_EXPOSURE_ITEM_NAME)) {
			request->items[i].number.value = request->items[i].number.target = exposure;
		} else if (!strcmp(request->items[i].name, CCD_STREAMING_COUNT_ITEM_NAME)) {
			request->items[i].number.value = request->items[i].number.target = count;
		}
	}
	indigo_result result = indigo_change_property(&simulator_test_client, request);
	indigo_release_property(request);
	return result;
}

static bool begin(bool connect) {
	reset_fake();
	reset_simulator_context(&uvc_case);
	simulator_test_client.update_property = observe_image;
	if (indigo_start() != INDIGO_OK || indigo_attach_client(&simulator_test_client) != INDIGO_OK || indigo_ccd_uvc(INDIGO_DRIVER_INIT, NULL) != INDIGO_OK || !wait_atomic(&attached, 1)) {
		fprintf(stderr, "UVC begin failed, attached=%d trace:\n%s\n", atomic_load(&attached), trace_buffer);
		return false;
	}
	enumerate_simulator_device();
	if (connect) {
		indigo_change_switch_property_1(&simulator_test_client, device_name, CONNECTION_PROPERTY_NAME, CONNECTION_CONNECTED_ITEM_NAME, true);
		bool connected = wait_for_simulator_connection_state(true);
		if (!connected) {
			fprintf(stderr, "UVC connect failed, trace:\n%s\n", trace_buffer);
		}
		return connected;
	}
	return true;
}

static void end(void) {
	if (context.connected) {
		indigo_change_switch_property_1(&simulator_test_client, device_name, CONNECTION_PROPERTY_NAME, CONNECTION_DISCONNECTED_ITEM_NAME, true);
		wait_for_simulator_connection_state(false);
	}
	indigo_ccd_uvc(INDIGO_DRIVER_SHUTDOWN, NULL);
	indigo_detach_client(&simulator_test_client);
	indigo_stop();
	release_cached_properties();
}

static void metadata_and_property_contract(void) {
	assert_simulator_driver_info(&uvc_case);
	ASSERT_TRUE(begin(true));
	assert_device_interface(INDIGO_INTERFACE_CCD);
	assert_property_has_item(CCD_INFO_PROPERTY_NAME, CCD_INFO_WIDTH_ITEM_NAME);
	assert_property_has_item(CCD_INFO_PROPERTY_NAME, CCD_INFO_HEIGHT_ITEM_NAME);
	ASSERT_EQ_INT(2, find_cached_property(CCD_INFO_PROPERTY_NAME)->count);
	ASSERT_TRUE(find_cached_property(CCD_BIN_PROPERTY_NAME) == NULL);
	ASSERT_EQ_INT(INDIGO_RO_PERM, find_cached_property(CCD_FRAME_PROPERTY_NAME)->perm);
	ASSERT_EQ_INT(4, find_cached_property(CCD_MODE_PROPERTY_NAME)->count);
	ASSERT_EQ_INT(7, find_cached_property(CCD_IMAGE_FORMAT_PROPERTY_NAME)->count);
	ASSERT_TRUE(find_cached_property(CCD_STREAMING_PROPERTY_NAME) != NULL);
	ASSERT_TRUE(find_cached_property(CCD_STREAMING_SETTINGS_PROPERTY_NAME) != NULL);
	ASSERT_TRUE(find_cached_property(CCD_GAIN_PROPERTY_NAME) != NULL);
	ASSERT_TRUE(find_cached_property(CCD_GAMMA_PROPERTY_NAME) != NULL);
	ASSERT_NEAR(64, cached_number_value(CCD_INFO_PROPERTY_NAME, CCD_INFO_WIDTH_ITEM_NAME), 0);
	ASSERT_NEAR(48, cached_number_value(CCD_INFO_PROPERTY_NAME, CCD_INFO_HEIGHT_ITEM_NAME), 0);
	ASSERT_NEAR(.001, find_cached_item(CCD_EXPOSURE_PROPERTY_NAME, CCD_EXPOSURE_ITEM_NAME)->number.min, .000001);
	ASSERT_NEAR(10, find_cached_item(CCD_EXPOSURE_PROPERTY_NAME, CCD_EXPOSURE_ITEM_NAME)->number.max, .000001);
	end();
}

static void lifecycle_reconnect_and_rejected_shutdown(void) {
	ASSERT_TRUE(begin(true));
	ASSERT_EQ_INT(1, cameras[0].opens);
	ASSERT_EQ_INT(INDIGO_BUSY, indigo_ccd_uvc(INDIGO_DRIVER_SHUTDOWN, NULL));
	ASSERT_EQ_INT(INDIGO_OK, indigo_change_switch_property_1(&simulator_test_client, device_name, CONNECTION_PROPERTY_NAME, CONNECTION_DISCONNECTED_ITEM_NAME, true));
	ASSERT_TRUE(wait_for_simulator_connection_state(false));
	ASSERT_EQ_INT(1, cameras[0].closes);
	ASSERT_EQ_INT(INDIGO_OK, indigo_change_switch_property_1(&simulator_test_client, device_name, CONNECTION_PROPERTY_NAME, CONNECTION_CONNECTED_ITEM_NAME, true));
	ASSERT_TRUE(wait_for_simulator_connection_state(true));
	ASSERT_EQ_INT(2, cameras[0].opens);
	end();
}

static void mode_controls_and_call_order(void) {
	ASSERT_TRUE(begin(true));
	ASSERT_EQ_INT(INDIGO_OK, indigo_change_switch_property_1(&simulator_test_client, device_name, CCD_MODE_PROPERTY_NAME, "4_16x12", true));
	ASSERT_TRUE(wait_for_property_state(CCD_MODE_PROPERTY_NAME, INDIGO_OK_STATE));
	ASSERT_NEAR(16, cached_number_value(CCD_FRAME_PROPERTY_NAME, CCD_FRAME_WIDTH_ITEM_NAME), 0);
	ASSERT_NEAR(16, cached_number_value(CCD_FRAME_PROPERTY_NAME, CCD_FRAME_BITS_PER_PIXEL_ITEM_NAME), 0);
	ASSERT_EQ_INT(INDIGO_OK, indigo_change_number_property_1(&simulator_test_client, device_name, CCD_GAIN_PROPERTY_NAME, CCD_GAIN_ITEM_NAME, 23));
	ASSERT_EQ_INT(INDIGO_OK, indigo_change_number_property_1(&simulator_test_client, device_name, CCD_GAMMA_PROPERTY_NAME, CCD_GAMMA_ITEM_NAME, 111));
	ASSERT_TRUE(wait_for_property_state(CCD_GAIN_PROPERTY_NAME, INDIGO_OK_STATE));
	ASSERT_TRUE(wait_for_property_state(CCD_GAMMA_PROPERTY_NAME, INDIGO_OK_STATE));
	end();
}

static void mono8_mono16_raw8_and_rgb_images(void) {
	ASSERT_TRUE(begin(true));
	ASSERT_EQ_INT(INDIGO_OK, indigo_change_switch_property_1(&simulator_test_client, device_name, CCD_IMAGE_FORMAT_PROPERTY_NAME, CCD_IMAGE_FORMAT_RAW_ITEM_NAME, true));
	const char *modes[] = { "3_32x24", "4_16x12", "9_8x6", "0_64x48" };
	for (int i = 0; i < 4; i++) {
		ASSERT_EQ_INT(INDIGO_OK, indigo_change_switch_property_1(&simulator_test_client, device_name, CCD_MODE_PROPERTY_NAME, modes[i], true));
		ASSERT_TRUE(wait_for_property_state(CCD_MODE_PROPERTY_NAME, INDIGO_OK_STATE));
		unsigned revision = property_revision(CCD_EXPOSURE_PROPERTY_NAME);
		ASSERT_EQ_INT(INDIGO_OK, indigo_change_number_property_1(&simulator_test_client, device_name, CCD_EXPOSURE_PROPERTY_NAME, CCD_EXPOSURE_ITEM_NAME, .01));
		ASSERT_TRUE(wait_for_property_state_seen_after(CCD_EXPOSURE_PROPERTY_NAME, INDIGO_BUSY_STATE, revision));
		ASSERT_TRUE(wait_for_property_state_after(CCD_EXPOSURE_PROPERTY_NAME, INDIGO_OK_STATE, revision));
	}
	ASSERT_EQ_INT(4, blobs);
	ASSERT_EQ_INT(0, bad_blobs);
	ASSERT_EQ_INT(1, allocated_frames);
	ASSERT_EQ_INT(1, freed_frames);
	end();
}

static void finite_and_indefinite_streaming(void) {
	ASSERT_TRUE(begin(true));
	indigo_change_switch_property_1(&simulator_test_client, device_name, CCD_IMAGE_FORMAT_PROPERTY_NAME, CCD_IMAGE_FORMAT_RAW_ITEM_NAME, true);
	ASSERT_EQ_INT(INDIGO_OK, change_stream(.01, 3));
	ASSERT_TRUE(wait_for_property_state(CCD_STREAMING_PROPERTY_NAME, INDIGO_OK_STATE));
	ASSERT_EQ_INT(3, blobs);
	ASSERT_EQ_INT(INDIGO_OK, change_stream(.01, -1));
	ASSERT_TRUE(wait_for_property_state(CCD_STREAMING_PROPERTY_NAME, INDIGO_BUSY_STATE));
	ASSERT_TRUE(wait_atomic(&cameras[0].stream_opens, 2));
	unsigned abort_revision = property_revision(CCD_ABORT_EXPOSURE_PROPERTY_NAME);
	ASSERT_EQ_INT(INDIGO_OK, indigo_change_switch_property_1(&simulator_test_client, device_name, CCD_ABORT_EXPOSURE_PROPERTY_NAME, CCD_ABORT_EXPOSURE_ITEM_NAME, true));
	ASSERT_TRUE(wait_for_property_state_after(CCD_ABORT_EXPOSURE_PROPERTY_NAME, INDIGO_OK_STATE, abort_revision));
	ASSERT_TRUE(wait_for_property_not_busy(CCD_STREAMING_PROPERTY_NAME));
	ASSERT_EQ_INT(2, cameras[0].stream_opens);
	ASSERT_TRUE(wait_atomic(&cameras[0].stream_closes, 2));
	end();
}

static void open_mode_and_stream_failures_recover(void) {
	ASSERT_TRUE(begin(false));
	atomic_store(&fail_call, "open");
	indigo_change_switch_property_1(&simulator_test_client, device_name, CONNECTION_PROPERTY_NAME, CONNECTION_CONNECTED_ITEM_NAME, true);
	ASSERT_TRUE(wait_for_property_state(CONNECTION_PROPERTY_NAME, INDIGO_ALERT_STATE));
	atomic_store(&fail_call, NULL);
	indigo_change_switch_property_1(&simulator_test_client, device_name, CONNECTION_PROPERTY_NAME, CONNECTION_CONNECTED_ITEM_NAME, true);
	ASSERT_TRUE(wait_for_simulator_connection_state(true));
	atomic_store(&fail_call, "stream_ctrl");
	indigo_change_switch_property_1(&simulator_test_client, device_name, CCD_MODE_PROPERTY_NAME, "3_32x24", true);
	ASSERT_TRUE(wait_for_property_state(CCD_MODE_PROPERTY_NAME, INDIGO_ALERT_STATE));
	atomic_store(&fail_call, NULL);
	indigo_change_switch_property_1(&simulator_test_client, device_name, CCD_MODE_PROPERTY_NAME, "3_32x24", true);
	ASSERT_TRUE(wait_for_property_state(CCD_MODE_PROPERTY_NAME, INDIGO_OK_STATE));
	atomic_store(&fail_call, "stream_open");
	indigo_change_number_property_1(&simulator_test_client, device_name, CCD_EXPOSURE_PROPERTY_NAME, CCD_EXPOSURE_ITEM_NAME, .01);
	ASSERT_TRUE(wait_for_property_state(CCD_EXPOSURE_PROPERTY_NAME, INDIGO_ALERT_STATE));
	atomic_store(&fail_call, "stream_start");
	indigo_change_number_property_1(&simulator_test_client, device_name, CCD_EXPOSURE_PROPERTY_NAME, CCD_EXPOSURE_ITEM_NAME, .01);
	ASSERT_TRUE(wait_for_property_state(CCD_EXPOSURE_PROPERTY_NAME, INDIGO_ALERT_STATE));
	atomic_store(&fail_call, NULL);
	indigo_change_number_property_1(&simulator_test_client, device_name, CCD_EXPOSURE_PROPERTY_NAME, CCD_EXPOSURE_ITEM_NAME, .01);
	ASSERT_TRUE(wait_for_property_state(CCD_EXPOSURE_PROPERTY_NAME, INDIGO_OK_STATE));
	end();
}

static void frame_failure_and_reacquire(void) {
	ASSERT_TRUE(begin(true));
	atomic_store(&fail_call, "frame");
	indigo_change_number_property_1(&simulator_test_client, device_name, CCD_EXPOSURE_PROPERTY_NAME, CCD_EXPOSURE_ITEM_NAME, .01);
	ASSERT_TRUE(wait_for_property_state(CCD_EXPOSURE_PROPERTY_NAME, INDIGO_ALERT_STATE));
	atomic_store(&fail_call, NULL);
	indigo_change_number_property_1(&simulator_test_client, device_name, CCD_EXPOSURE_PROPERTY_NAME, CCD_EXPOSURE_ITEM_NAME, .01);
	ASSERT_TRUE(wait_for_property_state(CCD_EXPOSURE_PROPERTY_NAME, INDIGO_OK_STATE));
	ASSERT_EQ_INT(1, blobs);
	end();
}

static void empty_frame_wakeup_retries(void) {
	ASSERT_TRUE(begin(true));
	atomic_store(&empty_frames, 1);
	indigo_change_number_property_1(&simulator_test_client, device_name, CCD_EXPOSURE_PROPERTY_NAME, CCD_EXPOSURE_ITEM_NAME, .01);
	ASSERT_TRUE(wait_for_property_state(CCD_EXPOSURE_PROPERTY_NAME, INDIGO_OK_STATE));
	ASSERT_EQ_INT(1, cameras[0].frames);
	ASSERT_TRUE(cameras[0].timeouts >= 2);
	end();
}

static void short_frame_and_watchdog_recovery(void) {
	ASSERT_TRUE(begin(true));
	atomic_store(&malformed_frame, 1);
	unsigned revision = property_revision(CCD_EXPOSURE_PROPERTY_NAME);
	indigo_change_number_property_1(&simulator_test_client, device_name, CCD_EXPOSURE_PROPERTY_NAME, CCD_EXPOSURE_ITEM_NAME, .01);
	ASSERT_TRUE(wait_for_property_state_after(CCD_EXPOSURE_PROPERTY_NAME, INDIGO_OK_STATE, revision));
	ASSERT_EQ_INT(2, cameras[0].frames);
	atomic_store(&malformed_frame, -1);
	revision = property_revision(CCD_EXPOSURE_PROPERTY_NAME);
	indigo_change_number_property_1(&simulator_test_client, device_name, CCD_EXPOSURE_PROPERTY_NAME, CCD_EXPOSURE_ITEM_NAME, .01);
	ASSERT_TRUE(wait_for_property_state_seen_after(CCD_EXPOSURE_PROPERTY_NAME, INDIGO_BUSY_STATE, revision));
	ASSERT_TRUE(wait_atomic(&cameras[0].stream_starts, 2));
	atomic_store(&clock_advance, 20);
	ASSERT_TRUE(wait_for_property_state_after(CCD_EXPOSURE_PROPERTY_NAME, INDIGO_ALERT_STATE, revision));
	atomic_store(&clock_advance, 0);
	atomic_store(&malformed_frame, 0);
	atomic_store(&hold_frames, 1);
	revision = property_revision(CCD_EXPOSURE_PROPERTY_NAME);
	indigo_change_number_property_1(&simulator_test_client, device_name, CCD_EXPOSURE_PROPERTY_NAME, CCD_EXPOSURE_ITEM_NAME, .01);
	ASSERT_TRUE(wait_for_property_state_seen_after(CCD_EXPOSURE_PROPERTY_NAME, INDIGO_BUSY_STATE, revision));
	ASSERT_TRUE(wait_atomic(&cameras[0].stream_starts, 3));
	atomic_store(&clock_advance, 20);
	ASSERT_TRUE(wait_for_property_state_after(CCD_EXPOSURE_PROPERTY_NAME, INDIGO_ALERT_STATE, revision));
	atomic_store(&clock_advance, 0);
	atomic_store(&hold_frames, 0);
	revision = property_revision(CCD_EXPOSURE_PROPERTY_NAME);
	indigo_change_number_property_1(&simulator_test_client, device_name, CCD_EXPOSURE_PROPERTY_NAME, CCD_EXPOSURE_ITEM_NAME, .01);
	ASSERT_TRUE(wait_for_property_state_after(CCD_EXPOSURE_PROPERTY_NAME, INDIGO_OK_STATE, revision));
	end();
}

// CCD_MODE reprograms the stream, so it carries a reject_change guard. Without it the request was
// dropped silently and the client kept showing the mode the camera never switched to.
static void rejected_mode_change_during_exposure(void) {
	ASSERT_TRUE(begin(true));
	atomic_store(&hold_frames, 1);
	unsigned revision = property_revision(CCD_EXPOSURE_PROPERTY_NAME);
	indigo_change_number_property_1(&simulator_test_client, device_name, CCD_EXPOSURE_PROPERTY_NAME, CCD_EXPOSURE_ITEM_NAME, .01);
	ASSERT_TRUE(wait_for_property_state_seen_after(CCD_EXPOSURE_PROPERTY_NAME, INDIGO_BUSY_STATE, revision));
	ASSERT_TRUE(assert_rejected_switch_change(CCD_MODE_PROPERTY_NAME, "4_16x12"));
	atomic_store(&hold_frames, 0);
	ASSERT_TRUE(wait_for_property_state_after(CCD_EXPOSURE_PROPERTY_NAME, INDIGO_OK_STATE, revision));
	// A guard must not be sticky once the camera is idle again.
	ASSERT_EQ_INT(INDIGO_OK, indigo_change_switch_property_1(&simulator_test_client, device_name, CCD_MODE_PROPERTY_NAME, "4_16x12", true));
	ASSERT_TRUE(wait_for_property_state(CCD_MODE_PROPERTY_NAME, INDIGO_OK_STATE));
	end();
}

static void acquisition_control_failures_and_values(void) {
	ASSERT_TRUE(begin(true));
	ASSERT_EQ_INT(INDIGO_OK, indigo_change_number_property_1(&simulator_test_client, device_name, CCD_GAIN_PROPERTY_NAME, CCD_GAIN_ITEM_NAME, 23));
	ASSERT_EQ_INT(INDIGO_OK, indigo_change_number_property_1(&simulator_test_client, device_name, CCD_GAMMA_PROPERTY_NAME, CCD_GAMMA_ITEM_NAME, 111));
	const char *failures[] = { "ae", "exposure", "gain", "gamma" };
	for (int i = 0; i < ARRAY_SIZE(failures); i++) {
		int starts = atomic_load(&cameras[0].stream_starts);
		atomic_store(&fail_call, failures[i]);
		unsigned revision = property_revision(CCD_EXPOSURE_PROPERTY_NAME);
		indigo_change_number_property_1(&simulator_test_client, device_name, CCD_EXPOSURE_PROPERTY_NAME, CCD_EXPOSURE_ITEM_NAME, .01);
		ASSERT_TRUE(wait_for_property_state_after(CCD_EXPOSURE_PROPERTY_NAME, INDIGO_ALERT_STATE, revision));
		ASSERT_EQ_INT(starts, cameras[0].stream_starts);
	}
	atomic_store(&fail_call, NULL);
	unsigned revision = property_revision(CCD_EXPOSURE_PROPERTY_NAME);
	indigo_change_number_property_1(&simulator_test_client, device_name, CCD_EXPOSURE_PROPERTY_NAME, CCD_EXPOSURE_ITEM_NAME, .01);
	ASSERT_TRUE(wait_for_property_state_after(CCD_EXPOSURE_PROPERTY_NAME, INDIGO_OK_STATE, revision));
	ASSERT_EQ_INT(23, cameras[0].gain);
	ASSERT_EQ_INT(111, cameras[0].gamma);
	end();
}

static void optional_control_capability_profiles(void) {
	ASSERT_TRUE(begin(false));
	atomic_store(&control_flags, 0);
	indigo_change_switch_property_1(&simulator_test_client, device_name, CONNECTION_PROPERTY_NAME, CONNECTION_CONNECTED_ITEM_NAME, true);
	ASSERT_TRUE(wait_for_simulator_connection_state(true));
	ASSERT_TRUE(find_cached_property(CCD_GAIN_PROPERTY_NAME) == NULL);
	ASSERT_TRUE(find_cached_property(CCD_GAMMA_PROPERTY_NAME) == NULL);
	end();
	ASSERT_TRUE(begin(false));
	atomic_store(&control_flags, TEST_UVC_CTRL_FLAG_GET_CUR);
	indigo_change_switch_property_1(&simulator_test_client, device_name, CONNECTION_PROPERTY_NAME, CONNECTION_CONNECTED_ITEM_NAME, true);
	ASSERT_TRUE(wait_for_simulator_connection_state(true));
	ASSERT_EQ_INT(INDIGO_RO_PERM, find_cached_property(CCD_GAIN_PROPERTY_NAME)->perm);
	ASSERT_EQ_INT(INDIGO_RO_PERM, find_cached_property(CCD_GAMMA_PROPERTY_NAME)->perm);
	end();
}

static void exposure_overlap_abort_and_reacquire(void) {
	ASSERT_TRUE(begin(true));
	atomic_store(&hold_frames, 1);
	unsigned revision = property_revision(CCD_EXPOSURE_PROPERTY_NAME);
	indigo_change_number_property_1(&simulator_test_client, device_name, CCD_EXPOSURE_PROPERTY_NAME, CCD_EXPOSURE_ITEM_NAME, .2);
	ASSERT_TRUE(wait_for_property_state_seen_after(CCD_EXPOSURE_PROPERTY_NAME, INDIGO_BUSY_STATE, revision));
	ASSERT_TRUE(wait_atomic(&cameras[0].stream_opens, 1));
	indigo_change_number_property_1(&simulator_test_client, device_name, CCD_EXPOSURE_PROPERTY_NAME, CCD_EXPOSURE_ITEM_NAME, .3);
	indigo_usleep(50000);
	ASSERT_EQ_INT(1, cameras[0].stream_opens);
	revision = property_revision(CCD_EXPOSURE_PROPERTY_NAME);
	indigo_change_switch_property_1(&simulator_test_client, device_name, CCD_ABORT_EXPOSURE_PROPERTY_NAME, CCD_ABORT_EXPOSURE_ITEM_NAME, true);
	ASSERT_TRUE(wait_for_property_not_busy_after(CCD_EXPOSURE_PROPERTY_NAME, revision));
	ASSERT_TRUE(wait_atomic(&cameras[0].stream_closes, 1));
	atomic_store(&hold_frames, 0);
	revision = property_revision(CCD_EXPOSURE_PROPERTY_NAME);
	indigo_change_number_property_1(&simulator_test_client, device_name, CCD_EXPOSURE_PROPERTY_NAME, CCD_EXPOSURE_ITEM_NAME, .01);
	ASSERT_TRUE(wait_for_property_state_after(CCD_EXPOSURE_PROPERTY_NAME, INDIGO_OK_STATE, revision));
	ASSERT_EQ_INT(2, cameras[0].stream_opens);
	end();
}

static void active_stream_abort_and_disconnect(void) {
	ASSERT_TRUE(begin(true));
	atomic_store(&hold_frames, 1);
	ASSERT_EQ_INT(INDIGO_OK, change_stream(.01, -1));
	ASSERT_TRUE(wait_for_property_state(CCD_STREAMING_PROPERTY_NAME, INDIGO_BUSY_STATE));
	ASSERT_EQ_INT(INDIGO_OK, indigo_change_switch_property_1(&simulator_test_client, device_name, CCD_ABORT_EXPOSURE_PROPERTY_NAME, CCD_ABORT_EXPOSURE_ITEM_NAME, true));
	atomic_store(&hold_frames, 0);
	ASSERT_TRUE(wait_for_property_not_busy(CCD_STREAMING_PROPERTY_NAME));
	ASSERT_EQ_INT(INDIGO_OK, indigo_change_switch_property_1(&simulator_test_client, device_name, CONNECTION_PROPERTY_NAME, CONNECTION_DISCONNECTED_ITEM_NAME, true));
	ASSERT_TRUE(wait_for_simulator_connection_state(false));
	ASSERT_EQ_INT(0, calls_after_close);
	end();
}

static void hotplug_multiple_duplicate_capacity_and_recovery(void) {
	ASSERT_TRUE(begin(false));
	for (int i = 1; i < CAMERAS; i++) {
		cameras[i].visible = true;
		usb_callback(NULL, (libusb_device *)(usb_tokens + i), LIBUSB_HOTPLUG_EVENT_DEVICE_ARRIVED, NULL);
	}
	ASSERT_TRUE(wait_atomic(&attached, 5));
	cameras[4].visible = false;
	usb_callback(NULL, (libusb_device *)(usb_tokens + 4), LIBUSB_HOTPLUG_EVENT_DEVICE_LEFT, NULL);
	ASSERT_TRUE(wait_atomic(&attached, 4));
	usb_callback(NULL, (libusb_device *)(usb_tokens + 11), LIBUSB_HOTPLUG_EVENT_DEVICE_ARRIVED, NULL);
	ASSERT_TRUE(wait_atomic(&attached, 5));
	end();
}

static void active_removal_and_replug(void) {
	ASSERT_TRUE(begin(true));
	indigo_change_switch_property_1(&simulator_test_client, device_name, CONNECTION_PROPERTY_NAME, CONNECTION_DISCONNECTED_ITEM_NAME, true);
	ASSERT_TRUE(wait_for_simulator_connection_state(false));
	cameras[0].visible = false;
	usb_callback(NULL, (libusb_device *)usb_tokens, LIBUSB_HOTPLUG_EVENT_DEVICE_LEFT, NULL);
	ASSERT_TRUE(wait_atomic(&attached, 0));
	cameras[0].visible = true;
	usb_callback(NULL, (libusb_device *)usb_tokens, LIBUSB_HOTPLUG_EVENT_DEVICE_ARRIVED, NULL);
	ASSERT_TRUE(wait_atomic(&attached, 1));
	context.connected = false;
	context.disconnected = true;
	end();
}

static void removal_during_exposure_and_recovery(void) {
	ASSERT_TRUE(begin(true));
	atomic_store(&hold_frames, 1);
	indigo_change_number_property_1(&simulator_test_client, device_name, CCD_EXPOSURE_PROPERTY_NAME, CCD_EXPOSURE_ITEM_NAME, .2);
	ASSERT_TRUE(wait_for_property_state(CCD_EXPOSURE_PROPERTY_NAME, INDIGO_BUSY_STATE));
	cameras[0].visible = false;
	usb_callback(NULL, (libusb_device *)usb_tokens, LIBUSB_HOTPLUG_EVENT_DEVICE_LEFT, NULL);
	ASSERT_TRUE(wait_atomic(&attached, 0));
	ASSERT_TRUE(wait_atomic(&cameras[0].stream_closes, 1));
	ASSERT_EQ_INT(0, calls_after_close);
	cameras[0].visible = true;
	atomic_store(&hold_frames, 0);
	usb_callback(NULL, (libusb_device *)usb_tokens, LIBUSB_HOTPLUG_EVENT_DEVICE_ARRIVED, NULL);
	ASSERT_TRUE(wait_atomic(&attached, 1));
	context.connected = false;
	context.disconnected = true;
	end();
}

static void initialization_and_registration_failures(void) {
	reset_fake();
	reset_simulator_context(&uvc_case);
	ASSERT_EQ_INT(INDIGO_OK, indigo_start());
	atomic_store(&fail_register, 1);
	ASSERT_EQ_INT(INDIGO_FAILED, indigo_ccd_uvc(INDIGO_DRIVER_INIT, NULL));
	ASSERT_EQ_INT(INDIGO_OK, indigo_ccd_uvc(INDIGO_DRIVER_SHUTDOWN, NULL));
	atomic_store(&fail_register, 0);
	ASSERT_EQ_INT(INDIGO_OK, indigo_ccd_uvc(INDIGO_DRIVER_INIT, NULL));
	ASSERT_TRUE(wait_atomic(&attached, 1));
	ASSERT_EQ_INT(INDIGO_OK, indigo_ccd_uvc(INDIGO_DRIVER_SHUTDOWN, NULL));
	indigo_stop();
}

static void initialization_queue_discovery_and_attach_recovery(void) {
	reset_fake();
	reset_simulator_context(&uvc_case);
	ASSERT_EQ_INT(INDIGO_OK, indigo_start());
	atomic_store(&fail_init, 1);
	ASSERT_EQ_INT(INDIGO_FAILED, indigo_ccd_uvc(INDIGO_DRIVER_INIT, NULL));
	atomic_store(&fail_init, 0);
	atomic_store(&fail_queue, 1);
	ASSERT_EQ_INT(INDIGO_FAILED, indigo_ccd_uvc(INDIGO_DRIVER_INIT, NULL));
	atomic_store(&fail_queue, 0);
	atomic_store(&fail_list, 1);
	ASSERT_EQ_INT(INDIGO_OK, indigo_ccd_uvc(INDIGO_DRIVER_INIT, NULL));
	indigo_usleep(100000);
	ASSERT_EQ_INT(0, attached);
	atomic_store(&fail_list, 0);
	usb_callback(NULL, (libusb_device *)usb_tokens, LIBUSB_HOTPLUG_EVENT_DEVICE_ARRIVED, NULL);
	ASSERT_TRUE(wait_atomic(&attached, 1));
	ASSERT_EQ_INT(INDIGO_OK, indigo_ccd_uvc(INDIGO_DRIVER_SHUTDOWN, NULL));
	indigo_stop();
	reset_fake();
	reset_simulator_context(&uvc_case);
	ASSERT_EQ_INT(INDIGO_OK, indigo_start());
	atomic_store(&fail_attach, 1);
	ASSERT_EQ_INT(INDIGO_OK, indigo_ccd_uvc(INDIGO_DRIVER_INIT, NULL));
	indigo_usleep(100000);
	ASSERT_EQ_INT(0, attached);
	atomic_store(&fail_attach, 0);
	usb_callback(NULL, (libusb_device *)usb_tokens, LIBUSB_HOTPLUG_EVENT_DEVICE_ARRIVED, NULL);
	ASSERT_TRUE(wait_atomic(&attached, 1));
	ASSERT_EQ_INT(INDIGO_OK, indigo_ccd_uvc(INDIGO_DRIVER_SHUTDOWN, NULL));
	indigo_stop();
}

static void resource_ownership_balances(void) {
	ASSERT_TRUE(begin(true));
	end();
	ASSERT_EQ_INT(0, usb_refs);
	ASSERT_EQ_INT(0, uvc_refs);
	ASSERT_EQ_INT(descriptor_allocations, descriptor_frees);
	ASSERT_EQ_INT(cameras[0].opens, cameras[0].closes);
	ASSERT_EQ_INT(cameras[0].stream_opens, cameras[0].stream_closes);
}

static void reference_trace_contract(void) {
	ASSERT_TRUE(begin(true));
	indigo_change_switch_property_1(&simulator_test_client, device_name, CCD_IMAGE_FORMAT_PROPERTY_NAME, CCD_IMAGE_FORMAT_RAW_ITEM_NAME, true);
	indigo_change_number_property_1(&simulator_test_client, device_name, CCD_EXPOSURE_PROPERTY_NAME, CCD_EXPOSURE_ITEM_NAME, .01);
	ASSERT_TRUE(wait_for_property_state(CCD_EXPOSURE_PROPERTY_NAME, INDIGO_OK_STATE));
	if (getenv("UVC_PRINT_TRACE")) {
		fprintf(stdout, "--- UVC REFERENCE TRACE ---\n%s\n--- END UVC REFERENCE TRACE ---\n", trace_buffer);
	}
	ASSERT_TRUE(strstr(trace_buffer, "uvc_open camera=0\nuvc_print_diag\nuvc_get_format_descs") != NULL);
	ASSERT_TRUE(strstr(trace_buffer, "uvc_set_ae_mode value=1\nuvc_set_exposure value=100\nuvc_set_gain value=10\nuvc_set_gamma value=100\nuvc_stream_open") != NULL);
	ASSERT_TRUE(strstr(trace_buffer, "property CCD_EXPOSURE state=2\nuvc_set_ae_mode value=1") != NULL);
	ASSERT_TRUE(strstr(trace_buffer, "uvc_stream_start flags=0\nuvc_stream_get_frame timeout=1000") != NULL);
	FILE *file = fopen(UVC_REFERENCE_TRACE_PATH, "r");
	ASSERT_TRUE(file != NULL);
	char expected[TRACE_SIZE];
	size_t length = fread(expected, 1, sizeof(expected) - 1, file);
	fclose(file);
	expected[length] = 0;
	while (length > 0 && (expected[length - 1] == '\n' || expected[length - 1] == '\r')) {
		expected[--length] = 0;
	}
	ASSERT_STREQ(expected, trace_buffer);
	end();
}

static void known_duplicate_arrival_reproducer(void) {
	ASSERT_TRUE(begin(false));
	usb_callback(NULL, (libusb_device *)usb_tokens, LIBUSB_HOTPLUG_EVENT_DEVICE_ARRIVED, NULL);
	indigo_usleep(200000);
	ASSERT_EQ_INT(1, attached);
	end();
}

static void known_descriptor_failure_reproducer(void) {
	reset_fake();
	reset_simulator_context(&uvc_case);
	atomic_store(&fail_descriptor, 1);
	ASSERT_EQ_INT(INDIGO_OK, indigo_start());
	ASSERT_EQ_INT(INDIGO_OK, indigo_attach_client(&simulator_test_client));
	ASSERT_EQ_INT(INDIGO_OK, indigo_ccd_uvc(INDIGO_DRIVER_INIT, NULL));
	indigo_usleep(200000);
	ASSERT_EQ_INT(0, attached);
	indigo_ccd_uvc(INDIGO_DRIVER_SHUTDOWN, NULL);
	indigo_detach_client(&simulator_test_client);
	indigo_stop();
}

static void known_control_failure_reproducer(void) {
	ASSERT_TRUE(begin(true));
	atomic_store(&fail_call, "exposure");
	indigo_change_number_property_1(&simulator_test_client, device_name, CCD_EXPOSURE_PROPERTY_NAME, CCD_EXPOSURE_ITEM_NAME, .01);
	ASSERT_TRUE(wait_for_property_state(CCD_EXPOSURE_PROPERTY_NAME, INDIGO_ALERT_STATE));
	ASSERT_EQ_INT(0, cameras[0].stream_starts);
	end();
}

static void known_conversion_leak_reproducer(void) {
	ASSERT_TRUE(begin(true));
	atomic_store(&conversion_error, 1);
	ASSERT_EQ_INT(INDIGO_OK, change_stream(.01, 1));
	ASSERT_TRUE(wait_for_property_state(CCD_STREAMING_PROPERTY_NAME, INDIGO_ALERT_STATE));
	ASSERT_EQ_INT(allocated_frames, freed_frames);
	end();
}

int main(int argc, char **argv) {
	setvbuf(stdout, NULL, _IONBF, 0);
	const indigo_test_case tests[] = {
		{ "Metadata and property contract", metadata_and_property_contract },
		{ "Lifecycle reconnect and rejected shutdown", lifecycle_reconnect_and_rejected_shutdown },
		{ "Mode controls and call order", mode_controls_and_call_order },
		{ "Mono8 mono16 raw8 and RGB images", mono8_mono16_raw8_and_rgb_images },
		{ "Finite and indefinite streaming", finite_and_indefinite_streaming },
		{ "Open mode and stream failures recover", open_mode_and_stream_failures_recover },
		{ "Frame failure and reacquire", frame_failure_and_reacquire },
		{ "Empty frame wakeup retries", empty_frame_wakeup_retries },
		{ "Short frame and watchdog recovery", short_frame_and_watchdog_recovery },
		{ "Rejected mode change during exposure", rejected_mode_change_during_exposure },
		{ "Acquisition control failures and values", acquisition_control_failures_and_values },
		{ "Optional control capability profiles", optional_control_capability_profiles },
		{ "Exposure overlap abort and reacquire", exposure_overlap_abort_and_reacquire },
		{ "Active stream abort and disconnect", active_stream_abort_and_disconnect },
		{ "Hotplug multiple duplicate capacity and recovery", hotplug_multiple_duplicate_capacity_and_recovery },
		{ "Active removal and replug", active_removal_and_replug },
		{ "Removal during exposure and recovery", removal_during_exposure_and_recovery },
		{ "Initialization and registration failures", initialization_and_registration_failures },
		{ "Initialization queue discovery and attach recovery", initialization_queue_discovery_and_attach_recovery },
		{ "Resource ownership balances", resource_ownership_balances },
		{ "Reference trace contract", reference_trace_contract }
	};
	const indigo_test_case known_defects[] = {
		{ "Descriptor failure is rejected", known_descriptor_failure_reproducer },
		{ "Control failure prevents acquisition", known_control_failure_reproducer },
		{ "Conversion failure releases frame", known_conversion_leak_reproducer },
		{ "Duplicate arrival is ignored", known_duplicate_arrival_reproducer }
	};
	if (argc >= 2 && !strcmp(argv[1], "--known-defects")) {
		int result = 0, matched = 0;
		for (int i = 0; i < ARRAY_SIZE(known_defects); i++) {
			if (argc < 3 || strstr(known_defects[i].name, argv[2])) {
				matched++;
				result |= indigo_run_tests("UVC known-defect reproducer", known_defects + i, 1);
			}
		}
		return matched ? result : 1;
	}
	int result = 0, matched = 0;
	for (int i = 0; i < ARRAY_SIZE(tests); i++) {
		if (argc < 2 || strstr(tests[i].name, argv[1])) {
			matched++;
			result |= indigo_run_tests("UVC fake SDK", tests + i, 1);
		}
	}
	return matched ? result : 1;
}
