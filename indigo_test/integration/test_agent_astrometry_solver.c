// Copyright (c) 2026 INDIGO initiative
// All rights reserved.
//
// You may use this software under the terms of 'INDIGO Astronomy
// open-source license' (see LICENSE.md).
//
// THIS SOFTWARE IS PROVIDED BY THE AUTHORS 'AS IS' AND ANY EXPRESS
// OR IMPLIED WARRANTIES, INCLUDING, BUT NOT LIMITED TO, THE IMPLIED
// WARRANTIES OF MERCHANTABILITY AND FITNESS FOR A PARTICULAR PURPOSE
// ARE DISCLAIMED. IN NO EVENT SHALL THE AUTHOR BE LIABLE FOR ANY
// DIRECT, INDIRECT, INCIDENTAL, SPECIAL, EXEMPLARY, OR CONSEQUENTIAL
// DAMAGES (INCLUDING, BUT NOT LIMITED TO, PROCUREMENT OF SUBSTITUTE
// GOODS OR SERVICES; LOSS OF USE, DATA, OR PROFITS; OR BUSINESS
// INTERRUPTION) HOWEVER CAUSED AND ON ANY THEORY OF LIABILITY,
// WHETHER IN CONTRACT, STRICT LIABILITY, OR TORT (INCLUDING
// NEGLIGENCE OR OTHERWISE) ARISING IN ANY WAY OUT OF THE USE OF THIS
// SOFTWARE, EVEN IF ADVISED OF THE POSSIBILITY OF SUCH DAMAGE.

// Code is generated by AI

// The production Astrometry agent with the real astrometry.net solver (solve-field, image2xy) and
// index 4112, which the agent downloads itself. The frames come from the related Imager Agent
// capturing with the CCD Guider Simulator, the only camera that renders catalogue stars (4° over
// 1200 px, about 12"/px), and the mount is the Mount Simulator behind a related Mount Agent. The
// camera follows the physical (raw) pointing of the mount, so a sync of the mount to wrong
// coordinates is a pointing error the solver has to find.
// Covered: solve only, solve and sync, solve, sync and center, precise GOTO, and the three point
// polar alignment with its recalculation against the polar error set on the simulator.
// Opt-in: it needs the solver installed and data.astrometry.net reachable.

#include <math.h>
#include <pthread.h>
#include <stdlib.h>
#include <arpa/inet.h>
#include <netinet/in.h>
#include <sys/socket.h>
#include <sys/wait.h>
#include <unistd.h>

#include <indigo/indigo_align.h>
#include <indigo/indigo_driver.h>
#include <indigo/indigo_mount_driver.h>
#include <indigo/indigo_platesolver.h>
#include <indigo_drivers/agent_astrometry/indigo_agent_astrometry.h>
#include <indigo_drivers/agent_guider/indigo_agent_guider.h>
#include <indigo_drivers/agent_imager/indigo_agent_imager.h>
#include <indigo_drivers/agent_mount/indigo_agent_mount.h>
#include <indigo_drivers/ccd_simulator/indigo_ccd_simulator.h>
#include <indigo_drivers/mount_simulator/indigo_mount_simulator.h>

#include "../test_runner.h"

#define ASTROMETRY "Astrometry Agent"
#define IMAGER "Imager Agent"
#define GUIDER "Guider Agent"
#define MOUNT "Mount Agent"
#define CAMERA "CCD Guider Simulator"
#define MOUNT_DEVICE "Mount Simulator"
#define INDEX_41 "AGENT_ASTROMETRY_INDEX_41XX"
#define INDEX "4112"
// the site of the mount simulator
#define SITE_LATITUDE 48.1485965
#define SITE_LONGITUDE 17.1077478
#define SUITE "Astrometry agent with the astrometry.net solver"
#define ARRAY_SIZE(a) (sizeof(a) / sizeof((a)[0]))
#define REQUIRE(c) do { if (!(c)) { fprintf(stderr, "%s:%d: %s\n", __FILE__, __LINE__, #c); indigo_test_failures++; return false; } } while (0)
#define WAIT_UNTIL(condition, timeout) ({ double deadline_ = indigo_monotonic_time() + (timeout); bool ready_ = (condition); while (!ready_ && indigo_monotonic_time() < deadline_) { indigo_usleep(10000); ready_ = (condition); } ready_; })

// 12"/px of the guider camera: 4° over 1200 px
#define EXPECTED_SCALE (4.0 / 1200.0)

typedef struct {
	char device[INDIGO_NAME_SIZE];
	char name[INDIGO_NAME_SIZE];
	indigo_property *property;
	unsigned revision;
	unsigned states[4];
} observation;

static observation cache[4096];
static pthread_mutex_t cache_mutex = PTHREAD_MUTEX_INITIALIZER;
static indigo_client observer;
static char messages[262144];
static bool bus_started, observer_attached, ccd_started, mount_started, imager_started, guider_started, mount_agent_started, astrometry_started;

static observation *find_observation(const char *device, const char *name) {
	observation *free_entry = NULL;
	for (unsigned i = 0; i < ARRAY_SIZE(cache); i++) {
		if (!*cache[i].name) {
			if (!free_entry) {
				free_entry = cache + i;
			}
		} else if (!strcmp(cache[i].device, device) && !strcmp(cache[i].name, name)) {
			return cache + i;
		}
	}
	if (free_entry) {
		INDIGO_COPY_NAME(free_entry->device, device);
		INDIGO_COPY_NAME(free_entry->name, name);
	}
	return free_entry;
}

static void add_message(const char *device, const char *message) {
	if (message && *message && strlen(messages) + strlen(device) + strlen(message) + 4 < sizeof(messages)) {
		strcat(messages, device);
		strcat(messages, ": ");
		strcat(messages, message);
		strcat(messages, "\n");
	}
}

static indigo_result observe(indigo_property *property, bool update, const char *message) {
	pthread_mutex_lock(&cache_mutex);
	add_message(property->device, message);
	observation *entry = find_observation(property->device, property->name);
	if (entry) {
		indigo_release_property(entry->property);
		entry->property = indigo_copy_property(NULL, property);
		entry->revision++;
		if (update && property->state <= INDIGO_ALERT_STATE) {
			entry->states[property->state]++;
		}
	}
	pthread_mutex_unlock(&cache_mutex);
	return INDIGO_OK;
}

static indigo_result defined(indigo_client *client, indigo_device *device, indigo_property *property, const char *message) {
	return observe(property, false, message);
}

static indigo_result updated(indigo_client *client, indigo_device *device, indigo_property *property, const char *message) {
	return observe(property, true, message);
}

static indigo_result deleted(indigo_client *client, indigo_device *device, indigo_property *property, const char *message) {
	pthread_mutex_lock(&cache_mutex);
	for (unsigned i = 0; i < ARRAY_SIZE(cache); i++) {
		observation *entry = cache + i;
		if (*entry->name && !strcmp(entry->device, property->device) && (!*property->name || !strcmp(entry->name, property->name))) {
			indigo_release_property(entry->property);
			memset(entry, 0, sizeof(*entry));
		}
	}
	pthread_mutex_unlock(&cache_mutex);
	return INDIGO_OK;
}

static indigo_result message_received(indigo_client *client, indigo_device *device, indigo_property *property, const char *message) {
	pthread_mutex_lock(&cache_mutex);
	add_message(device->name, message);
	pthread_mutex_unlock(&cache_mutex);
	return INDIGO_OK;
}

static void dump_messages(void) {
	pthread_mutex_lock(&cache_mutex);
	fprintf(stderr, "---- messages ----\n%s------------------\n", messages);
	pthread_mutex_unlock(&cache_mutex);
}

static bool exists(const char *device, const char *name) {
	pthread_mutex_lock(&cache_mutex);
	observation *entry = find_observation(device, name);
	bool result = entry && entry->property;
	pthread_mutex_unlock(&cache_mutex);
	return result;
}

static unsigned revision(const char *device, const char *name) {
	pthread_mutex_lock(&cache_mutex);
	observation *entry = find_observation(device, name);
	unsigned result = entry ? entry->revision : 0;
	pthread_mutex_unlock(&cache_mutex);
	return result;
}

static unsigned state_count(const char *device, const char *name, indigo_property_state state) {
	pthread_mutex_lock(&cache_mutex);
	observation *entry = find_observation(device, name);
	unsigned result = entry ? entry->states[state] : 0;
	pthread_mutex_unlock(&cache_mutex);
	return result;
}

static int state(const char *device, const char *name) {
	pthread_mutex_lock(&cache_mutex);
	observation *entry = find_observation(device, name);
	int result = entry && entry->property ? (int)entry->property->state : -1;
	pthread_mutex_unlock(&cache_mutex);
	return result;
}

static bool item_lookup(const char *device, const char *name, const char *item_name, indigo_item *result) {
	bool found = false;
	pthread_mutex_lock(&cache_mutex);
	observation *entry = find_observation(device, name);
	if (entry && entry->property) {
		for (int i = 0; i < entry->property->count; i++) {
			if (!strcmp(entry->property->items[i].name, item_name)) {
				*result = entry->property->items[i];
				found = true;
				break;
			}
		}
	}
	pthread_mutex_unlock(&cache_mutex);
	return found;
}

static double number(const char *device, const char *name, const char *item_name) {
	indigo_item item;
	return item_lookup(device, name, item_name, &item) ? item.number.value : NAN;
}

static bool switch_value(const char *device, const char *name, const char *item_name) {
	indigo_item item;
	return item_lookup(device, name, item_name, &item) && item.sw.value;
}

static bool has_item(const char *device, const char *name, const char *item_name) {
	indigo_item item;
	return item_lookup(device, name, item_name, &item);
}

static bool change_switch_and_wait(const char *device, const char *name, const char *item_name, bool value, indigo_property_state expected, double timeout) {
	REQUIRE(WAIT_UNTIL(has_item(device, name, item_name), 10));
	unsigned before = revision(device, name);
	REQUIRE(indigo_change_switch_property_1(&observer, device, name, item_name, value) == INDIGO_OK);
	if (!WAIT_UNTIL(revision(device, name) > before && state(device, name) == (int)expected && switch_value(device, name, item_name) == value, timeout)) {
		fprintf(stderr, "%s.%s.%s = %d did not settle in state %d (state %d)\n", device, name, item_name, value, expected, state(device, name));
		dump_messages();
		return false;
	}
	return true;
}

static bool change_numbers(const char *device, const char *name, int count, const char **items, const double *values) {
	REQUIRE(WAIT_UNTIL(exists(device, name), 10));
	unsigned before = revision(device, name);
	REQUIRE(indigo_change_number_property(&observer, device, name, count, items, values) == INDIGO_OK);
	if (!WAIT_UNTIL(revision(device, name) > before && state(device, name) != INDIGO_BUSY_STATE, 10)) {
		fprintf(stderr, "%s.%s did not settle after a number change (state %d)\n", device, name, state(device, name));
		return false;
	}
	return true;
}

static bool change_number(const char *device, const char *name, const char *item_name, double value) {
	return change_numbers(device, name, 1, (const char *[]){ item_name }, (double []){ value });
}

static bool relate(const char *agent, const char *related) {
	REQUIRE(WAIT_UNTIL(has_item(agent, FILTER_RELATED_AGENT_LIST_PROPERTY_NAME, related), 10));
	REQUIRE(indigo_change_switch_property_1(&observer, agent, FILTER_RELATED_AGENT_LIST_PROPERTY_NAME, related, true) == INDIGO_OK);
	REQUIRE(WAIT_UNTIL(switch_value(agent, FILTER_RELATED_AGENT_LIST_PROPERTY_NAME, related), 10));
	return true;
}

static double mount_ra(void) {
	return number(MOUNT_DEVICE, MOUNT_EQUATORIAL_COORDINATES_PROPERTY_NAME, MOUNT_EQUATORIAL_COORDINATES_RA_ITEM_NAME);
}

static double mount_dec(void) {
	return number(MOUNT_DEVICE, MOUNT_EQUATORIAL_COORDINATES_PROPERTY_NAME, MOUNT_EQUATORIAL_COORDINATES_DEC_ITEM_NAME);
}

static double wcs(const char *item_name) {
	return number(ASTROMETRY, AGENT_PLATESOLVER_WCS_PROPERTY_NAME, item_name);
}

static double pa_state(const char *item_name) {
	return number(ASTROMETRY, AGENT_PLATESOLVER_PA_STATE_PROPERTY_NAME, item_name);
}

// Angular distance in degrees, ra in hours
static double distance(double ra1, double dec1, double ra2, double dec2) {
	double d2r = M_PI / 180;
	double c = sin(dec1 * d2r) * sin(dec2 * d2r) + cos(dec1 * d2r) * cos(dec2 * d2r) * cos((ra1 - ra2) * 15 * d2r);
	return acos(fmax(-1, fmin(1, c))) / d2r;
}

// J2000 coordinates of the physical pointing the camera simulator renders
static void rendered_center_j2000(double *ra, double *dec) {
	*ra = number(CAMERA, "SIMULATION_SETUP", "RA");
	*dec = number(CAMERA, "SIMULATION_SETUP", "DEC");
	if (number(CAMERA, "SIMULATION_SETUP", "EPOCH") == 0) {
		indigo_jnow_to_j2k(ra, dec);
	}
}

// J2000 coordinates the mount physically points at, shared by the mount simulator; the camera
// simulator takes them over only when it exposes the next frame
static void physical_j2000(double *ra, double *dec) {
	indigo_simulated_mount_state state = { 0 };
	indigo_get_simulated_mount_state(&state);
	*ra = state.ra;
	*dec = state.dec;
	if (state.epoch == 0) {
		indigo_jnow_to_j2k(ra, dec);
	}
}

// J2000 coordinates the mount reports
static void mount_j2000(double *ra, double *dec) {
	*ra = mount_ra();
	*dec = mount_dec();
	if (number(MOUNT_DEVICE, MOUNT_EPOCH_PROPERTY_NAME, MOUNT_EPOCH_ITEM_NAME) == 0) {
		indigo_jnow_to_j2k(ra, dec);
	}
}

// Runs one Astrometry agent process and waits for its end in the expected state
static bool run_process(const char *operation, indigo_property_state expected, double timeout) {
	unsigned busy = state_count(ASTROMETRY, AGENT_START_PROCESS_PROPERTY_NAME, INDIGO_BUSY_STATE);
	REQUIRE(indigo_change_switch_property_1(&observer, ASTROMETRY, AGENT_START_PROCESS_PROPERTY_NAME, operation, true) == INDIGO_OK);
	REQUIRE(WAIT_UNTIL(state_count(ASTROMETRY, AGENT_START_PROCESS_PROPERTY_NAME, INDIGO_BUSY_STATE) > busy, 10));
	double start = indigo_monotonic_time();
	if (!WAIT_UNTIL(state(ASTROMETRY, AGENT_START_PROCESS_PROPERTY_NAME) != INDIGO_BUSY_STATE, timeout)) {
		fprintf(stderr, "%s did not finish in %g s\n", operation, timeout);
		dump_messages();
		return false;
	}
	printf("  %s finished in %.1f s\n", operation, indigo_monotonic_time() - start);
	if (state(ASTROMETRY, AGENT_START_PROCESS_PROPERTY_NAME) != (int)expected) {
		fprintf(stderr, "%s finished in state %d, expected %d\n", operation, state(ASTROMETRY, AGENT_START_PROCESS_PROPERTY_NAME), expected);
		dump_messages();
		return false;
	}
	return true;
}

// Moves the mount through the Mount Agent and waits until the slew finishes
static bool slew(double ra, double dec) {
	REQUIRE(change_numbers(MOUNT, AGENT_MOUNT_TARGET_COORDINATES_PROPERTY_NAME, 2, (const char *[]){ AGENT_MOUNT_TARGET_COORDINATES_RA_ITEM_NAME, AGENT_MOUNT_TARGET_COORDINATES_DEC_ITEM_NAME }, (double []){ ra, dec }));
	unsigned busy = state_count(MOUNT, AGENT_START_PROCESS_PROPERTY_NAME, INDIGO_BUSY_STATE);
	REQUIRE(indigo_change_switch_property_1(&observer, MOUNT, AGENT_START_PROCESS_PROPERTY_NAME, AGENT_MOUNT_START_SLEW_ITEM_NAME, true) == INDIGO_OK);
	REQUIRE(WAIT_UNTIL(state_count(MOUNT, AGENT_START_PROCESS_PROPERTY_NAME, INDIGO_BUSY_STATE) > busy, 10));
	if (!WAIT_UNTIL(state(MOUNT, AGENT_START_PROCESS_PROPERTY_NAME) != INDIGO_BUSY_STATE, 180)) {
		fprintf(stderr, "slew to %g %g did not finish\n", ra, dec);
		dump_messages();
		return false;
	}
	REQUIRE(state(MOUNT, AGENT_START_PROCESS_PROPERTY_NAME) == INDIGO_OK_STATE);
	return true;
}

// Syncs the mount simulator directly, so the coordinates it reports differ from its physical pointing
static bool mount_sync_directly(double ra, double dec) {
	REQUIRE(change_switch_and_wait(MOUNT_DEVICE, MOUNT_ON_COORDINATES_SET_PROPERTY_NAME, MOUNT_ON_COORDINATES_SET_SYNC_ITEM_NAME, true, INDIGO_OK_STATE, 10));
	REQUIRE(change_numbers(MOUNT_DEVICE, MOUNT_EQUATORIAL_COORDINATES_PROPERTY_NAME, 2, (const char *[]){ MOUNT_EQUATORIAL_COORDINATES_RA_ITEM_NAME, MOUNT_EQUATORIAL_COORDINATES_DEC_ITEM_NAME }, (double []){ ra, dec }));
	REQUIRE(change_switch_and_wait(MOUNT_DEVICE, MOUNT_ON_COORDINATES_SET_PROPERTY_NAME, MOUNT_ON_COORDINATES_SET_TRACK_ITEM_NAME, true, INDIGO_OK_STATE, 10));
	REQUIRE(fabs(mount_ra() - ra) < 0.001 && fabs(mount_dec() - dec) < 0.01);
	return true;
}

// Solved field angle minus the rotation the camera simulator rendered. The simulator turns the field
// by 180° on the west side of the pier; solve-field reports IMAGE_ROTATION_ANGLE there and 180° more
// on the east side.
static double angle_error(void) {
	double rotation = number(CAMERA, "SIMULATION_SETUP", "IMAGE_ROTATION_ANGLE") + (number(CAMERA, "SIMULATION_SETUP", "SIDE_OF_PIER") == 1 ? 0 : 180);
	return remainder(wcs(AGENT_PLATESOLVER_WCS_ANGLE_ITEM_NAME) - rotation, 360);
}

// The mount reports coordinates shifted by the given offset from where it points, as after a wrong sync
static bool add_pointing_error(double ra_offset, double dec_offset) {
	return mount_sync_directly(fmod(mount_ra() + ra_offset + 24, 24), mount_dec() + dec_offset);
}

static void print_wcs(const char *label) {
	double ra, dec;
	rendered_center_j2000(&ra, &dec);
	printf("  %s: WCS RA %.4f h Dec %.4f° angle %.2f° scale %.2f\"/px parity %g index %g, rendered %.4f h %.4f° rotation %g°, mount %.4f h %.4f°\n", label, wcs(AGENT_PLATESOLVER_WCS_RA_ITEM_NAME), wcs(AGENT_PLATESOLVER_WCS_DEC_ITEM_NAME), wcs(AGENT_PLATESOLVER_WCS_ANGLE_ITEM_NAME), wcs(AGENT_PLATESOLVER_WCS_SCALE_ITEM_NAME) * 3600, wcs(AGENT_PLATESOLVER_WCS_PARITY_ITEM_NAME), wcs(AGENT_PLATESOLVER_WCS_INDEX_ITEM_NAME), ra, dec, number(CAMERA, "SIMULATION_SETUP", "IMAGE_ROTATION_ANGLE"), mount_ra(), mount_dec());
}

// The solution matches what the camera simulator rendered: its J2000 centre and its scale
static bool solution_matches_rendered_field(void) {
	double ra, dec;
	rendered_center_j2000(&ra, &dec);
	print_wcs("solution");
	REQUIRE(state(ASTROMETRY, AGENT_PLATESOLVER_WCS_PROPERTY_NAME) == INDIGO_OK_STATE);
	REQUIRE(wcs(AGENT_PLATESOLVER_WCS_EPOCH_ITEM_NAME) == 2000);
	REQUIRE(distance(wcs(AGENT_PLATESOLVER_WCS_RA_ITEM_NAME), wcs(AGENT_PLATESOLVER_WCS_DEC_ITEM_NAME), ra, dec) < 0.02);
	REQUIRE(fabs(wcs(AGENT_PLATESOLVER_WCS_SCALE_ITEM_NAME) / EXPECTED_SCALE - 1) < 0.02);
	REQUIRE(wcs(AGENT_PLATESOLVER_WCS_INDEX_ITEM_NAME) == atoi(INDEX));
	REQUIRE(fabs(angle_error()) < 0.1);
	return true;
}

// Downloads a Tycho-2 index through the agent into the cache shared by the run, or finds it there, and
// selects it: an index found on disk is offered unselected to a fresh configuration, only a downloaded one
// is selected
static bool install_index(const char *name) {
	REQUIRE(change_switch_and_wait(ASTROMETRY, INDEX_41, name, true, INDIGO_OK_STATE, 300));
	REQUIRE(WAIT_UNTIL(has_item(ASTROMETRY, AGENT_PLATESOLVER_USE_INDEX_PROPERTY_NAME, name), 10));
	if (!switch_value(ASTROMETRY, AGENT_PLATESOLVER_USE_INDEX_PROPERTY_NAME, name)) {
		REQUIRE(change_switch_and_wait(ASTROMETRY, AGENT_PLATESOLVER_USE_INDEX_PROPERTY_NAME, name, true, INDIGO_OK_STATE, 10));
	}
	return true;
}

static bool setup(void) {
	indigo_set_log_level(getenv("INDIGO_TEST_DEBUG") ? INDIGO_LOG_DEBUG : INDIGO_LOG_ERROR);
	REQUIRE(indigo_start() == INDIGO_OK);
	bus_started = true;
	INDIGO_COPY_NAME(observer.name, "Astrometry solver observer");
	observer.version = INDIGO_VERSION_CURRENT;
	observer.define_property = defined;
	observer.update_property = updated;
	observer.delete_property = deleted;
	observer.send_message = message_received;
	REQUIRE(indigo_attach_client(&observer) == INDIGO_OK);
	observer_attached = true;
	REQUIRE(indigo_ccd_simulator(INDIGO_DRIVER_INIT, NULL) == INDIGO_OK);
	ccd_started = true;
	REQUIRE(indigo_mount_simulator(INDIGO_DRIVER_INIT, NULL) == INDIGO_OK);
	mount_started = true;
	REQUIRE(indigo_agent_imager(INDIGO_DRIVER_INIT, NULL) == INDIGO_OK);
	imager_started = true;
	REQUIRE(indigo_agent_guider(INDIGO_DRIVER_INIT, NULL) == INDIGO_OK);
	guider_started = true;
	REQUIRE(indigo_agent_mount(INDIGO_DRIVER_INIT, NULL) == INDIGO_OK);
	mount_agent_started = true;
	REQUIRE(indigo_agent_astrometry(INDIGO_DRIVER_INIT, NULL) == INDIGO_OK);
	astrometry_started = true;
	REQUIRE(change_switch_and_wait(IMAGER, FILTER_CCD_LIST_PROPERTY_NAME, CAMERA, true, INDIGO_OK_STATE, 20));
	// the whole catalogue, it ends at magnitude 9.3
	REQUIRE(change_number(CAMERA, "SIMULATION_SETUP", "MAGNITUDE_LIMIT", 9.5));
	REQUIRE(change_switch_and_wait(MOUNT, FILTER_MOUNT_LIST_PROPERTY_NAME, MOUNT_DEVICE, true, INDIGO_OK_STATE, 20));
	REQUIRE(relate(ASTROMETRY, IMAGER));
	REQUIRE(relate(ASTROMETRY, MOUNT));
	// the site is set on the Mount Agent, as a user does; the agent passes it to the mount and the camera follows the mount
	REQUIRE(change_numbers(MOUNT, GEOGRAPHIC_COORDINATES_PROPERTY_NAME, 2, (const char *[]){ GEOGRAPHIC_COORDINATES_LATITUDE_ITEM_NAME, GEOGRAPHIC_COORDINATES_LONGITUDE_ITEM_NAME }, (double []){ SITE_LATITUDE, SITE_LONGITUDE }));
	REQUIRE(change_switch_and_wait(MOUNT_DEVICE, MOUNT_PARK_PROPERTY_NAME, MOUNT_PARK_UNPARKED_ITEM_NAME, true, INDIGO_OK_STATE, 60));
	REQUIRE(install_index(INDEX));
	REQUIRE(change_number(ASTROMETRY, AGENT_PLATESOLVER_EXPOSURE_SETTINGS_PROPERTY_NAME, AGENT_PLATESOLVER_EXPOSURE_SETTINGS_EXPOSURE_ITEM_NAME, 1));
	REQUIRE(change_number(ASTROMETRY, AGENT_PLATESOLVER_MOUNT_SETTLE_TIME_PROPERTY_NAME, AGENT_PLATESOLVER_MOUNT_SETTLE_TIME_ITEM_NAME, 0));
	return true;
}

static void detach_remote_imager(void);

static void cleanup(void) {
	detach_remote_imager();
	if (astrometry_started) {
		indigo_agent_astrometry(INDIGO_DRIVER_SHUTDOWN, NULL);
	}
	if (mount_agent_started) {
		indigo_agent_mount(INDIGO_DRIVER_SHUTDOWN, NULL);
	}
	if (guider_started) {
		indigo_agent_guider(INDIGO_DRIVER_SHUTDOWN, NULL);
	}
	if (imager_started) {
		indigo_agent_imager(INDIGO_DRIVER_SHUTDOWN, NULL);
	}
	if (mount_started) {
		indigo_mount_simulator(INDIGO_DRIVER_SHUTDOWN, NULL);
	}
	if (ccd_started) {
		indigo_ccd_simulator(INDIGO_DRIVER_SHUTDOWN, NULL);
	}
	if (observer_attached) {
		indigo_detach_client(&observer);
	}
	if (bus_started) {
		indigo_stop();
	}
}

// A blind solve of a frame captured by the related Imager Agent finds the field the simulator rendered
static void solve_only(void) {
	ASSERT_TRUE(slew(18.6, 38.8));
	ASSERT_TRUE(run_process(AGENT_PLATESOLVER_START_SOLVE_ITEM_NAME, INDIGO_OK_STATE, 180));
	ASSERT_TRUE(solution_matches_rendered_field());
}

// The mount reports coordinates 1.5° off its pointing; solve and sync makes it report where it points
static void solve_and_sync(void) {
	ASSERT_TRUE(slew(18.6, 38.8));
	ASSERT_TRUE(add_pointing_error(0.05, -1));
	ASSERT_TRUE(run_process(AGENT_PLATESOLVER_START_SYNC_ITEM_NAME, INDIGO_OK_STATE, 180));
	ASSERT_TRUE(solution_matches_rendered_field());
	double ra, dec, synced_ra, synced_dec;
	rendered_center_j2000(&ra, &dec);
	mount_j2000(&synced_ra, &synced_dec);
	printf("  the mount reports %.4f h %.4f°, %.4f° from its pointing\n", synced_ra, synced_dec, distance(synced_ra, synced_dec, ra, dec));
	ASSERT_TRUE(distance(synced_ra, synced_dec, ra, dec) < 0.02);
}

// With the mount reporting coordinates off its pointing, center syncs it and slews to the coordinates
// it reported before, so that the field is centred on them
static void solve_sync_and_center(void) {
	ASSERT_TRUE(slew(18.6, 38.8));
	ASSERT_TRUE(add_pointing_error(-0.05, 1));
	double target_ra, target_dec, ra, dec;
	mount_j2000(&target_ra, &target_dec);
	physical_j2000(&ra, &dec);
	printf("  the mount reports %.4f h %.4f° pointing %.3f° away from it\n", target_ra, target_dec, distance(ra, dec, target_ra, target_dec));
	ASSERT_TRUE(run_process(AGENT_PLATESOLVER_START_CENTER_ITEM_NAME, INDIGO_OK_STATE, 300));
	physical_j2000(&ra, &dec);
	print_wcs("centered");
	printf("  the mount points %.4f° from the target\n", distance(ra, dec, target_ra, target_dec));
	ASSERT_TRUE(distance(ra, dec, target_ra, target_dec) < 0.02);
}

// The sparsest field of the sky. Its quads decide the index: with the field turned as IMAGE_ROTATION_ANGLE
// turns it (solve-field sees -36° or 144°) too few of the 2.8-4° quads of index 4113 fit in the 4° x 5.3° frame
// and it does not solve, the 2-2.8° quads of 4112 solve it at any angle.
static void south_galactic_pole(void) {
	ASSERT_TRUE(slew(0.85, -27.1));
	ASSERT_TRUE(run_process(AGENT_PLATESOLVER_START_SOLVE_ITEM_NAME, INDIGO_OK_STATE, 180));
	ASSERT_TRUE(solution_matches_rendered_field());
}

// Precise GOTO slews to the target, solves, syncs and slews again, so that the field is centred on
// the target although the mount reports coordinates off its pointing
static bool precise_goto_to(double target_ra, double target_dec, double ra_offset, double dec_offset) {
	REQUIRE(add_pointing_error(ra_offset, dec_offset));
	REQUIRE(change_numbers(ASTROMETRY, AGENT_PLATESOLVER_GOTO_SETTINGS_PROPERTY_NAME, 2, (const char *[]){ AGENT_PLATESOLVER_GOTO_SETTINGS_RA_ITEM_NAME, AGENT_PLATESOLVER_GOTO_SETTINGS_DEC_ITEM_NAME }, (double []){ target_ra, target_dec }));
	REQUIRE(run_process(AGENT_PLATESOLVER_START_PRECISE_GOTO_ITEM_NAME, INDIGO_OK_STATE, 300));
	double ra, dec;
	physical_j2000(&ra, &dec);
	print_wcs("goto");
	printf("  target %.4f h %+.4f°, the mount points %.4f° from it, angle error %+.2f°\n", target_ra, target_dec, distance(ra, dec, target_ra, target_dec), angle_error());
	REQUIRE(distance(ra, dec, target_ra, target_dec) < 0.02);
	// the last frame was taken before the final slew, the solution belongs to it
	REQUIRE(fabs(wcs(AGENT_PLATESOLVER_WCS_SCALE_ITEM_NAME) / EXPECTED_SCALE - 1) < 0.02);
	REQUIRE(fabs(angle_error()) < 0.1);
	return true;
}

static void precise_goto(void) {
	ASSERT_TRUE(slew(18.6, 38.8));
	ASSERT_TRUE(precise_goto_to(18.0, 30.0, 0.05, 0.5));
}

// Three point polar alignment, then the corrections a user makes: each step removes 70 % of the
// measured error on the simulator and recalculates, until the measured error is below 1'.
static void polar_alignment(void) {
	double alt_error = 0.8, az_error = -1.1;
	ASSERT_TRUE(change_numbers(CAMERA, "SIMULATION_SETUP", 2, (const char *[]){ "ALT_POLAR_ERROR", "AZ_POLAR_ERROR" }, (double []){ alt_error, az_error }));
	// The references follow the sidereal time; a longitude putting it at 9.35 h keeps them at RA 9.1, 7.8 and 6.4 h
	// (Hydra, Monoceros) at any time of the day, so that the case does not depend on the time it runs
	double pinned_lst = getenv("PA_LST") ? atof(getenv("PA_LST")) : 9.35;
	double longitude = remainder(SITE_LONGITUDE + (pinned_lst - indigo_lst(NULL, SITE_LONGITUDE)) * 15, 360);
	ASSERT_TRUE(change_numbers(MOUNT, GEOGRAPHIC_COORDINATES_PROPERTY_NAME, 2, (const char *[]){ GEOGRAPHIC_COORDINATES_LATITUDE_ITEM_NAME, GEOGRAPHIC_COORDINATES_LONGITUDE_ITEM_NAME }, (double []){ SITE_LATITUDE, longitude }));
	ASSERT_TRUE(WAIT_UNTIL(fabs(remainder(number(MOUNT, MOUNT_GEOGRAPHIC_COORDINATES_PROPERTY_NAME, MOUNT_GEOGRAPHIC_COORDINATES_LONGITUDE_ITEM_NAME) - longitude, 360)) < 1e-6, 10));
	// POLAR_ALIGNMENT.md: start just past the meridian at 35-50° altitude, the positive hour angle move goes west
	ASSERT_TRUE(slew(fmod(indigo_lst(NULL, longitude) - 0.25 + 24, 24), 5));
	ASSERT_TRUE(run_process(AGENT_PLATESOLVER_START_CALCULATE_PA_ERROR_ITEM_NAME, INDIGO_OK_STATE, 600));
	ASSERT_EQ_INT(INDIGO_POLAR_ALIGN_IN_PROGRESS, (int)pa_state(AGENT_PLATESOLVER_PA_STATE_ITEM_NAME));
	bool aligned = false;
	for (int step = 0; step <= 10; step++) {
		double measured_alt = pa_state(AGENT_PLATESOLVER_PA_STATE_ALT_ERROR_ITEM_NAME);
		double measured_az = pa_state(AGENT_PLATESOLVER_PA_STATE_AZ_ERROR_ITEM_NAME);
		double measured = pa_state(AGENT_PLATESOLVER_PA_STATE_POLAR_ERROR_ITEM_NAME);
		printf("  step %d: polar error %6.2f' (alt %+7.2f' az %+7.2f'), simulator %6.2f' (alt %+7.2f' az %+7.2f')\n", step, measured * 60, measured_alt * 60, measured_az * 60, hypot(alt_error, az_error) * 60, alt_error * 60, az_error * 60);
		// within half an arcminute of the error set on the simulator in every step
		ASSERT_TRUE(fabs(measured_alt - alt_error) < 0.5 / 60 && fabs(measured_az - az_error) < 0.5 / 60);
		if (measured < 1.0 / 60) {
			aligned = true;
			break;
		}
		alt_error -= 0.7 * measured_alt;
		az_error -= 0.7 * measured_az;
		ASSERT_TRUE(change_numbers(CAMERA, "SIMULATION_SETUP", 2, (const char *[]){ "ALT_POLAR_ERROR", "AZ_POLAR_ERROR" }, (double []){ alt_error, az_error }));
		ASSERT_TRUE(run_process(AGENT_PLATESOLVER_START_RECALCULATE_PA_ERROR_ITEM_NAME, INDIGO_OK_STATE, 300));
		ASSERT_EQ_INT(INDIGO_POLAR_ALIGN_IN_PROGRESS, (int)pa_state(AGENT_PLATESOLVER_PA_STATE_ITEM_NAME));
	}
	ASSERT_TRUE(aligned);
	ASSERT_TRUE(hypot(alt_error, az_error) < 1.0 / 60);
}

// True while a solver started by the agent is still running
static bool solver_running(void) {
	return system("pgrep -f 'image2xy -[O]|astrometry[.]cfg' >/dev/null") == 0;
}

// Anything a process of the agent started that is still moving: the agent itself, a capture,
// an exposure, a slew or a solver
static bool anything_busy(void) {
	return state(ASTROMETRY, AGENT_START_PROCESS_PROPERTY_NAME) == INDIGO_BUSY_STATE ||
		state(ASTROMETRY, AGENT_PLATESOLVER_WCS_PROPERTY_NAME) == INDIGO_BUSY_STATE ||
		state(IMAGER, AGENT_IMAGER_CAPTURE_PROPERTY_NAME) == INDIGO_BUSY_STATE ||
		state(GUIDER, AGENT_START_PROCESS_PROPERTY_NAME) == INDIGO_BUSY_STATE ||
		state(CAMERA, CCD_EXPOSURE_PROPERTY_NAME) == INDIGO_BUSY_STATE ||
		state(MOUNT, AGENT_START_PROCESS_PROPERTY_NAME) == INDIGO_BUSY_STATE ||
		state(MOUNT_DEVICE, MOUNT_EQUATORIAL_COORDINATES_PROPERTY_NAME) == INDIGO_BUSY_STATE ||
		solver_running();
}

static void print_busy(void) {
	fprintf(stderr, "  agent %d, WCS %d (solver state %g), capture %d, guider %d, exposure %d, mount agent %d, mount %d, solver %s\n",
		state(ASTROMETRY, AGENT_START_PROCESS_PROPERTY_NAME), state(ASTROMETRY, AGENT_PLATESOLVER_WCS_PROPERTY_NAME), wcs(AGENT_PLATESOLVER_WCS_STATE_ITEM_NAME),
		state(IMAGER, AGENT_IMAGER_CAPTURE_PROPERTY_NAME), state(GUIDER, AGENT_START_PROCESS_PROPERTY_NAME), state(CAMERA, CCD_EXPOSURE_PROPERTY_NAME),
		state(MOUNT, AGENT_START_PROCESS_PROPERTY_NAME), state(MOUNT_DEVICE, MOUNT_EQUATORIAL_COORDINATES_PROPERTY_NAME), solver_running() ? "running" : "not running");
}

// Starts a process and waits until the solver reaches the given state
static bool start_and_wait_for(const char *operation, int solver_state, double timeout) {
	REQUIRE(indigo_change_switch_property_1(&observer, ASTROMETRY, AGENT_START_PROCESS_PROPERTY_NAME, operation, true) == INDIGO_OK);
	if (!WAIT_UNTIL(state(ASTROMETRY, AGENT_PLATESOLVER_WCS_PROPERTY_NAME) == INDIGO_BUSY_STATE && (int)wcs(AGENT_PLATESOLVER_WCS_STATE_ITEM_NAME) == solver_state, timeout)) {
		fprintf(stderr, "%s did not reach solver state %d\n", operation, solver_state);
		print_busy();
		dump_messages();
		return false;
	}
	return true;
}

// Aborts the running process: the agent ends it in ALERT within a few seconds, everything it started
// stops and nothing starts again afterwards
static bool abort_and_check(void) {
	double start = indigo_monotonic_time();
	REQUIRE(indigo_change_switch_property_1(&observer, ASTROMETRY, AGENT_ABORT_PROCESS_PROPERTY_NAME, AGENT_ABORT_PROCESS_ITEM_NAME, true) == INDIGO_OK);
	bool stopped = WAIT_UNTIL(!anything_busy(), 10);
	printf("  abort took %.1f s\n", indigo_monotonic_time() - start);
	if (!stopped) {
		fprintf(stderr, "still busy 10 s after the abort\n");
		print_busy();
		dump_messages();
		return false;
	}
	REQUIRE(state(ASTROMETRY, AGENT_START_PROCESS_PROPERTY_NAME) == INDIGO_ALERT_STATE);
	if (WAIT_UNTIL(anything_busy(), 10)) {
		fprintf(stderr, "the process continued after the abort\n");
		print_busy();
		dump_messages();
		return false;
	}
	return true;
}

// The agent works again after an abort
static bool solves_after_abort(void) {
	REQUIRE(run_process(AGENT_PLATESOLVER_START_SOLVE_ITEM_NAME, INDIGO_OK_STATE, 180));
	REQUIRE(solution_matches_rendered_field());
	return true;
}

// Abort while solve-field runs
static void abort_while_solving(void) {
	ASSERT_TRUE(slew(18.6, 38.8));
	ASSERT_TRUE(start_and_wait_for(AGENT_PLATESOLVER_START_SOLVE_ITEM_NAME, INDIGO_SOLVER_STATE_SOLVING, 60));
	ASSERT_TRUE(WAIT_UNTIL(system("pgrep -f 'astrometry[.]cfg' >/dev/null") == 0, 20));
	ASSERT_TRUE(abort_and_check());
	ASSERT_TRUE(solves_after_abort());
}

// Abort while the related Imager Agent exposes the frame
static void abort_while_exposing(void) {
	ASSERT_TRUE(slew(18.6, 38.8));
	ASSERT_TRUE(change_number(ASTROMETRY, AGENT_PLATESOLVER_EXPOSURE_SETTINGS_PROPERTY_NAME, AGENT_PLATESOLVER_EXPOSURE_SETTINGS_EXPOSURE_ITEM_NAME, 30));
	ASSERT_TRUE(start_and_wait_for(AGENT_PLATESOLVER_START_SOLVE_ITEM_NAME, INDIGO_SOLVER_STATE_WAITING_FOR_IMAGE, 20));
	ASSERT_TRUE(WAIT_UNTIL(state(CAMERA, CCD_EXPOSURE_PROPERTY_NAME) == INDIGO_BUSY_STATE, 10));
	indigo_usleep(2000000);
	ASSERT_TRUE(abort_and_check());
	ASSERT_TRUE(change_number(ASTROMETRY, AGENT_PLATESOLVER_EXPOSURE_SETTINGS_PROPERTY_NAME, AGENT_PLATESOLVER_EXPOSURE_SETTINGS_EXPOSURE_ITEM_NAME, 1));
	ASSERT_TRUE(solves_after_abort());
}

// Abort while the related Guider Agent exposes the frame, the image source when no Imager Agent is related
static void abort_while_guider_exposes(void) {
	// a camera is used by one agent at a time
	ASSERT_TRUE(change_switch_and_wait(IMAGER, FILTER_CCD_LIST_PROPERTY_NAME, FILTER_DEVICE_LIST_NONE_ITEM_NAME, true, INDIGO_OK_STATE, 20));
	ASSERT_TRUE(WAIT_UNTIL(switch_value(CAMERA, CONNECTION_PROPERTY_NAME, CONNECTION_DISCONNECTED_ITEM_NAME) && state(CAMERA, CONNECTION_PROPERTY_NAME) != INDIGO_BUSY_STATE, 20));
	ASSERT_TRUE(change_switch_and_wait(GUIDER, FILTER_CCD_LIST_PROPERTY_NAME, CAMERA, true, INDIGO_OK_STATE, 20));
	ASSERT_EQ_INT(INDIGO_OK, indigo_change_switch_property_1(&observer, ASTROMETRY, FILTER_RELATED_AGENT_LIST_PROPERTY_NAME, IMAGER, false));
	ASSERT_TRUE(WAIT_UNTIL(!switch_value(ASTROMETRY, FILTER_RELATED_AGENT_LIST_PROPERTY_NAME, IMAGER), 10));
	ASSERT_TRUE(relate(ASTROMETRY, GUIDER));
	ASSERT_TRUE(slew(18.6, 38.8));
	ASSERT_TRUE(change_number(ASTROMETRY, AGENT_PLATESOLVER_EXPOSURE_SETTINGS_PROPERTY_NAME, AGENT_PLATESOLVER_EXPOSURE_SETTINGS_EXPOSURE_ITEM_NAME, 30));
	ASSERT_TRUE(start_and_wait_for(AGENT_PLATESOLVER_START_SOLVE_ITEM_NAME, INDIGO_SOLVER_STATE_WAITING_FOR_IMAGE, 20));
	ASSERT_TRUE(WAIT_UNTIL(state(CAMERA, CCD_EXPOSURE_PROPERTY_NAME) == INDIGO_BUSY_STATE, 10));
	indigo_usleep(2000000);
	ASSERT_TRUE(abort_and_check());
	ASSERT_TRUE(change_number(ASTROMETRY, AGENT_PLATESOLVER_EXPOSURE_SETTINGS_PROPERTY_NAME, AGENT_PLATESOLVER_EXPOSURE_SETTINGS_EXPOSURE_ITEM_NAME, 1));
	ASSERT_TRUE(solves_after_abort());
}

// Abort while precise GOTO slews to its target
static void abort_while_goto_slews(void) {
	ASSERT_TRUE(slew(18.6, 38.8));
	ASSERT_TRUE(change_numbers(ASTROMETRY, AGENT_PLATESOLVER_GOTO_SETTINGS_PROPERTY_NAME, 2, (const char *[]){ AGENT_PLATESOLVER_GOTO_SETTINGS_RA_ITEM_NAME, AGENT_PLATESOLVER_GOTO_SETTINGS_DEC_ITEM_NAME }, (double []){ 12.0, -20.0 }));
	ASSERT_TRUE(start_and_wait_for(AGENT_PLATESOLVER_START_PRECISE_GOTO_ITEM_NAME, INDIGO_SOLVER_STATE_GOTO, 20));
	ASSERT_TRUE(WAIT_UNTIL(state(MOUNT_DEVICE, MOUNT_EQUATORIAL_COORDINATES_PROPERTY_NAME) == INDIGO_BUSY_STATE, 10));
	indigo_usleep(1000000);
	ASSERT_TRUE(abort_and_check());
}

// Abort while the solution of solve, sync and center is being centred
static void abort_while_centering(void) {
	ASSERT_TRUE(slew(18.6, 38.8));
	// the mount reports a position 10° off, so centring needs a long slew
	ASSERT_TRUE(add_pointing_error(0, 10));
	ASSERT_TRUE(start_and_wait_for(AGENT_PLATESOLVER_START_CENTER_ITEM_NAME, INDIGO_SOLVER_STATE_CENTERING, 180));
	ASSERT_TRUE(abort_and_check());
}

// Abort in the middle of the three point polar alignment, while it slews to the second reference
static void abort_polar_alignment(void) {
	ASSERT_TRUE(slew(fmod(indigo_lst(NULL, SITE_LONGITUDE) - 0.25 + 24, 24), 5));
	ASSERT_TRUE(start_and_wait_for(AGENT_PLATESOLVER_START_CALCULATE_PA_ERROR_ITEM_NAME, INDIGO_SOLVER_STATE_CENTERING, 180));
	ASSERT_TRUE(abort_and_check());
	ASSERT_EQ_INT(INDIGO_POLAR_ALIGN_IDLE, (int)pa_state(AGENT_PLATESOLVER_PA_STATE_ITEM_NAME));
	ASSERT_TRUE(state(ASTROMETRY, AGENT_PLATESOLVER_PA_STATE_PROPERTY_NAME) != INDIGO_BUSY_STATE);
}

// A loopback HTTP server handing out one small FITS image per connection, each after a delay, as a remote
// camera does over a slow link
typedef struct {
	int socket;
	int connections;
	double delay;
} slow_image_server;

static void *serve_slowly(void *arg) {
	slow_image_server *server = arg;
	static char image[2880];
	memset(image, ' ', sizeof(image));
	memcpy(image, "SIMPLE  =                    T", 30);
	memcpy(image + 80, "END", 3);
	for (int i = 0; i < server->connections; i++) {
		int connection = accept(server->socket, NULL, NULL);
		if (connection < 0) {
			break;
		}
		char request[1024];
		long received = 0;
		while (received < (long)sizeof(request) - 1) {
			long n = read(connection, request + received, sizeof(request) - 1 - received);
			if (n <= 0) {
				break;
			}
			received += n;
			request[received] = 0;
			if (strstr(request, "\r\n\r\n")) {
				break;
			}
		}
		indigo_usleep(server->delay * 1000000);
		char header[128];
		int length = snprintf(header, sizeof(header), "HTTP/1.1 200 OK\r\nContent-Length: %d\r\n\r\n", (int)sizeof(image));
		if (write(connection, header, length) != length || write(connection, image, sizeof(image)) != (long)sizeof(image)) {
			fprintf(stderr, "slow image server: write failed\n");
		}
		close(connection);
	}
	return NULL;
}

static bool start_slow_image_server(slow_image_server *server, pthread_t *thread, char *url, size_t url_size) {
	server->socket = socket(AF_INET, SOCK_STREAM, 0);
	REQUIRE(server->socket >= 0);
	struct sockaddr_in address = { .sin_family = AF_INET, .sin_addr.s_addr = htonl(INADDR_LOOPBACK), .sin_port = 0 };
	socklen_t address_size = sizeof(address);
	REQUIRE(bind(server->socket, (struct sockaddr *)&address, sizeof(address)) == 0);
	REQUIRE(listen(server->socket, 4) == 0);
	REQUIRE(getsockname(server->socket, (struct sockaddr *)&address, &address_size) == 0);
	snprintf(url, url_size, "http://127.0.0.1:%d/image.fits", ntohs(address.sin_port));
	REQUIRE(pthread_create(thread, NULL, serve_slowly, server) == 0);
	return true;
}

// An Imager Agent of another server: its images arrive as URLs, the agent downloads them
#define REMOTE_IMAGER "Imager Agent @ remote"

static indigo_property *remote_properties[4];
static char remote_image_url[128];
static indigo_device remote_imager;
static bool remote_attached;

static indigo_result remote_enumerate(indigo_device *device, indigo_client *client, indigo_property *property) {
	for (int i = 0; i < (int)ARRAY_SIZE(remote_properties); i++) {
		if (indigo_property_match(remote_properties[i], property)) {
			indigo_define_property(device, remote_properties[i], NULL);
		}
	}
	return INDIGO_OK;
}

static void remote_capture_done(indigo_device *device) {
	indigo_item *image = remote_properties[3]->items;
	image->blob.value = NULL;
	image->blob.size = 0;
	INDIGO_COPY_VALUE(image->blob.url, remote_image_url);
	INDIGO_COPY_NAME(image->blob.format, ".fits");
	remote_properties[3]->state = INDIGO_OK_STATE;
	indigo_update_property(device, remote_properties[3], NULL);
	remote_properties[1]->state = INDIGO_OK_STATE;
	indigo_update_property(device, remote_properties[1], NULL);
}

static indigo_result remote_change(indigo_device *device, indigo_client *client, indigo_property *property) {
	if (indigo_property_match(remote_properties[1], property)) {
		indigo_property_copy_values(remote_properties[1], property, false);
		remote_properties[1]->state = INDIGO_BUSY_STATE;
		indigo_update_property(device, remote_properties[1], NULL);
		remote_properties[3]->state = INDIGO_BUSY_STATE;
		indigo_update_property(device, remote_properties[3], NULL);
		indigo_set_timer(device, 0.1, remote_capture_done, NULL);
	} else if (indigo_property_match(remote_properties[2], property)) {
		remote_properties[2]->state = INDIGO_OK_STATE;
		indigo_update_property(device, remote_properties[2], NULL);
	}
	return INDIGO_OK;
}

static bool attach_remote_imager(void) {
	char interface[32];
	snprintf(interface, sizeof(interface), "%d", INDIGO_INTERFACE_AGENT);
	remote_properties[0] = indigo_init_text_property(NULL, REMOTE_IMAGER, INFO_PROPERTY_NAME, "Main", "Info", INDIGO_OK_STATE, INDIGO_RO_PERM, 1);
	indigo_init_text_item(remote_properties[0]->items, INFO_DEVICE_INTERFACE_ITEM_NAME, "Interface", interface);
	remote_properties[1] = indigo_init_number_property(NULL, REMOTE_IMAGER, AGENT_IMAGER_CAPTURE_PROPERTY_NAME, "Agent", "Capture", INDIGO_OK_STATE, INDIGO_RW_PERM, 1);
	indigo_init_number_item(remote_properties[1]->items, AGENT_IMAGER_CAPTURE_ITEM_NAME, "Capture", 0, 60, 1, 0);
	remote_properties[2] = indigo_init_switch_property(NULL, REMOTE_IMAGER, CCD_ABORT_EXPOSURE_PROPERTY_NAME, "Camera", "Abort", INDIGO_OK_STATE, INDIGO_RW_PERM, INDIGO_AT_MOST_ONE_RULE, 1);
	indigo_init_switch_item(remote_properties[2]->items, CCD_ABORT_EXPOSURE_ITEM_NAME, "Abort", false);
	remote_properties[3] = indigo_init_blob_property(NULL, REMOTE_IMAGER, CCD_IMAGE_PROPERTY_NAME, "Camera", "Image", INDIGO_OK_STATE, 1);
	indigo_init_blob_item(remote_properties[3]->items, CCD_IMAGE_ITEM_NAME, "Image");
	remote_imager = (indigo_device)INDIGO_DEVICE_INITIALIZER(REMOTE_IMAGER, NULL, remote_enumerate, remote_change, NULL, NULL);
	REQUIRE(indigo_attach_device(&remote_imager) == INDIGO_OK);
	remote_attached = true;
	for (int i = 0; i < (int)ARRAY_SIZE(remote_properties); i++) {
		indigo_define_property(&remote_imager, remote_properties[i], NULL);
	}
	return true;
}

static void detach_remote_imager(void) {
	if (!remote_attached) {
		return;
	}
	remote_attached = false;
	indigo_delete_property(&remote_imager, NULL, NULL);
	indigo_detach_device(&remote_imager);
	for (int i = 0; i < (int)ARRAY_SIZE(remote_properties); i++) {
		indigo_release_property(remote_properties[i]);
	}
}

// Abort while the agent downloads the image of a remote Imager Agent: the solve must not start once the image
// arrives. The first process, not aborted, shows that the downloaded image does get solved.
static void abort_while_image_downloads(void) {
	slow_image_server server = { .connections = 2, .delay = 2 };
	pthread_t thread;
	ASSERT_TRUE(start_slow_image_server(&server, &thread, remote_image_url, sizeof(remote_image_url)));
	ASSERT_TRUE(attach_remote_imager());
	ASSERT_EQ_INT(INDIGO_OK, indigo_change_switch_property_1(&observer, ASTROMETRY, FILTER_RELATED_AGENT_LIST_PROPERTY_NAME, IMAGER, false));
	ASSERT_TRUE(WAIT_UNTIL(!switch_value(ASTROMETRY, FILTER_RELATED_AGENT_LIST_PROPERTY_NAME, IMAGER), 10));
	ASSERT_TRUE(relate(ASTROMETRY, REMOTE_IMAGER));
	unsigned busy = state_count(ASTROMETRY, AGENT_PLATESOLVER_WCS_PROPERTY_NAME, INDIGO_BUSY_STATE);
	ASSERT_TRUE(start_and_wait_for(AGENT_PLATESOLVER_START_SOLVE_ITEM_NAME, INDIGO_SOLVER_STATE_SOLVING, 20));
	ASSERT_TRUE(WAIT_UNTIL(state(ASTROMETRY, AGENT_START_PROCESS_PROPERTY_NAME) != INDIGO_BUSY_STATE, 60));
	busy = state_count(ASTROMETRY, AGENT_PLATESOLVER_WCS_PROPERTY_NAME, INDIGO_BUSY_STATE);
	unsigned solving_before = busy;
	ASSERT_EQ_INT(INDIGO_OK, indigo_change_switch_property_1(&observer, ASTROMETRY, AGENT_START_PROCESS_PROPERTY_NAME, AGENT_PLATESOLVER_START_SOLVE_ITEM_NAME, true));
	// the image is published 0.1 s after the capture starts and its download takes 2 s
	indigo_usleep(1000000);
	busy = state_count(ASTROMETRY, AGENT_PLATESOLVER_WCS_PROPERTY_NAME, INDIGO_BUSY_STATE);
	ASSERT_TRUE(abort_and_check());
	pthread_join(thread, NULL);
	close(server.socket);
	// the image arrived about a second after the abort; nothing may start solving it
	bool started = WAIT_UNTIL(state_count(ASTROMETRY, AGENT_PLATESOLVER_WCS_PROPERTY_NAME, INDIGO_BUSY_STATE) > busy || solver_running(), 5);
	if (started) {
		fprintf(stderr, "the aborted image was solved\n");
		dump_messages();
	}
	printf("  WCS busy updates: %u before the process, %u at the abort, %u now\n", solving_before, busy, state_count(ASTROMETRY, AGENT_PLATESOLVER_WCS_PROPERTY_NAME, INDIGO_BUSY_STATE));
	ASSERT_FALSE(started);
}

// Precise GOTO with a pointing error at 20 places spread over the whole sky, dense and sparse fields,
// both celestial hemispheres and near the pole; the south galactic pole has a case of its own
static const double sky[][2] = {
	{ 0.0, 0 }, { 1.5, 45 }, { 3.0, -30 }, { 4.5, 70 }, { 6.0, 20 },
	{ 7.5, -60 }, { 9.0, 40 }, { 10.5, -10 }, { 12.0, 80 }, { 12.85, 27.1 },
	{ 13.5, -45 }, { 15.0, 10 }, { 16.5, 55 }, { 17.76, -29 }, { 19.5, 30 },
	{ 20.5, 45 }, { 21.0, -5 }, { 22.5, 65 }, { 23.0, -40 }, { 5.5, -35 }
};

static void sky_position(int i) {
	printf("  position %d: RA %.2f h Dec %+.1f°\n", i + 1, sky[i][0], sky[i][1]);
	ASSERT_TRUE(slew(sky[i][0], sky[i][1]));
	ASSERT_TRUE(precise_goto_to(sky[i][0], sky[i][1], 0.03, -0.4));
}

#define SKY_CASE(n) static void sky_##n(void) { sky_position(n - 1); }
SKY_CASE(1) SKY_CASE(2) SKY_CASE(3) SKY_CASE(4) SKY_CASE(5) SKY_CASE(6) SKY_CASE(7) SKY_CASE(8) SKY_CASE(9) SKY_CASE(10)
SKY_CASE(11) SKY_CASE(12) SKY_CASE(13) SKY_CASE(14) SKY_CASE(15) SKY_CASE(16) SKY_CASE(17) SKY_CASE(18) SKY_CASE(19) SKY_CASE(20)

static indigo_test_case tests[] = {
	{ "solve only", solve_only },
	{ "south galactic pole", south_galactic_pole },
	{ "solve and sync", solve_and_sync },
	{ "solve, sync and center", solve_sync_and_center },
	{ "precise goto", precise_goto },
	{ "polar alignment", polar_alignment },
	{ "abort while solving", abort_while_solving },
	{ "abort while exposing", abort_while_exposing },
	{ "abort while guider exposes", abort_while_guider_exposes },
	{ "abort while precise goto slews", abort_while_goto_slews },
	{ "abort while centering", abort_while_centering },
	{ "abort polar alignment", abort_polar_alignment },
	{ "abort while image downloads", abort_while_image_downloads },
	{ "sky 01 RA 0.00 Dec +0", sky_1 },
	{ "sky 02 RA 1.50 Dec +45", sky_2 },
	{ "sky 03 RA 3.00 Dec -30", sky_3 },
	{ "sky 04 RA 4.50 Dec +70", sky_4 },
	{ "sky 05 RA 6.00 Dec +20", sky_5 },
	{ "sky 06 RA 7.50 Dec -60", sky_6 },
	{ "sky 07 RA 9.00 Dec +40", sky_7 },
	{ "sky 08 RA 10.50 Dec -10", sky_8 },
	{ "sky 09 RA 12.00 Dec +80", sky_9 },
	{ "sky 10 RA 12.85 Dec +27 (north galactic pole)", sky_10 },
	{ "sky 11 RA 13.50 Dec -45", sky_11 },
	{ "sky 12 RA 15.00 Dec +10", sky_12 },
	{ "sky 13 RA 16.50 Dec +55", sky_13 },
	{ "sky 14 RA 17.76 Dec -29 (galactic centre)", sky_14 },
	{ "sky 15 RA 19.50 Dec +30", sky_15 },
	{ "sky 16 RA 20.50 Dec +45", sky_16 },
	{ "sky 17 RA 21.00 Dec -5", sky_17 },
	{ "sky 18 RA 22.50 Dec +65", sky_18 },
	{ "sky 19 RA 23.00 Dec -40", sky_19 },
	{ "sky 20 RA 5.50 Dec -35", sky_20 },
};

int main(int argc, char **argv) {
	setvbuf(stdout, NULL, _IONBF, 0);
	const char *filter = argc > 1 ? argv[1] : getenv("INDIGO_TEST_CASE_FILTER");
	int selected = 0;
	for (int i = 0; i < (int)ARRAY_SIZE(tests); i++) {
		if (filter == NULL || strstr(tests[i].name, filter)) {
			selected++;
		}
	}
	indigo_test_plan(SUITE, selected, filter);
	if (system("command -v solve-field >/dev/null && command -v image2xy >/dev/null && command -v curl >/dev/null") != 0) {
		fprintf(stderr, "solve-field, image2xy or curl is not installed, see 'Building the Real Astrometry.net Solver' in indigo_test/AGENTS.md\n");
		return 1;
	}
	char cache_base[] = "/tmp/indigo-astrometry-solver.XXXXXX";
	if (mkdtemp(cache_base) == NULL) {
		perror("mkdtemp");
		return 1;
	}
	setenv("INDIGO_CACHE_BASE", cache_base, 1);
	int result = 0, executed = 0, passed = 0;
	for (int i = 0; i < (int)ARRAY_SIZE(tests); i++) {
		if (filter != NULL && !strstr(tests[i].name, filter)) {
			continue;
		}
		executed++;
		pid_t child = fork();
		if (child == 0) {
			alarm(900);
			if (!indigo_test_use_private_home()) {
				exit(1);
			}
			bool ready = setup();
			int status = ready ? indigo_run_tests(SUITE, tests + i, 1) : 1;
			cleanup();
			indigo_test_remove_private_home();
			exit(status || indigo_test_failures ? 1 : 0);
		}
		int status = -1;
		if (child < 0 || waitpid(child, &status, 0) != child || !WIFEXITED(status) || WEXITSTATUS(status)) {
			fprintf(stderr, "Failed case: %s (status %d)\n", tests[i].name, status);
			result = 1;
		} else {
			passed++;
		}
	}
	indigo_test_remove_tree(cache_base);
	indigo_test_plan_recorded = false;
	printf(SUITE ": %d/%d cases passed (including cleanup)\n", passed, executed);
	return executed ? result : 2;
}
