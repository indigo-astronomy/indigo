// Copyright (c) 2026 INDIGO initiative
// All rights reserved.
//
// You may use this software under the terms of 'INDIGO Astronomy
// open-source license' (see LICENSE.md).
//
// THIS SOFTWARE IS PROVIDED BY THE AUTHORS 'AS IS' AND ANY EXPRESS
// OR IMPLIED WARRANTIES, INCLUDING, BUT NOT LIMITED TO, THE IMPLIED
// WARRANTIES OF MERCHANTABILITY AND FITNESS FOR A PARTICULAR PURPOSE
// ARE DISCLAIMED. IN NO EVENT SHALL THE AUTHOR BE LIABLE FOR ANY
// DIRECT, INDIRECT, INCIDENTAL, SPECIAL, EXEMPLARY, OR CONSEQUENTIAL
// DAMAGES (INCLUDING, BUT NOT LIMITED TO, PROCUREMENT OF SUBSTITUTE
// GOODS OR SERVICES; LOSS OF USE, DATA, OR PROFITS; OR BUSINESS
// INTERRUPTION) HOWEVER CAUSED AND ON ANY THEORY OF LIABILITY,
// WHETHER IN CONTRACT, STRICT LIABILITY, OR TORT (INCLUDING
// NEGLIGENCE OR OTHERWISE) ARISING IN ANY WAY OUT OF THE USE OF THIS
// SOFTWARE, EVEN IF ADVISED OF THE POSSIBILITY OF SUCH DAMAGE.

// Code is generated by AI

// Cooperation of the real Imager, Guider and Mount agents over one in-process bus, driving the
// CCD simulator (imager camera, guider camera and its guide output) and the mount simulator.
// Covered: the imager/guider dithering handshake during a guided batch, its cadence, abort of
// either side while dithering, and the Mount Agent stopping imager and guider processes through
// ABORT_RELATED_PROCESS on slew and park.

#include <math.h>
#include <pthread.h>
#include <stdatomic.h>
#include <stdlib.h>
#include <sys/wait.h>
#include <unistd.h>

#include <indigo/indigo_driver.h>
#include <indigo_drivers/agent_guider/indigo_agent_guider.h>
#include <indigo_drivers/agent_imager/indigo_agent_imager.h>
#include <indigo_drivers/agent_mount/indigo_agent_mount.h>
#include <indigo_drivers/ccd_simulator/indigo_ccd_simulator.h>
#include <indigo_drivers/mount_simulator/indigo_mount_simulator.h>

#include "../test_runner.h"

#define IMAGER "Imager Agent"
#define GUIDER "Guider Agent"
#define MOUNT "Mount Agent"
#define IMAGER_CAMERA "CCD Imager Simulator"
#define GUIDER_CAMERA "CCD Guider Simulator"
#define GUIDER_OUTPUT "CCD Guider Simulator (guider)"
#define MOUNT_DEVICE "Mount Simulator"
#define ARRAY_SIZE(a) (sizeof(a) / sizeof((a)[0]))
#define REQUIRE(c) do { if (!(c)) { fprintf(stderr, "%s:%d: %s\n", __FILE__, __LINE__, #c); indigo_test_failures++; return false; } } while (0)
#define WAIT_UNTIL(condition, timeout) ({ double deadline_ = indigo_monotonic_time() + (timeout); bool ready_ = (condition); while (!ready_ && indigo_monotonic_time() < deadline_) { indigo_usleep(5000); ready_ = (condition); } ready_; })

typedef struct {
	char device[INDIGO_NAME_SIZE];
	char name[INDIGO_NAME_SIZE];
	indigo_property *property;
	unsigned revision;
	unsigned states[4];
} observation;

static observation cache[4096];
static pthread_mutex_t cache_mutex = PTHREAD_MUTEX_INITIALIZER;
static indigo_client observer;
static char messages[262144];
static atomic_uint imager_phases;
static atomic_int dither_busy, dither_ok, dither_alert, dither_state = -1;
static bool bus_started, observer_attached, ccd_started, mount_started, imager_started, guider_started, mount_agent_started;

static observation *find_observation(const char *device, const char *name) {
	observation *free_entry = NULL;
	for (unsigned i = 0; i < ARRAY_SIZE(cache); i++) {
		if (!*cache[i].name) {
			if (!free_entry) {
				free_entry = cache + i;
			}
		} else if (!strcmp(cache[i].device, device) && !strcmp(cache[i].name, name)) {
			return cache + i;
		}
	}
	if (free_entry) {
		INDIGO_COPY_NAME(free_entry->device, device);
		INDIGO_COPY_NAME(free_entry->name, name);
	}
	return free_entry;
}

static void record_transitions(indigo_property *property) {
	if (!strcmp(property->device, IMAGER) && !strcmp(property->name, AGENT_IMAGER_STATS_PROPERTY_NAME)) {
		for (int i = 0; i < property->count; i++) {
			if (!strcmp(property->items[i].name, AGENT_IMAGER_STATS_PHASE_ITEM_NAME)) {
				atomic_fetch_or(&imager_phases, 1u << (int)property->items[i].number.value);
			}
		}
	} else if (!strcmp(property->device, GUIDER) && !strcmp(property->name, AGENT_GUIDER_DITHER_PROPERTY_NAME)) {
		int previous = atomic_exchange(&dither_state, (int)property->state);
		if (property->state == INDIGO_BUSY_STATE) {
			if (previous != INDIGO_BUSY_STATE) {
				atomic_fetch_add(&dither_busy, 1);
			}
		} else if (property->state == INDIGO_OK_STATE) {
			atomic_fetch_add(&dither_ok, 1);
		} else if (property->state == INDIGO_ALERT_STATE) {
			atomic_fetch_add(&dither_alert, 1);
		}
	}
}

static indigo_result observe(indigo_property *property, bool update) {
	pthread_mutex_lock(&cache_mutex);
	observation *entry = find_observation(property->device, property->name);
	if (entry) {
		indigo_release_property(entry->property);
		entry->property = indigo_copy_property(NULL, property);
		entry->revision++;
		if (update && property->state <= INDIGO_ALERT_STATE) {
			entry->states[property->state]++;
		}
	}
	if (update) {
		record_transitions(property);
	}
	pthread_mutex_unlock(&cache_mutex);
	return INDIGO_OK;
}

static indigo_result defined(indigo_client *client, indigo_device *device, indigo_property *property, const char *message) {
	return observe(property, false);
}

static indigo_result updated(indigo_client *client, indigo_device *device, indigo_property *property, const char *message) {
	return observe(property, true);
}

static indigo_result deleted(indigo_client *client, indigo_device *device, indigo_property *property, const char *message) {
	pthread_mutex_lock(&cache_mutex);
	for (unsigned i = 0; i < ARRAY_SIZE(cache); i++) {
		observation *entry = cache + i;
		if (*entry->name && !strcmp(entry->device, property->device) && (!*property->name || !strcmp(entry->name, property->name))) {
			indigo_release_property(entry->property);
			memset(entry, 0, sizeof(*entry));
		}
	}
	pthread_mutex_unlock(&cache_mutex);
	return INDIGO_OK;
}

static indigo_result message_received(indigo_client *client, indigo_device *device, indigo_property *property, const char *message) {
	pthread_mutex_lock(&cache_mutex);
	if (message && strlen(messages) + strlen(device->name) + strlen(message) + 4 < sizeof(messages)) {
		strcat(messages, device->name);
		strcat(messages, ": ");
		strcat(messages, message);
		strcat(messages, "\n");
	}
	pthread_mutex_unlock(&cache_mutex);
	return INDIGO_OK;
}

static bool has_message(const char *text) {
	pthread_mutex_lock(&cache_mutex);
	bool result = strstr(messages, text) != NULL;
	pthread_mutex_unlock(&cache_mutex);
	return result;
}

static void dump_messages(void) {
	pthread_mutex_lock(&cache_mutex);
	fprintf(stderr, "---- agent messages ----\n%s------------------------\n", messages);
	pthread_mutex_unlock(&cache_mutex);
}

static bool exists(const char *device, const char *name) {
	pthread_mutex_lock(&cache_mutex);
	observation *entry = find_observation(device, name);
	bool result = entry && entry->property;
	pthread_mutex_unlock(&cache_mutex);
	return result;
}

static unsigned revision(const char *device, const char *name) {
	pthread_mutex_lock(&cache_mutex);
	observation *entry = find_observation(device, name);
	unsigned result = entry ? entry->revision : 0;
	pthread_mutex_unlock(&cache_mutex);
	return result;
}

static unsigned state_count(const char *device, const char *name, indigo_property_state state) {
	pthread_mutex_lock(&cache_mutex);
	observation *entry = find_observation(device, name);
	unsigned result = entry ? entry->states[state] : 0;
	pthread_mutex_unlock(&cache_mutex);
	return result;
}

static int state(const char *device, const char *name) {
	pthread_mutex_lock(&cache_mutex);
	observation *entry = find_observation(device, name);
	int result = entry && entry->property ? (int)entry->property->state : -1;
	pthread_mutex_unlock(&cache_mutex);
	return result;
}

static bool item_lookup(const char *device, const char *name, const char *item_name, indigo_item *result) {
	bool found = false;
	pthread_mutex_lock(&cache_mutex);
	observation *entry = find_observation(device, name);
	if (entry && entry->property) {
		for (int i = 0; i < entry->property->count; i++) {
			if (!strcmp(entry->property->items[i].name, item_name)) {
				*result = entry->property->items[i];
				found = true;
				break;
			}
		}
	}
	pthread_mutex_unlock(&cache_mutex);
	return found;
}

static double number(const char *device, const char *name, const char *item_name) {
	indigo_item item;
	return item_lookup(device, name, item_name, &item) ? item.number.value : NAN;
}

static bool switch_value(const char *device, const char *name, const char *item_name) {
	indigo_item item;
	return item_lookup(device, name, item_name, &item) && item.sw.value;
}

static bool has_item(const char *device, const char *name, const char *item_name) {
	indigo_item item;
	return item_lookup(device, name, item_name, &item);
}

static bool change_switch(const char *device, const char *name, const char *item_name, bool value) {
	REQUIRE(WAIT_UNTIL(has_item(device, name, item_name), 10));
	REQUIRE(indigo_change_switch_property_1(&observer, device, name, item_name, value) == INDIGO_OK);
	return true;
}

static bool change_switch_and_wait(const char *device, const char *name, const char *item_name, bool value, indigo_property_state expected, double timeout) {
	unsigned before = revision(device, name);
	REQUIRE(change_switch(device, name, item_name, value));
	if (!WAIT_UNTIL(revision(device, name) > before && state(device, name) == (int)expected && switch_value(device, name, item_name) == value, timeout)) {
		fprintf(stderr, "%s.%s.%s = %d did not settle in state %d (state %d)\n", device, name, item_name, value, expected, state(device, name));
		dump_messages();
		return false;
	}
	return true;
}

static bool change_numbers(const char *device, const char *name, int count, const char **items, const double *values) {
	REQUIRE(WAIT_UNTIL(exists(device, name), 10));
	unsigned before = revision(device, name);
	REQUIRE(indigo_change_number_property(&observer, device, name, count, items, values) == INDIGO_OK);
	if (!WAIT_UNTIL(revision(device, name) > before && state(device, name) != INDIGO_BUSY_STATE, 10)) {
		fprintf(stderr, "%s.%s did not settle after a number change (state %d)\n", device, name, state(device, name));
		return false;
	}
	return true;
}

static bool change_number(const char *device, const char *name, const char *item_name, double value) {
	return change_numbers(device, name, 1, (const char *[]){ item_name }, (double []){ value });
}

static bool select_device(const char *agent, const char *list, const char *device) {
	REQUIRE(WAIT_UNTIL(has_item(agent, list, device), 10));
	if (!change_switch_and_wait(agent, list, device, true, INDIGO_OK_STATE, 20)) {
		return false;
	}
	return true;
}

static bool relate(const char *agent, const char *related) {
	REQUIRE(WAIT_UNTIL(has_item(agent, FILTER_RELATED_AGENT_LIST_PROPERTY_NAME, related), 10));
	REQUIRE(change_switch(agent, FILTER_RELATED_AGENT_LIST_PROPERTY_NAME, related, true));
	REQUIRE(WAIT_UNTIL(switch_value(agent, FILTER_RELATED_AGENT_LIST_PROPERTY_NAME, related), 10));
	return true;
}

static bool process_running(const char *agent) {
	return state(agent, AGENT_START_PROCESS_PROPERTY_NAME) == INDIGO_BUSY_STATE;
}

static double guider_phase(void) {
	return number(GUIDER, AGENT_GUIDER_STATS_PROPERTY_NAME, AGENT_GUIDER_STATS_PHASE_ITEM_NAME);
}

static double guider_frame(void) {
	return number(GUIDER, AGENT_GUIDER_STATS_PROPERTY_NAME, AGENT_GUIDER_STATS_FRAME_ITEM_NAME);
}

static double imager_phase(void) {
	return number(IMAGER, AGENT_IMAGER_STATS_PROPERTY_NAME, AGENT_IMAGER_STATS_PHASE_ITEM_NAME);
}

static bool guiding(void) {
	return process_running(GUIDER) && guider_phase() == INDIGO_GUIDER_PHASE_GUIDING;
}

static bool imager_saw_phase(int phase) {
	return (atomic_load(&imager_phases) & (1u << phase)) != 0;
}

static void reset_transitions(void) {
	atomic_store(&imager_phases, 0);
	atomic_store(&dither_busy, 0);
	atomic_store(&dither_ok, 0);
	atomic_store(&dither_alert, 0);
}

// Moves the unparked mount to an hour angle and declination well away from the pole, where the
// Guider Agent accepts to guide, and waits until the slew finishes.
static bool slew_mount(double declination) {
	double ra = number(MOUNT_DEVICE, MOUNT_EQUATORIAL_COORDINATES_PROPERTY_NAME, MOUNT_EQUATORIAL_COORDINATES_RA_ITEM_NAME);
	REQUIRE(!isnan(ra));
	unsigned busy = state_count(MOUNT, MOUNT_EQUATORIAL_COORDINATES_PROPERTY_NAME, INDIGO_BUSY_STATE);
	REQUIRE(indigo_change_number_property(&observer, MOUNT, MOUNT_EQUATORIAL_COORDINATES_PROPERTY_NAME, 2, (const char *[]){ MOUNT_EQUATORIAL_COORDINATES_RA_ITEM_NAME, MOUNT_EQUATORIAL_COORDINATES_DEC_ITEM_NAME }, (double []){ ra, declination }) == INDIGO_OK);
	REQUIRE(WAIT_UNTIL(state_count(MOUNT, MOUNT_EQUATORIAL_COORDINATES_PROPERTY_NAME, INDIGO_BUSY_STATE) > busy, 10));
	if (!WAIT_UNTIL(state(MOUNT_DEVICE, MOUNT_EQUATORIAL_COORDINATES_PROPERTY_NAME) == INDIGO_OK_STATE && fabs(number(MOUNT_DEVICE, MOUNT_EQUATORIAL_COORDINATES_PROPERTY_NAME, MOUNT_EQUATORIAL_COORDINATES_DEC_ITEM_NAME) - declination) < 0.01, 120)) {
		fprintf(stderr, "mount did not reach declination %g (dec %g, state %d)\n", declination, number(MOUNT_DEVICE, MOUNT_EQUATORIAL_COORDINATES_PROPERTY_NAME, MOUNT_EQUATORIAL_COORDINATES_DEC_ITEM_NAME), state(MOUNT_DEVICE, MOUNT_EQUATORIAL_COORDINATES_PROPERTY_NAME));
		dump_messages();
		return false;
	}
	return true;
}

static bool configure_imager_batch(double count, double exposure, double skip) {
	return change_numbers(IMAGER, AGENT_IMAGER_BATCH_PROPERTY_NAME, 4, (const char *[]){ AGENT_IMAGER_BATCH_COUNT_ITEM_NAME, AGENT_IMAGER_BATCH_EXPOSURE_ITEM_NAME, AGENT_IMAGER_BATCH_DELAY_ITEM_NAME, AGENT_IMAGER_BATCH_FRAMES_TO_SKIP_BEFORE_DITHER_ITEM_NAME }, (double []){ count, exposure, 0, skip });
}

static bool configure_dithering(double amount, double settle_frames, double settle_limit) {
	return change_numbers(GUIDER, AGENT_GUIDER_SETTINGS_PROPERTY_NAME, 5, (const char *[]){ AGENT_GUIDER_SETTINGS_EXPOSURE_ITEM_NAME, AGENT_GUIDER_SETTINGS_DELAY_ITEM_NAME, AGENT_GUIDER_SETTINGS_DITHERING_AMOUNT_ITEM_NAME, AGENT_GUIDER_SETTINGS_DITH_LIMIT_ITEM_NAME, AGENT_GUIDER_SETTINGS_DITHERING_TIME_LIMIT_ITEM_NAME }, (double []){ 0.1, 0, amount, settle_frames, settle_limit });
}

static bool enable_dithering(bool enabled, bool after_last_frame) {
	REQUIRE(change_switch(IMAGER, AGENT_PROCESS_FEATURES_PROPERTY_NAME, AGENT_IMAGER_ENABLE_DITHERING_FEATURE_ITEM_NAME, enabled));
	REQUIRE(WAIT_UNTIL(switch_value(IMAGER, AGENT_PROCESS_FEATURES_PROPERTY_NAME, AGENT_IMAGER_ENABLE_DITHERING_FEATURE_ITEM_NAME) == enabled, 10));
	REQUIRE(change_switch(IMAGER, AGENT_PROCESS_FEATURES_PROPERTY_NAME, AGENT_IMAGER_DITHER_AFTER_BATCH_FEATURE_ITEM_NAME, after_last_frame));
	REQUIRE(WAIT_UNTIL(switch_value(IMAGER, AGENT_PROCESS_FEATURES_PROPERTY_NAME, AGENT_IMAGER_DITHER_AFTER_BATCH_FEATURE_ITEM_NAME) == after_last_frame, 10));
	return true;
}

static bool start_guiding(void) {
	REQUIRE(change_switch(GUIDER, AGENT_START_PROCESS_PROPERTY_NAME, AGENT_GUIDER_START_CALIBRATION_AND_GUIDING_ITEM_NAME, true));
	if (!WAIT_UNTIL(guiding() && guider_frame() > 5, 180)) {
		fprintf(stderr, "guider did not reach guiding (process state %d, phase %g, frame %g)\n", state(GUIDER, AGENT_START_PROCESS_PROPERTY_NAME), guider_phase(), guider_frame());
		dump_messages();
		return false;
	}
	return true;
}

static bool start_batch(void) {
	reset_transitions();
	REQUIRE(change_switch(IMAGER, AGENT_START_PROCESS_PROPERTY_NAME, AGENT_IMAGER_START_EXPOSURE_ITEM_NAME, true));
	REQUIRE(WAIT_UNTIL(process_running(IMAGER), 10));
	return true;
}

static bool wait_batch(indigo_property_state expected, double timeout) {
	if (!WAIT_UNTIL(!process_running(IMAGER), timeout)) {
		fprintf(stderr, "imager batch still running (phase %g)\n", imager_phase());
		dump_messages();
		return false;
	}
	if (state(IMAGER, AGENT_START_PROCESS_PROPERTY_NAME) != (int)expected) {
		fprintf(stderr, "imager batch finished in state %d, expected %d\n", state(IMAGER, AGENT_START_PROCESS_PROPERTY_NAME), expected);
		dump_messages();
		return false;
	}
	return true;
}

static bool abort_agent(const char *agent) {
	REQUIRE(change_switch(agent, AGENT_ABORT_PROCESS_PROPERTY_NAME, AGENT_ABORT_PROCESS_ITEM_NAME, true));
	REQUIRE(WAIT_UNTIL(!process_running(agent), 20));
	return true;
}

static bool related_abort_allowed(const char *item_name) {
	return switch_value(MOUNT, AGENT_ABORT_RELATED_PROCESS_PROPERTY_NAME, item_name);
}

static bool setup(void) {
	indigo_set_log_level(getenv("INDIGO_TEST_DEBUG") ? INDIGO_LOG_DEBUG : INDIGO_LOG_ERROR);
	REQUIRE(indigo_start() == INDIGO_OK);
	bus_started = true;
	INDIGO_COPY_NAME(observer.name, "Agent cooperation observer");
	observer.version = INDIGO_VERSION_CURRENT;
	observer.define_property = defined;
	observer.update_property = updated;
	observer.delete_property = deleted;
	observer.send_message = message_received;
	REQUIRE(indigo_attach_client(&observer) == INDIGO_OK);
	observer_attached = true;
	REQUIRE(indigo_ccd_simulator(INDIGO_DRIVER_INIT, NULL) == INDIGO_OK);
	ccd_started = true;
	REQUIRE(indigo_mount_simulator(INDIGO_DRIVER_INIT, NULL) == INDIGO_OK);
	mount_started = true;
	REQUIRE(indigo_agent_imager(INDIGO_DRIVER_INIT, NULL) == INDIGO_OK);
	imager_started = true;
	REQUIRE(indigo_agent_guider(INDIGO_DRIVER_INIT, NULL) == INDIGO_OK);
	guider_started = true;
	REQUIRE(indigo_agent_mount(INDIGO_DRIVER_INIT, NULL) == INDIGO_OK);
	mount_agent_started = true;
	REQUIRE(select_device(IMAGER, FILTER_CCD_LIST_PROPERTY_NAME, IMAGER_CAMERA));
	REQUIRE(select_device(GUIDER, FILTER_CCD_LIST_PROPERTY_NAME, GUIDER_CAMERA));
	REQUIRE(select_device(GUIDER, FILTER_GUIDER_LIST_PROPERTY_NAME, GUIDER_OUTPUT));
	REQUIRE(select_device(MOUNT, FILTER_MOUNT_LIST_PROPERTY_NAME, MOUNT_DEVICE));
	REQUIRE(relate(IMAGER, GUIDER));
	REQUIRE(relate(IMAGER, MOUNT));
	REQUIRE(relate(GUIDER, MOUNT));
	REQUIRE(relate(MOUNT, IMAGER));
	REQUIRE(relate(MOUNT, GUIDER));
	REQUIRE(WAIT_UNTIL(exists(MOUNT, MOUNT_PARK_PROPERTY_NAME) && exists(MOUNT_DEVICE, MOUNT_EQUATORIAL_COORDINATES_PROPERTY_NAME), 10));
	REQUIRE(change_switch_and_wait(MOUNT, MOUNT_PARK_PROPERTY_NAME, MOUNT_PARK_UNPARKED_ITEM_NAME, true, INDIGO_OK_STATE, 60));
	REQUIRE(slew_mount(20));
	REQUIRE(WAIT_UNTIL(fabs(number(GUIDER, AGENT_GUIDER_MOUNT_COORDINATES_PROPERTY_NAME, AGENT_GUIDER_MOUNT_COORDINATES_DEC_ITEM_NAME) - 20) < 0.1, 10));
	REQUIRE(configure_dithering(1, 3, 60));
	return true;
}

static void cleanup(void) {
	if (mount_agent_started) {
		indigo_agent_mount(INDIGO_DRIVER_SHUTDOWN, NULL);
	}
	if (guider_started) {
		indigo_agent_guider(INDIGO_DRIVER_SHUTDOWN, NULL);
	}
	if (imager_started) {
		indigo_agent_imager(INDIGO_DRIVER_SHUTDOWN, NULL);
	}
	if (mount_started) {
		indigo_mount_simulator(INDIGO_DRIVER_SHUTDOWN, NULL);
	}
	if (ccd_started) {
		indigo_ccd_simulator(INDIGO_DRIVER_SHUTDOWN, NULL);
	}
	if (observer_attached) {
		indigo_detach_client(&observer);
	}
	if (bus_started) {
		indigo_stop();
	}
}

// A guided three frame batch dithers after the first and the second frame only; the imager waits
// in the DITHERING phase until the guider settles, and guiding survives the batch.
static void guided_batch_dithers_between_frames(void) {
	ASSERT_TRUE(start_guiding());
	ASSERT_TRUE(enable_dithering(true, false));
	ASSERT_TRUE(configure_imager_batch(3, 0.2, 0));
	ASSERT_TRUE(start_batch());
	ASSERT_TRUE(WAIT_UNTIL(related_abort_allowed(AGENT_ABORT_IMAGER_ITEM_NAME), 10));
	ASSERT_TRUE(wait_batch(INDIGO_OK_STATE, 120));
	ASSERT_EQ_INT(2, atomic_load(&dither_busy));
	ASSERT_EQ_INT(2, atomic_load(&dither_ok));
	ASSERT_EQ_INT(0, atomic_load(&dither_alert));
	ASSERT_TRUE(imager_saw_phase(INDIGO_IMAGER_PHASE_DITHERING));
	ASSERT_FALSE(has_message("Dithering failed"));
	ASSERT_EQ_INT(3, (int)number(IMAGER, AGENT_IMAGER_STATS_PROPERTY_NAME, AGENT_IMAGER_STATS_FRAME_ITEM_NAME));
	ASSERT_TRUE(WAIT_UNTIL(!related_abort_allowed(AGENT_ABORT_IMAGER_ITEM_NAME), 10));
	ASSERT_TRUE(guiding());
	ASSERT_TRUE(related_abort_allowed(AGENT_ABORT_GUIDER_ITEM_NAME));
	double frame = guider_frame();
	ASSERT_TRUE(WAIT_UNTIL(guider_frame() > frame + 2, 20));
	ASSERT_TRUE(abort_agent(GUIDER));
	ASSERT_TRUE(WAIT_UNTIL(!related_abort_allowed(AGENT_ABORT_GUIDER_ITEM_NAME), 10));
}

// FRAMES_TO_SKIP_BEFORE_DITHER = 1 dithers after every second frame, and DITHER_AFTER_LAST_FRAME
// adds the dither after the final frame: four frames give dithers after frames two and four.
static void dither_cadence_skip_and_after_last_frame(void) {
	ASSERT_TRUE(start_guiding());
	ASSERT_TRUE(enable_dithering(true, true));
	ASSERT_TRUE(configure_imager_batch(4, 0.2, 1));
	ASSERT_TRUE(start_batch());
	ASSERT_TRUE(wait_batch(INDIGO_OK_STATE, 180));
	ASSERT_EQ_INT(2, atomic_load(&dither_busy));
	ASSERT_EQ_INT(2, atomic_load(&dither_ok));
	ASSERT_EQ_INT(0, atomic_load(&dither_alert));
	ASSERT_TRUE(guiding());
	ASSERT_TRUE(abort_agent(GUIDER));
}

// Aborting the imager while it waits for the guider to settle ends the batch at once; the guider
// keeps guiding, finishes its dither on its own and stays abortable by the mount.
static void imager_abort_while_dithering(void) {
	ASSERT_TRUE(configure_dithering(3, 50, 120));
	ASSERT_TRUE(start_guiding());
	ASSERT_TRUE(enable_dithering(true, false));
	ASSERT_TRUE(configure_imager_batch(5, 0.2, 0));
	ASSERT_TRUE(start_batch());
	ASSERT_TRUE(WAIT_UNTIL(imager_phase() == INDIGO_IMAGER_PHASE_DITHERING && state(GUIDER, AGENT_GUIDER_DITHER_PROPERTY_NAME) == INDIGO_BUSY_STATE, 60));
	double started = indigo_monotonic_time();
	ASSERT_TRUE(change_switch(IMAGER, AGENT_ABORT_PROCESS_PROPERTY_NAME, AGENT_ABORT_PROCESS_ITEM_NAME, true));
	ASSERT_TRUE(wait_batch(INDIGO_ALERT_STATE, 10));
	ASSERT_TRUE(indigo_monotonic_time() - started < 2);
	ASSERT_TRUE(has_message("Batch aborted"));
	ASSERT_TRUE(WAIT_UNTIL(!related_abort_allowed(AGENT_ABORT_IMAGER_ITEM_NAME), 10));
	ASSERT_TRUE(guiding());
	ASSERT_TRUE(related_abort_allowed(AGENT_ABORT_GUIDER_ITEM_NAME));
	ASSERT_TRUE(WAIT_UNTIL(state(GUIDER, AGENT_GUIDER_DITHER_PROPERTY_NAME) != INDIGO_BUSY_STATE, 120));
	ASSERT_TRUE(guiding());
	ASSERT_TRUE(abort_agent(GUIDER));
}

// Aborting the guider while the imager waits for the dither to settle must release the imager:
// the guider reports the dither as failed and the batch goes on and completes.
static void guider_abort_while_dithering_releases_imager(void) {
	ASSERT_TRUE(configure_dithering(3, 50, 120));
	ASSERT_TRUE(start_guiding());
	ASSERT_TRUE(enable_dithering(true, false));
	ASSERT_TRUE(configure_imager_batch(3, 0.2, 0));
	ASSERT_TRUE(start_batch());
	ASSERT_TRUE(WAIT_UNTIL(imager_phase() == INDIGO_IMAGER_PHASE_DITHERING && state(GUIDER, AGENT_GUIDER_DITHER_PROPERTY_NAME) == INDIGO_BUSY_STATE, 60));
	ASSERT_TRUE(abort_agent(GUIDER));
	ASSERT_TRUE(WAIT_UNTIL(state(GUIDER, AGENT_GUIDER_DITHER_PROPERTY_NAME) == INDIGO_ALERT_STATE, 10));
	ASSERT_TRUE(WAIT_UNTIL(imager_phase() != INDIGO_IMAGER_PHASE_DITHERING, 10));
	ASSERT_TRUE(wait_batch(INDIGO_OK_STATE, 60));
	ASSERT_EQ_INT(3, (int)number(IMAGER, AGENT_IMAGER_STATS_PROPERTY_NAME, AGENT_IMAGER_STATS_FRAME_ITEM_NAME));
	ASSERT_TRUE(WAIT_UNTIL(!related_abort_allowed(AGENT_ABORT_GUIDER_ITEM_NAME), 10));
}

// With the guider not guiding, a dither request is acknowledged and refused at once, and the batch
// is not delayed by the dither wait.
static void dither_request_without_guiding_does_not_stall_batch(void) {
	ASSERT_TRUE(enable_dithering(true, false));
	ASSERT_TRUE(configure_imager_batch(3, 0.2, 0));
	double started = indigo_monotonic_time();
	ASSERT_TRUE(start_batch());
	ASSERT_TRUE(wait_batch(INDIGO_OK_STATE, 60));
	ASSERT_TRUE(indigo_monotonic_time() - started < 20);
	ASSERT_EQ_INT(2, atomic_load(&dither_busy));
	ASSERT_EQ_INT(2, atomic_load(&dither_alert));
	ASSERT_EQ_INT(0, atomic_load(&dither_ok));
	ASSERT_FALSE(has_message("Dithering failed to settle down"));
}

static bool start_guided_long_batch(void) {
	REQUIRE(start_guiding());
	REQUIRE(enable_dithering(false, false));
	REQUIRE(configure_imager_batch(100, 0.5, 0));
	REQUIRE(start_batch());
	REQUIRE(WAIT_UNTIL(related_abort_allowed(AGENT_ABORT_IMAGER_ITEM_NAME) && related_abort_allowed(AGENT_ABORT_GUIDER_ITEM_NAME), 10));
	REQUIRE(WAIT_UNTIL(number(IMAGER, AGENT_IMAGER_STATS_PROPERTY_NAME, AGENT_IMAGER_STATS_FRAME_ITEM_NAME) >= 2, 30));
	return true;
}

// A slew requested through the Mount Agent stops both the running batch and guiding.
static void mount_slew_aborts_imager_and_guider(void) {
	ASSERT_TRUE(start_guided_long_batch());
	double ra = number(MOUNT_DEVICE, MOUNT_EQUATORIAL_COORDINATES_PROPERTY_NAME, MOUNT_EQUATORIAL_COORDINATES_RA_ITEM_NAME);
	ASSERT_TRUE(indigo_change_number_property(&observer, MOUNT, MOUNT_EQUATORIAL_COORDINATES_PROPERTY_NAME, 2, (const char *[]){ MOUNT_EQUATORIAL_COORDINATES_RA_ITEM_NAME, MOUNT_EQUATORIAL_COORDINATES_DEC_ITEM_NAME }, (double []){ ra, 30 }) == INDIGO_OK);
	ASSERT_TRUE(WAIT_UNTIL(!process_running(IMAGER) && !process_running(GUIDER), 20));
	ASSERT_EQ_INT(INDIGO_ALERT_STATE, state(IMAGER, AGENT_START_PROCESS_PROPERTY_NAME));
	ASSERT_TRUE(has_message("Aborting Imager agent process due to slew"));
	ASSERT_TRUE(has_message("Aborting Guider agent process due to slew"));
	ASSERT_TRUE(WAIT_UNTIL(!related_abort_allowed(AGENT_ABORT_IMAGER_ITEM_NAME) && !related_abort_allowed(AGENT_ABORT_GUIDER_ITEM_NAME), 10));
	ASSERT_TRUE(WAIT_UNTIL(state(MOUNT_DEVICE, MOUNT_EQUATORIAL_COORDINATES_PROPERTY_NAME) == INDIGO_OK_STATE, 120));
	ASSERT_FALSE(process_running(IMAGER));
	ASSERT_FALSE(process_running(GUIDER));
}

// Parking through the Mount Agent stops both the running batch and guiding.
static void mount_park_aborts_imager_and_guider(void) {
	ASSERT_TRUE(start_guided_long_batch());
	ASSERT_TRUE(change_switch(MOUNT, MOUNT_PARK_PROPERTY_NAME, MOUNT_PARK_PARKED_ITEM_NAME, true));
	ASSERT_TRUE(WAIT_UNTIL(!process_running(IMAGER) && !process_running(GUIDER), 20));
	ASSERT_EQ_INT(INDIGO_ALERT_STATE, state(IMAGER, AGENT_START_PROCESS_PROPERTY_NAME));
	ASSERT_TRUE(has_message("Aborting Imager agent process due to"));
	ASSERT_TRUE(has_message("Aborting Guider agent process due to"));
	ASSERT_TRUE(WAIT_UNTIL(!related_abort_allowed(AGENT_ABORT_IMAGER_ITEM_NAME) && !related_abort_allowed(AGENT_ABORT_GUIDER_ITEM_NAME), 10));
	ASSERT_TRUE(WAIT_UNTIL(state(MOUNT, MOUNT_PARK_PROPERTY_NAME) == INDIGO_OK_STATE && switch_value(MOUNT, MOUNT_PARK_PROPERTY_NAME, MOUNT_PARK_PARKED_ITEM_NAME), 120));
}

// Withdrawing the IMAGER permission on the Mount Agent keeps the batch running through a slew,
// while guiding, still permitted, is stopped.
static void withdrawn_permission_keeps_imager_running(void) {
	ASSERT_TRUE(start_guided_long_batch());
	ASSERT_TRUE(change_switch(MOUNT, AGENT_ABORT_RELATED_PROCESS_PROPERTY_NAME, AGENT_ABORT_IMAGER_ITEM_NAME, false));
	ASSERT_TRUE(WAIT_UNTIL(!related_abort_allowed(AGENT_ABORT_IMAGER_ITEM_NAME), 10));
	double ra = number(MOUNT_DEVICE, MOUNT_EQUATORIAL_COORDINATES_PROPERTY_NAME, MOUNT_EQUATORIAL_COORDINATES_RA_ITEM_NAME);
	ASSERT_TRUE(indigo_change_number_property(&observer, MOUNT, MOUNT_EQUATORIAL_COORDINATES_PROPERTY_NAME, 2, (const char *[]){ MOUNT_EQUATORIAL_COORDINATES_RA_ITEM_NAME, MOUNT_EQUATORIAL_COORDINATES_DEC_ITEM_NAME }, (double []){ ra, 25 }) == INDIGO_OK);
	ASSERT_TRUE(WAIT_UNTIL(!process_running(GUIDER), 20));
	ASSERT_TRUE(WAIT_UNTIL(state(MOUNT_DEVICE, MOUNT_EQUATORIAL_COORDINATES_PROPERTY_NAME) == INDIGO_OK_STATE, 120));
	ASSERT_TRUE(process_running(IMAGER));
	ASSERT_FALSE(has_message("Aborting Imager agent process"));
	double frame = number(IMAGER, AGENT_IMAGER_STATS_PROPERTY_NAME, AGENT_IMAGER_STATS_FRAME_ITEM_NAME);
	ASSERT_TRUE(WAIT_UNTIL(number(IMAGER, AGENT_IMAGER_STATS_PROPERTY_NAME, AGENT_IMAGER_STATS_FRAME_ITEM_NAME) > frame, 30));
	ASSERT_TRUE(abort_agent(IMAGER));
}

static const indigo_test_case tests[] = {
	{ "guided batch dithers between frames", guided_batch_dithers_between_frames },
	{ "dither cadence skip and after last frame", dither_cadence_skip_and_after_last_frame },
	{ "imager abort while dithering", imager_abort_while_dithering },
	{ "guider abort while dithering releases imager", guider_abort_while_dithering_releases_imager },
	{ "dither request without guiding does not stall batch", dither_request_without_guiding_does_not_stall_batch },
	{ "mount slew aborts imager and guider", mount_slew_aborts_imager_and_guider },
	{ "mount park aborts imager and guider", mount_park_aborts_imager_and_guider },
	{ "withdrawn permission keeps imager running", withdrawn_permission_keeps_imager_running }
};

int main(int argc, char **argv) {
	setvbuf(stdout, NULL, _IONBF, 0);
	int result = 0, executed = 0, passed = 0;
	for (int i = 0; i < (int)ARRAY_SIZE(tests); i++) {
		if (argc > 1 && !strstr(tests[i].name, argv[1])) {
			continue;
		}
		executed++;
		pid_t child = fork();
		if (child == 0) {
			alarm(420);
			if (!indigo_test_use_private_home()) {
				exit(1);
			}
			bool ready = setup();
			int status = ready ? indigo_run_tests("Imager, Guider and Mount Agent cooperation", tests + i, 1) : 1;
			cleanup();
			indigo_test_remove_private_home();
			exit(status || indigo_test_failures ? 1 : 0);
		}
		int status = -1;
		if (child < 0 || waitpid(child, &status, 0) != child || !WIFEXITED(status) || WEXITSTATUS(status)) {
			fprintf(stderr, "Failed case: %s (status %d)\n", tests[i].name, status);
			result = 1;
		} else {
			passed++;
		}
	}
	printf("Imager, Guider and Mount Agent cooperation: %d/%d cases passed (including cleanup)\n", passed, executed);
	return executed ? result : 2;
}
