// Copyright (c) 2026 INDIGO initiative
// All rights reserved.
//
// You may use this software under the terms of 'INDIGO Astronomy
// open-source license' (see LICENSE.md).
//
// THIS SOFTWARE IS PROVIDED BY THE AUTHORS 'AS IS' AND ANY EXPRESS
// OR IMPLIED WARRANTIES, INCLUDING, BUT NOT LIMITED TO, THE IMPLIED
// WARRANTIES OF MERCHANTABILITY AND FITNESS FOR A PARTICULAR PURPOSE
// ARE DISCLAIMED. IN NO EVENT SHALL THE AUTHOR BE LIABLE FOR ANY
// DIRECT, INDIRECT, INCIDENTAL, SPECIAL, EXEMPLARY, OR CONSEQUENTIAL
// DAMAGES (INCLUDING, BUT NOT LIMITED TO, PROCUREMENT OF SUBSTITUTE
// GOODS OR SERVICES; LOSS OF USE, DATA, OR PROFITS; OR BUSINESS
// INTERRUPTION) HOWEVER CAUSED AND ON ANY THEORY OF LIABILITY,
// WHETHER IN CONTRACT, STRICT LIABILITY, OR TORT (INCLUDING
// NEGLIGENCE OR OTHERWISE) ARISING IN ANY WAY OUT OF THE USE OF THIS
// SOFTWARE, EVEN IF ADVISED OF THE POSSIBILITY OF SUCH DAMAGE.

// Code is generated by AI

#include <indigo/indigo_driver.h>
#include <indigo/indigo_names.h>
#include "../test_runner.h"

static indigo_property *live_reset_property;
static unsigned reset_allocations, reset_releases;

static indigo_property *observe_switch_allocation(indigo_property *property, const char *device, const char *name,
	const char *group, const char *label, indigo_property_state state, indigo_property_perm perm, indigo_rule rule, int count) {
	indigo_property *result = indigo_init_switch_property(property, device, name, group, label, state, perm, rule, count);
	if (!strcmp(name, AGENT_GUIDER_RESET_MKGP_PROPERTY_NAME) && result != NULL) {
		if (live_reset_property != NULL) {
			fprintf(stderr, "MKGP reset property from the previous instance remains allocated\n");
			indigo_test_failures++;
		}
		live_reset_property = result;
		reset_allocations++;
	}
	return result;
}

static void observe_release(indigo_property *property) {
	if (property != NULL && property == live_reset_property) {
		reset_releases++;
		live_reset_property = NULL;
	}
	indigo_release_property(property);
}

// Use real agent initialization, callback shutdown and detach; count its actual property ownership.
#define indigo_init_switch_property observe_switch_allocation
#define indigo_release_property observe_release
#include "../../indigo_drivers/agent_guider/indigo_agent_guider.c"
#undef indigo_release_property
#undef indigo_init_switch_property

static void reset_property_lifecycle(void) {
	ASSERT_EQ_INT(INDIGO_OK, indigo_start());
	for (int cycle = 0; cycle < 5; cycle++) {
		ASSERT_EQ_INT(INDIGO_OK, indigo_agent_guider(INDIGO_DRIVER_INIT, NULL));
		ASSERT_TRUE(live_reset_property != NULL);
		ASSERT_EQ_INT(cycle + 1, reset_allocations);
		ASSERT_EQ_INT(cycle, reset_releases);
		ASSERT_EQ_INT(INDIGO_OK, indigo_agent_guider(INDIGO_DRIVER_SHUTDOWN, NULL));
		ASSERT_TRUE(live_reset_property == NULL);
		ASSERT_EQ_INT(cycle + 1, reset_releases);
	}
	ASSERT_EQ_INT(INDIGO_OK, indigo_stop());
}

int main(void) {
	if (!indigo_test_use_private_home()) return 1;
	indigo_test_case cases[] = {
		{ "five attach detach cycles release each MKGP reset allocation", reset_property_lifecycle }
	};
	int result = indigo_run_tests("Guider Agent reset property lifecycle", cases, 1);
	indigo_test_remove_private_home();
	return result;
}
