// Copyright (c) 2026 INDIGO initiative
// All rights reserved.
//
// You may use this software under the terms of 'INDIGO Astronomy
// open-source license' (see LICENSE.md).
//
// THIS SOFTWARE IS PROVIDED BY THE AUTHORS 'AS IS' AND ANY EXPRESS
// OR IMPLIED WARRANTIES, INCLUDING, BUT NOT LIMITED TO, THE IMPLIED
// WARRANTIES OF MERCHANTABILITY AND FITNESS FOR A PARTICULAR PURPOSE
// ARE DISCLAIMED. IN NO EVENT SHALL THE AUTHOR BE LIABLE FOR ANY
// DIRECT, INDIRECT, INCIDENTAL, SPECIAL, EXEMPLARY, OR CONSEQUENTIAL
// DAMAGES (INCLUDING, BUT NOT LIMITED TO, PROCUREMENT OF SUBSTITUTE
// GOODS OR SERVICES; LOSS OF USE, DATA, OR PROFITS; OR BUSINESS
// INTERRUPTION) HOWEVER CAUSED AND ON ANY THEORY OF LIABILITY,
// WHETHER IN CONTRACT, STRICT LIABILITY, OR TORT (INCLUDING
// NEGLIGENCE OR OTHERWISE) ARISING IN ANY WAY OUT OF THE USE OF THIS
// SOFTWARE, EVEN IF ADVISED OF THE POSSIBILITY OF SUCH DAMAGE.

// Code is generated by AI

// Detach-abort registry and mount manual-motion ownership.
//
// indigo_register_detach_abort() / indigo_unregister_detach_abort() in the bus, and the mount base
// class helpers indigo_mount_record_motion_client() / indigo_mount_commit_motion_client() called by
// the generated MOUNT_MOTION_DEC/RA and MOUNT_ABORT_MOTION handlers, release manual motion when the
// client that started it detaches. The default mode runs everything over one in-process bus:
//
// * registry_*   the bus API against a minimal test device (no driver involved);
// * simulator_*  the generated mount simulator driver, owners are in-process clients that detach;
// * agent_*      the Mount Agent forwarding a motion request, the requesting client stays the owner;
// * lx200_*      the generated LX200 driver against its host-side serial simulator (OnStep and
//                classic profiles), for a driver whose motion handler does serial I/O.
//
// With --network (opt-in target test-detach-abort-network, it opens loopback sockets) the same bus
// also runs the production TCP server on an ephemeral port and the owners are real TCP peers that
// close orderly, reset the connection, lose it through a cuttable proxy or race the close with the
// request, as the XML adapter of indigo_server sees them.
//
// Observation never relies on sleeps: registrations are proven by the bus log markers "Aborting",
// "Releasing" and "Forgetting" (the log handler is redirected), a device queue fence proves that a
// queued motion handler and its commit have finished, and a queue gate holds the device queue so a
// request can be admitted before its handler runs. indigo_unregister_detach_abort() is used as the
// final probe that no entry is left: it returns INDIGO_NOT_FOUND unless an entry exists.

#include <arpa/inet.h>
#include <errno.h>
#include <netinet/in.h>
#include <netinet/tcp.h>
#include <poll.h>
#include <pthread.h>
#include <signal.h>
#include <stdarg.h>
#include <stdatomic.h>
#include <sys/socket.h>

#include <indigo/indigo_driver.h>
#include <indigo/indigo_server_tcp.h>
#include <indigo_drivers/agent_mount/indigo_agent_mount.h>
#include <indigo_drivers/mount_lx200/indigo_mount_lx200.h>
#include <indigo_drivers/mount_simulator/indigo_mount_simulator.h>

#include "serial_simulator_test_common.h"

#ifndef MOUNT_LX200_SIMULATOR_EXECUTABLE
#define MOUNT_LX200_SIMULATOR_EXECUTABLE "build/integration/mount_lx200_simulator"
#endif

// The generated public headers expose only the driver entry points.
#define MOUNT_SIMULATOR_NAME             "Mount Simulator"
#define MOUNT_LX200_NAME                 "Mount LX200"
#define MOUNT_LX200_GUIDER_NAME          "Mount LX200 (guider)"
#define MOUNT_TYPE_PROPERTY_NAME         "X_MOUNT_TYPE"

#define OWNER_A_NAME                     "Detach Test Owner A"
#define OWNER_B_NAME                     "Detach Test Owner B"
#define XML_ADAPTER_NAME                 "XML Driver Adapter"

#define RACE_REPETITIONS                 20
#define NETWORK_RACE_REPETITIONS         10
#define LX200_RACE_REPETITIONS           5

#define WAIT_UNTIL(condition, timeout) ({ double deadline_ = indigo_monotonic_time() + (timeout); bool ready_ = (condition); while (!ready_ && indigo_monotonic_time() < deadline_) { indigo_usleep(5000); ready_ = (condition); } ready_; })

static const simulator_driver_case mount_simulator_case = {
	"Mount Simulator",
	"indigo_mount_simulator",
	MOUNT_SIMULATOR_NAME,
	indigo_mount_simulator,
	false,
	NULL, 0, NULL, 0, NULL, 0, NULL, 0
};

static const simulator_driver_case lx200_case = {
	"LX200 Mount",
	"indigo_mount_lx200",
	MOUNT_LX200_NAME,
	indigo_mount_lx200,
	false,
	NULL, 0, NULL, 0, NULL, 0, NULL, 0
};

static const simulator_driver_case lx200_guider_case = {
	"LX200 Mount (guider)",
	"indigo_mount_lx200",
	MOUNT_LX200_GUIDER_NAME,
	indigo_mount_lx200,
	false,
	NULL, 0, NULL, 0, NULL, 0, NULL, 0
};

// Owners of the motion. They have no callbacks: an owner only sends requests and detaches.
static indigo_client owner_a = { OWNER_A_NAME, false, NULL, INDIGO_OK, INDIGO_VERSION_CURRENT, NULL, NULL, NULL, NULL, NULL, NULL, NULL, false, false };
static indigo_client owner_b = { OWNER_B_NAME, false, NULL, INDIGO_OK, INDIGO_VERSION_CURRENT, NULL, NULL, NULL, NULL, NULL, NULL, NULL, false, false };
static indigo_client unattached_client = { "Detach Test Unattached", false, NULL, INDIGO_OK, INDIGO_VERSION_CURRENT, NULL, NULL, NULL, NULL, NULL, NULL, NULL, false, false };

static bool debug_enabled = false;

#pragma mark - Log markers

// The bus logs "Aborting '<device>'.<property> started by detached client '<client>'" when it sends a
// registered release, "Forgetting '<device>'.<property> left registered by detached device" when it
// drops an entry of a detached device, and the mount base class logs "Releasing '<device>'.<property>,
// ..." when it could not register a started motion and released it at once.

#define MAX_LOG_MARKERS 512

static pthread_mutex_t log_marker_mutex = PTHREAD_MUTEX_INITIALIZER;
static char log_markers[MAX_LOG_MARKERS][INDIGO_VALUE_SIZE];
static int log_marker_count = 0;
static char marker_device[INDIGO_NAME_SIZE];
static int failures_at_reset = 0;

static void capture_log_message(indigo_log_levels level, const char *message) {
	if (strstr(message, "Aborting '") != NULL || strstr(message, "Releasing '") != NULL || strstr(message, "Forgetting '") != NULL) {
		pthread_mutex_lock(&log_marker_mutex);
		if (log_marker_count < MAX_LOG_MARKERS) {
			snprintf(log_markers[log_marker_count++], INDIGO_VALUE_SIZE, "%s", message);
		}
		pthread_mutex_unlock(&log_marker_mutex);
	}
	if (debug_enabled || level == INDIGO_LOG_ERROR) {
		fprintf(stderr, "    log: %s\n", message);
	}
}

static void reset_log_markers(const char *device_name) {
	pthread_mutex_lock(&log_marker_mutex);
	log_marker_count = 0;
	snprintf(marker_device, sizeof(marker_device), "%s", device_name);
	failures_at_reset = indigo_test_failures;
	pthread_mutex_unlock(&log_marker_mutex);
}

// Markers of one verb for one property of the current device, optionally naming a client.
static int count_markers(const char *verb, const char *property_name, const char *client_name) {
	char needle[INDIGO_VALUE_SIZE];
	snprintf(needle, sizeof(needle), "%s '%s'.%s", verb, marker_device, property_name);
	size_t length = strlen(needle);
	int count = 0;
	pthread_mutex_lock(&log_marker_mutex);
	for (int i = 0; i < log_marker_count; i++) {
		const char *line = log_markers[i];
		if (!strncmp(line, needle, length) && (line[length] == ' ' || line[length] == ',') && (client_name == NULL || strstr(line + length, client_name) != NULL)) {
			count++;
		}
	}
	pthread_mutex_unlock(&log_marker_mutex);
	return count;
}

static int total_markers(void) {
	pthread_mutex_lock(&log_marker_mutex);
	int count = log_marker_count;
	pthread_mutex_unlock(&log_marker_mutex);
	return count;
}

// Print the markers seen since the last reset when the current case failed since then.
static void dump_markers(void) {
	if (indigo_test_failures == failures_at_reset) {
		return;
	}
	pthread_mutex_lock(&log_marker_mutex);
	for (int i = 0; i < log_marker_count; i++) {
		fprintf(stderr, "    marker: %s\n", log_markers[i]);
	}
	pthread_mutex_unlock(&log_marker_mutex);
}

#pragma mark - Observer

// The observer is simulator_test_client with its property cache. It additionally records the device
// pointer of the watched mount (for queue fences and registry probes) and the Mount Agent state.

static char watched_device_name[INDIGO_NAME_SIZE];
static _Atomic(indigo_device *) watched_device = NULL;
static atomic_bool agent_lists_mount;
static atomic_bool agent_selected_mount;
static atomic_bool agent_defines_motion;

static void observe_agent(indigo_property *property, bool deleted) {
	if (strcmp(property->device, MOUNT_AGENT_NAME)) {
		return;
	}
	if (!strcmp(property->name, FILTER_MOUNT_LIST_PROPERTY_NAME)) {
		for (int i = 0; i < property->count; i++) {
			if (!strcmp(property->items[i].name, MOUNT_SIMULATOR_NAME)) {
				atomic_store(&agent_lists_mount, !deleted);
				atomic_store(&agent_selected_mount, !deleted && property->items[i].sw.value && property->state == INDIGO_OK_STATE);
			}
		}
	} else if (!strcmp(property->name, MOUNT_MOTION_DEC_PROPERTY_NAME) || *property->name == 0) {
		atomic_store(&agent_defines_motion, !deleted);
	}
}

static indigo_result observer_define_property(indigo_client *client, indigo_device *device, indigo_property *property, const char *message) {
	if (device != NULL && *watched_device_name && !strcmp(property->device, watched_device_name)) {
		atomic_store(&watched_device, device);
	}
	observe_agent(property, false);
	return simulator_client_define_property(client, device, property, message);
}

static indigo_result observer_update_property(indigo_client *client, indigo_device *device, indigo_property *property, const char *message) {
	observe_agent(property, false);
	return simulator_client_update_property(client, device, property, message);
}

static indigo_result observer_delete_property(indigo_client *client, indigo_device *device, indigo_property *property, const char *message) {
	observe_agent(property, true);
	return simulator_client_delete_property(client, device, property, message);
}

static void watch_device(const char *device_name) {
	snprintf(watched_device_name, sizeof(watched_device_name), "%s", device_name);
	atomic_store(&watched_device, NULL);
	reset_log_markers(device_name);
}

static bool switch_is(const char *property_name, const char *item_name, bool value) {
	indigo_item *item = find_cached_item(property_name, item_name);
	return item != NULL && item->sw.value == value;
}

static int state_of(const char *property_name) {
	indigo_property *property = find_cached_property(property_name);
	return property == NULL ? -1 : (int)property->state;
}

static bool dec_stopped(void) {
	return switch_is(MOUNT_MOTION_DEC_PROPERTY_NAME, MOUNT_MOTION_NORTH_ITEM_NAME, false) && switch_is(MOUNT_MOTION_DEC_PROPERTY_NAME, MOUNT_MOTION_SOUTH_ITEM_NAME, false) && state_of(MOUNT_MOTION_DEC_PROPERTY_NAME) != INDIGO_BUSY_STATE;
}

static bool ra_stopped(void) {
	return switch_is(MOUNT_MOTION_RA_PROPERTY_NAME, MOUNT_MOTION_EAST_ITEM_NAME, false) && switch_is(MOUNT_MOTION_RA_PROPERTY_NAME, MOUNT_MOTION_WEST_ITEM_NAME, false) && state_of(MOUNT_MOTION_RA_PROPERTY_NAME) != INDIGO_BUSY_STATE;
}

static bool axis_stopped(const char *property_name) {
	return !strcmp(property_name, MOUNT_MOTION_DEC_PROPERTY_NAME) ? dec_stopped() : ra_stopped();
}

#pragma mark - Device queue fence and gate

// A fence queued behind a request runs only after every handler queued before it has finished, so
// once it passed, the motion handler of that request and its commit are done. The gate occupies the
// device queue, so requests sent while it is closed are admitted by change_property() but their
// handlers run only after it opens.

static atomic_int fence_passes;
static atomic_bool gate_entered;
static atomic_bool gate_open = true;

static void fence_handler(indigo_device *device) {
	atomic_fetch_add(&fence_passes, 1);
}

static void gate_handler(indigo_device *device) {
	atomic_store(&gate_entered, true);
	double deadline = indigo_monotonic_time() + 30;
	while (!atomic_load(&gate_open) && indigo_monotonic_time() < deadline) {
		indigo_usleep(1000);
	}
}

static bool drain_device_queue(void) {
	indigo_device *device = atomic_load(&watched_device);
	if (device == NULL) {
		fprintf(stderr, "    no device pointer recorded for '%s'\n", watched_device_name);
		return false;
	}
	int before = atomic_load(&fence_passes);
	indigo_execute_handler(device, fence_handler);
	if (!WAIT_UNTIL(atomic_load(&fence_passes) > before, 15)) {
		fprintf(stderr, "    queue fence of '%s' did not pass\n", device->name);
		return false;
	}
	return true;
}

static bool close_gate(void) {
	indigo_device *device = atomic_load(&watched_device);
	if (device == NULL) {
		return false;
	}
	atomic_store(&gate_open, false);
	atomic_store(&gate_entered, false);
	indigo_execute_priority_handler_in(device, INDIGO_TASK_PRIORITY_URGENT, 0, gate_handler);
	return WAIT_UNTIL(atomic_load(&gate_entered), 10);
}

static void open_gate(void) {
	atomic_store(&gate_open, true);
}

// True when no entry is registered for the property of the watched device. The probe removes an entry
// it finds, which only happens when the assertion fails anyway.
static bool no_entry(const char *property_name) {
	indigo_device *device = atomic_load(&watched_device);
	return device != NULL && indigo_unregister_detach_abort(device, property_name) == INDIGO_NOT_FOUND;
}

static void detach_owners(void) {
	indigo_detach_client(&owner_a);
	indigo_detach_client(&owner_b);
}

static bool attach_owners(void) {
	return indigo_attach_client(&owner_a) == INDIGO_OK && indigo_attach_client(&owner_b) == INDIGO_OK;
}

// Request manual motion from an owner and wait until its handler and commit have run.
static bool owner_moves(indigo_client *owner, const char *property_name, const char *item_name) {
	if (indigo_change_switch_property_1(owner, watched_device_name, property_name, item_name, true) != INDIGO_OK) {
		return false;
	}
	if (!drain_device_queue()) {
		return false;
	}
	if (!switch_is(property_name, item_name, true) || state_of(property_name) == INDIGO_ALERT_STATE) {
		fprintf(stderr, "    %s.%s did not start (state %d)\n", property_name, item_name, state_of(property_name));
		return false;
	}
	return true;
}

// The motion ended: the items are off and not BUSY, and stay so after every queued handler finished.
static bool motion_ended(const char *property_name) {
	if (!WAIT_UNTIL(axis_stopped(property_name), 10)) {
		fprintf(stderr, "    %s did not stop\n", property_name);
		return false;
	}
	return drain_device_queue() && axis_stopped(property_name);
}

#pragma mark - Mount simulator lifecycle

static bool simulator_up = false;

static bool unpark(const char *device_name) {
	// some LX200 profiles have no park at all
	if (find_cached_property(MOUNT_PARK_PROPERTY_NAME) == NULL) {
		return true;
	}
	if (switch_is(MOUNT_PARK_PROPERTY_NAME, MOUNT_PARK_UNPARKED_ITEM_NAME, true) && state_of(MOUNT_PARK_PROPERTY_NAME) == INDIGO_OK_STATE) {
		return true;
	}
	if (indigo_change_switch_property_1(&simulator_test_client, device_name, MOUNT_PARK_PROPERTY_NAME, MOUNT_PARK_UNPARKED_ITEM_NAME, true) != INDIGO_OK) {
		return false;
	}
	return WAIT_UNTIL(switch_is(MOUNT_PARK_PROPERTY_NAME, MOUNT_PARK_UNPARKED_ITEM_NAME, true) && state_of(MOUNT_PARK_PROPERTY_NAME) == INDIGO_OK_STATE, 30);
}

static bool start_simulator_mount_unconnected(void) {
	watch_device(MOUNT_SIMULATOR_NAME);
	if (!bring_up_serial_driver(&mount_simulator_case)) {
		return false;
	}
	simulator_up = true;
	enumerate_simulator_device();
	return attach_owners();
}

static bool start_simulator_mount(void) {
	if (!start_simulator_mount_unconnected()) {
		return false;
	}
	if (!connect_serial_device(&mount_simulator_case, NULL)) {
		return false;
	}
	return unpark(MOUNT_SIMULATOR_NAME);
}

static void stop_simulator_mount(void) {
	open_gate();
	detach_owners();
	if (simulator_up) {
		stop_serial_driver(&mount_simulator_case);
		simulator_up = false;
	}
}

#pragma mark - Registry cases (bus API only)

#define REGISTRY_DEVICE_NAME  "Detach Abort Test Device"
#define REGISTRY_PROPERTY     "TEST_OPERATION"
#define REGISTRY_TOKEN        0x5eedULL
#define REGISTRY_MAX_PROBE    1024

static indigo_device registry_device;
static atomic_int registry_requests;
static char registry_last_name[INDIGO_NAME_SIZE];
static bool registry_last_values[2];
static indigo_token registry_last_token;
static bool registry_last_client_was_null;
static bool registry_reenter = false;
static indigo_result registry_reenter_unregister = INDIGO_OK;
static indigo_result registry_reenter_register = INDIGO_FAILED;
static bool registry_up = false;

static indigo_property *registry_release(const char *name) {
	indigo_property *property = indigo_init_switch_property(NULL, REGISTRY_DEVICE_NAME, name, NULL, NULL, INDIGO_OK_STATE, INDIGO_RW_PERM, INDIGO_AT_MOST_ONE_RULE, 2);
	indigo_init_switch_item(property->items + 0, "FIRST", NULL, false);
	indigo_init_switch_item(property->items + 1, "SECOND", NULL, false);
	return property;
}

static indigo_result registry_change_property(indigo_device *device, indigo_client *client, indigo_property *property) {
	if (strncmp(property->name, "TEST_", 5)) {
		return INDIGO_OK;
	}
	snprintf(registry_last_name, sizeof(registry_last_name), "%s", property->name);
	for (int i = 0; i < 2; i++) {
		registry_last_values[i] = i < property->count ? property->items[i].sw.value : true;
	}
	registry_last_token = property->access_token;
	registry_last_client_was_null = client == NULL;
	if (registry_reenter) {
		// a driver unregisters (and may register again) from inside the release it receives
		registry_reenter = false;
		registry_reenter_unregister = indigo_unregister_detach_abort(device, property->name);
		indigo_client_ref owner = indigo_current_client_ref(&owner_b);
		indigo_property *again = registry_release(property->name);
		registry_reenter_register = indigo_register_detach_abort(device, &owner, again, again);
		indigo_release_property(again);
	}
	atomic_fetch_add(&registry_requests, 1);
	return INDIGO_OK;
}

static bool start_registry(void) {
	reset_log_markers(REGISTRY_DEVICE_NAME);
	atomic_store(&registry_requests, 0);
	*registry_last_name = 0;
	registry_reenter = false;
	if (indigo_start() != INDIGO_OK) {
		return false;
	}
	registry_up = true;
	memset(&registry_device, 0, sizeof(registry_device));
	snprintf(registry_device.name, sizeof(registry_device.name), "%s", REGISTRY_DEVICE_NAME);
	registry_device.change_property = registry_change_property;
	if (indigo_attach_device(&registry_device) != INDIGO_OK) {
		return false;
	}
	// a device locked by a client: its own release must carry this token to pass the bus check
	registry_device.access_token = REGISTRY_TOKEN;
	atomic_store(&registry_requests, 0);
	return attach_owners();
}

static void stop_registry(void) {
	if (registry_up) {
		char name[INDIGO_NAME_SIZE];
		indigo_unregister_detach_abort(&registry_device, REGISTRY_PROPERTY);
		for (int i = 0; i < REGISTRY_MAX_PROBE; i++) {
			snprintf(name, sizeof(name), "TEST_%d", i);
			indigo_unregister_detach_abort(&registry_device, name);
		}
		detach_owners();
		indigo_detach_device(&registry_device);
		indigo_stop();
		registry_up = false;
	}
}

static indigo_result registry_register(indigo_client *owner, const char *name) {
	indigo_client_ref record = indigo_current_client_ref(owner);
	indigo_property *release = registry_release(name);
	indigo_result result = indigo_register_detach_abort(&registry_device, &record, release, release);
	indigo_release_property(release);
	return result;
}

static void registry_client_detach_sends_registered_release(void) {
	indigo_property *release = NULL;
	SERIAL_CHECK_TRUE(start_registry());
	indigo_client_ref record = indigo_current_client_ref(&owner_a);
	release = registry_release(REGISTRY_PROPERTY);
	SERIAL_CHECK_EQ_INT(INDIGO_OK, indigo_register_detach_abort(&registry_device, &record, release, release));
	// the release is copied at registration, later changes of the caller's property do not leak into it
	release->items[0].sw.value = true;
	snprintf(release->name, sizeof(release->name), "TEST_CHANGED");
	SERIAL_CHECK_EQ_INT(0, atomic_load(&registry_requests));
	SERIAL_CHECK_EQ_INT(INDIGO_OK, indigo_detach_client(&owner_b));
	SERIAL_CHECK_EQ_INT(0, atomic_load(&registry_requests));
	SERIAL_CHECK_EQ_INT(INDIGO_OK, indigo_detach_client(&owner_a));
	SERIAL_CHECK_EQ_INT(1, atomic_load(&registry_requests));
	SERIAL_CHECK_TRUE(!strcmp(registry_last_name, REGISTRY_PROPERTY));
	SERIAL_CHECK_TRUE(!registry_last_values[0] && !registry_last_values[1]);
	SERIAL_CHECK_TRUE(registry_last_token == REGISTRY_TOKEN);
	SERIAL_CHECK_TRUE(registry_last_client_was_null);
	SERIAL_CHECK_EQ_INT(1, count_markers("Aborting", REGISTRY_PROPERTY, OWNER_A_NAME));
	// the entry was removed with the release
	SERIAL_CHECK_EQ_INT(INDIGO_NOT_FOUND, indigo_unregister_detach_abort(&registry_device, REGISTRY_PROPERTY));
	SERIAL_CHECK_EQ_INT(INDIGO_OK, indigo_attach_client(&owner_a));
	SERIAL_CHECK_EQ_INT(INDIGO_OK, indigo_detach_client(&owner_a));
	SERIAL_CHECK_EQ_INT(1, atomic_load(&registry_requests));
cleanup:
	indigo_release_property(release);
	stop_registry();
}

static void registry_refuses_operation_without_attached_owner(void) {
	indigo_property *release = NULL;
	SERIAL_CHECK_TRUE(start_registry());
	release = registry_release(REGISTRY_PROPERTY);
	indigo_client_ref record = { NULL, 0 };
	SERIAL_CHECK_EQ_INT(INDIGO_NOT_FOUND, indigo_register_detach_abort(&registry_device, &record, release, release));
	// a client that is not attached has no reference, and a forged one does not match either
	record = indigo_current_client_ref(&unattached_client);
	SERIAL_CHECK_TRUE(record.client == NULL && record.generation == 0);
	SERIAL_CHECK_EQ_INT(INDIGO_NOT_FOUND, indigo_register_detach_abort(&registry_device, &record, release, release));
	record.client = &unattached_client;
	record.generation = indigo_current_client_ref(&owner_a).generation;
	SERIAL_CHECK_EQ_INT(INDIGO_NOT_FOUND, indigo_register_detach_abort(&registry_device, &record, release, release));
	record = indigo_current_client_ref(&owner_a);
	SERIAL_CHECK_EQ_INT(INDIGO_FAILED, indigo_register_detach_abort(NULL, &record, release, release));
	SERIAL_CHECK_EQ_INT(INDIGO_FAILED, indigo_register_detach_abort(&registry_device, NULL, release, release));
	SERIAL_CHECK_EQ_INT(INDIGO_FAILED, indigo_register_detach_abort(&registry_device, &record, NULL, release));
	SERIAL_CHECK_EQ_INT(INDIGO_FAILED, indigo_register_detach_abort(&registry_device, &record, release, NULL));
	SERIAL_CHECK_EQ_INT(INDIGO_FAILED, indigo_unregister_detach_abort(NULL, REGISTRY_PROPERTY));
	SERIAL_CHECK_EQ_INT(INDIGO_FAILED, indigo_unregister_detach_abort(&registry_device, NULL));
	SERIAL_CHECK_EQ_INT(INDIGO_NOT_FOUND, indigo_unregister_detach_abort(&registry_device, REGISTRY_PROPERTY));
	SERIAL_CHECK_EQ_INT(INDIGO_OK, indigo_detach_client(&owner_a));
	SERIAL_CHECK_EQ_INT(0, atomic_load(&registry_requests));
	SERIAL_CHECK_EQ_INT(0, total_markers());
cleanup:
	indigo_release_property(release);
	stop_registry();
}

static void registry_later_registration_replaces_owner(void) {
	SERIAL_CHECK_TRUE(start_registry());
	SERIAL_CHECK_EQ_INT(INDIGO_OK, registry_register(&owner_a, REGISTRY_PROPERTY));
	SERIAL_CHECK_EQ_INT(INDIGO_OK, registry_register(&owner_b, REGISTRY_PROPERTY));
	SERIAL_CHECK_EQ_INT(INDIGO_OK, indigo_detach_client(&owner_a));
	SERIAL_CHECK_EQ_INT(0, atomic_load(&registry_requests));
	SERIAL_CHECK_EQ_INT(INDIGO_OK, indigo_detach_client(&owner_b));
	SERIAL_CHECK_EQ_INT(1, atomic_load(&registry_requests));
	SERIAL_CHECK_EQ_INT(1, count_markers("Aborting", REGISTRY_PROPERTY, OWNER_B_NAME));
	SERIAL_CHECK_EQ_INT(0, count_markers("Aborting", REGISTRY_PROPERTY, OWNER_A_NAME));
cleanup:
	stop_registry();
}

static void registry_owner_is_read_at_registration(void) {
	indigo_property *release = NULL;
	SERIAL_CHECK_TRUE(start_registry());
	// the device's record of the requester is dereferenced once, a later write does not move the entry
	indigo_client_ref record = indigo_current_client_ref(&owner_a);
	release = registry_release(REGISTRY_PROPERTY);
	SERIAL_CHECK_EQ_INT(INDIGO_OK, indigo_register_detach_abort(&registry_device, &record, release, release));
	record = indigo_current_client_ref(&owner_b);
	SERIAL_CHECK_EQ_INT(INDIGO_OK, indigo_detach_client(&owner_b));
	SERIAL_CHECK_EQ_INT(0, atomic_load(&registry_requests));
	SERIAL_CHECK_EQ_INT(INDIGO_OK, indigo_detach_client(&owner_a));
	SERIAL_CHECK_EQ_INT(1, atomic_load(&registry_requests));
cleanup:
	indigo_release_property(release);
	stop_registry();
}

// A reference identifies one attachment: after the owner detached, a client attached at the same address (here the
// same indigo_client re-attached, as the allocator does with a freed XML adapter) does not match the old reference.
static void registry_stale_attachment_is_refused(void) {
	indigo_property *release = NULL;
	SERIAL_CHECK_TRUE(start_registry());
	indigo_client_ref record = indigo_current_client_ref(&owner_a);
	SERIAL_CHECK_TRUE(record.client == &owner_a && record.generation != 0);
	SERIAL_CHECK_TRUE(indigo_current_client_ref(&owner_b).generation != record.generation);
	SERIAL_CHECK_EQ_INT(INDIGO_OK, indigo_detach_client(&owner_a));
	SERIAL_CHECK_EQ_INT(INDIGO_OK, indigo_attach_client(&owner_a));
	indigo_client_ref current = indigo_current_client_ref(&owner_a);
	SERIAL_CHECK_TRUE(current.client == &owner_a && current.generation != 0 && current.generation != record.generation);
	release = registry_release(REGISTRY_PROPERTY);
	SERIAL_CHECK_EQ_INT(INDIGO_NOT_FOUND, indigo_register_detach_abort(&registry_device, &record, release, release));
	SERIAL_CHECK_EQ_INT(INDIGO_NOT_FOUND, indigo_unregister_detach_abort(&registry_device, REGISTRY_PROPERTY));
	// the current attachment registers, and its detach sends the release exactly once
	SERIAL_CHECK_EQ_INT(INDIGO_OK, indigo_register_detach_abort(&registry_device, &current, release, release));
	SERIAL_CHECK_EQ_INT(INDIGO_OK, indigo_detach_client(&owner_a));
	SERIAL_CHECK_EQ_INT(1, atomic_load(&registry_requests));
	SERIAL_CHECK_EQ_INT(1, count_markers("Aborting", REGISTRY_PROPERTY, OWNER_A_NAME));
	SERIAL_CHECK_EQ_INT(INDIGO_OK, indigo_attach_client(&owner_a));
cleanup:
	indigo_release_property(release);
	stop_registry();
}

static void registry_unregister_removes_entry(void) {
	SERIAL_CHECK_TRUE(start_registry());
	SERIAL_CHECK_EQ_INT(INDIGO_OK, registry_register(&owner_a, REGISTRY_PROPERTY));
	SERIAL_CHECK_EQ_INT(INDIGO_OK, registry_register(&owner_a, "TEST_OTHER"));
	SERIAL_CHECK_EQ_INT(INDIGO_OK, indigo_unregister_detach_abort(&registry_device, REGISTRY_PROPERTY));
	SERIAL_CHECK_EQ_INT(INDIGO_NOT_FOUND, indigo_unregister_detach_abort(&registry_device, REGISTRY_PROPERTY));
	// entries are per property: the other one is still registered and released on detach
	SERIAL_CHECK_EQ_INT(INDIGO_OK, indigo_detach_client(&owner_a));
	SERIAL_CHECK_EQ_INT(1, atomic_load(&registry_requests));
	SERIAL_CHECK_TRUE(!strcmp(registry_last_name, "TEST_OTHER"));
	SERIAL_CHECK_EQ_INT(0, count_markers("Aborting", REGISTRY_PROPERTY, NULL));
	SERIAL_CHECK_EQ_INT(1, count_markers("Aborting", "TEST_OTHER", OWNER_A_NAME));
cleanup:
	stop_registry();
}

static void registry_full_registry_is_reported(void) {
	char name[INDIGO_NAME_SIZE];
	int registered = 0;
	indigo_result result = INDIGO_OK;
	SERIAL_CHECK_TRUE(start_registry());
	for (; registered < REGISTRY_MAX_PROBE; registered++) {
		snprintf(name, sizeof(name), "TEST_%d", registered);
		result = registry_register(&owner_a, name);
		if (result != INDIGO_OK) {
			break;
		}
	}
	SERIAL_CHECK_EQ_INT(INDIGO_TOO_MANY_ELEMENTS, result);
	SERIAL_CHECK_TRUE(registered >= 16);
	// a full registry still accepts a registration that replaces an existing entry
	SERIAL_CHECK_EQ_INT(INDIGO_OK, registry_register(&owner_b, "TEST_0"));
	for (int i = 1; i < registered; i++) {
		snprintf(name, sizeof(name), "TEST_%d", i);
		SERIAL_CHECK_EQ_INT(INDIGO_OK, indigo_unregister_detach_abort(&registry_device, name));
	}
	SERIAL_CHECK_EQ_INT(INDIGO_OK, indigo_detach_client(&owner_a));
	SERIAL_CHECK_EQ_INT(0, atomic_load(&registry_requests));
	SERIAL_CHECK_EQ_INT(INDIGO_OK, indigo_detach_client(&owner_b));
	SERIAL_CHECK_EQ_INT(1, atomic_load(&registry_requests));
	SERIAL_CHECK_TRUE(!strcmp(registry_last_name, "TEST_0"));
cleanup:
	stop_registry();
}

static void registry_device_detach_forgets_entries(void) {
	SERIAL_CHECK_TRUE(start_registry());
	SERIAL_CHECK_EQ_INT(INDIGO_OK, registry_register(&owner_a, REGISTRY_PROPERTY));
	SERIAL_CHECK_EQ_INT(INDIGO_OK, indigo_detach_device(&registry_device));
	SERIAL_CHECK_EQ_INT(1, count_markers("Forgetting", REGISTRY_PROPERTY, NULL));
	SERIAL_CHECK_EQ_INT(INDIGO_OK, indigo_detach_client(&owner_a));
	SERIAL_CHECK_EQ_INT(0, atomic_load(&registry_requests));
	SERIAL_CHECK_EQ_INT(0, count_markers("Aborting", REGISTRY_PROPERTY, NULL));
cleanup:
	stop_registry();
}

static void registry_release_may_reenter_registry(void) {
	SERIAL_CHECK_TRUE(start_registry());
	SERIAL_CHECK_EQ_INT(INDIGO_OK, registry_register(&owner_a, REGISTRY_PROPERTY));
	registry_reenter = true;
	registry_reenter_unregister = INDIGO_OK;
	registry_reenter_register = INDIGO_FAILED;
	SERIAL_CHECK_EQ_INT(INDIGO_OK, indigo_detach_client(&owner_a));
	SERIAL_CHECK_EQ_INT(1, atomic_load(&registry_requests));
	// the entry is removed before its release is sent, a new registration from the handler survives
	SERIAL_CHECK_EQ_INT(INDIGO_NOT_FOUND, registry_reenter_unregister);
	SERIAL_CHECK_EQ_INT(INDIGO_OK, registry_reenter_register);
	SERIAL_CHECK_EQ_INT(INDIGO_OK, indigo_detach_client(&owner_b));
	SERIAL_CHECK_EQ_INT(2, atomic_load(&registry_requests));
	SERIAL_CHECK_EQ_INT(1, count_markers("Aborting", REGISTRY_PROPERTY, OWNER_B_NAME));
cleanup:
	registry_reenter = false;
	stop_registry();
}

#pragma mark - Mount simulator cases

static void simulator_owner_detach_releases_motion(void) {
	SERIAL_CHECK_TRUE(start_simulator_mount());
	SERIAL_CHECK_TRUE(owner_moves(&owner_a, MOUNT_MOTION_DEC_PROPERTY_NAME, MOUNT_MOTION_NORTH_ITEM_NAME));
	SERIAL_CHECK_EQ_INT(0, total_markers());
	SERIAL_CHECK_EQ_INT(INDIGO_OK, indigo_detach_client(&owner_a));
	SERIAL_CHECK_EQ_INT(1, count_markers("Aborting", MOUNT_MOTION_DEC_PROPERTY_NAME, OWNER_A_NAME));
	SERIAL_CHECK_TRUE(motion_ended(MOUNT_MOTION_DEC_PROPERTY_NAME));
	SERIAL_CHECK_EQ_INT(0, count_markers("Releasing", MOUNT_MOTION_DEC_PROPERTY_NAME, NULL));
	SERIAL_CHECK_TRUE(no_entry(MOUNT_MOTION_DEC_PROPERTY_NAME));
	SERIAL_CHECK_TRUE(no_entry(MOUNT_MOTION_RA_PROPERTY_NAME));
cleanup:
	dump_markers();
	stop_simulator_mount();
}

static void simulator_released_motion_is_not_released_again(void) {
	SERIAL_CHECK_TRUE(start_simulator_mount());
	SERIAL_CHECK_TRUE(owner_moves(&owner_a, MOUNT_MOTION_DEC_PROPERTY_NAME, MOUNT_MOTION_NORTH_ITEM_NAME));
	SERIAL_CHECK_EQ_INT(INDIGO_OK, indigo_change_switch_property_1(&owner_a, MOUNT_SIMULATOR_NAME, MOUNT_MOTION_DEC_PROPERTY_NAME, MOUNT_MOTION_NORTH_ITEM_NAME, false));
	SERIAL_CHECK_TRUE(motion_ended(MOUNT_MOTION_DEC_PROPERTY_NAME));
	SERIAL_CHECK_EQ_INT(INDIGO_OK, indigo_detach_client(&owner_a));
	SERIAL_CHECK_TRUE(drain_device_queue());
	SERIAL_CHECK_EQ_INT(0, total_markers());
	SERIAL_CHECK_TRUE(no_entry(MOUNT_MOTION_DEC_PROPERTY_NAME));
cleanup:
	stop_simulator_mount();
}

static void simulator_abort_by_other_client_unregisters(void) {
	SERIAL_CHECK_TRUE(start_simulator_mount());
	SERIAL_CHECK_TRUE(owner_moves(&owner_a, MOUNT_MOTION_DEC_PROPERTY_NAME, MOUNT_MOTION_NORTH_ITEM_NAME));
	SERIAL_CHECK_TRUE(owner_moves(&owner_a, MOUNT_MOTION_RA_PROPERTY_NAME, MOUNT_MOTION_WEST_ITEM_NAME));
	SERIAL_CHECK_EQ_INT(INDIGO_OK, indigo_change_switch_property_1(&owner_b, MOUNT_SIMULATOR_NAME, MOUNT_ABORT_MOTION_PROPERTY_NAME, MOUNT_ABORT_MOTION_ITEM_NAME, true));
	SERIAL_CHECK_TRUE(motion_ended(MOUNT_MOTION_DEC_PROPERTY_NAME));
	SERIAL_CHECK_TRUE(motion_ended(MOUNT_MOTION_RA_PROPERTY_NAME));
	SERIAL_CHECK_TRUE(WAIT_UNTIL(state_of(MOUNT_ABORT_MOTION_PROPERTY_NAME) == INDIGO_OK_STATE, 10));
	SERIAL_CHECK_EQ_INT(INDIGO_OK, indigo_detach_client(&owner_a));
	SERIAL_CHECK_TRUE(drain_device_queue());
	SERIAL_CHECK_EQ_INT(0, total_markers());
	SERIAL_CHECK_TRUE(no_entry(MOUNT_MOTION_DEC_PROPERTY_NAME));
	SERIAL_CHECK_TRUE(no_entry(MOUNT_MOTION_RA_PROPERTY_NAME));
cleanup:
	stop_simulator_mount();
}

static void simulator_takeover_moves_ownership(void) {
	SERIAL_CHECK_TRUE(start_simulator_mount());
	// B reverses A's DEC motion and repeats A's RA motion; both axes now belong to B
	SERIAL_CHECK_TRUE(owner_moves(&owner_a, MOUNT_MOTION_DEC_PROPERTY_NAME, MOUNT_MOTION_NORTH_ITEM_NAME));
	SERIAL_CHECK_TRUE(owner_moves(&owner_a, MOUNT_MOTION_RA_PROPERTY_NAME, MOUNT_MOTION_WEST_ITEM_NAME));
	SERIAL_CHECK_TRUE(owner_moves(&owner_b, MOUNT_MOTION_DEC_PROPERTY_NAME, MOUNT_MOTION_SOUTH_ITEM_NAME));
	SERIAL_CHECK_TRUE(owner_moves(&owner_b, MOUNT_MOTION_RA_PROPERTY_NAME, MOUNT_MOTION_WEST_ITEM_NAME));
	SERIAL_CHECK_EQ_INT(INDIGO_OK, indigo_detach_client(&owner_a));
	SERIAL_CHECK_TRUE(drain_device_queue());
	SERIAL_CHECK_EQ_INT(0, total_markers());
	SERIAL_CHECK_TRUE(switch_is(MOUNT_MOTION_DEC_PROPERTY_NAME, MOUNT_MOTION_SOUTH_ITEM_NAME, true));
	SERIAL_CHECK_TRUE(switch_is(MOUNT_MOTION_RA_PROPERTY_NAME, MOUNT_MOTION_WEST_ITEM_NAME, true));
	SERIAL_CHECK_EQ_INT(INDIGO_OK, indigo_detach_client(&owner_b));
	SERIAL_CHECK_EQ_INT(1, count_markers("Aborting", MOUNT_MOTION_DEC_PROPERTY_NAME, OWNER_B_NAME));
	SERIAL_CHECK_EQ_INT(1, count_markers("Aborting", MOUNT_MOTION_RA_PROPERTY_NAME, OWNER_B_NAME));
	SERIAL_CHECK_TRUE(motion_ended(MOUNT_MOTION_DEC_PROPERTY_NAME));
	SERIAL_CHECK_TRUE(motion_ended(MOUNT_MOTION_RA_PROPERTY_NAME));
	SERIAL_CHECK_EQ_INT(2, total_markers());
cleanup:
	dump_markers();
	stop_simulator_mount();
}

static void simulator_release_by_other_client_unregisters(void) {
	SERIAL_CHECK_TRUE(start_simulator_mount());
	SERIAL_CHECK_TRUE(owner_moves(&owner_a, MOUNT_MOTION_DEC_PROPERTY_NAME, MOUNT_MOTION_NORTH_ITEM_NAME));
	SERIAL_CHECK_EQ_INT(INDIGO_OK, indigo_change_switch_property_1_with_token(&owner_b, MOUNT_SIMULATOR_NAME, 0, MOUNT_MOTION_DEC_PROPERTY_NAME, MOUNT_MOTION_NORTH_ITEM_NAME, false));
	SERIAL_CHECK_TRUE(motion_ended(MOUNT_MOTION_DEC_PROPERTY_NAME));
	SERIAL_CHECK_EQ_INT(INDIGO_OK, indigo_detach_client(&owner_a));
	SERIAL_CHECK_EQ_INT(INDIGO_OK, indigo_detach_client(&owner_b));
	SERIAL_CHECK_TRUE(drain_device_queue());
	SERIAL_CHECK_EQ_INT(0, total_markers());
	SERIAL_CHECK_TRUE(no_entry(MOUNT_MOTION_DEC_PROPERTY_NAME));
cleanup:
	stop_simulator_mount();
}

static void simulator_disconnect_and_shutdown_unregister(void) {
	bool shut_down = false;
	SERIAL_CHECK_TRUE(start_simulator_mount());
	SERIAL_CHECK_TRUE(owner_moves(&owner_a, MOUNT_MOTION_DEC_PROPERTY_NAME, MOUNT_MOTION_NORTH_ITEM_NAME));
	SERIAL_CHECK_TRUE(owner_moves(&owner_a, MOUNT_MOTION_RA_PROPERTY_NAME, MOUNT_MOTION_EAST_ITEM_NAME));
	disconnect_serial_device(&mount_simulator_case);
	SERIAL_CHECK_TRUE(context.disconnected && !context.connected);
	SERIAL_CHECK_TRUE(no_entry(MOUNT_MOTION_DEC_PROPERTY_NAME));
	SERIAL_CHECK_TRUE(no_entry(MOUNT_MOTION_RA_PROPERTY_NAME));
	SERIAL_CHECK_EQ_INT(INDIGO_OK, indigo_detach_client(&owner_a));
	SERIAL_CHECK_EQ_INT(0, total_markers());
	// again, and this time the driver detaches its devices while the owner is still attached: nothing is
	// left for the bus to forget and the owner's later detach sends nothing to the detached device
	SERIAL_CHECK_EQ_INT(INDIGO_OK, indigo_attach_client(&owner_a));
	SERIAL_CHECK_TRUE(connect_serial_device(&mount_simulator_case, NULL));
	SERIAL_CHECK_TRUE(unpark(MOUNT_SIMULATOR_NAME));
	SERIAL_CHECK_TRUE(owner_moves(&owner_a, MOUNT_MOTION_DEC_PROPERTY_NAME, MOUNT_MOTION_SOUTH_ITEM_NAME));
	disconnect_serial_device(&mount_simulator_case);
	SERIAL_CHECK_TRUE(context.disconnected && !context.connected);
	SERIAL_CHECK_EQ_INT(INDIGO_OK, mount_simulator_case.entry(INDIGO_DRIVER_SHUTDOWN, NULL));
	shut_down = true;
	atomic_store(&watched_device, NULL);
	SERIAL_CHECK_EQ_INT(0, count_markers("Forgetting", MOUNT_MOTION_DEC_PROPERTY_NAME, NULL));
	SERIAL_CHECK_EQ_INT(INDIGO_OK, indigo_detach_client(&owner_a));
	SERIAL_CHECK_EQ_INT(0, total_markers());
cleanup:
	dump_markers();
	if (shut_down) {
		detach_owners();
		indigo_detach_client(&simulator_test_client);
		indigo_stop();
		release_cached_properties();
		simulator_up = false;
	}
	stop_simulator_mount();
}

static void simulator_finite_goto_survives_owner_detach(void) {
	SERIAL_CHECK_TRUE(start_simulator_mount());
	double ra = cached_number_value(MOUNT_EQUATORIAL_COORDINATES_PROPERTY_NAME, MOUNT_EQUATORIAL_COORDINATES_RA_ITEM_NAME);
	double dec = cached_number_value(MOUNT_EQUATORIAL_COORDINATES_PROPERTY_NAME, MOUNT_EQUATORIAL_COORDINATES_DEC_ITEM_NAME);
	double target_ra = fmod(ra + 0.5, 24);
	double target_dec = dec > 0 ? dec - 5 : dec + 5;
	const char *items[] = { MOUNT_EQUATORIAL_COORDINATES_RA_ITEM_NAME, MOUNT_EQUATORIAL_COORDINATES_DEC_ITEM_NAME };
	double values[] = { target_ra, target_dec };
	SERIAL_CHECK_EQ_INT(INDIGO_OK, indigo_change_number_property(&owner_a, MOUNT_SIMULATOR_NAME, MOUNT_EQUATORIAL_COORDINATES_PROPERTY_NAME, 2, items, values));
	SERIAL_CHECK_TRUE(WAIT_UNTIL(state_of(MOUNT_EQUATORIAL_COORDINATES_PROPERTY_NAME) == INDIGO_BUSY_STATE, 10));
	SERIAL_CHECK_EQ_INT(INDIGO_OK, indigo_detach_client(&owner_a));
	SERIAL_CHECK_EQ_INT(0, total_markers());
	SERIAL_CHECK_TRUE(state_of(MOUNT_EQUATORIAL_COORDINATES_PROPERTY_NAME) == INDIGO_BUSY_STATE);
	SERIAL_CHECK_TRUE(WAIT_UNTIL(state_of(MOUNT_EQUATORIAL_COORDINATES_PROPERTY_NAME) == INDIGO_OK_STATE, 60));
	SERIAL_CHECK_TRUE(fabs(cached_number_value(MOUNT_EQUATORIAL_COORDINATES_PROPERTY_NAME, MOUNT_EQUATORIAL_COORDINATES_DEC_ITEM_NAME) - target_dec) < 0.01);
	SERIAL_CHECK_EQ_INT(0, total_markers());
cleanup:
	stop_simulator_mount();
}

// The request is admitted, then the mount is parked before its handler runs: the handler's parked
// guard refuses it with ALERT and the guard's commit registers nothing.
static void simulator_parked_guard_refusal_registers_nothing(void) {
	SERIAL_CHECK_TRUE(start_simulator_mount());
	SERIAL_CHECK_TRUE(close_gate());
	SERIAL_CHECK_EQ_INT(INDIGO_OK, indigo_change_switch_property_1(&owner_a, MOUNT_SIMULATOR_NAME, MOUNT_MOTION_DEC_PROPERTY_NAME, MOUNT_MOTION_NORTH_ITEM_NAME, true));
	SERIAL_CHECK_EQ_INT(INDIGO_OK, indigo_change_switch_property_1(&simulator_test_client, MOUNT_SIMULATOR_NAME, MOUNT_PARK_PROPERTY_NAME, MOUNT_PARK_PARKED_ITEM_NAME, true));
	open_gate();
	SERIAL_CHECK_TRUE(WAIT_UNTIL(state_of(MOUNT_MOTION_DEC_PROPERTY_NAME) == INDIGO_ALERT_STATE, 10));
	SERIAL_CHECK_TRUE(drain_device_queue());
	SERIAL_CHECK_EQ_INT(INDIGO_OK, indigo_detach_client(&owner_a));
	SERIAL_CHECK_TRUE(drain_device_queue());
	SERIAL_CHECK_EQ_INT(0, total_markers());
	SERIAL_CHECK_TRUE(no_entry(MOUNT_MOTION_DEC_PROPERTY_NAME));
	SERIAL_CHECK_TRUE(WAIT_UNTIL(state_of(MOUNT_PARK_PROPERTY_NAME) == INDIGO_OK_STATE && switch_is(MOUNT_PARK_PROPERTY_NAME, MOUNT_PARK_PARKED_ITEM_NAME, true), 60));
cleanup:
	stop_simulator_mount();
}

// A registered motion, then a direction change from the same owner refused by the parked guard: the
// guard's commit sees ALERT and removes the entry, the owner's detach sends nothing.
static void simulator_parked_guard_refusal_unregisters_motion(void) {
	SERIAL_CHECK_TRUE(start_simulator_mount());
	SERIAL_CHECK_TRUE(owner_moves(&owner_a, MOUNT_MOTION_DEC_PROPERTY_NAME, MOUNT_MOTION_NORTH_ITEM_NAME));
	SERIAL_CHECK_TRUE(close_gate());
	SERIAL_CHECK_EQ_INT(INDIGO_OK, indigo_change_switch_property_1(&owner_a, MOUNT_SIMULATOR_NAME, MOUNT_MOTION_DEC_PROPERTY_NAME, MOUNT_MOTION_SOUTH_ITEM_NAME, true));
	SERIAL_CHECK_EQ_INT(INDIGO_OK, indigo_change_switch_property_1(&simulator_test_client, MOUNT_SIMULATOR_NAME, MOUNT_PARK_PROPERTY_NAME, MOUNT_PARK_PARKED_ITEM_NAME, true));
	open_gate();
	SERIAL_CHECK_TRUE(WAIT_UNTIL(state_of(MOUNT_MOTION_DEC_PROPERTY_NAME) == INDIGO_ALERT_STATE, 10));
	SERIAL_CHECK_TRUE(drain_device_queue());
	SERIAL_CHECK_EQ_INT(INDIGO_OK, indigo_detach_client(&owner_a));
	SERIAL_CHECK_TRUE(drain_device_queue());
	SERIAL_CHECK_EQ_INT(0, total_markers());
	SERIAL_CHECK_TRUE(no_entry(MOUNT_MOTION_DEC_PROPERTY_NAME));
	SERIAL_CHECK_TRUE(WAIT_UNTIL(state_of(MOUNT_PARK_PROPERTY_NAME) == INDIGO_OK_STATE && switch_is(MOUNT_PARK_PROPERTY_NAME, MOUNT_PARK_PARKED_ITEM_NAME, true), 120));
cleanup:
	stop_simulator_mount();
}

static void simulator_diagonal_motion_releases_both_axes(void) {
	SERIAL_CHECK_TRUE(start_simulator_mount());
	SERIAL_CHECK_TRUE(owner_moves(&owner_a, MOUNT_MOTION_DEC_PROPERTY_NAME, MOUNT_MOTION_NORTH_ITEM_NAME));
	SERIAL_CHECK_TRUE(owner_moves(&owner_a, MOUNT_MOTION_RA_PROPERTY_NAME, MOUNT_MOTION_EAST_ITEM_NAME));
	SERIAL_CHECK_EQ_INT(INDIGO_OK, indigo_detach_client(&owner_a));
	SERIAL_CHECK_EQ_INT(1, count_markers("Aborting", MOUNT_MOTION_DEC_PROPERTY_NAME, OWNER_A_NAME));
	SERIAL_CHECK_EQ_INT(1, count_markers("Aborting", MOUNT_MOTION_RA_PROPERTY_NAME, OWNER_A_NAME));
	SERIAL_CHECK_TRUE(motion_ended(MOUNT_MOTION_DEC_PROPERTY_NAME));
	SERIAL_CHECK_TRUE(motion_ended(MOUNT_MOTION_RA_PROPERTY_NAME));
	SERIAL_CHECK_EQ_INT(2, total_markers());
cleanup:
	stop_simulator_mount();
}

static void simulator_direction_change_keeps_owner(void) {
	SERIAL_CHECK_TRUE(start_simulator_mount());
	SERIAL_CHECK_TRUE(owner_moves(&owner_a, MOUNT_MOTION_DEC_PROPERTY_NAME, MOUNT_MOTION_NORTH_ITEM_NAME));
	SERIAL_CHECK_TRUE(owner_moves(&owner_a, MOUNT_MOTION_DEC_PROPERTY_NAME, MOUNT_MOTION_SOUTH_ITEM_NAME));
	SERIAL_CHECK_TRUE(switch_is(MOUNT_MOTION_DEC_PROPERTY_NAME, MOUNT_MOTION_NORTH_ITEM_NAME, false));
	SERIAL_CHECK_EQ_INT(INDIGO_OK, indigo_detach_client(&owner_a));
	SERIAL_CHECK_EQ_INT(1, count_markers("Aborting", MOUNT_MOTION_DEC_PROPERTY_NAME, OWNER_A_NAME));
	SERIAL_CHECK_TRUE(motion_ended(MOUNT_MOTION_DEC_PROPERTY_NAME));
	SERIAL_CHECK_EQ_INT(1, total_markers());
cleanup:
	stop_simulator_mount();
}

// The owner detaches after its request was admitted but before the handler ran: the commit cannot
// register the motion and releases it at once.
static void simulator_detach_before_commit_releases_at_once(void) {
	SERIAL_CHECK_TRUE(start_simulator_mount());
	SERIAL_CHECK_TRUE(close_gate());
	SERIAL_CHECK_EQ_INT(INDIGO_OK, indigo_change_switch_property_1(&owner_a, MOUNT_SIMULATOR_NAME, MOUNT_MOTION_DEC_PROPERTY_NAME, MOUNT_MOTION_NORTH_ITEM_NAME, true));
	SERIAL_CHECK_EQ_INT(INDIGO_OK, indigo_detach_client(&owner_a));
	SERIAL_CHECK_EQ_INT(0, total_markers());
	open_gate();
	SERIAL_CHECK_TRUE(WAIT_UNTIL(count_markers("Releasing", MOUNT_MOTION_DEC_PROPERTY_NAME, NULL) == 1, 10));
	SERIAL_CHECK_TRUE(motion_ended(MOUNT_MOTION_DEC_PROPERTY_NAME));
	SERIAL_CHECK_EQ_INT(0, count_markers("Aborting", MOUNT_MOTION_DEC_PROPERTY_NAME, NULL));
	SERIAL_CHECK_EQ_INT(1, total_markers());
	SERIAL_CHECK_TRUE(no_entry(MOUNT_MOTION_DEC_PROPERTY_NAME));
cleanup:
	stop_simulator_mount();
}

// The owner detaches after its request was admitted but before the handler ran, and a client is attached at the same
// address before the handler runs (the same indigo_client re-attached, as the allocator of the TCP server reuses the
// memory of a freed XML adapter for the next connection). The new attachment must not adopt the motion: the commit
// refuses the stale reference and releases the motion at once, and the new client's detach sends nothing.
static void simulator_client_at_reused_address_does_not_adopt_motion(void) {
	SERIAL_CHECK_TRUE(start_simulator_mount());
	SERIAL_CHECK_TRUE(close_gate());
	SERIAL_CHECK_EQ_INT(INDIGO_OK, indigo_change_switch_property_1(&owner_a, MOUNT_SIMULATOR_NAME, MOUNT_MOTION_DEC_PROPERTY_NAME, MOUNT_MOTION_NORTH_ITEM_NAME, true));
	SERIAL_CHECK_EQ_INT(INDIGO_OK, indigo_detach_client(&owner_a));
	SERIAL_CHECK_EQ_INT(INDIGO_OK, indigo_attach_client(&owner_a));
	SERIAL_CHECK_EQ_INT(0, total_markers());
	open_gate();
	SERIAL_CHECK_TRUE(WAIT_UNTIL(count_markers("Releasing", MOUNT_MOTION_DEC_PROPERTY_NAME, NULL) == 1, 10));
	SERIAL_CHECK_TRUE(motion_ended(MOUNT_MOTION_DEC_PROPERTY_NAME));
	SERIAL_CHECK_TRUE(no_entry(MOUNT_MOTION_DEC_PROPERTY_NAME));
	SERIAL_CHECK_EQ_INT(INDIGO_OK, indigo_detach_client(&owner_a));
	SERIAL_CHECK_TRUE(drain_device_queue());
	SERIAL_CHECK_EQ_INT(0, count_markers("Aborting", MOUNT_MOTION_DEC_PROPERTY_NAME, NULL));
	SERIAL_CHECK_EQ_INT(1, total_markers());
cleanup:
	dump_markers();
	stop_simulator_mount();
}

// The owner detaches right after the request, racing the handler. Either the handler committed first
// (the detach sends the registered release) or it found the owner gone (it releases at once); in both
// cases exactly one release is sent and the motion ends.
static void simulator_detach_race_always_ends_motion(void) {
	int aborted = 0, released = 0;
	SERIAL_CHECK_TRUE(start_simulator_mount());
	// every repetition attaches the owner anew, a client attached twice would stay attached after one detach
	indigo_detach_client(&owner_a);
	for (int i = 0; i < RACE_REPETITIONS; i++) {
		reset_log_markers(MOUNT_SIMULATOR_NAME);
		SERIAL_CHECK_EQ_INT(INDIGO_OK, indigo_attach_client(&owner_a));
		SERIAL_CHECK_EQ_INT(INDIGO_OK, indigo_change_switch_property_1(&owner_a, MOUNT_SIMULATOR_NAME, MOUNT_MOTION_DEC_PROPERTY_NAME, i % 2 ? MOUNT_MOTION_SOUTH_ITEM_NAME : MOUNT_MOTION_NORTH_ITEM_NAME, true));
		SERIAL_CHECK_EQ_INT(INDIGO_OK, indigo_detach_client(&owner_a));
		SERIAL_CHECK_TRUE(WAIT_UNTIL(total_markers() >= 1, 10));
		SERIAL_CHECK_TRUE(motion_ended(MOUNT_MOTION_DEC_PROPERTY_NAME));
		SERIAL_CHECK_EQ_INT(1, total_markers());
		aborted += count_markers("Aborting", MOUNT_MOTION_DEC_PROPERTY_NAME, OWNER_A_NAME);
		released += count_markers("Releasing", MOUNT_MOTION_DEC_PROPERTY_NAME, NULL);
		SERIAL_CHECK_TRUE(no_entry(MOUNT_MOTION_DEC_PROPERTY_NAME));
	}
	SERIAL_CHECK_EQ_INT(RACE_REPETITIONS, aborted + released);
	printf("    race outcomes: registered then released on detach %d, refused and released by the handler %d\n", aborted, released);
cleanup:
	dump_markers();
	stop_simulator_mount();
}

// A device locked with an access token: the release the bus sends on the owner's behalf carries the
// device's current token, so it passes the lock that rejects an ordinary request of another client.
static void simulator_locked_mount_accepts_release(void) {
	const indigo_token token = 0x0123abcdULL;
	const indigo_token master_token = 0x0fedcba9ULL;
	bool locked = false;
	// without a master token the bus accepts token-less requests on a locked device, so one is set
	indigo_set_master_token(master_token);
	SERIAL_CHECK_TRUE(start_simulator_mount_unconnected());
	SERIAL_CHECK_EQ_INT(INDIGO_OK, indigo_change_switch_property_1_with_token(&simulator_test_client, MOUNT_SIMULATOR_NAME, token, CONNECTION_PROPERTY_NAME, CONNECTION_CONNECTED_ITEM_NAME, true));
	SERIAL_CHECK_TRUE(wait_for_simulator_connection_state(true));
	locked = true;
	SERIAL_CHECK_EQ_INT(INDIGO_OK, indigo_change_switch_property_1_with_token(&simulator_test_client, MOUNT_SIMULATOR_NAME, token, MOUNT_PARK_PROPERTY_NAME, MOUNT_PARK_UNPARKED_ITEM_NAME, true));
	SERIAL_CHECK_TRUE(WAIT_UNTIL(switch_is(MOUNT_PARK_PROPERTY_NAME, MOUNT_PARK_UNPARKED_ITEM_NAME, true) && state_of(MOUNT_PARK_PROPERTY_NAME) == INDIGO_OK_STATE, 30));
	SERIAL_CHECK_EQ_INT(INDIGO_OK, indigo_change_switch_property_1_with_token(&owner_a, MOUNT_SIMULATOR_NAME, token, MOUNT_MOTION_DEC_PROPERTY_NAME, MOUNT_MOTION_NORTH_ITEM_NAME, true));
	SERIAL_CHECK_TRUE(drain_device_queue());
	SERIAL_CHECK_TRUE(switch_is(MOUNT_MOTION_DEC_PROPERTY_NAME, MOUNT_MOTION_NORTH_ITEM_NAME, true));
	// control: without the token another client cannot release the motion
	SERIAL_CHECK_EQ_INT(INDIGO_OK, indigo_change_switch_property_1_with_token(&owner_b, MOUNT_SIMULATOR_NAME, 0, MOUNT_MOTION_DEC_PROPERTY_NAME, MOUNT_MOTION_NORTH_ITEM_NAME, false));
	SERIAL_CHECK_TRUE(drain_device_queue());
	SERIAL_CHECK_TRUE(switch_is(MOUNT_MOTION_DEC_PROPERTY_NAME, MOUNT_MOTION_NORTH_ITEM_NAME, true));
	SERIAL_CHECK_EQ_INT(INDIGO_OK, indigo_detach_client(&owner_a));
	SERIAL_CHECK_EQ_INT(1, count_markers("Aborting", MOUNT_MOTION_DEC_PROPERTY_NAME, OWNER_A_NAME));
	SERIAL_CHECK_TRUE(motion_ended(MOUNT_MOTION_DEC_PROPERTY_NAME));
cleanup:
	if (locked) {
		indigo_change_switch_property_1_with_token(&simulator_test_client, MOUNT_SIMULATOR_NAME, token, CONNECTION_PROPERTY_NAME, CONNECTION_DISCONNECTED_ITEM_NAME, true);
		wait_for_simulator_connection_state(false);
	}
	stop_simulator_mount();
	indigo_set_master_token(0);
}

#pragma mark - Mount Agent case

static bool agent_up = false;

static bool start_agent_for_simulator(void) {
	atomic_store(&agent_lists_mount, false);
	atomic_store(&agent_selected_mount, false);
	atomic_store(&agent_defines_motion, false);
	if (indigo_agent_mount(INDIGO_DRIVER_INIT, NULL) != INDIGO_OK) {
		return false;
	}
	agent_up = true;
	if (!WAIT_UNTIL(atomic_load(&agent_lists_mount), 10)) {
		fprintf(stderr, "    Mount Agent does not list '%s'\n", MOUNT_SIMULATOR_NAME);
		return false;
	}
	if (indigo_change_switch_property_1(&simulator_test_client, MOUNT_AGENT_NAME, FILTER_MOUNT_LIST_PROPERTY_NAME, MOUNT_SIMULATOR_NAME, true) != INDIGO_OK) {
		return false;
	}
	if (!WAIT_UNTIL(atomic_load(&agent_selected_mount) && atomic_load(&agent_defines_motion), 20)) {
		fprintf(stderr, "    Mount Agent did not select '%s'\n", MOUNT_SIMULATOR_NAME);
		return false;
	}
	// the agent selects only a disconnected device and connects it itself
	if (!wait_for_simulator_connection_state(true)) {
		fprintf(stderr, "    Mount Agent did not connect '%s'\n", MOUNT_SIMULATOR_NAME);
		return false;
	}
	return unpark(MOUNT_SIMULATOR_NAME);
}

static void stop_agent(void) {
	if (agent_up) {
		indigo_change_switch_property_1(&simulator_test_client, MOUNT_AGENT_NAME, FILTER_MOUNT_LIST_PROPERTY_NAME, FILTER_DEVICE_LIST_NONE_ITEM_NAME, true);
		WAIT_UNTIL(!atomic_load(&agent_selected_mount), 10);
		indigo_agent_mount(INDIGO_DRIVER_SHUTDOWN, NULL);
		agent_up = false;
	}
}

// The Mount Agent forwards a motion request with the requesting client, so that client, not the agent,
// owns the motion and its detach releases it.
static void agent_owner_detach_releases_motion(void) {
	SERIAL_CHECK_TRUE(start_simulator_mount_unconnected());
	SERIAL_CHECK_TRUE(start_agent_for_simulator());
	SERIAL_CHECK_EQ_INT(INDIGO_OK, indigo_change_switch_property_1(&owner_a, MOUNT_AGENT_NAME, MOUNT_MOTION_DEC_PROPERTY_NAME, MOUNT_MOTION_SOUTH_ITEM_NAME, true));
	SERIAL_CHECK_TRUE(WAIT_UNTIL(switch_is(MOUNT_MOTION_DEC_PROPERTY_NAME, MOUNT_MOTION_SOUTH_ITEM_NAME, true), 10));
	SERIAL_CHECK_TRUE(drain_device_queue());
	SERIAL_CHECK_TRUE(state_of(MOUNT_MOTION_DEC_PROPERTY_NAME) != INDIGO_ALERT_STATE);
	SERIAL_CHECK_EQ_INT(0, total_markers());
	SERIAL_CHECK_EQ_INT(INDIGO_OK, indigo_detach_client(&owner_a));
	SERIAL_CHECK_EQ_INT(1, count_markers("Aborting", MOUNT_MOTION_DEC_PROPERTY_NAME, OWNER_A_NAME));
	SERIAL_CHECK_TRUE(motion_ended(MOUNT_MOTION_DEC_PROPERTY_NAME));
	SERIAL_CHECK_EQ_INT(1, total_markers());
cleanup:
	dump_markers();
	stop_agent();
	stop_simulator_mount();
}

#pragma mark - LX200 serial simulator cases

static external_serial_simulator lx200_simulator;
static bool lx200_up = false;
static bool lx200_guider_connected = false;

static int lx200_event_count(const char *command) {
	char path[PATH_MAX];
	if (!simulator_fixture_path(path, sizeof(path), "%s.events", lx200_simulator.ready_file, NULL)) {
		return -1;
	}
	FILE *file = fopen(path, "r");
	if (file == NULL) {
		return 0;
	}
	char line[256];
	int count = 0;
	while (fgets(line, sizeof(line), file)) {
		char *tab = strchr(line, '\t');
		if (tab != NULL) {
			tab++;
			tab[strcspn(tab, "\r\n")] = 0;
			if (!strcmp(tab, command)) {
				count++;
			}
		}
	}
	fclose(file);
	return count;
}

static bool lx200_select_type(const char *type) {
	unsigned int revision = property_revision(MOUNT_TYPE_PROPERTY_NAME);
	if (indigo_change_switch_property_1(&simulator_test_client, MOUNT_LX200_NAME, MOUNT_TYPE_PROPERTY_NAME, type, true) != INDIGO_OK) {
		return false;
	}
	return wait_for_property_state_seen_after(MOUNT_TYPE_PROPERTY_NAME, INDIGO_OK_STATE, revision);
}

static bool start_lx200_mount(const char *model, const char *type) {
	const char *arguments[] = { "--model", model, NULL };
	watch_device(MOUNT_LX200_NAME);
	if (!start_external_serial_simulator_with_args(&lx200_simulator, MOUNT_LX200_SIMULATOR_EXECUTABLE, arguments)) {
		return false;
	}
	if (!bring_up_serial_driver(&lx200_case)) {
		return false;
	}
	lx200_up = true;
	enumerate_simulator_device();
	if (!attach_owners() || !lx200_select_type(type)) {
		return false;
	}
	if (!connect_serial_device(&lx200_case, lx200_simulator.port)) {
		return false;
	}
	return unpark(MOUNT_LX200_NAME);
}

// The classic profile with the guider connected first, then the mount, as a classic guide pulse runs
// on the shared device queue and blocks manual motion while it lasts.
static bool start_lx200_classic_mount_and_guider(void) {
	const char *arguments[] = { "--model", "classic", NULL };
	watch_device(MOUNT_LX200_NAME);
	if (!start_external_serial_simulator_with_args(&lx200_simulator, MOUNT_LX200_SIMULATOR_EXECUTABLE, arguments)) {
		return false;
	}
	if (!bring_up_serial_driver(&lx200_guider_case)) {
		return false;
	}
	lx200_up = true;
	if (!attach_owners()) {
		return false;
	}
	if (indigo_change_switch_property_1(&simulator_test_client, MOUNT_LX200_NAME, MOUNT_TYPE_PROPERTY_NAME, "CLASSIC", true) != INDIGO_OK) {
		return false;
	}
	if (indigo_change_text_property_1_raw(&simulator_test_client, MOUNT_LX200_NAME, DEVICE_PORT_PROPERTY_NAME, DEVICE_PORT_ITEM_NAME, lx200_simulator.port) != INDIGO_OK) {
		return false;
	}
	if (!connect_serial_device(&lx200_guider_case, NULL)) {
		return false;
	}
	lx200_guider_connected = true;
	if (!connect_serial_device(&lx200_case, lx200_simulator.port)) {
		return false;
	}
	return unpark(MOUNT_LX200_NAME);
}

static void stop_lx200_mount(void) {
	open_gate();
	detach_owners();
	if (lx200_up) {
		if (lx200_guider_connected) {
			disconnect_serial_device(&lx200_guider_case);
			lx200_guider_connected = false;
		}
		stop_serial_driver(&lx200_case);
		lx200_up = false;
	}
	stop_external_serial_simulator(&lx200_simulator);
}

static void lx200_owner_detach_releases_motion(void) {
	SERIAL_CHECK_TRUE(start_lx200_mount("onstep", "ONSTEP"));
	int stops = lx200_event_count("Qn");
	SERIAL_CHECK_TRUE(owner_moves(&owner_a, MOUNT_MOTION_DEC_PROPERTY_NAME, MOUNT_MOTION_NORTH_ITEM_NAME));
	SERIAL_CHECK_TRUE(lx200_event_count("Mn") >= 1);
	SERIAL_CHECK_TRUE(state_of(MOUNT_MOTION_DEC_PROPERTY_NAME) == INDIGO_BUSY_STATE);
	SERIAL_CHECK_EQ_INT(0, total_markers());
	SERIAL_CHECK_EQ_INT(INDIGO_OK, indigo_detach_client(&owner_a));
	SERIAL_CHECK_EQ_INT(1, count_markers("Aborting", MOUNT_MOTION_DEC_PROPERTY_NAME, OWNER_A_NAME));
	SERIAL_CHECK_TRUE(motion_ended(MOUNT_MOTION_DEC_PROPERTY_NAME));
	// the driver really stopped the axis on the device
	SERIAL_CHECK_TRUE(WAIT_UNTIL(lx200_event_count("Qn") > stops, 5));
	SERIAL_CHECK_EQ_INT(1, total_markers());
	SERIAL_CHECK_TRUE(no_entry(MOUNT_MOTION_DEC_PROPERTY_NAME));
cleanup:
	dump_markers();
	stop_lx200_mount();
}

// The owner detaches while the motion handler is still talking to the serial device.
static void lx200_detach_during_handler_ends_motion(void) {
	int aborted = 0, released = 0;
	SERIAL_CHECK_TRUE(start_lx200_mount("onstep", "ONSTEP"));
	indigo_detach_client(&owner_a);
	for (int i = 0; i < LX200_RACE_REPETITIONS; i++) {
		reset_log_markers(MOUNT_LX200_NAME);
		int stops = lx200_event_count("Qn");
		SERIAL_CHECK_EQ_INT(INDIGO_OK, indigo_attach_client(&owner_a));
		SERIAL_CHECK_EQ_INT(INDIGO_OK, indigo_change_switch_property_1(&owner_a, MOUNT_LX200_NAME, MOUNT_MOTION_DEC_PROPERTY_NAME, MOUNT_MOTION_NORTH_ITEM_NAME, true));
		SERIAL_CHECK_EQ_INT(INDIGO_OK, indigo_detach_client(&owner_a));
		SERIAL_CHECK_TRUE(WAIT_UNTIL(total_markers() >= 1, 10));
		SERIAL_CHECK_TRUE(motion_ended(MOUNT_MOTION_DEC_PROPERTY_NAME));
		SERIAL_CHECK_EQ_INT(1, total_markers());
		SERIAL_CHECK_TRUE(WAIT_UNTIL(lx200_event_count("Qn") > stops, 5));
		aborted += count_markers("Aborting", MOUNT_MOTION_DEC_PROPERTY_NAME, OWNER_A_NAME);
		released += count_markers("Releasing", MOUNT_MOTION_DEC_PROPERTY_NAME, NULL);
		SERIAL_CHECK_TRUE(no_entry(MOUNT_MOTION_DEC_PROPERTY_NAME));
	}
	SERIAL_CHECK_EQ_INT(LX200_RACE_REPETITIONS, aborted + released);
	printf("    lx200 race outcomes: registered then released on detach %d, refused and released by the handler %d\n", aborted, released);
cleanup:
	dump_markers();
	stop_lx200_mount();
}

// A classic LX200 refuses manual motion while a classic guide pulse runs ("Classic guiding is active");
// the refusal publishes ALERT and its commit leaves no entry, so the owner's detach sends nothing.
static void lx200_classic_guiding_refusal_registers_nothing(void) {
	SERIAL_CHECK_TRUE(start_lx200_classic_mount_and_guider());
	int pulses = lx200_event_count("Mn");
	SERIAL_CHECK_EQ_INT(INDIGO_OK, indigo_change_number_property_1(&simulator_test_client, MOUNT_LX200_GUIDER_NAME, GUIDER_GUIDE_DEC_PROPERTY_NAME, GUIDER_GUIDE_NORTH_ITEM_NAME, 3000));
	SERIAL_CHECK_TRUE(WAIT_UNTIL(lx200_event_count("Mn") > pulses, 5));
	int moves = lx200_event_count("Ms");
	SERIAL_CHECK_EQ_INT(INDIGO_OK, indigo_change_switch_property_1(&owner_a, MOUNT_LX200_NAME, MOUNT_MOTION_DEC_PROPERTY_NAME, MOUNT_MOTION_SOUTH_ITEM_NAME, true));
	SERIAL_CHECK_TRUE(drain_device_queue());
	SERIAL_CHECK_EQ_INT(INDIGO_ALERT_STATE, state_of(MOUNT_MOTION_DEC_PROPERTY_NAME));
	SERIAL_CHECK_EQ_INT(moves, lx200_event_count("Ms"));
	SERIAL_CHECK_EQ_INT(INDIGO_OK, indigo_detach_client(&owner_a));
	SERIAL_CHECK_TRUE(drain_device_queue());
	SERIAL_CHECK_EQ_INT(0, total_markers());
	SERIAL_CHECK_TRUE(no_entry(MOUNT_MOTION_DEC_PROPERTY_NAME));
	SERIAL_CHECK_EQ_INT(moves, lx200_event_count("Ms"));
cleanup:
	dump_markers();
	stop_lx200_mount();
}

#pragma mark - Network: in-process TCP server, TCP peers and a cuttable proxy

static atomic_int server_client_count;
static atomic_bool server_listening;
static atomic_bool server_finished;
static pthread_t server_thread;
static bool server_started = false;

static void test_server_callback(int count) {
	atomic_store(&server_client_count, count);
	atomic_store(&server_listening, true);
}

static void *test_server_run(void *data) {
	indigo_server_start(test_server_callback);
	atomic_store(&server_finished, true);
	return NULL;
}

// The production TCP server of indigo_server, on an ephemeral port, serving the in-process bus.
static bool start_test_server(void) {
	indigo_use_bonjour = false;
	indigo_server_tcp_port = 0;
	atomic_store(&server_client_count, 0);
	atomic_store(&server_listening, false);
	atomic_store(&server_finished, false);
	if (pthread_create(&server_thread, NULL, test_server_run, NULL) != 0) {
		return false;
	}
	server_started = true;
	if (!WAIT_UNTIL(atomic_load(&server_listening) && indigo_server_tcp_port != 0, 5)) {
		fprintf(stderr, "    TCP server did not start\n");
		return false;
	}
	return true;
}

static bool wait_server_clients(int count) {
	if (!WAIT_UNTIL(atomic_load(&server_client_count) == count, 10)) {
		fprintf(stderr, "    server has %d clients, expected %d\n", atomic_load(&server_client_count), count);
		return false;
	}
	return true;
}

static int connect_loopback(int port) {
	int fd = socket(AF_INET, SOCK_STREAM, 0);
	if (fd < 0) {
		return -1;
	}
	struct sockaddr_in address = { 0 };
	address.sin_family = AF_INET;
	address.sin_port = htons(port);
	address.sin_addr.s_addr = htonl(INADDR_LOOPBACK);
	if (connect(fd, (struct sockaddr *)&address, sizeof(address)) < 0) {
		close(fd);
		return -1;
	}
	int value = 1;
	setsockopt(fd, IPPROTO_TCP, TCP_NODELAY, &value, sizeof(value));
	return fd;
}

static void stop_test_server(void) {
	if (server_started) {
		wait_server_clients(0);
		int port = indigo_server_tcp_port;
		indigo_server_shutdown();
		if (!WAIT_UNTIL(atomic_load(&server_finished), 1)) {
			// the listener may stay in accept() after its socket is shut down, a connection wakes it
			int fd = connect_loopback(port);
			if (fd >= 0) {
				close(fd);
			}
		}
		if (WAIT_UNTIL(atomic_load(&server_finished), 5)) {
			pthread_join(server_thread, NULL);
		} else {
			fprintf(stderr, "    TCP server thread did not finish\n");
			indigo_test_failures++;
			pthread_detach(server_thread);
		}
		wait_server_clients(0);
		server_started = false;
	}
}

typedef struct {
	int fd;
	pthread_t reader;
	bool reader_started;
	atomic_bool stop;
	atomic_bool ready;
	atomic_bool eof;
	char marker[INDIGO_VALUE_SIZE];
} tcp_peer;

static void *tcp_peer_read(void *data) {
	tcp_peer *peer = data;
	char buffer[16384];
	size_t kept = 0, marker_length = strlen(peer->marker);
	while (!atomic_load(&peer->stop)) {
		struct pollfd descriptor = { peer->fd, POLLIN, 0 };
		int result = poll(&descriptor, 1, 20);
		if (result < 0 && errno != EINTR) {
			break;
		}
		if (result <= 0) {
			continue;
		}
		ssize_t length = recv(peer->fd, buffer + kept, sizeof(buffer) - kept - 1, 0);
		if (length <= 0) {
			break;
		}
		kept += length;
		buffer[kept] = 0;
		if (!atomic_load(&peer->ready) && strstr(buffer, peer->marker) != NULL) {
			atomic_store(&peer->ready, true);
		}
		if (kept > marker_length) {
			memmove(buffer, buffer + kept - marker_length, marker_length);
			kept = marker_length;
		}
	}
	atomic_store(&peer->eof, true);
	return NULL;
}

static bool tcp_peer_send(tcp_peer *peer, const char *format, ...) {
	char message[4096];
	va_list arguments;
	va_start(arguments, format);
	int length = vsnprintf(message, sizeof(message), format, arguments);
	va_end(arguments);
	if (length < 0 || length >= (int)sizeof(message)) {
		return false;
	}
	for (int sent = 0; sent < length;) {
		ssize_t result = send(peer->fd, message + sent, length - sent, 0);
		if (result <= 0) {
			return false;
		}
		sent += result;
	}
	return true;
}

// Connect an XML peer, ask for the properties and wait until the definition of the given property of
// the given device arrived, so the server's adapter is attached and the device is known to it.
static bool tcp_peer_open(tcp_peer *peer, int port, const char *device_name, const char *property_name) {
	memset(peer, 0, sizeof(*peer));
	peer->fd = connect_loopback(port);
	if (peer->fd < 0) {
		fprintf(stderr, "    can't connect to port %d (%s)\n", port, strerror(errno));
		return false;
	}
	snprintf(peer->marker, sizeof(peer->marker), "<defSwitchVector device='%s' name='%s'", device_name, property_name);
	if (pthread_create(&peer->reader, NULL, tcp_peer_read, peer) != 0) {
		return false;
	}
	peer->reader_started = true;
	if (!tcp_peer_send(peer, "<getProperties version='2.0' switch='2.0'/>\n")) {
		return false;
	}
	if (!WAIT_UNTIL(atomic_load(&peer->ready), 10)) {
		fprintf(stderr, "    no definition of '%s'.%s received\n", device_name, property_name);
		return false;
	}
	return true;
}

static bool tcp_peer_switch(tcp_peer *peer, const char *device_name, const char *property_name, const char *item_name, bool value) {
	return tcp_peer_send(peer, "<newSwitchVector device='%s' name='%s'><oneSwitch name='%s'>%s</oneSwitch></newSwitchVector>\n", device_name, property_name, item_name, value ? "On" : "Off");
}

// Close orderly (FIN) or abruptly (SO_LINGER 0, the peer sees a connection reset).
static void tcp_peer_close(tcp_peer *peer, bool abrupt) {
	if (peer->reader_started) {
		atomic_store(&peer->stop, true);
		pthread_join(peer->reader, NULL);
		peer->reader_started = false;
	}
	if (peer->fd > 0) {
		if (abrupt) {
			struct linger linger = { 1, 0 };
			setsockopt(peer->fd, SOL_SOCKET, SO_LINGER, &linger, sizeof(linger));
		}
		close(peer->fd);
		peer->fd = -1;
	}
}

// A proxy between one peer and the server. cut() ends the server side of the connection while the
// peer keeps its socket open, as a lost link looks to the server.
typedef struct {
	int listen_fd;
	int client_fd;
	int server_fd;
	int port;
	int upstream_port;
	pthread_t thread;
	bool started;
	atomic_bool stop;
} tcp_proxy;

static bool tcp_proxy_pump(int from, int to) {
	char buffer[16384];
	ssize_t length = recv(from, buffer, sizeof(buffer), 0);
	if (length <= 0) {
		return false;
	}
	for (ssize_t sent = 0; sent < length;) {
		ssize_t result = send(to, buffer + sent, length - sent, 0);
		if (result <= 0) {
			return false;
		}
		sent += result;
	}
	return true;
}

static void *tcp_proxy_run(void *data) {
	tcp_proxy *proxy = data;
	while (!atomic_load(&proxy->stop) && proxy->client_fd < 0) {
		struct pollfd descriptor = { proxy->listen_fd, POLLIN, 0 };
		if (poll(&descriptor, 1, 20) > 0) {
			proxy->client_fd = accept(proxy->listen_fd, NULL, NULL);
		}
	}
	if (proxy->client_fd < 0) {
		return NULL;
	}
	proxy->server_fd = connect_loopback(proxy->upstream_port);
	if (proxy->server_fd < 0) {
		return NULL;
	}
	bool open = true;
	while (open && !atomic_load(&proxy->stop)) {
		struct pollfd descriptors[2] = { { proxy->client_fd, POLLIN, 0 }, { proxy->server_fd, POLLIN, 0 } };
		if (poll(descriptors, 2, 20) <= 0) {
			continue;
		}
		if (descriptors[0].revents) {
			open = tcp_proxy_pump(proxy->client_fd, proxy->server_fd);
		}
		if (open && descriptors[1].revents) {
			open = tcp_proxy_pump(proxy->server_fd, proxy->client_fd);
		}
	}
	return NULL;
}

static bool tcp_proxy_start(tcp_proxy *proxy, int upstream_port) {
	memset(proxy, 0, sizeof(*proxy));
	proxy->client_fd = proxy->server_fd = -1;
	proxy->upstream_port = upstream_port;
	proxy->listen_fd = socket(AF_INET, SOCK_STREAM, 0);
	if (proxy->listen_fd < 0) {
		return false;
	}
	struct sockaddr_in address = { 0 };
	socklen_t length = sizeof(address);
	address.sin_family = AF_INET;
	address.sin_addr.s_addr = htonl(INADDR_LOOPBACK);
	if (bind(proxy->listen_fd, (struct sockaddr *)&address, sizeof(address)) < 0 || listen(proxy->listen_fd, 1) < 0 || getsockname(proxy->listen_fd, (struct sockaddr *)&address, &length) < 0) {
		close(proxy->listen_fd);
		proxy->listen_fd = -1;
		return false;
	}
	proxy->port = ntohs(address.sin_port);
	if (pthread_create(&proxy->thread, NULL, tcp_proxy_run, proxy) != 0) {
		return false;
	}
	proxy->started = true;
	return true;
}

static void tcp_proxy_cut(tcp_proxy *proxy) {
	if (proxy->server_fd >= 0) {
		shutdown(proxy->server_fd, SHUT_RDWR);
	}
}

static void tcp_proxy_stop(tcp_proxy *proxy) {
	if (proxy->started) {
		atomic_store(&proxy->stop, true);
		pthread_join(proxy->thread, NULL);
		proxy->started = false;
	}
	if (proxy->server_fd >= 0) {
		close(proxy->server_fd);
		proxy->server_fd = -1;
	}
	if (proxy->client_fd >= 0) {
		close(proxy->client_fd);
		proxy->client_fd = -1;
	}
	if (proxy->listen_fd > 0) {
		close(proxy->listen_fd);
		proxy->listen_fd = -1;
	}
}

#pragma mark - Network cases

static bool start_network_simulator_mount(void) {
	return start_simulator_mount() && start_test_server();
}

// The peer starts DEC motion, the handler and its commit finish, then the peer loses its connection.
static void network_close_releases_motion(bool abrupt) {
	tcp_peer peer = { .fd = -1 };
	SERIAL_CHECK_TRUE(start_network_simulator_mount());
	SERIAL_CHECK_TRUE(tcp_peer_open(&peer, indigo_server_tcp_port, MOUNT_SIMULATOR_NAME, MOUNT_MOTION_DEC_PROPERTY_NAME));
	SERIAL_CHECK_TRUE(wait_server_clients(1));
	SERIAL_CHECK_TRUE(tcp_peer_switch(&peer, MOUNT_SIMULATOR_NAME, MOUNT_MOTION_DEC_PROPERTY_NAME, MOUNT_MOTION_NORTH_ITEM_NAME, true));
	// the simulator's handler publishes OK with the item on, a fence then covers its commit
	SERIAL_CHECK_TRUE(WAIT_UNTIL(switch_is(MOUNT_MOTION_DEC_PROPERTY_NAME, MOUNT_MOTION_NORTH_ITEM_NAME, true) && state_of(MOUNT_MOTION_DEC_PROPERTY_NAME) == INDIGO_OK_STATE, 10));
	SERIAL_CHECK_TRUE(drain_device_queue());
	SERIAL_CHECK_EQ_INT(0, total_markers());
	tcp_peer_close(&peer, abrupt);
	SERIAL_CHECK_TRUE(wait_server_clients(0));
	SERIAL_CHECK_EQ_INT(1, count_markers("Aborting", MOUNT_MOTION_DEC_PROPERTY_NAME, XML_ADAPTER_NAME));
	SERIAL_CHECK_TRUE(motion_ended(MOUNT_MOTION_DEC_PROPERTY_NAME));
	SERIAL_CHECK_EQ_INT(1, total_markers());
	SERIAL_CHECK_TRUE(no_entry(MOUNT_MOTION_DEC_PROPERTY_NAME));
cleanup:
	dump_markers();
	tcp_peer_close(&peer, false);
	stop_test_server();
	stop_simulator_mount();
}

static void network_orderly_close_releases_motion(void) {
	network_close_releases_motion(false);
}

static void network_connection_reset_releases_motion(void) {
	network_close_releases_motion(true);
}

static void network_cut_connection_releases_motion(void) {
	tcp_peer peer = { .fd = -1 };
	tcp_proxy proxy = { .listen_fd = -1, .client_fd = -1, .server_fd = -1 };
	SERIAL_CHECK_TRUE(start_network_simulator_mount());
	SERIAL_CHECK_TRUE(tcp_proxy_start(&proxy, indigo_server_tcp_port));
	SERIAL_CHECK_TRUE(tcp_peer_open(&peer, proxy.port, MOUNT_SIMULATOR_NAME, MOUNT_MOTION_DEC_PROPERTY_NAME));
	SERIAL_CHECK_TRUE(wait_server_clients(1));
	SERIAL_CHECK_TRUE(tcp_peer_switch(&peer, MOUNT_SIMULATOR_NAME, MOUNT_MOTION_RA_PROPERTY_NAME, MOUNT_MOTION_WEST_ITEM_NAME, true));
	SERIAL_CHECK_TRUE(WAIT_UNTIL(switch_is(MOUNT_MOTION_RA_PROPERTY_NAME, MOUNT_MOTION_WEST_ITEM_NAME, true) && state_of(MOUNT_MOTION_RA_PROPERTY_NAME) == INDIGO_OK_STATE, 10));
	SERIAL_CHECK_TRUE(drain_device_queue());
	SERIAL_CHECK_EQ_INT(0, total_markers());
	tcp_proxy_cut(&proxy);
	SERIAL_CHECK_TRUE(wait_server_clients(0));
	// the peer itself is still alive and holds its socket
	SERIAL_CHECK_TRUE(peer.fd >= 0);
	SERIAL_CHECK_EQ_INT(1, count_markers("Aborting", MOUNT_MOTION_RA_PROPERTY_NAME, XML_ADAPTER_NAME));
	SERIAL_CHECK_TRUE(motion_ended(MOUNT_MOTION_RA_PROPERTY_NAME));
	SERIAL_CHECK_EQ_INT(1, total_markers());
cleanup:
	dump_markers();
	tcp_peer_close(&peer, false);
	tcp_proxy_stop(&proxy);
	stop_test_server();
	stop_simulator_mount();
}

static void network_agent_owner_close_releases_motion(void) {
	tcp_peer peer = { .fd = -1 };
	SERIAL_CHECK_TRUE(start_simulator_mount_unconnected());
	SERIAL_CHECK_TRUE(start_agent_for_simulator());
	SERIAL_CHECK_TRUE(start_test_server());
	SERIAL_CHECK_TRUE(tcp_peer_open(&peer, indigo_server_tcp_port, MOUNT_AGENT_NAME, MOUNT_MOTION_DEC_PROPERTY_NAME));
	SERIAL_CHECK_TRUE(wait_server_clients(1));
	SERIAL_CHECK_TRUE(tcp_peer_switch(&peer, MOUNT_AGENT_NAME, MOUNT_MOTION_DEC_PROPERTY_NAME, MOUNT_MOTION_SOUTH_ITEM_NAME, true));
	SERIAL_CHECK_TRUE(WAIT_UNTIL(switch_is(MOUNT_MOTION_DEC_PROPERTY_NAME, MOUNT_MOTION_SOUTH_ITEM_NAME, true) && state_of(MOUNT_MOTION_DEC_PROPERTY_NAME) == INDIGO_OK_STATE, 10));
	SERIAL_CHECK_TRUE(drain_device_queue());
	SERIAL_CHECK_EQ_INT(0, total_markers());
	tcp_peer_close(&peer, false);
	SERIAL_CHECK_TRUE(wait_server_clients(0));
	SERIAL_CHECK_EQ_INT(1, count_markers("Aborting", MOUNT_MOTION_DEC_PROPERTY_NAME, XML_ADAPTER_NAME));
	SERIAL_CHECK_TRUE(motion_ended(MOUNT_MOTION_DEC_PROPERTY_NAME));
	SERIAL_CHECK_EQ_INT(1, total_markers());
cleanup:
	dump_markers();
	tcp_peer_close(&peer, false);
	stop_test_server();
	stop_agent();
	stop_simulator_mount();
}

// The peer sends the request and closes at once, orderly or with a reset. The request is parsed before
// the end of the connection, so exactly one release is sent: the registered one or the handler's own.
// A reset may also discard the unread request in the server's receive buffer; then the motion never
// starts, which the unchanged revision of the property proves.
static void network_close_race_always_ends_motion(void) {
	int aborted = 0, released = 0, discarded = 0;
	tcp_peer peer = { .fd = -1 };
	SERIAL_CHECK_TRUE(start_network_simulator_mount());
	for (int i = 0; i < NETWORK_RACE_REPETITIONS; i++) {
		reset_log_markers(MOUNT_SIMULATOR_NAME);
		SERIAL_CHECK_TRUE(tcp_peer_open(&peer, indigo_server_tcp_port, MOUNT_SIMULATOR_NAME, MOUNT_MOTION_DEC_PROPERTY_NAME));
		SERIAL_CHECK_TRUE(wait_server_clients(1));
		unsigned int revision = property_revision(MOUNT_MOTION_DEC_PROPERTY_NAME);
		SERIAL_CHECK_TRUE(tcp_peer_switch(&peer, MOUNT_SIMULATOR_NAME, MOUNT_MOTION_DEC_PROPERTY_NAME, MOUNT_MOTION_NORTH_ITEM_NAME, true));
		tcp_peer_close(&peer, i % 2 == 1);
		SERIAL_CHECK_TRUE(wait_server_clients(0));
		SERIAL_CHECK_TRUE(drain_device_queue());
		SERIAL_CHECK_TRUE(motion_ended(MOUNT_MOTION_DEC_PROPERTY_NAME));
		SERIAL_CHECK_TRUE(total_markers() <= 1);
		if (total_markers() == 0) {
			SERIAL_CHECK_TRUE(i % 2 == 1);
			SERIAL_CHECK_EQ_INT(revision, property_revision(MOUNT_MOTION_DEC_PROPERTY_NAME));
			discarded++;
		}
		aborted += count_markers("Aborting", MOUNT_MOTION_DEC_PROPERTY_NAME, XML_ADAPTER_NAME);
		released += count_markers("Releasing", MOUNT_MOTION_DEC_PROPERTY_NAME, NULL);
		SERIAL_CHECK_TRUE(no_entry(MOUNT_MOTION_DEC_PROPERTY_NAME));
	}
	SERIAL_CHECK_EQ_INT(NETWORK_RACE_REPETITIONS, aborted + released + discarded);
	printf("    network race outcomes: registered then released on close %d, refused and released by the handler %d, request discarded by reset %d\n", aborted, released, discarded);
cleanup:
	dump_markers();
	tcp_peer_close(&peer, false);
	stop_test_server();
	stop_simulator_mount();
}

static void network_lx200_close_releases_motion(void) {
	tcp_peer peer = { .fd = -1 };
	SERIAL_CHECK_TRUE(start_lx200_mount("onstep", "ONSTEP"));
	SERIAL_CHECK_TRUE(start_test_server());
	SERIAL_CHECK_TRUE(tcp_peer_open(&peer, indigo_server_tcp_port, MOUNT_LX200_NAME, MOUNT_MOTION_DEC_PROPERTY_NAME));
	SERIAL_CHECK_TRUE(wait_server_clients(1));
	int moves = lx200_event_count("Mn");
	int stops = lx200_event_count("Qn");
	SERIAL_CHECK_TRUE(tcp_peer_switch(&peer, MOUNT_LX200_NAME, MOUNT_MOTION_DEC_PROPERTY_NAME, MOUNT_MOTION_NORTH_ITEM_NAME, true));
	// Mn is sent by the handler, a fence behind it covers the commit
	SERIAL_CHECK_TRUE(WAIT_UNTIL(lx200_event_count("Mn") > moves, 10));
	SERIAL_CHECK_TRUE(drain_device_queue());
	SERIAL_CHECK_EQ_INT(INDIGO_BUSY_STATE, state_of(MOUNT_MOTION_DEC_PROPERTY_NAME));
	SERIAL_CHECK_EQ_INT(0, total_markers());
	tcp_peer_close(&peer, false);
	SERIAL_CHECK_TRUE(wait_server_clients(0));
	SERIAL_CHECK_EQ_INT(1, count_markers("Aborting", MOUNT_MOTION_DEC_PROPERTY_NAME, XML_ADAPTER_NAME));
	SERIAL_CHECK_TRUE(motion_ended(MOUNT_MOTION_DEC_PROPERTY_NAME));
	SERIAL_CHECK_TRUE(WAIT_UNTIL(lx200_event_count("Qn") > stops, 5));
	SERIAL_CHECK_EQ_INT(1, total_markers());
cleanup:
	dump_markers();
	tcp_peer_close(&peer, false);
	stop_test_server();
	stop_lx200_mount();
}

#pragma mark - Main

int main(int argc, char **argv) {
	if (!indigo_test_use_private_home()) {
		return 1;
	}
	bool network = argc > 1 && !strcmp(argv[1], "--network");
	debug_enabled = getenv("INDIGO_TEST_DEBUG") != NULL && !strcmp(getenv("INDIGO_TEST_DEBUG"), "1");
	signal(SIGPIPE, SIG_IGN);
	simulator_test_client.define_property = observer_define_property;
	simulator_test_client.update_property = observer_update_property;
	simulator_test_client.delete_property = observer_delete_property;
	indigo_log_message_handler = capture_log_message;
	// the markers are logged on the info level; INDIGO_TEST_DEBUG=1 prints the log, INDIGO_TEST_TRACE=1 the bus traffic
	indigo_set_log_level(getenv("INDIGO_TEST_TRACE") != NULL ? INDIGO_LOG_TRACE_BUS : debug_enabled ? INDIGO_LOG_DEBUG : INDIGO_LOG_INFO);
	debug_enabled = debug_enabled || getenv("INDIGO_TEST_TRACE") != NULL;
	int result;
	if (network) {
		const indigo_test_case tests[] = {
			{ "network_orderly_close_releases_motion", network_orderly_close_releases_motion },
			{ "network_connection_reset_releases_motion", network_connection_reset_releases_motion },
			{ "network_cut_connection_releases_motion", network_cut_connection_releases_motion },
			{ "network_agent_owner_close_releases_motion", network_agent_owner_close_releases_motion },
			{ "network_close_race_always_ends_motion", network_close_race_always_ends_motion },
			{ "network_lx200_close_releases_motion", network_lx200_close_releases_motion }
		};
		result = indigo_run_tests("detach-abort network tests", tests, ARRAY_SIZE(tests));
	} else {
		const indigo_test_case tests[] = {
			{ "registry_client_detach_sends_registered_release", registry_client_detach_sends_registered_release },
			{ "registry_refuses_operation_without_attached_owner", registry_refuses_operation_without_attached_owner },
			{ "registry_later_registration_replaces_owner", registry_later_registration_replaces_owner },
			{ "registry_owner_is_read_at_registration", registry_owner_is_read_at_registration },
			{ "registry_stale_attachment_is_refused", registry_stale_attachment_is_refused },
			{ "registry_unregister_removes_entry", registry_unregister_removes_entry },
			{ "registry_full_registry_is_reported", registry_full_registry_is_reported },
			{ "registry_device_detach_forgets_entries", registry_device_detach_forgets_entries },
			{ "registry_release_may_reenter_registry", registry_release_may_reenter_registry },
			{ "simulator_owner_detach_releases_motion", simulator_owner_detach_releases_motion },
			{ "simulator_released_motion_is_not_released_again", simulator_released_motion_is_not_released_again },
			{ "simulator_abort_by_other_client_unregisters", simulator_abort_by_other_client_unregisters },
			{ "simulator_takeover_moves_ownership", simulator_takeover_moves_ownership },
			{ "simulator_release_by_other_client_unregisters", simulator_release_by_other_client_unregisters },
			{ "simulator_disconnect_and_shutdown_unregister", simulator_disconnect_and_shutdown_unregister },
			{ "simulator_finite_goto_survives_owner_detach", simulator_finite_goto_survives_owner_detach },
			{ "simulator_parked_guard_refusal_registers_nothing", simulator_parked_guard_refusal_registers_nothing },
			{ "simulator_parked_guard_refusal_unregisters_motion", simulator_parked_guard_refusal_unregisters_motion },
			{ "simulator_diagonal_motion_releases_both_axes", simulator_diagonal_motion_releases_both_axes },
			{ "simulator_direction_change_keeps_owner", simulator_direction_change_keeps_owner },
			{ "simulator_detach_before_commit_releases_at_once", simulator_detach_before_commit_releases_at_once },
			{ "simulator_client_at_reused_address_does_not_adopt_motion", simulator_client_at_reused_address_does_not_adopt_motion },
			{ "simulator_detach_race_always_ends_motion", simulator_detach_race_always_ends_motion },
			{ "simulator_locked_mount_accepts_release", simulator_locked_mount_accepts_release },
			{ "agent_owner_detach_releases_motion", agent_owner_detach_releases_motion },
			{ "lx200_owner_detach_releases_motion", lx200_owner_detach_releases_motion },
			{ "lx200_detach_during_handler_ends_motion", lx200_detach_during_handler_ends_motion },
			{ "lx200_classic_guiding_refusal_registers_nothing", lx200_classic_guiding_refusal_registers_nothing }
		};
		result = indigo_run_tests("detach-abort tests", tests, ARRAY_SIZE(tests));
	}
	indigo_log_message_handler = NULL;
	indigo_test_remove_private_home();
	return result;
}
