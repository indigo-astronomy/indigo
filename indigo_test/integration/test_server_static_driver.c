// Copyright (c) 2026 INDIGO initiative
// All rights reserved.
//
// You may use this software under the terms of 'INDIGO Astronomy
// open-source license' (see LICENSE.md).
//
// THIS SOFTWARE IS PROVIDED BY THE AUTHORS 'AS IS' AND ANY EXPRESS
// OR IMPLIED WARRANTIES, INCLUDING, BUT NOT LIMITED TO, THE IMPLIED
// WARRANTIES OF MERCHANTABILITY AND FITNESS FOR A PARTICULAR PURPOSE
// ARE DISCLAIMED. IN NO EVENT SHALL THE AUTHOR BE LIABLE FOR ANY
// DIRECT, INDIRECT, INCIDENTAL, SPECIAL, EXEMPLARY, OR CONSEQUENTIAL
// DAMAGES (INCLUDING, BUT NOT LIMITED TO, PROCUREMENT OF SUBSTITUTE
// GOODS OR SERVICES; LOSS OF USE, DATA, OR PROFITS; OR BUSINESS
// INTERRUPTION) HOWEVER CAUSED AND ON ANY THEORY OF LIABILITY,
// WHETHER IN CONTRACT, STRICT LIABILITY, OR TORT (INCLUDING
// NEGLIGENCE OR OTHERWISE) ARISING IN ANY WAY OUT OF THE USE OF THIS
// SOFTWARE, EVEN IF ADVISED OF THE POSSIBILITY OF SUCH DAMAGE.

// Code is generated by AI

// Server.UNLOAD of a statically linked driver followed by Server.DRIVERS enable.
//
// indigo_server.c is compiled into this test so that its server device, its UNLOAD and DRIVERS handlers and the
// driver registry run in process. A stub entry point stands for a statically linked driver: it is registered with
// indigo_add_driver(), so it has no library handle, and it counts INIT and SHUTDOWN calls.

#include <stdatomic.h>

#define main indigo_server_main
#include "../../indigo_server/indigo_server.c"
#undef main

#include "../test_runner.h"

#define STUB_DRIVER_NAME                 "indigo_stub_static"
#define WAIT_TIMEOUT                     5.0

static atomic_int stub_init_calls;
static atomic_int stub_shutdown_calls;
static atomic_int stub_shutdown_result;
static indigo_driver_entry *stub_entry;

static indigo_result stub_static_driver(indigo_driver_action action, indigo_driver_info *info) {
	SET_DRIVER_INFO(info, "Stub static driver", STUB_DRIVER_NAME, 0x03000001, false, INDIGO_DRIVER_SHUTDOWN);
	switch (action) {
		case INDIGO_DRIVER_INIT:
			atomic_fetch_add(&stub_init_calls, 1);
			return INDIGO_OK;
		case INDIGO_DRIVER_SHUTDOWN:
			atomic_fetch_add(&stub_shutdown_calls, 1);
			return atomic_load(&stub_shutdown_result);
		default:
			return INDIGO_OK;
	}
}

static indigo_item *stub_drivers_item(void) {
	for (int i = 0; i < SERVER_DRIVERS_PROPERTY->count; i++) {
		if (!strcmp(SERVER_DRIVERS_PROPERTY->items[i].name, STUB_DRIVER_NAME)) {
			return SERVER_DRIVERS_PROPERTY->items + i;
		}
	}
	return NULL;
}

static bool wait_for_state(indigo_property *property, indigo_property_state state) {
	double deadline = indigo_monotonic_time() + WAIT_TIMEOUT;
	while (property->state != state && indigo_monotonic_time() < deadline) {
		indigo_usleep(5000);
	}
	return property->state == state;
}

static void request_unload(void) {
	indigo_property *request = indigo_init_text_property(NULL, server_device.name, SERVER_UNLOAD_PROPERTY_NAME, NULL, NULL, INDIGO_OK_STATE, INDIGO_RW_PERM, 1);
	indigo_init_text_item(request->items, SERVER_UNLOAD_ITEM_NAME, NULL, STUB_DRIVER_NAME);
	SERVER_UNLOAD_PROPERTY->state = INDIGO_OK_STATE;
	indigo_change_property(NULL, request);
	indigo_release_property(request);
}

static void request_enable(bool value) {
	indigo_property *request = indigo_init_switch_property(NULL, server_device.name, SERVER_DRIVERS_PROPERTY_NAME, NULL, NULL, INDIGO_OK_STATE, INDIGO_RW_PERM, INDIGO_ANY_OF_MANY_RULE, 1);
	indigo_init_switch_item(request->items, STUB_DRIVER_NAME, NULL, value);
	indigo_change_property(NULL, request);
	indigo_release_property(request);
}

static void unload_then_enable_reinitializes(void) {
	ASSERT_TRUE(stub_entry->initialized);
	ASSERT_TRUE(stub_drivers_item() != NULL && stub_drivers_item()->sw.value);
	int init_calls = atomic_load(&stub_init_calls);
	int shutdown_calls = atomic_load(&stub_shutdown_calls);
	request_unload();
	ASSERT_TRUE(wait_for_state(SERVER_UNLOAD_PROPERTY, INDIGO_OK_STATE));
	ASSERT_EQ_INT(shutdown_calls + 1, atomic_load(&stub_shutdown_calls));
	ASSERT_FALSE(stub_entry->initialized);
	ASSERT_FALSE(stub_drivers_item()->sw.value);
	request_enable(true);
	ASSERT_TRUE(wait_for_state(SERVER_DRIVERS_PROPERTY, INDIGO_OK_STATE));
	ASSERT_EQ_INT(init_calls + 1, atomic_load(&stub_init_calls));
	ASSERT_TRUE(stub_entry->initialized);
	ASSERT_TRUE(stub_drivers_item()->sw.value);
}

static void busy_unload_keeps_driver_initialized(void) {
	ASSERT_TRUE(stub_entry->initialized);
	int init_calls = atomic_load(&stub_init_calls);
	int shutdown_calls = atomic_load(&stub_shutdown_calls);
	atomic_store(&stub_shutdown_result, INDIGO_BUSY);
	request_unload();
	ASSERT_TRUE(wait_for_state(SERVER_UNLOAD_PROPERTY, INDIGO_ALERT_STATE));
	atomic_store(&stub_shutdown_result, INDIGO_OK);
	ASSERT_EQ_INT(shutdown_calls + 1, atomic_load(&stub_shutdown_calls));
	ASSERT_TRUE(stub_entry->initialized);
	ASSERT_TRUE(stub_drivers_item()->sw.value);
	// the driver still runs, so enabling it again must not initialize it twice
	request_enable(true);
	ASSERT_TRUE(wait_for_state(SERVER_DRIVERS_PROPERTY, INDIGO_OK_STATE));
	ASSERT_EQ_INT(init_calls, atomic_load(&stub_init_calls));
}

int main(void) {
	if (!indigo_test_use_private_home()) {
		return 1;
	}
	atomic_store(&stub_shutdown_result, INDIGO_OK);
	indigo_start();
	if (indigo_add_driver(stub_static_driver, true, &stub_entry) != INDIGO_OK || stub_entry == NULL || stub_entry->dl_handle != NULL) {
		fprintf(stderr, "stub static driver was not registered\n");
		return 1;
	}
	indigo_attach_device(&server_device);
	indigo_test_case tests[] = {
		{ "busy unload keeps driver initialized", busy_unload_keeps_driver_initialized },
		{ "unload then enable reinitializes", unload_then_enable_reinitializes }
	};
	int result = indigo_run_tests("server static driver", tests, sizeof(tests) / sizeof(tests[0]));
	indigo_detach_device(&server_device);
	if (stub_entry->initialized) {
		stub_static_driver(INDIGO_DRIVER_SHUTDOWN, NULL);
	}
	indigo_stop();
	indigo_test_remove_private_home();
	return result || indigo_test_failures;
}
