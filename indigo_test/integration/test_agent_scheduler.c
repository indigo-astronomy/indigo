// Copyright (c) 2026 INDIGO initiative
// All rights reserved.
//
// You may use this software under the terms of 'INDIGO Astronomy
// open-source license' (see LICENSE.md).
//
// THIS SOFTWARE IS PROVIDED BY THE AUTHORS 'AS IS' AND ANY EXPRESS
// OR IMPLIED WARRANTIES, INCLUDING, BUT NOT LIMITED TO, THE IMPLIED
// WARRANTIES OF MERCHANTABILITY AND FITNESS FOR A PARTICULAR PURPOSE
// ARE DISCLAIMED. IN NO EVENT SHALL THE AUTHOR BE LIABLE FOR ANY
// DIRECT, INDIRECT, INCIDENTAL, SPECIAL, EXEMPLARY, OR CONSEQUENTIAL
// DAMAGES (INCLUDING, BUT NOT LIMITED TO, PROCUREMENT OF SUBSTITUTE
// GOODS OR SERVICES; LOSS OF USE, DATA, OR PROFITS; OR BUSINESS
// INTERRUPTION) HOWEVER CAUSED AND ON ANY THEORY OF LIABILITY,
// WHETHER IN CONTRACT, STRICT LIABILITY, OR TORT (INCLUDING
// NEGLIGENCE OR OTHERWISE) ARISING IN ANY WAY OUT OF THE USE OF THIS
// SOFTWARE, EVEN IF ADVISED OF THE POSSIBILITY OF SUCH DAMAGE.

// Code is generated by AI

// Scheduler Agent with the real Scripting Agent and Sequencer.js, see indigo_drivers/agent_scheduler/doc/SCHEDULER.md.
// Task bodies use Sequence.wait() steps, so the scheduling state machine runs without device
// simulators; stand-ins for the Mount Agent (site) and the Guider Agent (abort) complete the bus.
// Every case runs in its own process with a private HOME, so configurations never leak.

#include <stdio.h>
#include <string.h>
#include <math.h>
#include <pthread.h>
#include <stdatomic.h>
#include <stdlib.h>
#include <unistd.h>
#include <time.h>
#include <ftw.h>
#include <sys/stat.h>

#include <indigo/indigo_driver.h>
#include <indigo/indigo_align.h>
#include <indigo_drivers/agent_scripting/indigo_agent_scripting.h>
#include <indigo_drivers/agent_scheduler/indigo_agent_scheduler.h>
#include <indigo_drivers/agent_scheduler/indigo_agent_scheduler_night.h>
#include <indigo_drivers/agent_scheduler/indigo_agent_scheduler_sky.h>

#if defined(__SANITIZE_ADDRESS__)
#include <sanitizer/lsan_interface.h>
#endif

#include "../test_runner.h"
#include "parallel_case_runner.h"

#define AGENT SCHEDULER_AGENT_NAME
#define ARRAY_SIZE(a) (sizeof(a) / sizeof((a)[0]))
#define REQUIRE(c) do { if (!(c)) { fprintf(stderr, "%s:%d: %s\n", __FILE__, __LINE__, #c); indigo_test_failures++; return; } } while (0)
#define CHECK(c) do { if (!(c)) { fprintf(stderr, "%s:%d: %s\n", __FILE__, __LINE__, #c); indigo_test_failures++; return false; } } while (0)

#define BODY_WAIT(seconds) "var sequence = new Sequence(scheduler_task.name);\nsequence.wait(" #seconds ");\nsequence.start();\n"

typedef struct {
	char device[INDIGO_NAME_SIZE], name[INDIGO_NAME_SIZE];
	indigo_property *property;
	unsigned revision;
	// INDIGO sends the message of an update separately, right after the update
	char message[INDIGO_VALUE_SIZE];
	unsigned message_revision;
} observation;

static observation cache[512];
static pthread_mutex_t cache_mutex = PTHREAD_MUTEX_INITIALIZER;
static char messages[262144];
static indigo_client observer;
static bool scheduler_running, scripting_running, mount_attached, guider_attached;
static char fixture_dir[256];
static atomic_int guider_aborts;
static atomic_bool guider_stubborn;
static indigo_property *site_property, *guider_process_property, *guider_abort_property;

// -------------------------------------------------------------------------------- Observer

static observation *find(const char *device, const char *name) {
	observation *free_entry = NULL;
	for (unsigned i = 0; i < ARRAY_SIZE(cache); i++) {
		if (!*cache[i].name) {
			if (!free_entry) {
				free_entry = cache + i;
			}
		} else if (!strcmp(cache[i].device, device) && !strcmp(cache[i].name, name)) {
			return cache + i;
		}
	}
	if (free_entry) {
		INDIGO_COPY_NAME(free_entry->device, device);
		INDIGO_COPY_NAME(free_entry->name, name);
	}
	return free_entry;
}

static indigo_result observe(indigo_client *client, indigo_device *device, indigo_property *property, const char *message) {
	pthread_mutex_lock(&cache_mutex);
	observation *entry = find(property->device, property->name);
	if (entry) {
		indigo_release_property(entry->property);
		entry->property = indigo_copy_property(NULL, property);
		entry->revision++;
		entry->message[0] = 0;
	}
	pthread_mutex_unlock(&cache_mutex);
	return INDIGO_OK;
}

static indigo_result deleted(indigo_client *client, indigo_device *device, indigo_property *property, const char *message) {
	pthread_mutex_lock(&cache_mutex);
	for (unsigned i = 0; i < ARRAY_SIZE(cache); i++) {
		observation *entry = cache + i;
		if (*entry->name && !strcmp(entry->device, property->device) && (!*property->name || !strcmp(entry->name, property->name))) {
			indigo_release_property(entry->property);
			entry->property = NULL;
			entry->revision++;
		}
	}
	pthread_mutex_unlock(&cache_mutex);
	return INDIGO_OK;
}

static indigo_result message_received(indigo_client *client, indigo_device *device, indigo_property *property, const char *message) {
	pthread_mutex_lock(&cache_mutex);
	if (message && device && !strcmp(device->name, AGENT)) {
		if (strlen(messages) + strlen(message) + 2 < sizeof(messages)) {
			strcat(messages, message);
			strcat(messages, "\n");
		}
		if (property) {
			observation *entry = find(property->device, property->name);
			if (entry) {
				INDIGO_COPY_VALUE(entry->message, message);
				entry->message_revision = entry->revision;
			}
		}
	}
	pthread_mutex_unlock(&cache_mutex);
	return INDIGO_OK;
}

static indigo_property *snapshot(const char *name) {
	pthread_mutex_lock(&cache_mutex);
	observation *entry = find(AGENT, name);
	indigo_property *result = entry && entry->property ? indigo_copy_property(NULL, entry->property) : NULL;
	pthread_mutex_unlock(&cache_mutex);
	return result;
}

static unsigned revision(const char *name) {
	pthread_mutex_lock(&cache_mutex);
	observation *entry = find(AGENT, name);
	unsigned result = entry ? entry->revision : 0;
	pthread_mutex_unlock(&cache_mutex);
	return result;
}

static int count_messages(const char *text) {
	pthread_mutex_lock(&cache_mutex);
	int count = 0;
	for (const char *s = messages; (s = strstr(s, text)) != NULL; s += strlen(text)) {
		count++;
	}
	pthread_mutex_unlock(&cache_mutex);
	return count;
}

// position of the first occurrence of text in the message log, -1 if missing
static long message_position(const char *text) {
	pthread_mutex_lock(&cache_mutex);
	const char *s = strstr(messages, text);
	long result = s ? (long)(s - messages) : -1;
	pthread_mutex_unlock(&cache_mutex);
	return result;
}

// position of the last occurrence of text in the message log, -1 if missing
static long message_position_last(const char *text) {
	pthread_mutex_lock(&cache_mutex);
	const char *last = NULL;
	for (const char *s = messages; (s = strstr(s, text)) != NULL; s += strlen(text)) {
		last = s;
	}
	long result = last ? (long)(last - messages) : -1;
	pthread_mutex_unlock(&cache_mutex);
	return result;
}

static bool wait_message(const char *text, int count, double timeout) {
	for (double t = 0; t < timeout; t += 0.01) {
		if (count_messages(text) >= count) {
			return true;
		}
		indigo_usleep(10000);
	}
	fprintf(stderr, "Timeout waiting for message '%s' x%d, messages:\n%s\n", text, count, messages);
	return false;
}

// label of the TASK_STATE item of a task, empty if not listed
static bool task_label(const char *name, char *label, indigo_property_state *state) {
	indigo_property *property = snapshot(AGENT_SCHEDULER_TASK_STATE_PROPERTY_NAME);
	bool found = false;
	if (property) {
		char prefix[INDIGO_VALUE_SIZE];
		snprintf(prefix, sizeof(prefix), "%s", name);
		for (int i = 0; i < property->count; i++) {
			const char *item_label = property->items[i].label;
			if (!strncmp(item_label, prefix, strlen(prefix)) && (item_label[strlen(prefix)] == ' ')) {
				strcpy(label, item_label);
				if (state) {
					*state = property->items[i].light.value;
				}
				found = true;
				break;
			}
		}
		indigo_release_property(property);
	}
	return found;
}

static bool wait_task_state(const char *name, const char *state_name, double timeout) {
	char label[INDIGO_VALUE_SIZE] = "";
	for (double t = 0; t < timeout; t += 0.01) {
		if (task_label(name, label, NULL) && strstr(label, state_name)) {
			return true;
		}
		indigo_usleep(10000);
	}
	fprintf(stderr, "Timeout waiting for task '%s' in state %s, label '%s', messages:\n%s\n", name, state_name, label, messages);
	return false;
}

static bool wait_scheduler_state(indigo_property_state state, double timeout) {
	for (double t = 0; t < timeout; t += 0.01) {
		indigo_property *property = snapshot(AGENT_SCHEDULER_STATE_PROPERTY_NAME);
		bool ready = property && property->state == state;
		indigo_release_property(property);
		if (ready) {
			return true;
		}
		indigo_usleep(10000);
	}
	fprintf(stderr, "Timeout waiting for scheduler state %d, messages:\n%s\n", state, messages);
	return false;
}

static bool wait_property_state(const char *name, unsigned before, indigo_property_state state, char *message) {
	for (int i = 0; i < 1000; i++) {
		pthread_mutex_lock(&cache_mutex);
		observation *entry = find(AGENT, name);
		bool ready = entry && entry->property && entry->revision > before && entry->property->state == state;
		pthread_mutex_unlock(&cache_mutex);
		if (ready) {
			if (message) {
				// the message, if any, follows the update immediately
				message[0] = 0;
				for (int j = 0; j < 50; j++) {
					pthread_mutex_lock(&cache_mutex);
					bool arrived = entry->message_revision == entry->revision;
					if (arrived) {
						strcpy(message, entry->message);
					}
					pthread_mutex_unlock(&cache_mutex);
					if (arrived) {
						break;
					}
					indigo_usleep(10000);
				}
			}
			return true;
		}
		indigo_usleep(10000);
	}
	fprintf(stderr, "Timeout waiting for %s state %d\n", name, state);
	return false;
}

static bool current_reason(char *reason) {
	indigo_property *property = snapshot(AGENT_SCHEDULER_CURRENT_PROPERTY_NAME);
	if (property == NULL) {
		return false;
	}
	indigo_item *item = indigo_get_item(property, AGENT_SCHEDULER_CURRENT_REASON_ITEM_NAME);
	strcpy(reason, item ? indigo_get_text_item_value(item) : "");
	indigo_release_property(property);
	return true;
}

static bool wait_reason(const char *text, double timeout) {
	char reason[INDIGO_VALUE_SIZE] = "";
	for (double t = 0; t < timeout; t += 0.01) {
		if (current_reason(reason) && strstr(reason, text)) {
			return true;
		}
		indigo_usleep(10000);
	}
	fprintf(stderr, "Timeout waiting for reason '%s', reason is '%s'\n", text, reason);
	return false;
}

// -------------------------------------------------------------------------------- Requests

static bool change_text(const char *name, const char *item, const char *value, indigo_property_state expected, char *message) {
	unsigned before = revision(name);
	const char *items[] = { item };
	const char *values[] = { value };
	indigo_change_text_property(&observer, AGENT, name, 1, items, values);
	return wait_property_state(name, before, expected, message);
}

static bool upload(const char *text) {
	char message[INDIGO_VALUE_SIZE];
	if (!change_text(AGENT_SCHEDULER_ADD_TASK_PROPERTY_NAME, AGENT_SCHEDULER_ADD_TASK_TASK_ITEM_NAME, text, INDIGO_OK_STATE, message)) {
		fprintf(stderr, "Upload failed: %s\n", message);
		return false;
	}
	return true;
}

static bool urgent(const char *text) {
	return change_text(AGENT_SCHEDULER_URGENT_TASK_PROPERTY_NAME, AGENT_SCHEDULER_URGENT_TASK_TASK_ITEM_NAME, text, INDIGO_OK_STATE, NULL);
}

static bool command(const char *task, const char *item) {
	if (!change_text(AGENT_SCHEDULER_TASK_NAME_PROPERTY_NAME, AGENT_SCHEDULER_TASK_NAME_NAME_ITEM_NAME, task, INDIGO_OK_STATE, NULL)) {
		return false;
	}
	unsigned before = revision(AGENT_SCHEDULER_TASK_COMMAND_PROPERTY_NAME);
	indigo_change_switch_property_1(&observer, AGENT, AGENT_SCHEDULER_TASK_COMMAND_PROPERTY_NAME, item, true);
	return wait_property_state(AGENT_SCHEDULER_TASK_COMMAND_PROPERTY_NAME, before, INDIGO_OK_STATE, NULL);
}

static bool control(const char *item) {
	unsigned before = revision(AGENT_SCHEDULER_CONTROL_PROPERTY_NAME);
	indigo_change_switch_property_1(&observer, AGENT, AGENT_SCHEDULER_CONTROL_PROPERTY_NAME, item, true);
	return wait_property_state(AGENT_SCHEDULER_CONTROL_PROPERTY_NAME, before, INDIGO_OK_STATE, NULL);
}

static bool fast_settings(void) {
	unsigned before = revision(AGENT_SCHEDULER_SETTINGS_PROPERTY_NAME);
	const char *items[] = { AGENT_SCHEDULER_SETTINGS_IDLE_CHECK_INTERVAL_ITEM_NAME, AGENT_SCHEDULER_SETTINGS_STOP_TIMEOUT_ITEM_NAME, AGENT_SCHEDULER_SETTINGS_START_TIMEOUT_ITEM_NAME };
	double values[] = { 1, 5, 3 };
	indigo_change_number_property(&observer, AGENT, AGENT_SCHEDULER_SETTINGS_PROPERTY_NAME, 3, items, values);
	return wait_property_state(AGENT_SCHEDULER_SETTINGS_PROPERTY_NAME, before, INDIGO_OK_STATE, NULL);
}

static bool set_setting(const char *item, double value) {
	unsigned before = revision(AGENT_SCHEDULER_SETTINGS_PROPERTY_NAME);
	const char *items[] = { item };
	double values[] = { value };
	indigo_change_number_property(&observer, AGENT, AGENT_SCHEDULER_SETTINGS_PROPERTY_NAME, 1, items, values);
	return wait_property_state(AGENT_SCHEDULER_SETTINGS_PROPERTY_NAME, before, INDIGO_OK_STATE, NULL);
}

static indigo_property_state sequence_state(void) {
	pthread_mutex_lock(&cache_mutex);
	observation *entry = find(SCRIPTING_AGENT_NAME, "SEQUENCE_STATE");
	indigo_property_state state = entry && entry->property ? entry->property->state : (indigo_property_state)-1;
	pthread_mutex_unlock(&cache_mutex);
	return state;
}

static bool wait_sequence_state(indigo_property_state state, double timeout) {
	for (double t = 0; t < timeout; t += 0.01) {
		if (sequence_state() == state) {
			return true;
		}
		indigo_usleep(10000);
	}
	fprintf(stderr, "Timeout waiting for SEQUENCE_STATE %d, observed %d\n", state, sequence_state());
	return false;
}

static bool set_hooks(const char *startup, const char *shutdown, const char *idle) {
	unsigned before = revision(AGENT_SCHEDULER_HOOKS_PROPERTY_NAME);
	const char *items[] = { AGENT_SCHEDULER_HOOKS_STARTUP_ITEM_NAME, AGENT_SCHEDULER_HOOKS_SHUTDOWN_ITEM_NAME, AGENT_SCHEDULER_HOOKS_IDLE_ITEM_NAME };
	const char *values[] = { startup, shutdown, idle };
	indigo_change_text_property(&observer, AGENT, AGENT_SCHEDULER_HOOKS_PROPERTY_NAME, 3, items, values);
	return wait_property_state(AGENT_SCHEDULER_HOOKS_PROPERTY_NAME, before, INDIGO_OK_STATE, NULL);
}

static bool set_night_hooks(const char *night_start, const char *night_end, const char *resume) {
	unsigned before = revision(AGENT_SCHEDULER_HOOKS_PROPERTY_NAME);
	const char *items[] = { AGENT_SCHEDULER_HOOKS_NIGHT_START_ITEM_NAME, AGENT_SCHEDULER_HOOKS_NIGHT_END_ITEM_NAME, AGENT_SCHEDULER_HOOKS_RESUME_ITEM_NAME };
	const char *values[] = { night_start, night_end, resume };
	indigo_change_text_property(&observer, AGENT, AGENT_SCHEDULER_HOOKS_PROPERTY_NAME, 3, items, values);
	return wait_property_state(AGENT_SCHEDULER_HOOKS_PROPERTY_NAME, before, INDIGO_OK_STATE, NULL);
}

static bool set_night_limit(const char *item) {
	unsigned before = revision(AGENT_SCHEDULER_NIGHT_PROPERTY_NAME);
	indigo_change_switch_property_1(&observer, AGENT, AGENT_SCHEDULER_NIGHT_PROPERTY_NAME, item, true);
	return wait_property_state(AGENT_SCHEDULER_NIGHT_PROPERTY_NAME, before, INDIGO_OK_STATE, NULL);
}

// label of the newest history entry of a task, empty if none
static bool history_label(const char *task, int index, char *label) {
	indigo_property *property = snapshot(AGENT_SCHEDULER_HISTORY_PROPERTY_NAME);
	bool found = false;
	int seen = 0;
	if (property) {
		for (int i = 0; i < property->count; i++) {
			if (strstr(property->items[i].label, task) && seen++ == index) {
				strcpy(label, property->items[i].label);
				found = true;
				break;
			}
		}
		indigo_release_property(property);
	}
	return found;
}

static int history_count(void) {
	indigo_property *property = snapshot(AGENT_SCHEDULER_HISTORY_PROPERTY_NAME);
	int count = property ? property->count : -1;
	indigo_release_property(property);
	return count;
}

static void utc(time_t t, char *buffer) {
	struct tm tm_time;
	gmtime_r(&t, &tm_time);
	strftime(buffer, 32, "%Y-%m-%d %H:%M", &tm_time);
}

// -------------------------------------------------------------------------------- Stand-in agents

static indigo_result mount_enumerate(indigo_device *device, indigo_client *client, indigo_property *property) {
	if (indigo_property_match(site_property, property)) {
		indigo_define_property(device, site_property, NULL);
	}
	return INDIGO_OK;
}

static indigo_result guider_enumerate(indigo_device *device, indigo_client *client, indigo_property *property) {
	if (indigo_property_match(guider_process_property, property)) {
		indigo_define_property(device, guider_process_property, NULL);
	}
	if (indigo_property_match(guider_abort_property, property)) {
		indigo_define_property(device, guider_abort_property, NULL);
	}
	return INDIGO_OK;
}

static indigo_result guider_change(indigo_device *device, indigo_client *client, indigo_property *property) {
	if (indigo_property_match_changeable(guider_abort_property, property)) {
		atomic_fetch_add(&guider_aborts, 1);
		indigo_update_property(device, guider_abort_property, NULL);
		if (!atomic_load(&guider_stubborn)) {
			guider_process_property->state = INDIGO_ALERT_STATE;
			guider_process_property->items[0].sw.value = false;
			indigo_update_property(device, guider_process_property, "Guiding aborted");
		}
	}
	return INDIGO_OK;
}

static indigo_device mount_standin = INDIGO_DEVICE_INITIALIZER("Mount Agent", NULL, mount_enumerate, NULL, NULL, NULL);
static indigo_device guider_standin = INDIGO_DEVICE_INITIALIZER("Guider Agent", NULL, guider_enumerate, guider_change, NULL, NULL);

// the plan labels and states, the count or -1 when the property is missing; a redefine at a minute boundary deletes it for a moment
static int plan_items(char labels[][INDIGO_VALUE_SIZE], indigo_property_state *states, int max) {
	indigo_property *property = snapshot(AGENT_SCHEDULER_PLAN_PROPERTY_NAME);
	for (int i = 0; i < 100 && property == NULL; i++) {
		indigo_usleep(10000);
		property = snapshot(AGENT_SCHEDULER_PLAN_PROPERTY_NAME);
	}
	if (property == NULL) {
		return -1;
	}
	int count = property->count;
	for (int i = 0; i < count && i < max; i++) {
		strcpy(labels[i], property->items[i].label);
		states[i] = property->items[i].light.value;
	}
	indigo_release_property(property);
	return count;
}

// waits until the plan has count items and the item at index contains text
static bool wait_plan_item(int count, int index, const char *text, double timeout) {
	char labels[16][INDIGO_VALUE_SIZE];
	indigo_property_state states[16];
	int found = -1;
	for (double t = 0; t < timeout; t += 0.01) {
		found = plan_items(labels, states, 16);
		if (found == count && (count == 0 || strstr(labels[index], text))) {
			return true;
		}
		indigo_usleep(10000);
	}
	fprintf(stderr, "Timeout waiting for a plan of %d items with '%s' at %d, found %d:\n", count, text, index, found);
	for (int i = 0; i < found && i < 16; i++) {
		fprintf(stderr, "  %s [%d]\n", labels[i], states[i]);
	}
	return false;
}

// waits until some plan item contains text, or with present false until none does
static bool wait_plan_contains(const char *text, bool present, double timeout) {
	char labels[32][INDIGO_VALUE_SIZE];
	indigo_property_state states[32];
	int found = -1;
	for (double t = 0; t < timeout; t += 0.01) {
		found = plan_items(labels, states, 32);
		bool contains = false;
		for (int i = 0; i < found && i < 32; i++) {
			contains = contains || strstr(labels[i], text) != NULL;
		}
		if (found >= 0 && contains == present) {
			return true;
		}
		indigo_usleep(10000);
	}
	fprintf(stderr, "Timeout waiting for a plan %s '%s', found %d:\n", present ? "with" : "without", text, found);
	for (int i = 0; i < found && i < 32; i++) {
		fprintf(stderr, "  %s [%d]\n", labels[i], states[i]);
	}
	return false;
}

static bool wait_plan(int count, const char *text, double timeout) {
	return wait_plan_item(count, 0, text, timeout);
}

// waits until the first planned run contains text and has the state, Busy for the running task
static bool wait_plan_first(const char *text, indigo_property_state state, double timeout) {
	char labels[16][INDIGO_VALUE_SIZE];
	indigo_property_state states[16];
	int found = -1;
	for (double t = 0; t < timeout; t += 0.01) {
		found = plan_items(labels, states, 16);
		if (found > 0 && states[0] == state && strstr(labels[0], text)) {
			return true;
		}
		indigo_usleep(10000);
	}
	fprintf(stderr, "Timeout waiting for '%s' in state %d first in the plan, found %d:\n", text, state, found);
	for (int i = 0; i < found && i < 16; i++) {
		fprintf(stderr, "  %s [%d]\n", labels[i], states[i]);
	}
	return false;
}

// start and end of a planned run in minutes of the day, the label begins with "HH:MM\u2013HH:MM"
static bool plan_times(const char *label, int *start, int *end) {
	int start_hour, start_minute, end_hour, end_minute;
	if (sscanf(label, "%d:%d", &start_hour, &start_minute) != 2 || strncmp(label + 5, "\xe2\x80\x93", 3) || sscanf(label + 8, "%d:%d", &end_hour, &end_minute) != 2) {
		return false;
	}
	*start = start_hour * 60 + start_minute;
	*end = end_hour * 60 + end_minute;
	return true;
}

static int minutes_between(int from, int to) {
	return (to - from + 1440) % 1440;
}

// moves the site to the longitude where the mean solar time is 18:00, the next sunrise is then hours away whenever the case runs
static void site_at_evening(void) {
	time_t now = time(NULL);
	double hours = (now % 86400) / 3600.0;
	site_property->items[1].number.value = site_property->items[1].number.target = fmod((18 - hours) * 15 + 720, 360);
	indigo_update_property(&mount_standin, site_property, NULL);
}

// the night cases use the equator, where every night lasts about 11 hours at the nautical limit
#define NIGHT_LATITUDE		0
#define NIGHT_ELEVATION		140

static void set_site(double latitude, double longitude) {
	site_property->items[0].number.value = site_property->items[0].number.target = latitude;
	site_property->items[1].number.value = site_property->items[1].number.target = longitude;
	indigo_update_property(&mount_standin, site_property, NULL);
}

// the longitude where a nautical night starts (or ends) at target; the events move by 240 s per degree
static double night_longitude(time_t target, bool end) {
	static scheduler_nights nights;
	double longitude = 17.11;
	for (int i = 0; i < 6; i++) {
		indigo_scheduler_nights_build(&nights, target, NIGHT_LATITUDE, longitude, NIGHT_ELEVATION, -12, 0, 0);
		const scheduler_night *best = NULL;
		long best_error = 0;
		for (int j = 0; j < nights.count; j++) {
			const scheduler_night *night = nights.nights + j;
			if (end ? !night->end_known : !night->start_known) {
				continue;
			}
			long error = (long)((end ? night->end : night->start) - target);
			if (best == NULL || labs(error) < labs(best_error)) {
				best = night;
				best_error = error;
			}
		}
		if (best == NULL) {
			break;
		}
		longitude = fmod(longitude + best_error / 240.0 + 720, 360);
	}
	return longitude;
}

// a whole minute at least seconds ahead, so that a window can open with the night
static time_t minute_ahead(int seconds) {
	time_t t = time(NULL) + seconds;
	return t - t % 60 + 60;
}

static void wait_until(time_t t) {
	while (time(NULL) < t) {
		indigo_usleep(100000);
	}
}

static void set_guiding(bool guiding) {
	guider_process_property->items[0].sw.value = guiding;
	guider_process_property->state = guiding ? INDIGO_BUSY_STATE : INDIGO_OK_STATE;
	indigo_update_property(&guider_standin, guider_process_property, NULL);
}

// -------------------------------------------------------------------------------- Lifecycle

static bool start_scheduler(void) {
	CHECK(indigo_agent_scheduler(INDIGO_DRIVER_INIT, NULL) == INDIGO_OK);
	scheduler_running = true;
	for (int i = 0; i < 500 && revision(AGENT_SCHEDULER_SETTINGS_PROPERTY_NAME) == 0; i++) {
		indigo_usleep(10000);
	}
	CHECK(revision(AGENT_SCHEDULER_SETTINGS_PROPERTY_NAME) > 0);
	// let the configuration restore finish before the case changes anything
	indigo_usleep(300000);
	return fast_settings();
}

static void stop_scheduler(void) {
	if (scheduler_running) {
		indigo_agent_scheduler(INDIGO_DRIVER_SHUTDOWN, NULL);
		scheduler_running = false;
	}
}

static bool setup(void) {
	indigo_set_log_level(getenv("INDIGO_TEST_DEBUG") ? INDIGO_LOG_DEBUG : INDIGO_LOG_ERROR);
	CHECK(indigo_start() == INDIGO_OK);
	strcpy(observer.name, "Scheduler test observer");
	observer.version = INDIGO_VERSION_CURRENT;
	observer.define_property = observe;
	observer.update_property = observe;
	observer.delete_property = deleted;
	observer.send_message = message_received;
	CHECK(indigo_attach_client(&observer) == INDIGO_OK);
	site_property = indigo_init_number_property(NULL, mount_standin.name, GEOGRAPHIC_COORDINATES_PROPERTY_NAME, "Site", "Location", INDIGO_OK_STATE, INDIGO_RO_PERM, 3);
	indigo_init_number_item(site_property->items + 0, GEOGRAPHIC_COORDINATES_LATITUDE_ITEM_NAME, "Latitude", -90, 90, 0, 48.15);
	indigo_init_number_item(site_property->items + 1, GEOGRAPHIC_COORDINATES_LONGITUDE_ITEM_NAME, "Longitude", 0, 360, 0, 17.11);
	indigo_init_number_item(site_property->items + 2, GEOGRAPHIC_COORDINATES_ELEVATION_ITEM_NAME, "Elevation", -400, 9000, 0, 140);
	guider_process_property = indigo_init_switch_property(NULL, guider_standin.name, AGENT_START_PROCESS_PROPERTY_NAME, "Guider", "Start process", INDIGO_OK_STATE, INDIGO_RW_PERM, INDIGO_AT_MOST_ONE_RULE, 1);
	indigo_init_switch_item(guider_process_property->items, "GUIDING", "Guiding", false);
	guider_abort_property = indigo_init_switch_property(NULL, guider_standin.name, AGENT_ABORT_PROCESS_PROPERTY_NAME, "Guider", "Abort", INDIGO_OK_STATE, INDIGO_RW_PERM, INDIGO_AT_MOST_ONE_RULE, 1);
	indigo_init_switch_item(guider_abort_property->items, AGENT_ABORT_PROCESS_ITEM_NAME, "Abort", false);
	CHECK(indigo_attach_device(&mount_standin) == INDIGO_OK);
	mount_attached = true;
	CHECK(indigo_attach_device(&guider_standin) == INDIGO_OK);
	guider_attached = true;
	CHECK(indigo_agent_scripting(INDIGO_DRIVER_INIT, NULL) == INDIGO_OK);
	scripting_running = true;
	return start_scheduler();
}

static void cleanup(void) {
	stop_scheduler();
	if (scripting_running) {
		indigo_agent_scripting(INDIGO_DRIVER_SHUTDOWN, NULL);
	}
	if (guider_attached) {
		indigo_detach_device(&guider_standin);
	}
	if (mount_attached) {
		indigo_detach_device(&mount_standin);
	}
	indigo_detach_client(&observer);
	indigo_stop();
	for (unsigned i = 0; i < ARRAY_SIZE(cache); i++) {
		indigo_release_property(cache[i].property);
	}
	indigo_release_property(site_property);
	indigo_release_property(guider_process_property);
	indigo_release_property(guider_abort_property);
}

// -------------------------------------------------------------------------------- Cases

static void store_edit_and_delete(void) {
	REQUIRE(upload("// @task Alpha\n// @priority high 70\n\n" BODY_WAIT(1)));
	indigo_property *task = snapshot("AGENT_SCHEDULER_TASK_0");
	REQUIRE(task != NULL);
	ASSERT_STREQ("Alpha", task->label);
	ASSERT_TRUE(strstr(indigo_get_text_item_value(task->items), "// @priority high 70") != NULL);
	indigo_release_property(task);
	char label[INDIGO_VALUE_SIZE];
	ASSERT_TRUE(task_label("Alpha", label, NULL));
	ASSERT_TRUE(strstr(label, "QUEUED") != NULL);
	// invalid and duplicate uploads are rejected with the line and the problem
	char message[INDIGO_VALUE_SIZE];
	ASSERT_TRUE(change_text(AGENT_SCHEDULER_ADD_TASK_PROPERTY_NAME, AGENT_SCHEDULER_ADD_TASK_TASK_ITEM_NAME, "// @task Beta\n// @altitude > 30\n" BODY_WAIT(1), INDIGO_ALERT_STATE, message));
	ASSERT_TRUE(strstr(message, "require @target") != NULL);
	ASSERT_TRUE(change_text(AGENT_SCHEDULER_ADD_TASK_PROPERTY_NAME, AGENT_SCHEDULER_ADD_TASK_TASK_ITEM_NAME, "// @task Beta\n// @duration 0\n" BODY_WAIT(1), INDIGO_ALERT_STATE, message));
	ASSERT_TRUE(strstr(message, "line 2: @duration") != NULL);
	ASSERT_TRUE(change_text(AGENT_SCHEDULER_ADD_TASK_PROPERTY_NAME, AGENT_SCHEDULER_ADD_TASK_TASK_ITEM_NAME, "// @task alpha\n" BODY_WAIT(1), INDIGO_ALERT_STATE, message));
	ASSERT_TRUE(strstr(message, "already exists") != NULL);
	// an edit can rename the task, an invalid edit leaves it unchanged
	ASSERT_TRUE(change_text("AGENT_SCHEDULER_TASK_0", AGENT_SCHEDULER_TASK_TASK_ITEM_NAME, "// @task Gamma\n// @enabled maybe\n" BODY_WAIT(1), INDIGO_ALERT_STATE, message));
	ASSERT_TRUE(strstr(message, "@enabled") != NULL);
	ASSERT_TRUE(change_text("AGENT_SCHEDULER_TASK_0", AGENT_SCHEDULER_TASK_TASK_ITEM_NAME, "// @task Gamma\n" BODY_WAIT(2), INDIGO_OK_STATE, NULL));
	task = snapshot("AGENT_SCHEDULER_TASK_0");
	REQUIRE(task != NULL);
	ASSERT_STREQ("Gamma", task->label);
	ASSERT_TRUE(strstr(indigo_get_text_item_value(task->items), "wait(2)") != NULL);
	indigo_release_property(task);
	ASSERT_TRUE(task_label("Gamma", label, NULL));
	ASSERT_FALSE(task_label("Alpha", label, NULL));
	ASSERT_TRUE(change_text(AGENT_SCHEDULER_DELETE_TASK_PROPERTY_NAME, AGENT_SCHEDULER_DELETE_TASK_NAME_ITEM_NAME, "Gamma", INDIGO_OK_STATE, NULL));
	ASSERT_TRUE(snapshot("AGENT_SCHEDULER_TASK_0") == NULL);
	ASSERT_FALSE(task_label("Gamma", label, NULL));
	ASSERT_TRUE(change_text(AGENT_SCHEDULER_DELETE_TASK_PROPERTY_NAME, AGENT_SCHEDULER_DELETE_TASK_NAME_ITEM_NAME, "Gamma", INDIGO_ALERT_STATE, message));
	ASSERT_TRUE(strstr(message, "not found") != NULL);
}

static void commands_and_order(void) {
	REQUIRE(upload("// @task One\n" BODY_WAIT(1)));
	REQUIRE(upload("// @task Two\n" BODY_WAIT(1)));
	REQUIRE(upload("// @task Three\n" BODY_WAIT(1)));
	REQUIRE(command("Three", AGENT_SCHEDULER_TASK_COMMAND_MOVE_UP_ITEM_NAME));
	REQUIRE(command("One", AGENT_SCHEDULER_TASK_COMMAND_MOVE_DOWN_ITEM_NAME));
	indigo_property *list = snapshot(AGENT_SCHEDULER_TASK_STATE_PROPERTY_NAME);
	REQUIRE(list != NULL && list->count == 3);
	ASSERT_TRUE(!strncmp(list->items[0].label, "Three ", 6));
	ASSERT_TRUE(!strncmp(list->items[1].label, "One ", 4));
	ASSERT_TRUE(!strncmp(list->items[2].label, "Two ", 4));
	indigo_release_property(list);
	REQUIRE(command("Two", AGENT_SCHEDULER_TASK_COMMAND_DISABLE_ITEM_NAME));
	ASSERT_TRUE(wait_task_state("Two", "DISABLED", 2));
	REQUIRE(command("Two", AGENT_SCHEDULER_TASK_COMMAND_ENABLE_ITEM_NAME));
	ASSERT_TRUE(wait_task_state("Two", "QUEUED", 2));
	unsigned before = revision(AGENT_SCHEDULER_TASK_COMMAND_PROPERTY_NAME);
	REQUIRE(change_text(AGENT_SCHEDULER_TASK_NAME_PROPERTY_NAME, AGENT_SCHEDULER_TASK_NAME_NAME_ITEM_NAME, "Nobody", INDIGO_OK_STATE, NULL));
	indigo_change_switch_property_1(&observer, AGENT, AGENT_SCHEDULER_TASK_COMMAND_PROPERTY_NAME, AGENT_SCHEDULER_TASK_COMMAND_RESET_ITEM_NAME, true);
	ASSERT_TRUE(wait_property_state(AGENT_SCHEDULER_TASK_COMMAND_PROPERTY_NAME, before, INDIGO_ALERT_STATE, NULL));
}

static void run_order_by_priority(void) {
	REQUIRE(upload("// @task Low\n// @priority low 90\n" BODY_WAIT(1)));
	REQUIRE(upload("// @task Normal\n// @priority normal 10\n" BODY_WAIT(1)));
	REQUIRE(upload("// @task High\n// @priority high 0\n" BODY_WAIT(1)));
	REQUIRE(control(AGENT_SCHEDULER_CONTROL_START_ITEM_NAME));
	ASSERT_TRUE(wait_message("Starting task 'High'", 1, 15));
	// a task uploaded while another one runs never interrupts it
	REQUIRE(upload("// @task Later\n// @priority high 100\n" BODY_WAIT(1)));
	ASSERT_TRUE(wait_message("All tasks finished", 1, 30));
	long high = message_position("Task 'High' completed");
	long later = message_position("Starting task 'Later'");
	long normal = message_position("Starting task 'Normal'");
	long low = message_position("Starting task 'Low'");
	ASSERT_TRUE(high >= 0 && later > high && normal > later && low > normal);
	ASSERT_TRUE(wait_task_state("Low", "DONE", 2));
	ASSERT_TRUE(wait_scheduler_state(INDIGO_OK_STATE, 2));
	indigo_property *state = snapshot(AGENT_SCHEDULER_STATE_PROPERTY_NAME);
	REQUIRE(state != NULL);
	ASSERT_EQ_INT(4, (int)indigo_get_item(state, AGENT_SCHEDULER_STATE_DONE_ITEM_NAME)->number.value);
	ASSERT_EQ_INT(4, (int)indigo_get_item(state, AGENT_SCHEDULER_STATE_TOTAL_ITEM_NAME)->number.value);
	indigo_release_property(state);
}

static void window_wait_and_expiry(void) {
	time_t now = time(NULL);
	char start[32], end[32], short_end[32];
	// the window opens at the next whole minute, at least 10 s ahead so the case sees it closed first
	time_t open = now - now % 60 + 60;
	if (open - now < 10) {
		open += 60;
	}
	utc(open, start);
	utc(open + 3600, end);
	utc(open, short_end);
	char text[512];
	snprintf(text, sizeof(text), "// @task Window\n// @window %s .. %s\n// @duration 1\n" BODY_WAIT(1), start, end);
	REQUIRE(upload(text));
	// a task whose window closes before its duration elapses never starts and expires
	snprintf(text, sizeof(text), "// @task TooShort\n// @window .. %s\n// @duration 5\n" BODY_WAIT(1), short_end);
	REQUIRE(upload(text));
	REQUIRE(control(AGENT_SCHEDULER_CONTROL_START_ITEM_NAME));
	ASSERT_TRUE(wait_task_state("Window", "WAITING", 5));
	ASSERT_TRUE(wait_reason("window", 5));
	indigo_property *current = snapshot(AGENT_SCHEDULER_CURRENT_PROPERTY_NAME);
	REQUIRE(current != NULL);
	char expected[64];
	indigo_timetoisogm(open, expected, sizeof(expected));
	ASSERT_STREQ(expected, indigo_get_text_item_value(indigo_get_item(current, AGENT_SCHEDULER_CURRENT_NEXT_START_ITEM_NAME)));
	ASSERT_STREQ("Window", indigo_get_text_item_value(indigo_get_item(current, AGENT_SCHEDULER_CURRENT_NEXT_ITEM_NAME)));
	indigo_release_property(current);
	ASSERT_EQ_INT(0, count_messages("Starting task 'Window'"));
	ASSERT_TRUE(wait_message("Starting task 'Window'", 1, (double)(open - time(NULL)) + 5));
	ASSERT_TRUE(time(NULL) >= open);
	ASSERT_TRUE(wait_task_state("Window", "DONE", 10));
	ASSERT_TRUE(wait_task_state("TooShort", "EXPIRED", 5));
	ASSERT_EQ_INT(0, count_messages("Starting task 'TooShort'"));
}

static void target_below_horizon_waits(void) {
	REQUIRE(upload("// @task South\n// @target 06:00:00 -89:00:00\n// @duration 1\n" BODY_WAIT(1)));
	REQUIRE(control(AGENT_SCHEDULER_CONTROL_START_ITEM_NAME));
	ASSERT_TRUE(wait_task_state("South", "WAITING", 5));
	ASSERT_TRUE(wait_reason("target below the horizon", 5));
	ASSERT_EQ_INT(0, count_messages("Starting task 'South'"));
}

static void repeat_retry_and_failures(void) {
	REQUIRE(upload("// @task Twice\n// @repeat 2\n" BODY_WAIT(1)));
	// fails only when it runs, its estimate passes
	REQUIRE(upload("// @task Broken\n// @priority low\n// @retry 1\nif (!scheduler_task.estimate) { throw new Error(\"broken body\"); }\n" BODY_WAIT(1)));
	// a body that cannot run at all is found by its estimate and never runs
	REQUIRE(upload("// @task Syntax\n// @priority low 10\nvar = ;\n"));
	REQUIRE(upload("// @task Thrown\n// @priority low 20\nthrow new Error(\"always\");\n"));
	REQUIRE(upload("// @task NoStart\n// @priority low 0\nvar sequence = new Sequence(scheduler_task.name);\nsequence.wait(1);\n"));
	REQUIRE(control(AGENT_SCHEDULER_CONTROL_START_ITEM_NAME));
	ASSERT_TRUE(wait_message("Task 'Twice' completed run 1 of 2", 1, 15));
	ASSERT_TRUE(wait_message("Task 'Twice' completed", 2, 15));
	ASSERT_TRUE(wait_task_state("Twice", "DONE", 5));
	ASSERT_TRUE(wait_message("Task 'Broken' failed: Error: broken body, it will be retried", 1, 15));
	ASSERT_TRUE(wait_task_state("Broken", "FAILED", 15));
	ASSERT_EQ_INT(2, count_messages("Starting task 'Broken'"));
	ASSERT_TRUE(wait_task_state("Syntax", "SCRIPT ERROR", 15));
	ASSERT_TRUE(wait_message("Task 'Syntax' has a script error: SyntaxError", 1, 5));
	ASSERT_TRUE(wait_task_state("Thrown", "SCRIPT ERROR", 15));
	ASSERT_TRUE(wait_message("Task 'Thrown' has a script error: Error: always", 1, 5));
	ASSERT_EQ_INT(0, count_messages("Starting task 'Syntax'"));
	ASSERT_EQ_INT(0, count_messages("Starting task 'Thrown'"));
	ASSERT_TRUE(wait_task_state("NoStart", "FAILED", 15));
	ASSERT_TRUE(wait_message("Task 'NoStart' failed: the sequence was not started", 1, 5));
	ASSERT_TRUE(wait_message("All tasks finished", 1, 10));
}

static void quoted_name_reaches_the_body(void) {
	REQUIRE(upload("// @task Q \"a\" \\ b\nif (scheduler_task.name != \"Q \\\"a\\\" \\\\ b\") { throw new Error(\"wrong name \" + scheduler_task.name); }\n" BODY_WAIT(1)));
	REQUIRE(control(AGENT_SCHEDULER_CONTROL_START_ITEM_NAME));
	ASSERT_TRUE(wait_task_state("Q \"a\" \\ b", "DONE", 15));
}

static void urgent_preempts_and_task_is_retried(void) {
	REQUIRE(upload("// @task Long\n// @retry 1\n" BODY_WAIT(30)));
	REQUIRE(control(AGENT_SCHEDULER_CONTROL_START_ITEM_NAME));
	ASSERT_TRUE(wait_task_state("Long", "RUNNING", 15));
	set_guiding(true);
	indigo_usleep(1500000);
	REQUIRE(urgent("// @task Flash\n// @priority low\n" BODY_WAIT(1)));
	ASSERT_TRUE(wait_message("Task 'Long' preempted by an urgent task, it will be retried", 1, 10));
	ASSERT_TRUE(atomic_load(&guider_aborts) >= 1);
	ASSERT_TRUE(wait_message("Starting task 'Flash'", 1, 10));
	long preempted = message_position("Task 'Long' preempted");
	long flash = message_position("Starting task 'Flash'");
	ASSERT_TRUE(flash > preempted);
	ASSERT_TRUE(wait_message("Task 'Flash' completed", 1, 10));
	// the unstored urgent task is gone, the preempted one runs again from the beginning without using a retry
	char label[INDIGO_VALUE_SIZE];
	ASSERT_TRUE(wait_message("Starting task 'Long'", 2, 10));
	ASSERT_FALSE(task_label("Flash", label, NULL));
	ASSERT_TRUE(task_label("Long", label, NULL));
	ASSERT_TRUE(strstr(label, "retries left 1") != NULL);
	REQUIRE(control(AGENT_SCHEDULER_CONTROL_ABORT_ITEM_NAME));
	ASSERT_TRUE(wait_task_state("Long", "RETRY", 10));
}

static void preempted_task_fails_when_asked(void) {
	REQUIRE(upload("// @task Fragile\n// @preempted fail\n" BODY_WAIT(30)));
	REQUIRE(control(AGENT_SCHEDULER_CONTROL_START_ITEM_NAME));
	ASSERT_TRUE(wait_task_state("Fragile", "RUNNING", 15));
	indigo_usleep(1000000);
	REQUIRE(urgent("// @task Burst\n" BODY_WAIT(1)));
	ASSERT_TRUE(wait_task_state("Fragile", "FAILED", 10));
	ASSERT_TRUE(wait_message("Task 'Burst' completed", 1, 10));
	ASSERT_EQ_INT(1, count_messages("Starting task 'Fragile'"));
}

static void urgent_waits_for_eligibility(void) {
	REQUIRE(upload("// @task Steady\n" BODY_WAIT(4)));
	REQUIRE(control(AGENT_SCHEDULER_CONTROL_START_ITEM_NAME));
	ASSERT_TRUE(wait_task_state("Steady", "RUNNING", 15));
	char start[32];
	time_t now = time(NULL);
	utc(now - now % 60 + 3600, start);
	char text[512];
	snprintf(text, sizeof(text), "// @task Later\n// @window %s ..\n" BODY_WAIT(1), start);
	REQUIRE(urgent(text));
	ASSERT_TRUE(wait_message("Task 'Steady' completed", 1, 15));
	ASSERT_EQ_INT(0, count_messages("preempted"));
	ASSERT_TRUE(wait_task_state("Later", "WAITING", 5));
}

static void second_urgent_waits_for_the_first(void) {
	REQUIRE(control(AGENT_SCHEDULER_CONTROL_START_ITEM_NAME));
	REQUIRE(urgent("// @task First\n" BODY_WAIT(3)));
	ASSERT_TRUE(wait_task_state("First", "RUNNING", 15));
	REQUIRE(urgent("// @task Second\n" BODY_WAIT(1)));
	ASSERT_TRUE(wait_message("Task 'First' completed", 1, 15));
	ASSERT_TRUE(wait_message("Task 'Second' completed", 1, 15));
	ASSERT_EQ_INT(0, count_messages("preempted"));
	ASSERT_TRUE(message_position("Starting task 'Second'") > message_position("Task 'First' completed"));
}

static void urgent_submitted_while_stopped(void) {
	char message[INDIGO_VALUE_SIZE];
	REQUIRE(change_text(AGENT_SCHEDULER_URGENT_TASK_PROPERTY_NAME, AGENT_SCHEDULER_URGENT_TASK_TASK_ITEM_NAME, "// @task Pending\n" BODY_WAIT(1), INDIGO_OK_STATE, message));
	ASSERT_TRUE(strstr(message, "not running") != NULL);
	indigo_usleep(1500000);
	ASSERT_EQ_INT(0, count_messages("Starting task 'Pending'"));
	REQUIRE(control(AGENT_SCHEDULER_CONTROL_START_ITEM_NAME));
	ASSERT_TRUE(wait_message("Task 'Pending' completed", 1, 15));
}

static void stop_lets_the_task_finish(void) {
	REQUIRE(upload("// @task Finish\n" BODY_WAIT(2)));
	REQUIRE(upload("// @task Next\n// @priority low\n" BODY_WAIT(1)));
	REQUIRE(control(AGENT_SCHEDULER_CONTROL_START_ITEM_NAME));
	ASSERT_TRUE(wait_task_state("Finish", "RUNNING", 15));
	REQUIRE(control(AGENT_SCHEDULER_CONTROL_STOP_ITEM_NAME));
	ASSERT_TRUE(wait_task_state("Finish", "DONE", 10));
	ASSERT_TRUE(wait_scheduler_state(INDIGO_OK_STATE, 5));
	indigo_usleep(1500000);
	ASSERT_EQ_INT(0, count_messages("Starting task 'Next'"));
}

static void abort_and_delete_running_task(void) {
	REQUIRE(upload("// @task Aborted\n" BODY_WAIT(30)));
	REQUIRE(control(AGENT_SCHEDULER_CONTROL_START_ITEM_NAME));
	ASSERT_TRUE(wait_task_state("Aborted", "RUNNING", 15));
	REQUIRE(control(AGENT_SCHEDULER_CONTROL_ABORT_ITEM_NAME));
	ASSERT_TRUE(wait_task_state("Aborted", "RETRY", 10));
	ASSERT_TRUE(wait_scheduler_state(INDIGO_ALERT_STATE, 5));
	REQUIRE(control(AGENT_SCHEDULER_CONTROL_START_ITEM_NAME));
	ASSERT_TRUE(wait_message("Starting task 'Aborted'", 2, 15));
	ASSERT_TRUE(wait_task_state("Aborted", "RUNNING", 5));
	REQUIRE(change_text(AGENT_SCHEDULER_DELETE_TASK_PROPERTY_NAME, AGENT_SCHEDULER_DELETE_TASK_NAME_ITEM_NAME, "Aborted", INDIGO_OK_STATE, NULL));
	ASSERT_TRUE(wait_message("Task 'Aborted' aborted and deleted", 1, 10));
	char label[INDIGO_VALUE_SIZE];
	ASSERT_FALSE(task_label("Aborted", label, NULL));
}

static void edit_of_running_task_is_deferred(void) {
	REQUIRE(upload("// @task Edited\n" BODY_WAIT(2)));
	REQUIRE(control(AGENT_SCHEDULER_CONTROL_START_ITEM_NAME));
	ASSERT_TRUE(wait_task_state("Edited", "RUNNING", 15));
	char message[INDIGO_VALUE_SIZE];
	REQUIRE(change_text("AGENT_SCHEDULER_TASK_0", AGENT_SCHEDULER_TASK_TASK_ITEM_NAME, "// @task Edited\n// @repeat 3\n" BODY_WAIT(1), INDIGO_BUSY_STATE, message));
	ASSERT_TRUE(strstr(message, "after the task ends") != NULL);
	ASSERT_TRUE(wait_message("Task 'Edited' completed", 1, 10));
	indigo_property *task = snapshot("AGENT_SCHEDULER_TASK_0");
	REQUIRE(task != NULL);
	ASSERT_TRUE(strstr(indigo_get_text_item_value(task->items), "@repeat 3") != NULL);
	indigo_release_property(task);
}

static void stop_timeout_stops_the_scheduler(void) {
	REQUIRE(upload("// @task Stuck\n" BODY_WAIT(30)));
	REQUIRE(upload("// @task Blocked\n// @priority low\n" BODY_WAIT(1)));
	REQUIRE(control(AGENT_SCHEDULER_CONTROL_START_ITEM_NAME));
	ASSERT_TRUE(wait_task_state("Stuck", "RUNNING", 15));
	atomic_store(&guider_stubborn, true);
	set_guiding(true);
	REQUIRE(urgent("// @task Rescue\n" BODY_WAIT(1)));
	ASSERT_TRUE(wait_scheduler_state(INDIGO_ALERT_STATE, 15));
	indigo_usleep(1500000);
	ASSERT_EQ_INT(0, count_messages("Starting task 'Rescue'"));
	ASSERT_EQ_INT(0, count_messages("Starting task 'Blocked'"));
	atomic_store(&guider_stubborn, false);
}

static void persistence_across_restart(void) {
	REQUIRE(upload("// @task Kept\n// @priority high\n" BODY_WAIT(1)));
	REQUIRE(upload("// @task Sleeping\n// @priority low\n" BODY_WAIT(1)));
	REQUIRE(upload("// @task Third\n// @priority low 10\n" BODY_WAIT(1)));
	REQUIRE(command("Sleeping", AGENT_SCHEDULER_TASK_COMMAND_DISABLE_ITEM_NAME));
	REQUIRE(command("Third", AGENT_SCHEDULER_TASK_COMMAND_MOVE_UP_ITEM_NAME));
	REQUIRE(control(AGENT_SCHEDULER_CONTROL_START_ITEM_NAME));
	ASSERT_TRUE(wait_task_state("Third", "DONE", 20));
	ASSERT_TRUE(wait_task_state("Kept", "DONE", 20));
	REQUIRE(set_setting(AGENT_SCHEDULER_SETTINGS_SETTING_WEIGHT_ITEM_NAME, 2.5));
	REQUIRE(set_setting(AGENT_SCHEDULER_SETTINGS_NIGHT_START_OFFSET_ITEM_NAME, -30));
	REQUIRE(set_setting(AGENT_SCHEDULER_SETTINGS_NIGHT_END_OFFSET_ITEM_NAME, 45));
	REQUIRE(set_night_hooks("Evening", "Morning", "Resume"));
	REQUIRE(set_night_limit(AGENT_SCHEDULER_NIGHT_ASTRONOMICAL_ITEM_NAME));
	// the save is delayed, the shutdown right after the last change still writes it
	stop_scheduler();
	memset(messages, 0, sizeof(messages));
	REQUIRE(start_scheduler());
	char label[INDIGO_VALUE_SIZE];
	ASSERT_TRUE(wait_task_state("Kept", "DONE", 5));
	ASSERT_TRUE(wait_task_state("Sleeping", "DISABLED", 5));
	ASSERT_TRUE(wait_task_state("Third", "DONE", 5));
	indigo_property *list = snapshot(AGENT_SCHEDULER_TASK_STATE_PROPERTY_NAME);
	REQUIRE(list != NULL && list->count == 3);
	ASSERT_TRUE(!strncmp(list->items[0].label, "Kept ", 5));
	ASSERT_TRUE(!strncmp(list->items[1].label, "Third ", 6));
	ASSERT_TRUE(!strncmp(list->items[2].label, "Sleeping ", 9));
	indigo_release_property(list);
	indigo_property *settings = snapshot(AGENT_SCHEDULER_SETTINGS_PROPERTY_NAME);
	REQUIRE(settings != NULL);
	ASSERT_NEAR(2.5, indigo_get_item(settings, AGENT_SCHEDULER_SETTINGS_SETTING_WEIGHT_ITEM_NAME)->number.value, 1e-9);
	ASSERT_NEAR(-30, indigo_get_item(settings, AGENT_SCHEDULER_SETTINGS_NIGHT_START_OFFSET_ITEM_NAME)->number.value, 1e-9);
	ASSERT_NEAR(45, indigo_get_item(settings, AGENT_SCHEDULER_SETTINGS_NIGHT_END_OFFSET_ITEM_NAME)->number.value, 1e-9);
	indigo_release_property(settings);
	indigo_property *hooks = snapshot(AGENT_SCHEDULER_HOOKS_PROPERTY_NAME);
	REQUIRE(hooks != NULL);
	ASSERT_STREQ("Evening", indigo_get_text_item_value(indigo_get_item(hooks, AGENT_SCHEDULER_HOOKS_NIGHT_START_ITEM_NAME)));
	ASSERT_STREQ("Morning", indigo_get_text_item_value(indigo_get_item(hooks, AGENT_SCHEDULER_HOOKS_NIGHT_END_ITEM_NAME)));
	ASSERT_STREQ("Resume", indigo_get_text_item_value(indigo_get_item(hooks, AGENT_SCHEDULER_HOOKS_RESUME_ITEM_NAME)));
	indigo_release_property(hooks);
	indigo_property *night = snapshot(AGENT_SCHEDULER_NIGHT_PROPERTY_NAME);
	REQUIRE(night != NULL);
	ASSERT_TRUE(indigo_get_item(night, AGENT_SCHEDULER_NIGHT_ASTRONOMICAL_ITEM_NAME)->sw.value);
	ASSERT_FALSE(indigo_get_item(night, AGENT_SCHEDULER_NIGHT_NAUTICAL_ITEM_NAME)->sw.value);
	indigo_release_property(night);
	// the scheduler starts stopped and runs nothing that already finished
	indigo_usleep(1500000);
	ASSERT_EQ_INT(0, count_messages("Starting task"));
	ASSERT_TRUE(task_label("Kept", label, NULL));
}

static void running_task_restored_without_using_a_retry(void) {
	REQUIRE(upload("// @task Interrupted\n// @retry 2\n" BODY_WAIT(30)));
	REQUIRE(control(AGENT_SCHEDULER_CONTROL_START_ITEM_NAME));
	ASSERT_TRUE(wait_task_state("Interrupted", "RUNNING", 15));
	char start[32];
	time_t now = time(NULL);
	utc(now - now % 60 + 7200, start);
	char text[256];
	snprintf(text, sizeof(text), "// @task Pending\n// @window %s ..\n" BODY_WAIT(1), start);
	REQUIRE(urgent(text));
	stop_scheduler();
	memset(messages, 0, sizeof(messages));
	REQUIRE(start_scheduler());
	char label[INDIGO_VALUE_SIZE];
	ASSERT_TRUE(wait_task_state("Interrupted", "QUEUED", 5));
	ASSERT_TRUE(task_label("Interrupted", label, NULL));
	ASSERT_TRUE(strstr(label, "retries left 2") != NULL);
	// a submitted urgent task is not stored
	ASSERT_FALSE(task_label("Pending", label, NULL));
}

static void failure_after_start_aborts_the_sequence(void) {
	REQUIRE(upload("// @task Thrower\nvar sequence = new Sequence(scheduler_task.name);\nsequence.wait(30);\nsequence.start();\nif (!scheduler_task.estimate) { throw new Error(\"after start\"); }\n"));
	REQUIRE(upload("// @task Follower\n// @priority low\n" BODY_WAIT(1)));
	REQUIRE(control(AGENT_SCHEDULER_CONTROL_START_ITEM_NAME));
	ASSERT_TRUE(wait_message("Task 'Thrower' failed: Error: after start", 1, 15));
	ASSERT_TRUE(wait_task_state("Thrower", "FAILED", 5));
	// the sequence started by the failed body was aborted, so the next task can run
	ASSERT_TRUE(wait_task_state("Follower", "DONE", 15));
}

static void hand_started_sequence_blocks_all_but_urgent(void) {
	REQUIRE(control(AGENT_SCHEDULER_CONTROL_START_ITEM_NAME));
	// the scheduler loads Sequencer.js while it waits with an empty list
	ASSERT_TRUE(wait_sequence_state(INDIGO_OK_STATE, 15) || wait_sequence_state(INDIGO_IDLE_STATE, 1));
	const char *items[] = { AGENT_SCRIPTING_RUN_SCRIPT_ITEM_NAME };
	const char *values[] = { "var manual = new Sequence(\"Manual\");\nmanual.wait(30);\nmanual.start();\n" };
	indigo_change_text_property(&observer, SCRIPTING_AGENT_NAME, AGENT_SCRIPTING_RUN_SCRIPT_PROPERTY_NAME, 1, items, values);
	ASSERT_TRUE(wait_sequence_state(INDIGO_BUSY_STATE, 5));
	REQUIRE(upload("// @task Polite\n" BODY_WAIT(1)));
	ASSERT_TRUE(wait_reason("another sequence is running", 5));
	ASSERT_EQ_INT(0, count_messages("Starting task 'Polite'"));
	REQUIRE(urgent("// @task Pushy\n" BODY_WAIT(1)));
	ASSERT_TRUE(wait_message("Task 'Pushy' completed", 1, 15));
	ASSERT_TRUE(wait_task_state("Polite", "DONE", 15));
	ASSERT_TRUE(message_position("Starting task 'Polite'") > message_position("Task 'Pushy' completed"));
}

static void stop_request_blocks_preemption(void) {
	REQUIRE(upload("// @task Finishing\n" BODY_WAIT(3)));
	REQUIRE(control(AGENT_SCHEDULER_CONTROL_START_ITEM_NAME));
	ASSERT_TRUE(wait_task_state("Finishing", "RUNNING", 15));
	REQUIRE(control(AGENT_SCHEDULER_CONTROL_STOP_ITEM_NAME));
	REQUIRE(urgent("// @task Late\n" BODY_WAIT(1)));
	ASSERT_TRUE(wait_task_state("Finishing", "DONE", 10));
	ASSERT_TRUE(wait_scheduler_state(INDIGO_OK_STATE, 5));
	ASSERT_EQ_INT(0, count_messages("preempted"));
	ASSERT_EQ_INT(0, count_messages("Starting task 'Late'"));
}

// a client sending Sequencer.js before its own script must not disturb a scheduled task
static void library_reload_keeps_scheduled_task(void) {
	REQUIRE(upload("// @task Steadfast\n" BODY_WAIT(3)));
	REQUIRE(control(AGENT_SCHEDULER_CONTROL_START_ITEM_NAME));
	ASSERT_TRUE(wait_task_state("Steadfast", "RUNNING", 15));
	FILE *file = fopen(SEQUENCER_JS_PATH, "rb");
	REQUIRE(file != NULL);
	fseek(file, 0, SEEK_END);
	long length = ftell(file);
	rewind(file);
	char *source = indigo_safe_malloc((size_t)length + 1);
	size_t read = fread(source, 1, (size_t)length, file);
	fclose(file);
	source[read] = 0;
	const char *items[] = { AGENT_SCRIPTING_RUN_SCRIPT_ITEM_NAME };
	const char *values[] = { source };
	indigo_change_text_property(&observer, SCRIPTING_AGENT_NAME, AGENT_SCRIPTING_RUN_SCRIPT_PROPERTY_NAME, 1, items, values);
	free(source);
	ASSERT_TRUE(wait_task_state("Steadfast", "DONE", 15));
	ASSERT_EQ_INT(0, count_messages("Task 'Steadfast' failed"));
}

static void pending_rename_reserves_the_name(void) {
	REQUIRE(upload("// @task Original\n" BODY_WAIT(3)));
	REQUIRE(control(AGENT_SCHEDULER_CONTROL_START_ITEM_NAME));
	ASSERT_TRUE(wait_task_state("Original", "RUNNING", 15));
	REQUIRE(change_text("AGENT_SCHEDULER_TASK_0", AGENT_SCHEDULER_TASK_TASK_ITEM_NAME, "// @task Renamed\n" BODY_WAIT(1), INDIGO_BUSY_STATE, NULL));
	char message[INDIGO_VALUE_SIZE];
	ASSERT_TRUE(change_text(AGENT_SCHEDULER_ADD_TASK_PROPERTY_NAME, AGENT_SCHEDULER_ADD_TASK_TASK_ITEM_NAME, "// @task Renamed\n" BODY_WAIT(1), INDIGO_ALERT_STATE, message));
	ASSERT_TRUE(strstr(message, "already exists") != NULL);
	ASSERT_TRUE(wait_task_state("Renamed", "DONE", 15));
}

static void hooks_run_at_start_idle_and_stop(void) {
	char future[32];
	time_t now = time(NULL);
	utc(now - now % 60 + 7200, future);
	REQUIRE(set_setting(AGENT_SCHEDULER_SETTINGS_IDLE_PARK_AFTER_ITEM_NAME, 0));
	REQUIRE(upload("// @task Prepare\n" BODY_WAIT(1)));
	REQUIRE(upload("// @task Park\n" BODY_WAIT(1)));
	REQUIRE(upload("// @task Close\n" BODY_WAIT(1)));
	REQUIRE(upload("// @task Work\n" BODY_WAIT(1)));
	char text[256];
	snprintf(text, sizeof(text), "// @task Later\n// @window %s ..\n" BODY_WAIT(1), future);
	REQUIRE(upload(text));
	REQUIRE(set_hooks("Prepare", "Close", "Park"));
	ASSERT_TRUE(wait_task_state("Prepare", "STARTUP HOOK", 5));
	ASSERT_TRUE(wait_task_state("Close", "SHUTDOWN HOOK", 5));
	ASSERT_TRUE(wait_task_state("Park", "IDLE HOOK", 5));
	REQUIRE(control(AGENT_SCHEDULER_CONTROL_START_ITEM_NAME));
	ASSERT_TRUE(wait_message("Hook 'Prepare' completed", 1, 15));
	ASSERT_TRUE(wait_message("Task 'Work' completed", 1, 15));
	// nothing is eligible until the window of Later opens, so the idle hook runs once
	ASSERT_TRUE(wait_message("Hook 'Park' completed", 1, 15));
	indigo_usleep(3000000);
	ASSERT_EQ_INT(1, count_messages("Starting hook 'Park'"));
	ASSERT_TRUE(message_position("Starting hook 'Prepare'") < message_position("Starting task 'Work'"));
	ASSERT_TRUE(message_position("Task 'Work' completed") < message_position("Starting hook 'Park'"));
	ASSERT_EQ_INT(0, count_messages("Starting task 'Prepare'"));
	ASSERT_EQ_INT(0, count_messages("Starting task 'Close'"));
	REQUIRE(control(AGENT_SCHEDULER_CONTROL_STOP_ITEM_NAME));
	ASSERT_TRUE(wait_message("Hook 'Close' completed", 1, 15));
	ASSERT_TRUE(wait_scheduler_state(INDIGO_OK_STATE, 5));
	ASSERT_EQ_INT(0, count_messages("Starting task 'Later'"));
}

static void failed_startup_hook_stops_the_scheduler(void) {
	REQUIRE(upload("// @task Bad start\nif (!scheduler_task.estimate) { throw new Error(\"no power\"); }\n" BODY_WAIT(1)));
	REQUIRE(upload("// @task Work\n" BODY_WAIT(1)));
	REQUIRE(set_hooks("Bad start", "", ""));
	REQUIRE(control(AGENT_SCHEDULER_CONTROL_START_ITEM_NAME));
	ASSERT_TRUE(wait_scheduler_state(INDIGO_ALERT_STATE, 15));
	ASSERT_TRUE(wait_message("Hook 'Bad start' failed: Error: no power", 1, 5));
	ASSERT_EQ_INT(0, count_messages("Starting task 'Work'"));
}

static void abort_runs_the_shutdown_hook(void) {
	REQUIRE(upload("// @task Close\n" BODY_WAIT(1)));
	REQUIRE(upload("// @task Long\n" BODY_WAIT(30)));
	REQUIRE(set_hooks("", "Close", ""));
	REQUIRE(control(AGENT_SCHEDULER_CONTROL_START_ITEM_NAME));
	ASSERT_TRUE(wait_task_state("Long", "RUNNING", 15));
	REQUIRE(control(AGENT_SCHEDULER_CONTROL_ABORT_ITEM_NAME));
	ASSERT_TRUE(wait_message("Hook 'Close' completed", 1, 15));
	ASSERT_TRUE(wait_scheduler_state(INDIGO_ALERT_STATE, 5));
	ASSERT_TRUE(message_position("Task 'Long' aborted") < message_position("Starting hook 'Close'"));
}

static void start_during_shutdown_hook_continues(void) {
	REQUIRE(upload("// @task Prepare\n" BODY_WAIT(1)));
	REQUIRE(upload("// @task Close\n" BODY_WAIT(3)));
	REQUIRE(upload("// @task First\n" BODY_WAIT(1)));
	REQUIRE(set_hooks("Prepare", "Close", ""));
	REQUIRE(control(AGENT_SCHEDULER_CONTROL_START_ITEM_NAME));
	ASSERT_TRUE(wait_message("Task 'First' completed", 1, 15));
	REQUIRE(control(AGENT_SCHEDULER_CONTROL_STOP_ITEM_NAME));
	ASSERT_TRUE(wait_message("Starting hook 'Close'", 1, 15));
	// an edit of the running hook waits until it ends
	char message[INDIGO_VALUE_SIZE];
	ASSERT_TRUE(change_text("AGENT_SCHEDULER_TASK_1", AGENT_SCHEDULER_TASK_TASK_ITEM_NAME, "// @task Close\n" BODY_WAIT(1), INDIGO_BUSY_STATE, message));
	ASSERT_TRUE(strstr(message, "after the task ends") != NULL);
	REQUIRE(upload("// @task Second\n" BODY_WAIT(1)));
	REQUIRE(control(AGENT_SCHEDULER_CONTROL_START_ITEM_NAME));
	ASSERT_TRUE(wait_message("Hook 'Close' completed", 1, 15));
	ASSERT_TRUE(wait_message("Starting hook 'Prepare'", 2, 15));
	ASSERT_TRUE(wait_message("Task 'Second' completed", 1, 15));
	// the automatic stop after the last task runs the shutdown hook again
	ASSERT_TRUE(wait_message("Hook 'Close' completed", 2, 15));
	ASSERT_TRUE(wait_scheduler_state(INDIGO_OK_STATE, 5));
}

static void night_hooks_run_at_dusk_and_dawn(void) {
	time_t dusk = minute_ahead(30);
	char start[32], future[32], text[256];
	utc(dusk, start);
	utc(dusk + 2 * 86400, future);
	REQUIRE(set_setting(AGENT_SCHEDULER_SETTINGS_IDLE_PARK_AFTER_ITEM_NAME, 0));
	REQUIRE(upload("// @task Evening\n" BODY_WAIT(1)));
	REQUIRE(upload("// @task Morning\n" BODY_WAIT(1)));
	REQUIRE(upload("// @task Park\n" BODY_WAIT(1)));
	snprintf(text, sizeof(text), "// @task Work\n// @window %s ..\n" BODY_WAIT(1), start);
	REQUIRE(upload(text));
	// a task of a later night keeps the scheduler running
	snprintf(text, sizeof(text), "// @task Later\n// @window %s ..\n" BODY_WAIT(1), future);
	REQUIRE(upload(text));
	REQUIRE(set_hooks("", "", "Park"));
	REQUIRE(set_night_hooks("Evening", "Morning", ""));
	set_site(NIGHT_LATITUDE, night_longitude(dusk, false));
	ASSERT_TRUE(wait_task_state("Evening", "NIGHT START HOOK", 5));
	ASSERT_TRUE(wait_task_state("Morning", "NIGHT END HOOK", 5));
	REQUIRE(control(AGENT_SCHEDULER_CONTROL_START_ITEM_NAME));
	// the plan shows both night hooks of the coming night
	ASSERT_TRUE(wait_plan_contains("Evening (night start hook)", true, 15));
	ASSERT_TRUE(wait_plan_contains("Morning (night end hook)", true, 5));
	// before the night the idle hook puts the equipment away
	ASSERT_TRUE(wait_message("Hook 'Park' completed", 1, 15));
	wait_until(dusk - 2);
	ASSERT_EQ_INT(0, count_messages("Starting hook 'Evening'"));
	ASSERT_TRUE(wait_message("Hook 'Evening' completed", 1, 30));
	ASSERT_TRUE(wait_message("Task 'Work' completed", 1, 15));
	ASSERT_TRUE(message_position("Hook 'Evening' completed") < message_position("Starting task 'Work'"));
	// the night start hook ended the standby, so the idle hook runs again after the task
	ASSERT_TRUE(wait_message("Hook 'Park' completed", 2, 15));
	ASSERT_TRUE(wait_plan_contains("Evening (night start hook)", false, 10));
	ASSERT_TRUE(wait_plan_contains("Morning (night end hook)", true, 5));
	// the night ends in a few seconds at a new longitude
	set_site(NIGHT_LATITUDE, night_longitude(time(NULL) + 5, true));
	ASSERT_TRUE(wait_message("Hook 'Morning' completed", 1, 30));
	// after the night end the equipment stays put away during the day
	indigo_usleep(4000000);
	ASSERT_EQ_INT(2, count_messages("Starting hook 'Park'"));
	ASSERT_EQ_INT(1, count_messages("Starting hook 'Evening'"));
	ASSERT_EQ_INT(1, count_messages("Starting hook 'Morning'"));
	ASSERT_EQ_INT(0, count_messages("Starting task 'Later'"));
	char label[INDIGO_VALUE_SIZE];
	ASSERT_TRUE(history_label("Morning", 0, label));
	ASSERT_TRUE(strstr(label, "Morning (hook) #1  succeeded") != NULL);
}

static void night_without_work_skips_the_hooks(void) {
	char future[32], text[256];
	time_t dusk = time(NULL) + 15;
	utc(dusk + 2 * 86400, future);
	REQUIRE(upload("// @task Evening\n" BODY_WAIT(1)));
	REQUIRE(upload("// @task Morning\n" BODY_WAIT(1)));
	snprintf(text, sizeof(text), "// @task Later\n// @window %s ..\n" BODY_WAIT(1), future);
	REQUIRE(upload(text));
	REQUIRE(set_night_hooks("Evening", "Morning", ""));
	set_site(NIGHT_LATITUDE, night_longitude(dusk, false));
	REQUIRE(control(AGENT_SCHEDULER_CONTROL_START_ITEM_NAME));
	ASSERT_TRUE(wait_message("No task can run tonight, the night start hook is skipped", 1, 40));
	ASSERT_TRUE(wait_plan_contains("(night start hook)", false, 5));
	ASSERT_TRUE(wait_plan_contains("(night end hook)", false, 5));
	indigo_usleep(2000000);
	ASSERT_EQ_INT(0, count_messages("Starting hook 'Evening'"));
	ASSERT_EQ_INT(1, count_messages("No task can run tonight"));
	// work that appears later in the night is prepared for first
	REQUIRE(upload("// @task Late\n" BODY_WAIT(1)));
	ASSERT_TRUE(wait_message("Task 'Late' completed", 1, 20));
	ASSERT_TRUE(message_position("Hook 'Evening' completed") >= 0);
	ASSERT_TRUE(message_position("Hook 'Evening' completed") < message_position("Starting task 'Late'"));
	// that night then ends with its end hook
	set_site(NIGHT_LATITUDE, night_longitude(time(NULL) + 5, true));
	ASSERT_TRUE(wait_message("Hook 'Morning' completed", 1, 30));
	ASSERT_EQ_INT(1, count_messages("Starting hook 'Evening'"));
}

static void night_without_work_and_without_hooks_ends_quietly(void) {
	char future[32], text[256];
	time_t dusk = time(NULL) + 10;
	utc(dusk + 2 * 86400, future);
	snprintf(text, sizeof(text), "// @task Later\n// @window %s ..\n" BODY_WAIT(1), future);
	REQUIRE(upload(text));
	set_site(NIGHT_LATITUDE, night_longitude(dusk, false));
	REQUIRE(control(AGENT_SCHEDULER_CONTROL_START_ITEM_NAME));
	wait_until(dusk + 5);
	set_site(NIGHT_LATITUDE, night_longitude(time(NULL) + 3, true));
	indigo_usleep(6000000);
	// without night hooks there is nothing to tell
	ASSERT_EQ_INT(0, count_messages("No task can run tonight"));
	ASSERT_EQ_INT(0, count_messages("Starting hook"));
}

static void hooks_named_during_a_night_without_work(void) {
	char future[32], text[256];
	utc(time(NULL) + 2 * 86400, future);
	snprintf(text, sizeof(text), "// @task Later\n// @window %s ..\n" BODY_WAIT(1), future);
	REQUIRE(upload(text));
	set_site(NIGHT_LATITUDE, night_longitude(time(NULL) - 3600, false));
	REQUIRE(control(AGENT_SCHEDULER_CONTROL_START_ITEM_NAME));
	indigo_usleep(3000000);
	ASSERT_EQ_INT(0, count_messages("No task can run tonight"));
	// the night was decided before the hook was named, the message still comes; the hook task may be uploaded later
	REQUIRE(set_night_hooks("Evening", "", ""));
	ASSERT_TRUE(wait_message("No task can run tonight, the night start hook is skipped", 1, 10));
	indigo_usleep(2000000);
	ASSERT_EQ_INT(1, count_messages("No task can run tonight"));
	ASSERT_EQ_INT(0, count_messages("Starting hook 'Evening'"));
}

static void resume_hook_after_idle(void) {
	time_t later = minute_ahead(20);
	char start[32], future[32], text[256];
	utc(later, start);
	utc(later + 2 * 86400, future);
	REQUIRE(set_setting(AGENT_SCHEDULER_SETTINGS_IDLE_PARK_AFTER_ITEM_NAME, 0));
	REQUIRE(upload("// @task Park\n" BODY_WAIT(1)));
	REQUIRE(upload("// @task Prepare\n" BODY_WAIT(1)));
	REQUIRE(upload("// @task Work\n" BODY_WAIT(1)));
	snprintf(text, sizeof(text), "// @task Later\n// @window %s ..\n" BODY_WAIT(1), start);
	REQUIRE(upload(text));
	snprintf(text, sizeof(text), "// @task Far\n// @window %s ..\n" BODY_WAIT(1), future);
	REQUIRE(upload(text));
	REQUIRE(set_hooks("", "", "Park"));
	REQUIRE(set_night_hooks("", "", "Prepare"));
	ASSERT_TRUE(wait_task_state("Prepare", "RESUME HOOK", 5));
	REQUIRE(control(AGENT_SCHEDULER_CONTROL_START_ITEM_NAME));
	ASSERT_TRUE(wait_message("Task 'Work' completed", 1, 15));
	ASSERT_TRUE(wait_message("Hook 'Park' completed", 1, 15));
	// no standby before the first task, so it started without the resume hook
	ASSERT_EQ_INT(0, count_messages("Starting hook 'Prepare'"));
	// the idle hook does not run again in standby
	indigo_usleep(3000000);
	ASSERT_EQ_INT(1, count_messages("Starting hook 'Park'"));
	ASSERT_TRUE(wait_message("Task 'Later' completed", 1, 90));
	ASSERT_EQ_INT(1, count_messages("Starting hook 'Prepare'"));
	ASSERT_TRUE(message_position("Starting hook 'Park'") < message_position("Starting hook 'Prepare'"));
	ASSERT_TRUE(message_position("Hook 'Prepare' completed") < message_position("Starting task 'Later'"));
	// the task began a new idle period
	ASSERT_TRUE(wait_message("Hook 'Park' completed", 2, 15));
}

static void idle_without_resume_behaves_as_before(void) {
	time_t later = minute_ahead(20);
	char start[32], future[32], text[256];
	utc(later, start);
	utc(later + 2 * 86400, future);
	REQUIRE(set_setting(AGENT_SCHEDULER_SETTINGS_IDLE_PARK_AFTER_ITEM_NAME, 0));
	REQUIRE(upload("// @task Park\n" BODY_WAIT(1)));
	REQUIRE(upload("// @task Work\n" BODY_WAIT(1)));
	snprintf(text, sizeof(text), "// @task Later\n// @window %s ..\n" BODY_WAIT(1), start);
	REQUIRE(upload(text));
	snprintf(text, sizeof(text), "// @task Far\n// @window %s ..\n" BODY_WAIT(1), future);
	REQUIRE(upload(text));
	REQUIRE(set_hooks("", "", "Park"));
	REQUIRE(control(AGENT_SCHEDULER_CONTROL_START_ITEM_NAME));
	ASSERT_TRUE(wait_message("Hook 'Park' completed", 1, 15));
	// once per idle period, as without the new hooks
	ASSERT_TRUE(wait_message("Task 'Later' completed", 1, 90));
	ASSERT_TRUE(wait_message("Hook 'Park' completed", 2, 15));
	ASSERT_TRUE(message_position_last("Task 'Later' completed") < message_position_last("Starting hook 'Park'"));
}

static void failed_night_start_runs_the_shutdown_hook(void) {
	REQUIRE(upload("// @task Bad evening\nif (!scheduler_task.estimate) { throw new Error(\"no cooler\"); }\n" BODY_WAIT(1)));
	REQUIRE(upload("// @task Close\n" BODY_WAIT(1)));
	REQUIRE(upload("// @task Work\n" BODY_WAIT(1)));
	REQUIRE(set_hooks("", "Close", ""));
	REQUIRE(set_night_hooks("Bad evening", "", ""));
	// the scheduler starts in the night
	set_site(NIGHT_LATITUDE, night_longitude(time(NULL) - 3600, false));
	REQUIRE(control(AGENT_SCHEDULER_CONTROL_START_ITEM_NAME));
	ASSERT_TRUE(wait_message("Hook 'Bad evening' failed: Error: no cooler", 1, 15));
	ASSERT_TRUE(wait_message("Hook 'Close' completed", 1, 15));
	ASSERT_TRUE(wait_scheduler_state(INDIGO_ALERT_STATE, 5));
	ASSERT_TRUE(wait_message("The night start hook failed, the scheduler stopped", 1, 5));
	ASSERT_EQ_INT(0, count_messages("Starting task 'Work'"));
}

static void failed_resume_runs_the_shutdown_hook(void) {
	time_t later = minute_ahead(20);
	char start[32], text[256];
	utc(later, start);
	REQUIRE(set_setting(AGENT_SCHEDULER_SETTINGS_IDLE_PARK_AFTER_ITEM_NAME, 0));
	REQUIRE(upload("// @task Park\n" BODY_WAIT(1)));
	REQUIRE(upload("// @task Bad resume\nif (!scheduler_task.estimate) { throw new Error(\"stuck\"); }\n" BODY_WAIT(1)));
	REQUIRE(upload("// @task Close\n" BODY_WAIT(1)));
	snprintf(text, sizeof(text), "// @task Later\n// @window %s ..\n" BODY_WAIT(1), start);
	REQUIRE(upload(text));
	REQUIRE(set_hooks("", "Close", "Park"));
	REQUIRE(set_night_hooks("", "", "Bad resume"));
	REQUIRE(control(AGENT_SCHEDULER_CONTROL_START_ITEM_NAME));
	ASSERT_TRUE(wait_message("Hook 'Park' completed", 1, 15));
	ASSERT_TRUE(wait_message("Hook 'Bad resume' failed: Error: stuck", 1, 90));
	ASSERT_TRUE(wait_message("Hook 'Close' completed", 1, 15));
	ASSERT_TRUE(wait_scheduler_state(INDIGO_ALERT_STATE, 5));
	ASSERT_TRUE(wait_message("The resume hook failed, the scheduler stopped", 1, 5));
	ASSERT_EQ_INT(0, count_messages("Starting task 'Later'"));
}

static void shared_hook_task_runs_once(void) {
	REQUIRE(upload("// @task Prepare\n" BODY_WAIT(1)));
	REQUIRE(upload("// @task Work\n" BODY_WAIT(1)));
	REQUIRE(set_hooks("Prepare", "", ""));
	REQUIRE(set_night_hooks("Prepare", "", ""));
	// listed by its first hook
	ASSERT_TRUE(wait_task_state("Prepare", "STARTUP HOOK", 5));
	set_site(NIGHT_LATITUDE, night_longitude(time(NULL) - 3600, false));
	REQUIRE(control(AGENT_SCHEDULER_CONTROL_START_ITEM_NAME));
	ASSERT_TRUE(wait_message("Task 'Work' completed", 1, 15));
	ASSERT_EQ_INT(1, count_messages("Starting hook 'Prepare'"));
	ASSERT_TRUE(message_position("Hook 'Prepare' completed") < message_position("Starting task 'Work'"));
	// positive control: without the startup hook, the same START in the night runs Prepare as the night start hook
	REQUIRE(set_hooks("", "", ""));
	// with every task finished the scheduler stopped by itself
	ASSERT_TRUE(wait_scheduler_state(INDIGO_OK_STATE, 15));
	REQUIRE(upload("// @task More\n" BODY_WAIT(1)));
	REQUIRE(control(AGENT_SCHEDULER_CONTROL_START_ITEM_NAME));
	ASSERT_TRUE(wait_message("Task 'More' completed", 1, 15));
	ASSERT_EQ_INT(2, count_messages("Starting hook 'Prepare'"));
	ASSERT_TRUE(message_position_last("Hook 'Prepare' completed") < message_position("Starting task 'More'"));
}

// the scheduler runs in the night with Work done and Later kept for another night
static bool start_in_night(const char *night_end, const char *shutdown) {
	char future[32], text[256];
	utc(time(NULL) + 2 * 86400, future);
	CHECK(upload("// @task Work\n" BODY_WAIT(1)));
	snprintf(text, sizeof(text), "// @task Later\n// @window %s ..\n" BODY_WAIT(1), future);
	CHECK(upload(text));
	CHECK(set_hooks("", shutdown, ""));
	CHECK(set_night_hooks("", night_end, ""));
	set_site(NIGHT_LATITUDE, night_longitude(time(NULL) - 3600, false));
	CHECK(control(AGENT_SCHEDULER_CONTROL_START_ITEM_NAME));
	CHECK(wait_message("Task 'Work' completed", 1, 15));
	return true;
}

static void night_end_and_shutdown_share_a_task(void) {
	REQUIRE(upload("// @task Morning\n" BODY_WAIT(3)));
	REQUIRE(start_in_night("Morning", "Morning"));
	set_site(NIGHT_LATITUDE, night_longitude(time(NULL) + 3, true));
	ASSERT_TRUE(wait_message("Starting hook 'Morning'", 1, 30));
	// STOP while the night end hook runs: the shutdown hook names the same task, which runs once
	REQUIRE(control(AGENT_SCHEDULER_CONTROL_STOP_ITEM_NAME));
	ASSERT_TRUE(wait_scheduler_state(INDIGO_OK_STATE, 15));
	indigo_usleep(1000000);
	ASSERT_EQ_INT(1, count_messages("Starting hook 'Morning'"));
	// a later stop is not back to back and runs the shutdown hook again
	REQUIRE(control(AGENT_SCHEDULER_CONTROL_START_ITEM_NAME));
	indigo_usleep(2000000);
	REQUIRE(control(AGENT_SCHEDULER_CONTROL_STOP_ITEM_NAME));
	ASSERT_TRUE(wait_message("Starting hook 'Morning'", 2, 15));
}

static void stop_at_night_runs_only_the_shutdown_hook(void) {
	REQUIRE(upload("// @task Morning\n" BODY_WAIT(1)));
	REQUIRE(upload("// @task Close\n" BODY_WAIT(1)));
	REQUIRE(start_in_night("Morning", "Close"));
	REQUIRE(control(AGENT_SCHEDULER_CONTROL_STOP_ITEM_NAME));
	ASSERT_TRUE(wait_message("Hook 'Close' completed", 1, 15));
	ASSERT_TRUE(wait_scheduler_state(INDIGO_OK_STATE, 5));
	ASSERT_EQ_INT(0, count_messages("Starting hook 'Morning'"));
}

static void failed_night_end_is_reported(void) {
	REQUIRE(set_setting(AGENT_SCHEDULER_SETTINGS_IDLE_PARK_AFTER_ITEM_NAME, 0));
	REQUIRE(upload("// @task Bad morning\nif (!scheduler_task.estimate) { throw new Error(\"roof stuck\"); }\n" BODY_WAIT(1)));
	REQUIRE(upload("// @task Park\n" BODY_WAIT(1)));
	REQUIRE(start_in_night("Bad morning", ""));
	REQUIRE(set_hooks("", "", "Park"));
	ASSERT_TRUE(wait_message("Hook 'Park' completed", 1, 15));
	set_site(NIGHT_LATITUDE, night_longitude(time(NULL) + 3, true));
	ASSERT_TRUE(wait_message("Hook 'Bad morning' failed: Error: roof stuck", 1, 30));
	// only reported: the scheduler keeps running and the equipment counts as put away
	indigo_usleep(3000000);
	indigo_property *state = snapshot(AGENT_SCHEDULER_STATE_PROPERTY_NAME);
	REQUIRE(state != NULL);
	ASSERT_EQ_INT(INDIGO_BUSY_STATE, state->state);
	indigo_release_property(state);
	ASSERT_EQ_INT(0, count_messages("the scheduler stopped"));
	ASSERT_EQ_INT(1, count_messages("Starting hook 'Park'"));
}

static void resume_before_an_urgent_task(void) {
	char future[32], text[256];
	utc(time(NULL) + 2 * 86400, future);
	REQUIRE(set_setting(AGENT_SCHEDULER_SETTINGS_IDLE_PARK_AFTER_ITEM_NAME, 0));
	REQUIRE(upload("// @task Park\n" BODY_WAIT(1)));
	REQUIRE(upload("// @task Prepare\n" BODY_WAIT(1)));
	snprintf(text, sizeof(text), "// @task Far\n// @window %s ..\n" BODY_WAIT(1), future);
	REQUIRE(upload(text));
	REQUIRE(set_hooks("", "", "Park"));
	REQUIRE(set_night_hooks("", "", "Prepare"));
	REQUIRE(control(AGENT_SCHEDULER_CONTROL_START_ITEM_NAME));
	ASSERT_TRUE(wait_message("Hook 'Park' completed", 1, 15));
	REQUIRE(urgent("// @task Flash\n" BODY_WAIT(1)));
	ASSERT_TRUE(wait_message("Task 'Flash' completed", 1, 20));
	ASSERT_TRUE(message_position("Hook 'Prepare' completed") >= 0);
	ASSERT_TRUE(message_position("Hook 'Prepare' completed") < message_position("Starting task 'Flash'"));
}

static void plan_lasts_until_a_late_night_end(void) {
	char future[32], text[256];
	utc(time(NULL) + 2 * 86400, future);
	REQUIRE(upload("// @task Morning\n" BODY_WAIT(1)));
	REQUIRE(upload("// @task Work\n" BODY_WAIT(1)));
	snprintf(text, sizeof(text), "// @task Later\n// @window %s ..\n" BODY_WAIT(1), future);
	REQUIRE(upload(text));
	REQUIRE(set_night_hooks("", "Morning", ""));
	double longitude = night_longitude(time(NULL) - 3600, false);
	set_site(NIGHT_LATITUDE, longitude);
	// the night end the agent computes for this site, in minutes of the UTC day
	static scheduler_nights nights;
	indigo_scheduler_nights_build(&nights, time(NULL), NIGHT_LATITUDE, longitude, NIGHT_ELEVATION, -12, 0, 0);
	const scheduler_night *night = indigo_scheduler_night_at(&nights, time(NULL));
	REQUIRE(night != NULL);
	struct tm end_tm;
	gmtime_r(&night->end, &end_tm);
	int dawn = end_tm.tm_hour * 60 + end_tm.tm_min;
	char labels[16][INDIGO_VALUE_SIZE];
	indigo_property_state states[16];
	int start = -1, end = -1;
	for (int pass = 0; pass < 2; pass++) {
		// two hours after the nautical dawn is after sunrise: the hook is planned only because the plan lasts until it
		if (pass == 1) {
			REQUIRE(set_setting(AGENT_SCHEDULER_SETTINGS_NIGHT_END_OFFSET_ITEM_NAME, 120));
		}
		int expected = (dawn + pass * 120) % 1440;
		start = -1;
		for (int i = 0; i < 500 && start < 0; i++) {
			int count = plan_items(labels, states, 16);
			for (int j = 0; j < count && j < 16; j++) {
				int s, e;
				if (strstr(labels[j], "Morning (night end hook)") && plan_times(labels[j], &s, &e) && (minutes_between(expected, s) <= 1 || minutes_between(s, expected) <= 1)) {
					start = s;
					end = e;
				}
			}
			indigo_usleep(20000);
		}
		if (start < 0) {
			int count = plan_items(labels, states, 16);
			fprintf(stderr, "expected the night end hook at %02d:%02d, plan:\n", expected / 60, expected % 60);
			for (int j = 0; j < count && j < 16; j++) {
				fprintf(stderr, "  %s\n", labels[j]);
			}
		}
		REQUIRE(start >= 0);
	}
	REQUIRE(start >= 0);
	ASSERT_TRUE(end >= start || end < 60);
	// at the equator the sunrise is about 24 minutes after the nautical dawn, the hook is about 96 minutes after it
	time_t now = time(NULL);
	struct tm now_tm;
	gmtime_r(&now, &now_tm);
	time_t hook = now - (now_tm.tm_hour * 60 + now_tm.tm_min) * 60 - now_tm.tm_sec + start * 60;
	if (hook < now) {
		hook += 86400;
	}
	ASSERT_TRUE(indigo_scheduler_sun_altitude(hook, NIGHT_LATITUDE, site_property->items[1].number.value, NIGHT_ELEVATION) > 10);
}

static void missing_night_hook_task_is_reported(void) {
	REQUIRE(upload("// @task Work\n" BODY_WAIT(1)));
	REQUIRE(set_night_hooks("Nope", "", ""));
	set_site(NIGHT_LATITUDE, night_longitude(time(NULL) - 3600, false));
	REQUIRE(control(AGENT_SCHEDULER_CONTROL_START_ITEM_NAME));
	ASSERT_TRUE(wait_message("The night start hook 'Nope' names no task", 1, 15));
	ASSERT_TRUE(wait_message("Task 'Work' completed", 1, 15));
}

static void no_night_is_reported(void) {
	// near the pole on the summer side the Sun stays above the astronomical limit
	struct tm now_tm;
	time_t now = time(NULL);
	gmtime_r(&now, &now_tm);
	bool northern_summer = now_tm.tm_mon >= 3 && now_tm.tm_mon <= 8;
	REQUIRE(upload("// @task Evening\n" BODY_WAIT(1)));
	REQUIRE(upload("// @task Work\n// @priority low\n" BODY_WAIT(1)));
	REQUIRE(set_night_limit(AGENT_SCHEDULER_NIGHT_ASTRONOMICAL_ITEM_NAME));
	REQUIRE(set_night_hooks("Evening", "", ""));
	set_site(northern_summer ? 85 : -85, 17.11);
	REQUIRE(control(AGENT_SCHEDULER_CONTROL_START_ITEM_NAME));
	ASSERT_TRUE(wait_message("The Sun does not go below the night limit within a day, the night hooks do not run", 1, 15));
	ASSERT_TRUE(wait_plan_contains("No night at the night limit", true, 10));
	ASSERT_TRUE(wait_message("Task 'Work' completed", 1, 15));
	ASSERT_EQ_INT(0, count_messages("Starting hook 'Evening'"));
}

// a counter of AGENT_SCHEDULER_STATE, -1 when it is missing
static int state_counter(const char *item) {
	indigo_property *property = snapshot(AGENT_SCHEDULER_STATE_PROPERTY_NAME);
	indigo_item *found = property ? indigo_get_item(property, item) : NULL;
	int value = found ? (int)found->number.value : -1;
	indigo_release_property(property);
	return value;
}

static bool wait_counter(const char *item, int value, double timeout) {
	for (double t = 0; t < timeout; t += 0.01) {
		if (state_counter(item) == value) {
			return true;
		}
		indigo_usleep(10000);
	}
	fprintf(stderr, "Timeout waiting for %s = %d, it is %d\n", item, value, state_counter(item));
	return false;
}

static void urgent_tasks_are_counted(void) {
	char past[32], future[32], text[256];
	time_t now = time(NULL);
	utc(now - now % 60 - 120, past);
	utc(now + 2 * 86400, future);
	// the items come in this order, TOTAL last
	indigo_property *state = snapshot(AGENT_SCHEDULER_STATE_PROPERTY_NAME);
	REQUIRE(state != NULL && state->count == 5);
	ASSERT_STREQ(AGENT_SCHEDULER_STATE_DONE_ITEM_NAME, state->items[0].name);
	ASSERT_STREQ(AGENT_SCHEDULER_STATE_FAILED_ITEM_NAME, state->items[1].name);
	ASSERT_STREQ(AGENT_SCHEDULER_STATE_URGENT_DONE_ITEM_NAME, state->items[2].name);
	ASSERT_STREQ(AGENT_SCHEDULER_STATE_URGENT_FAILED_ITEM_NAME, state->items[3].name);
	ASSERT_STREQ(AGENT_SCHEDULER_STATE_TOTAL_ITEM_NAME, state->items[4].name);
	indigo_release_property(state);
	snprintf(text, sizeof(text), "// @task Later\n// @window %s ..\n" BODY_WAIT(1), future);
	REQUIRE(upload(text));
	REQUIRE(upload("// @task Stored urgent\n// @priority urgent\n" BODY_WAIT(1)));
	REQUIRE(control(AGENT_SCHEDULER_CONTROL_START_ITEM_NAME));
	ASSERT_TRUE(wait_task_state("Stored urgent", "DONE", 15));
	REQUIRE(urgent("// @task Flash\n" BODY_WAIT(1)));
	ASSERT_TRUE(wait_message("Task 'Flash' completed", 1, 15));
	REQUIRE(urgent("// @task Broken\nif (!scheduler_task.estimate) { throw new Error(\"no target\"); }\n" BODY_WAIT(1)));
	ASSERT_TRUE(wait_message("Task 'Broken' failed", 1, 15));
	snprintf(text, sizeof(text), "// @task Too late\n// @window .. %s\n" BODY_WAIT(1), past);
	REQUIRE(urgent(text));
	ASSERT_TRUE(wait_message("Task 'Too late' expired", 1, 15));
	// a deleted urgent task is not counted
	REQUIRE(urgent("// @task Cancelled\n" BODY_WAIT(30)));
	ASSERT_TRUE(wait_message("Starting task 'Cancelled'", 1, 15));
	REQUIRE(change_text(AGENT_SCHEDULER_DELETE_TASK_PROPERTY_NAME, AGENT_SCHEDULER_DELETE_TASK_NAME_ITEM_NAME, "Cancelled", INDIGO_OK_STATE, NULL));
	ASSERT_TRUE(wait_message("Task 'Cancelled' aborted and deleted", 1, 15));
	ASSERT_TRUE(wait_counter(AGENT_SCHEDULER_STATE_URGENT_DONE_ITEM_NAME, 1, 5));
	ASSERT_TRUE(wait_counter(AGENT_SCHEDULER_STATE_URGENT_FAILED_ITEM_NAME, 2, 5));
	// the stored urgent task is counted with the task list
	ASSERT_EQ_INT(1, state_counter(AGENT_SCHEDULER_STATE_DONE_ITEM_NAME));
	ASSERT_EQ_INT(0, state_counter(AGENT_SCHEDULER_STATE_FAILED_ITEM_NAME));
	ASSERT_EQ_INT(2, state_counter(AGENT_SCHEDULER_STATE_TOTAL_ITEM_NAME));
	// kept across a restart, with the history
	stop_scheduler();
	memset(messages, 0, sizeof(messages));
	REQUIRE(start_scheduler());
	ASSERT_TRUE(wait_counter(AGENT_SCHEDULER_STATE_URGENT_DONE_ITEM_NAME, 1, 5));
	ASSERT_TRUE(wait_counter(AGENT_SCHEDULER_STATE_URGENT_FAILED_ITEM_NAME, 2, 5));
	// and cleared with it
	unsigned before = revision(AGENT_SCHEDULER_CLEAR_HISTORY_PROPERTY_NAME);
	indigo_change_switch_property_1(&observer, AGENT, AGENT_SCHEDULER_CLEAR_HISTORY_PROPERTY_NAME, AGENT_SCHEDULER_CLEAR_HISTORY_CLEAR_ITEM_NAME, true);
	REQUIRE(wait_property_state(AGENT_SCHEDULER_CLEAR_HISTORY_PROPERTY_NAME, before, INDIGO_OK_STATE, NULL));
	ASSERT_TRUE(wait_counter(AGENT_SCHEDULER_STATE_URGENT_DONE_ITEM_NAME, 0, 5));
	ASSERT_TRUE(wait_counter(AGENT_SCHEDULER_STATE_URGENT_FAILED_ITEM_NAME, 0, 5));
	ASSERT_EQ_INT(1, state_counter(AGENT_SCHEDULER_STATE_DONE_ITEM_NAME));
	// a clear is saved too
	stop_scheduler();
	REQUIRE(start_scheduler());
	indigo_usleep(500000);
	ASSERT_EQ_INT(0, state_counter(AGENT_SCHEDULER_STATE_URGENT_DONE_ITEM_NAME));
	ASSERT_EQ_INT(0, state_counter(AGENT_SCHEDULER_STATE_URGENT_FAILED_ITEM_NAME));
}

// a command for all tasks, the task name is not used
static bool all_command(const char *item, indigo_property_state expected, char *message) {
	unsigned before = revision(AGENT_SCHEDULER_TASK_COMMAND_PROPERTY_NAME);
	indigo_change_switch_property_1(&observer, AGENT, AGENT_SCHEDULER_TASK_COMMAND_PROPERTY_NAME, item, true);
	return wait_property_state(AGENT_SCHEDULER_TASK_COMMAND_PROPERTY_NAME, before, expected, message);
}

static int task_count(void) {
	indigo_property *list = snapshot(AGENT_SCHEDULER_TASK_STATE_PROPERTY_NAME);
	int count = list ? list->count : -1;
	indigo_release_property(list);
	return count;
}

static void reset_all_keeps_running_task_and_urgent_order(void) {
	// both commands ask the client for a confirmation, the other items keep their places
	indigo_property *commands = snapshot(AGENT_SCHEDULER_TASK_COMMAND_PROPERTY_NAME);
	REQUIRE(commands != NULL && commands->count == 7);
	ASSERT_STREQ(AGENT_SCHEDULER_TASK_COMMAND_MOVE_DOWN_ITEM_NAME, commands->items[4].name);
	ASSERT_STREQ(AGENT_SCHEDULER_TASK_COMMAND_RESET_ALL_ITEM_NAME, commands->items[5].name);
	ASSERT_STREQ(AGENT_SCHEDULER_TASK_COMMAND_DELETE_ALL_ITEM_NAME, commands->items[6].name);
	ASSERT_TRUE(!strncmp(commands->items[5].hints, "warn_on_set:\"", 13));
	ASSERT_TRUE(!strncmp(commands->items[6].hints, "warn_on_set:\"", 13));
	ASSERT_TRUE(commands->items[0].hints[0] == 0);
	indigo_release_property(commands);
	// the urgent task submitted first takes the higher slot, the reset keeps it first
	REQUIRE(upload("// @task Filler\n" BODY_WAIT(1)));
	REQUIRE(urgent("// @task First urgent\n" BODY_WAIT(1)));
	REQUIRE(change_text(AGENT_SCHEDULER_DELETE_TASK_PROPERTY_NAME, AGENT_SCHEDULER_DELETE_TASK_NAME_ITEM_NAME, "Filler", INDIGO_OK_STATE, NULL));
	REQUIRE(urgent("// @task Second urgent\n" BODY_WAIT(1)));
	char message[INDIGO_VALUE_SIZE];
	REQUIRE(all_command(AGENT_SCHEDULER_TASK_COMMAND_RESET_ALL_ITEM_NAME, INDIGO_OK_STATE, message));
	ASSERT_STREQ("Tasks reset: 2", message);
	REQUIRE(upload("// @task Done once\n" BODY_WAIT(1)));
	REQUIRE(upload("// @task Broken\n// @priority low\nif (!scheduler_task.estimate) { throw new Error(\"broken\"); }\n" BODY_WAIT(1)));
	REQUIRE(upload("// @task Long\n// @priority low 10\n" BODY_WAIT(30)));
	REQUIRE(control(AGENT_SCHEDULER_CONTROL_START_ITEM_NAME));
	ASSERT_TRUE(wait_message("Task 'Second urgent' completed", 1, 15));
	ASSERT_TRUE(message_position("Starting task 'First urgent'") < message_position("Starting task 'Second urgent'"));
	ASSERT_TRUE(wait_task_state("Done once", "DONE", 15));
	ASSERT_TRUE(wait_task_state("Broken", "FAILED", 15));
	ASSERT_TRUE(wait_task_state("Long", "RUNNING", 15));
	ASSERT_TRUE(wait_counter(AGENT_SCHEDULER_STATE_DONE_ITEM_NAME, 1, 5));
	ASSERT_TRUE(wait_counter(AGENT_SCHEDULER_STATE_FAILED_ITEM_NAME, 1, 5));
	// the running task is left alone, the others run again
	REQUIRE(all_command(AGENT_SCHEDULER_TASK_COMMAND_RESET_ALL_ITEM_NAME, INDIGO_OK_STATE, message));
	ASSERT_STREQ("Tasks reset: 2, 'Long' is running and was not reset", message);
	ASSERT_TRUE(wait_task_state("Done once", "QUEUED", 5));
	ASSERT_TRUE(wait_task_state("Broken", "QUEUED", 5));
	ASSERT_TRUE(wait_task_state("Long", "RUNNING", 5));
	ASSERT_TRUE(wait_counter(AGENT_SCHEDULER_STATE_DONE_ITEM_NAME, 0, 5));
	ASSERT_TRUE(wait_counter(AGENT_SCHEDULER_STATE_FAILED_ITEM_NAME, 0, 5));
	REQUIRE(control(AGENT_SCHEDULER_CONTROL_ABORT_ITEM_NAME));
	ASSERT_TRUE(wait_task_state("Long", "RETRY", 10));
	ASSERT_TRUE(wait_scheduler_state(INDIGO_ALERT_STATE, 5));
	// the reset is saved
	stop_scheduler();
	REQUIRE(start_scheduler());
	ASSERT_TRUE(wait_task_state("Done once", "QUEUED", 5));
	ASSERT_TRUE(wait_task_state("Broken", "QUEUED", 5));
}

static void delete_all_keeps_hooks_and_needs_a_stopped_scheduler(void) {
	REQUIRE(upload("// @task Long\n" BODY_WAIT(30)));
	REQUIRE(control(AGENT_SCHEDULER_CONTROL_START_ITEM_NAME));
	ASSERT_TRUE(wait_task_state("Long", "RUNNING", 15));
	char message[INDIGO_VALUE_SIZE];
	REQUIRE(all_command(AGENT_SCHEDULER_TASK_COMMAND_DELETE_ALL_ITEM_NAME, INDIGO_ALERT_STATE, message));
	ASSERT_TRUE(strstr(message, "only while the scheduler is stopped") != NULL);
	ASSERT_TRUE(wait_task_state("Long", "RUNNING", 5));
	ASSERT_EQ_INT(1, task_count());
	REQUIRE(control(AGENT_SCHEDULER_CONTROL_ABORT_ITEM_NAME));
	ASSERT_TRUE(wait_task_state("Long", "RETRY", 10));
	ASSERT_TRUE(wait_scheduler_state(INDIGO_ALERT_STATE, 5));
	// the tasks named as hooks are kept, stored and urgent tasks are deleted
	REQUIRE(upload("// @task Prepare\n" BODY_WAIT(1)));
	REQUIRE(upload("// @task Park\n" BODY_WAIT(1)));
	REQUIRE(upload("// @task Morning\n" BODY_WAIT(1)));
	REQUIRE(upload("// @task Other\n" BODY_WAIT(1)));
	REQUIRE(urgent("// @task Pending\n" BODY_WAIT(1)));
	REQUIRE(set_hooks("Prepare", "Park", ""));
	REQUIRE(set_night_hooks("", "Morning", ""));
	ASSERT_EQ_INT(6, state_counter(AGENT_SCHEDULER_STATE_TOTAL_ITEM_NAME));
	REQUIRE(all_command(AGENT_SCHEDULER_TASK_COMMAND_DELETE_ALL_ITEM_NAME, INDIGO_OK_STATE, message));
	ASSERT_STREQ("Tasks deleted: 3, tasks named as hooks kept: 3", message);
	char label[INDIGO_VALUE_SIZE];
	ASSERT_FALSE(task_label("Long", label, NULL));
	ASSERT_FALSE(task_label("Other", label, NULL));
	ASSERT_FALSE(task_label("Pending", label, NULL));
	ASSERT_TRUE(task_label("Prepare", label, NULL));
	ASSERT_TRUE(task_label("Park", label, NULL));
	ASSERT_TRUE(task_label("Morning", label, NULL));
	ASSERT_EQ_INT(3, task_count());
	ASSERT_TRUE(wait_counter(AGENT_SCHEDULER_STATE_TOTAL_ITEM_NAME, 3, 5));
	// a list of hooks only, nothing more to delete
	REQUIRE(all_command(AGENT_SCHEDULER_TASK_COMMAND_DELETE_ALL_ITEM_NAME, INDIGO_OK_STATE, message));
	ASSERT_STREQ("Tasks deleted: 0, tasks named as hooks kept: 3", message);
	// the deletion is saved and the hooks still name their tasks
	stop_scheduler();
	REQUIRE(start_scheduler());
	ASSERT_EQ_INT(3, task_count());
	ASSERT_FALSE(task_label("Other", label, NULL));
	indigo_property *hooks = snapshot(AGENT_SCHEDULER_HOOKS_PROPERTY_NAME);
	REQUIRE(hooks != NULL);
	ASSERT_STREQ("Prepare", indigo_get_text_item_value(indigo_get_item(hooks, AGENT_SCHEDULER_HOOKS_STARTUP_ITEM_NAME)));
	ASSERT_STREQ("Park", indigo_get_text_item_value(indigo_get_item(hooks, AGENT_SCHEDULER_HOOKS_SHUTDOWN_ITEM_NAME)));
	ASSERT_STREQ("Morning", indigo_get_text_item_value(indigo_get_item(hooks, AGENT_SCHEDULER_HOOKS_NIGHT_END_ITEM_NAME)));
	indigo_release_property(hooks);
	// without hooks everything goes
	REQUIRE(set_hooks("", "", ""));
	REQUIRE(set_night_hooks("", "", ""));
	REQUIRE(all_command(AGENT_SCHEDULER_TASK_COMMAND_DELETE_ALL_ITEM_NAME, INDIGO_OK_STATE, message));
	ASSERT_STREQ("Tasks deleted: 3", message);
	ASSERT_EQ_INT(0, task_count());
}

static void reset_all_runs_finished_work_again(void) {
	char message[INDIGO_VALUE_SIZE];
	REQUIRE(all_command(AGENT_SCHEDULER_TASK_COMMAND_RESET_ALL_ITEM_NAME, INDIGO_OK_STATE, message));
	ASSERT_STREQ("Tasks reset: 0", message);
	REQUIRE(upload("// @task Twice\n// @repeat 2\n" BODY_WAIT(1)));
	REQUIRE(upload("// @task Broken\n// @priority low\n// @retry 1\nif (!scheduler_task.estimate) { throw new Error(\"broken body\"); }\n" BODY_WAIT(1)));
	REQUIRE(upload("// @task Syntax\n// @priority low 10\nvar = ;\n"));
	REQUIRE(upload("// @task Off\n// @priority low 20\n" BODY_WAIT(1)));
	REQUIRE(command("Off", AGENT_SCHEDULER_TASK_COMMAND_DISABLE_ITEM_NAME));
	REQUIRE(control(AGENT_SCHEDULER_CONTROL_START_ITEM_NAME));
	ASSERT_TRUE(wait_message("All tasks finished", 1, 30));
	ASSERT_TRUE(wait_scheduler_state(INDIGO_OK_STATE, 5));
	ASSERT_TRUE(wait_task_state("Twice", "DONE, run 2/2", 5));
	ASSERT_TRUE(wait_task_state("Broken", "FAILED, retries left 0", 5));
	ASSERT_TRUE(wait_task_state("Syntax", "SCRIPT ERROR", 5));
	ASSERT_EQ_INT(1, count_messages("Task 'Syntax' has a script error"));
	// the task name is not used, an unknown one does not matter
	REQUIRE(change_text(AGENT_SCHEDULER_TASK_NAME_PROPERTY_NAME, AGENT_SCHEDULER_TASK_NAME_NAME_ITEM_NAME, "Nobody", INDIGO_OK_STATE, NULL));
	REQUIRE(all_command(AGENT_SCHEDULER_TASK_COMMAND_RESET_ALL_ITEM_NAME, INDIGO_OK_STATE, message));
	ASSERT_STREQ("Tasks reset: 4", message);
	// the run and retry counters are cleared, the script is checked again, a disabled task stays disabled
	ASSERT_TRUE(wait_task_state("Twice", "QUEUED, run 0/2", 5));
	ASSERT_TRUE(wait_task_state("Broken", "QUEUED, retries left 1", 5));
	ASSERT_TRUE(wait_message("Task 'Syntax' has a script error", 2, 15));
	ASSERT_TRUE(wait_task_state("Syntax", "SCRIPT ERROR", 5));
	ASSERT_TRUE(wait_task_state("Off", "DISABLED", 5));
	ASSERT_TRUE(wait_counter(AGENT_SCHEDULER_STATE_DONE_ITEM_NAME, 0, 5));
	ASSERT_TRUE(wait_counter(AGENT_SCHEDULER_STATE_FAILED_ITEM_NAME, 0, 5));
	// a new start runs the finished work again
	REQUIRE(control(AGENT_SCHEDULER_CONTROL_START_ITEM_NAME));
	ASSERT_TRUE(wait_message("All tasks finished", 2, 30));
	ASSERT_TRUE(wait_task_state("Twice", "DONE, run 2/2", 5));
	ASSERT_TRUE(wait_task_state("Broken", "FAILED, retries left 0", 5));
	ASSERT_EQ_INT(4, count_messages("Starting task 'Twice'"));
	ASSERT_EQ_INT(4, count_messages("Starting task 'Broken'"));
	ASSERT_EQ_INT(0, count_messages("Starting task 'Syntax'"));
	ASSERT_EQ_INT(0, count_messages("Starting task 'Off'"));
}

static void delete_all_waits_for_the_shutdown_hook(void) {
	char message[INDIGO_VALUE_SIZE];
	REQUIRE(all_command(AGENT_SCHEDULER_TASK_COMMAND_DELETE_ALL_ITEM_NAME, INDIGO_OK_STATE, message));
	ASSERT_STREQ("Tasks deleted: 0", message);
	REQUIRE(upload("// @task Park\n" BODY_WAIT(2)));
	REQUIRE(upload("// @task Long\n" BODY_WAIT(3)));
	// a hook names its task regardless of case
	REQUIRE(set_hooks("", "park", ""));
	ASSERT_TRUE(wait_task_state("Park", "SHUTDOWN HOOK", 5));
	REQUIRE(control(AGENT_SCHEDULER_CONTROL_START_ITEM_NAME));
	ASSERT_TRUE(wait_task_state("Long", "RUNNING", 15));
	// a stop waits for the task, then runs the shutdown hook; the scheduler is not stopped before both end
	REQUIRE(control(AGENT_SCHEDULER_CONTROL_STOP_ITEM_NAME));
	REQUIRE(all_command(AGENT_SCHEDULER_TASK_COMMAND_DELETE_ALL_ITEM_NAME, INDIGO_ALERT_STATE, message));
	ASSERT_TRUE(strstr(message, "only while the scheduler is stopped") != NULL);
	ASSERT_TRUE(wait_message("Starting hook 'Park'", 1, 15));
	REQUIRE(all_command(AGENT_SCHEDULER_TASK_COMMAND_DELETE_ALL_ITEM_NAME, INDIGO_ALERT_STATE, message));
	ASSERT_TRUE(strstr(message, "only while the scheduler is stopped") != NULL);
	ASSERT_TRUE(wait_message("Hook 'Park' completed", 1, 15));
	ASSERT_TRUE(wait_scheduler_state(INDIGO_OK_STATE, 5));
	int entries = history_count();
	indigo_property *task = snapshot("AGENT_SCHEDULER_TASK_1");
	REQUIRE(task != NULL);
	ASSERT_STREQ("Long", task->label);
	indigo_release_property(task);
	REQUIRE(all_command(AGENT_SCHEDULER_TASK_COMMAND_DELETE_ALL_ITEM_NAME, INDIGO_OK_STATE, message));
	ASSERT_STREQ("Tasks deleted: 1, tasks named as hooks kept: 1", message);
	// the property of the deleted task goes, the history stays as it was
	ASSERT_TRUE(snapshot("AGENT_SCHEDULER_TASK_1") == NULL);
	task = snapshot("AGENT_SCHEDULER_TASK_0");
	REQUIRE(task != NULL);
	ASSERT_STREQ("Park", task->label);
	indigo_release_property(task);
	ASSERT_EQ_INT(entries, history_count());
	ASSERT_TRUE(wait_plan_contains("Long", false, 5));
	// the name and the slot can be used again
	REQUIRE(upload("// @task Long\n" BODY_WAIT(1)));
	task = snapshot("AGENT_SCHEDULER_TASK_1");
	REQUIRE(task != NULL);
	ASSERT_STREQ("Long", task->label);
	indigo_release_property(task);
}

// -------------------------------------------------------------------------------- Eligibility

// the longitude where the local mean solar time is hour, at the equator: 0 is deep night, 12 is noon
static double longitude_at_hour(double hour) {
	time_t now = time(NULL);
	double hours = (now % 86400) / 3600.0;
	return fmod((hour - hours) * 15 + 720, 360);
}

// J2000 coordinates of the point that stands at the hour angle (hours) and declination (degrees) of date at the current site
static void target_at(double hour_angle, double declination, char *text, size_t size) {
	time_t now = time(NULL);
	double ra = fmod(indigo_lst(&now, site_property->items[1].number.value) - hour_angle + 48, 24), dec = declination;
	indigo_jnow_to_j2k(&ra, &dec);
	snprintf(text, size, "%.6f %.6f", ra, dec);
}

// a task with a target placed by target_at() and extra header lines
static bool upload_placed(const char *name, double hour_angle, double declination, const char *header) {
	char target[64], text[1024];
	target_at(hour_angle, declination, target, sizeof(target));
	snprintf(text, sizeof(text), "// @task %s\n// @target %s\n%s" BODY_WAIT(1), name, target, header);
	return upload(text);
}

static void hhmm(time_t t, char *text) {
	struct tm tm;
	gmtime_r(&t, &tm);
	sprintf(text, "%02d:%02d", tm.tm_hour, tm.tm_min);
}

// a waiting task never started, with the scheduler's reason
static bool waits_with_reason(const char *name, const char *reason) {
	CHECK(wait_task_state(name, "WAITING", 10));
	CHECK(wait_reason(reason, 10));
	char text[128];
	snprintf(text, sizeof(text), "Starting task '%s'", name);
	CHECK(count_messages(text) == 0);
	return true;
}

static void altitude_limit_decides_and_follows_the_sky(void) {
	set_site(0, 17.11);
	// at the equator a target on the celestial equator stands 15 degrees lower per hour of hour angle: 45 degrees, rising
	REQUIRE(upload_placed("Steep", -3, 0, "// @priority high\n// @altitude > 70\n// @duration 5\n"));
	REQUIRE(upload_placed("Moderate", -3, 0, "// @altitude > 30\n// @duration 5\n"));
	REQUIRE(control(AGENT_SCHEDULER_CONTROL_START_ITEM_NAME));
	ASSERT_TRUE(wait_task_state("Moderate", "DONE", 15));
	ASSERT_TRUE(waits_with_reason("Steep", "target below the altitude limit"));
	// three hours of sidereal time later, the target culminates and the waiting task runs by itself
	set_site(0, 17.11 + 45);
	ASSERT_TRUE(wait_task_state("Steep", "DONE", 15));
}

static void airmass_limit_decides_and_follows_the_sky(void) {
	set_site(0, 17.11);
	// 30 degrees high, airmass 2
	REQUIRE(upload_placed("Thin air", -4, 0, "// @priority high\n// @airmass < 1.5\n// @duration 5\n"));
	REQUIRE(upload_placed("Thick air", -4, 0, "// @airmass < 2.5\n// @duration 5\n"));
	REQUIRE(control(AGENT_SCHEDULER_CONTROL_START_ITEM_NAME));
	ASSERT_TRUE(wait_task_state("Thick air", "DONE", 15));
	ASSERT_TRUE(waits_with_reason("Thin air", "airmass too high"));
	set_site(0, 17.11 + 60);
	ASSERT_TRUE(wait_task_state("Thin air", "DONE", 15));
}

static void hour_angle_ranges_including_wrapped(void) {
	set_site(0, 17.11);
	// one hour west of the meridian, 75 degrees high
	REQUIRE(upload_placed("East", 1, 0, "// @priority high\n// @ha -2 .. 0\n// @duration 5\n"));
	// a range from 3h through 12h to -3h, which excludes the meridian
	REQUIRE(upload_placed("Low sides", 1, 0, "// @priority high\n// @ha 3 .. -3\n// @duration 5\n"));
	REQUIRE(upload_placed("West", 1, 0, "// @ha 0 .. 2\n// @duration 5\n"));
	// a range from 0.5h through 12h to -0.5h, which includes 1h
	REQUIRE(upload_placed("Off meridian", 1, 0, "// @ha 0.5 .. -0.5\n// @duration 5\n"));
	REQUIRE(control(AGENT_SCHEDULER_CONTROL_START_ITEM_NAME));
	ASSERT_TRUE(wait_task_state("West", "DONE", 15));
	ASSERT_TRUE(wait_task_state("Off meridian", "DONE", 15));
	ASSERT_TRUE(waits_with_reason("East", "hour angle out of range"));
	ASSERT_TRUE(wait_task_state("Low sides", "WAITING", 5));
	// two hours earlier in sidereal time the target is at -1h: East runs, the meridian is still outside 3 .. -3
	set_site(0, 17.11 - 30);
	ASSERT_TRUE(wait_task_state("East", "DONE", 15));
	indigo_usleep(2000000);
	ASSERT_TRUE(wait_task_state("Low sides", "WAITING", 5));
	ASSERT_EQ_INT(0, count_messages("Starting task 'Low sides'"));
}

static void twilight_limit_follows_the_sun(void) {
	set_site(0, longitude_at_hour(12));
	REQUIRE(upload("// @task Night only\n// @priority high\n// @twilight nautical\n// @duration 5\n" BODY_WAIT(1)));
	REQUIRE(upload("// @task Any time\n// @duration 5\n" BODY_WAIT(1)));
	REQUIRE(control(AGENT_SCHEDULER_CONTROL_START_ITEM_NAME));
	ASSERT_TRUE(wait_task_state("Any time", "DONE", 15));
	ASSERT_TRUE(waits_with_reason("Night only", "too bright (twilight)"));
	// at midnight even the astronomical limit holds
	set_site(0, longitude_at_hour(0));
	ASSERT_TRUE(wait_task_state("Night only", "DONE", 15));
	REQUIRE(upload("// @task Dark\n// @twilight astronomical\n// @duration 5\n" BODY_WAIT(1)));
	ASSERT_TRUE(wait_task_state("Dark", "DONE", 15));
}

static void moon_separation_and_brightness(void) {
	// the site under the moon, so that the moon stands at the zenith
	scheduler_sky_grid *sky = indigo_safe_malloc(sizeof(scheduler_sky_grid));
	time_t now = time(NULL);
	indigo_scheduler_sky_build(sky, now, 0, 0, 140);
	double moon_ra = sky->moon_ra[0], moon_dec = sky->moon_dec[0];
	double longitude = fmod((moon_ra - indigo_lst(&now, 0)) * 15 + 720, 360);
	indigo_scheduler_sky_build(sky, now, moon_dec, longitude, 140);
	double days_from_full = sky->moon_days_from_full[0];
	bool moon_high = sky->moon_altitude[0] > 60;
	free(sky);
	REQUIRE(moon_high);
	set_site(moon_dec, longitude);
	// the separations are measured from the moon along the meridian
	REQUIRE(upload_placed("Beside", 0, moon_dec + 3, "// @priority high\n// @moon > 30\n// @duration 5\n"));
	REQUIRE(upload_placed("Away", 0, moon_dec - 40, "// @moon > 30\n// @duration 5\n"));
	// the Lorentzian limit of this moon age, a fixed limit just above the same separation
	double limit = indigo_scheduler_moon_limit(40, 3, days_from_full);
	double separation = fmin(limit + 8, 70);
	char header[128];
	snprintf(header, sizeof(header), "// @priority high\n// @moon > %.0f\n// @duration 5\n", ceil(separation + 8));
	REQUIRE(upload_placed("Fixed", 0, moon_dec - separation, header));
	REQUIRE(upload_placed("Lorentzian", 0, moon_dec - separation, "// @moon > 40 width 3\n// @duration 5\n"));
	// a limit the moon above the horizon can never meet, and one it always meets
	REQUIRE(upload("// @task Never\n// @priority high\n// @target 0 0\n// @illumination < 0\n// @duration 5\n" BODY_WAIT(1)));
	REQUIRE(upload_placed("Any phase", 0, moon_dec - 40, "// @illumination < 100\n// @duration 5\n"));
	REQUIRE(control(AGENT_SCHEDULER_CONTROL_START_ITEM_NAME));
	ASSERT_TRUE(wait_task_state("Away", "DONE", 15));
	ASSERT_TRUE(wait_task_state("Lorentzian", "DONE", 15));
	ASSERT_TRUE(wait_task_state("Any phase", "DONE", 15));
	ASSERT_TRUE(waits_with_reason("Beside", "too close to the moon"));
	ASSERT_TRUE(wait_task_state("Fixed", "WAITING", 5));
	ASSERT_EQ_INT(0, count_messages("Starting task 'Fixed'"));
	REQUIRE(change_text(AGENT_SCHEDULER_DELETE_TASK_PROPERTY_NAME, AGENT_SCHEDULER_DELETE_TASK_NAME_ITEM_NAME, "Beside", INDIGO_OK_STATE, NULL));
	REQUIRE(change_text(AGENT_SCHEDULER_DELETE_TASK_PROPERTY_NAME, AGENT_SCHEDULER_DELETE_TASK_NAME_ITEM_NAME, "Fixed", INDIGO_OK_STATE, NULL));
	REQUIRE(change_text(AGENT_SCHEDULER_DELETE_TASK_PROPERTY_NAME, AGENT_SCHEDULER_DELETE_TASK_NAME_ITEM_NAME, "Never", INDIGO_OK_STATE, NULL));
	REQUIRE(upload_placed("Never", 0, moon_dec - 40, "// @priority high\n// @illumination < 0\n// @duration 5\n"));
	ASSERT_TRUE(waits_with_reason("Never", "moon too bright"));
	// twelve hours of sidereal time later the moon is below the horizon and its limits are ignored
	set_site(moon_dec, fmod(longitude + 180, 360));
	REQUIRE(change_text(AGENT_SCHEDULER_DELETE_TASK_PROPERTY_NAME, AGENT_SCHEDULER_DELETE_TASK_NAME_ITEM_NAME, "Never", INDIGO_OK_STATE, NULL));
	REQUIRE(upload_placed("Moonless", 0, moon_dec, "// @moon > 90\n// @illumination < 0\n// @duration 5\n"));
	ASSERT_TRUE(wait_task_state("Moonless", "DONE", 15));
}

static void nightly_windows(void) {
	time_t now = time(NULL);
	char a[8], b[8], text[512];
	// the windows are given around the current time; one that crosses midnight works the same way
	hhmm(now + 7200, a);
	hhmm(now + 10800, b);
	snprintf(text, sizeof(text), "// @task Outside\n// @priority high\n// @window %s .. %s\n// @duration 5\n" BODY_WAIT(1), a, b);
	REQUIRE(upload(text));
	hhmm(now - 1800, a);
	hhmm(now + 240, b);
	snprintf(text, sizeof(text), "// @task Too short\n// @priority high\n// @window %s .. %s\n// @duration 30\n" BODY_WAIT(1), a, b);
	REQUIRE(upload(text));
	hhmm(now - 1800, a);
	hhmm(now + 3600, b);
	snprintf(text, sizeof(text), "// @task Inside\n// @window %s .. %s\n// @duration 5\n" BODY_WAIT(1), a, b);
	REQUIRE(upload(text));
	// from an hour ago through midnight to two hours ago: everything but one hour in the past
	hhmm(now - 3600, a);
	hhmm(now - 7200, b);
	snprintf(text, sizeof(text), "// @task Around\n// @window %s .. %s\n// @duration 5\n" BODY_WAIT(1), a, b);
	REQUIRE(upload(text));
	// from an hour ahead through midnight to an hour ago: everything but now
	hhmm(now + 3600, a);
	hhmm(now - 3600, b);
	snprintf(text, sizeof(text), "// @task Gap\n// @priority high\n// @window %s .. %s\n// @duration 5\n" BODY_WAIT(1), a, b);
	REQUIRE(upload(text));
	REQUIRE(control(AGENT_SCHEDULER_CONTROL_START_ITEM_NAME));
	ASSERT_TRUE(wait_task_state("Inside", "DONE", 15));
	ASSERT_TRUE(wait_task_state("Around", "DONE", 15));
	ASSERT_TRUE(waits_with_reason("Outside", "outside of the nightly window"));
	ASSERT_TRUE(wait_task_state("Gap", "WAITING", 5));
	ASSERT_EQ_INT(0, count_messages("Starting task 'Gap'"));
	REQUIRE(change_text(AGENT_SCHEDULER_DELETE_TASK_PROPERTY_NAME, AGENT_SCHEDULER_DELETE_TASK_NAME_ITEM_NAME, "Outside", INDIGO_OK_STATE, NULL));
	ASSERT_TRUE(waits_with_reason("Too short", "nightly window ends before the task can finish"));
	// a nightly window never expires
	ASSERT_EQ_INT(0, count_messages("expired"));
}

static void duration_must_fit_before_the_target_sets(void) {
	set_site(0, 17.11);
	// 7.5 degrees high and setting, below the horizon in about 30 minutes
	REQUIRE(upload_placed("Long look", 5.5, 0, "// @priority high\n// @duration 60\n"));
	REQUIRE(upload_placed("Short look", 5.5, 0, "// @duration 10\n"));
	REQUIRE(control(AGENT_SCHEDULER_CONTROL_START_ITEM_NAME));
	ASSERT_TRUE(wait_task_state("Short look", "DONE", 15));
	ASSERT_TRUE(waits_with_reason("Long look", "target below the horizon"));
}

static void unknown_site_blocks_only_sky_constraints(void) {
	indigo_delete_property(&mount_standin, site_property, NULL);
	REQUIRE(upload("// @task Placed\n// @priority high\n// @target 0 0\n// @duration 5\n" BODY_WAIT(1)));
	REQUIRE(upload("// @task Dark only\n// @priority high\n// @twilight civil\n// @duration 5\n" BODY_WAIT(1)));
	REQUIRE(upload("// @task Anywhere\n// @duration 5\n" BODY_WAIT(1)));
	REQUIRE(control(AGENT_SCHEDULER_CONTROL_START_ITEM_NAME));
	ASSERT_TRUE(wait_task_state("Anywhere", "DONE", 15));
	ASSERT_TRUE(waits_with_reason("Placed", "site coordinates unknown"));
	ASSERT_TRUE(wait_task_state("Dark only", "WAITING", 5));
	ASSERT_EQ_INT(0, count_messages("Starting task 'Dark only'"));
	// the site appears at midnight with the target at the zenith
	set_site(0, longitude_at_hour(0));
	indigo_define_property(&mount_standin, site_property, NULL);
	REQUIRE(change_text(AGENT_SCHEDULER_DELETE_TASK_PROPERTY_NAME, AGENT_SCHEDULER_DELETE_TASK_NAME_ITEM_NAME, "Placed", INDIGO_OK_STATE, NULL));
	REQUIRE(upload_placed("Placed", 0, 0, "// @priority high\n// @duration 5\n"));
	ASSERT_TRUE(wait_task_state("Placed", "DONE", 15));
	ASSERT_TRUE(wait_task_state("Dark only", "DONE", 15));
}

static void disabled_in_the_header_stays_disabled(void) {
	REQUIRE(upload("// @task Parked\n// @enabled no\n" BODY_WAIT(1)));
	REQUIRE(upload("// @task Active\n// @priority low\n" BODY_WAIT(1)));
	REQUIRE(control(AGENT_SCHEDULER_CONTROL_START_ITEM_NAME));
	ASSERT_TRUE(wait_task_state("Active", "DONE", 15));
	ASSERT_TRUE(wait_task_state("Parked", "DISABLED", 5));
	// ENABLE clears only the command flag
	REQUIRE(command("Parked", AGENT_SCHEDULER_TASK_COMMAND_ENABLE_ITEM_NAME));
	indigo_usleep(2000000);
	ASSERT_TRUE(wait_task_state("Parked", "DISABLED", 5));
	ASSERT_EQ_INT(0, count_messages("Starting task 'Parked'"));
	// the disabled task does not keep the scheduler running
	ASSERT_TRUE(wait_message("All tasks finished", 1, 10));
	// an edit of the header enables it
	REQUIRE(change_text("AGENT_SCHEDULER_TASK_0", AGENT_SCHEDULER_TASK_TASK_ITEM_NAME, "// @task Parked\n// @enabled yes\n" BODY_WAIT(1), INDIGO_OK_STATE, NULL));
	REQUIRE(control(AGENT_SCHEDULER_CONTROL_START_ITEM_NAME));
	ASSERT_TRUE(wait_task_state("Parked", "DONE", 15));
}

// order of the first starts of two tasks in the messages: true when first started before second
static bool started_before(const char *first, const char *second) {
	char a[128], b[128];
	snprintf(a, sizeof(a), "Starting task '%s'", first);
	snprintf(b, sizeof(b), "Starting task '%s'", second);
	long pa = message_position(a), pb = message_position(b);
	return pa >= 0 && pb >= 0 && pa < pb;
}

static void sky_bonuses_order_equal_priorities(void) {
	set_site(0, 17.11);
	// both 30 degrees high; Rising sets in 10 hours, Setting in 2 hours and has the larger setting bonus
	REQUIRE(upload_placed("Rising", -4, 0, "// @priority normal 70\n// @duration 5\n"));
	REQUIRE(upload_placed("Setting", 4, 0, "// @priority normal 50\n// @duration 5\n"));
	REQUIRE(control(AGENT_SCHEDULER_CONTROL_START_ITEM_NAME));
	ASSERT_TRUE(wait_message("All tasks finished", 1, 30));
	// the setting bonus outweighs a level difference of 20
	ASSERT_TRUE(started_before("Setting", "Rising"));
	// without it, the level decides
	REQUIRE(set_setting(AGENT_SCHEDULER_SETTINGS_SETTING_WEIGHT_ITEM_NAME, 0));
	REQUIRE(all_command(AGENT_SCHEDULER_TASK_COMMAND_RESET_ALL_ITEM_NAME, INDIGO_OK_STATE, NULL));
	memset(messages, 0, sizeof(messages));
	REQUIRE(control(AGENT_SCHEDULER_CONTROL_START_ITEM_NAME));
	ASSERT_TRUE(wait_message("All tasks finished", 1, 30));
	ASSERT_TRUE(started_before("Rising", "Setting"));
	// equal levels without sky bonuses: the list order decides
	REQUIRE(set_setting(AGENT_SCHEDULER_SETTINGS_ALTITUDE_WEIGHT_ITEM_NAME, 0));
	char target[64], text[512];
	target_at(-4, 0, target, sizeof(target));
	snprintf(text, sizeof(text), "// @task Rising\n// @target %s\n// @priority normal 50\n// @duration 5\n" BODY_WAIT(1), target);
	REQUIRE(change_text("AGENT_SCHEDULER_TASK_0", AGENT_SCHEDULER_TASK_TASK_ITEM_NAME, text, INDIGO_OK_STATE, NULL));
	REQUIRE(command("Setting", AGENT_SCHEDULER_TASK_COMMAND_MOVE_UP_ITEM_NAME));
	REQUIRE(all_command(AGENT_SCHEDULER_TASK_COMMAND_RESET_ALL_ITEM_NAME, INDIGO_OK_STATE, NULL));
	memset(messages, 0, sizeof(messages));
	REQUIRE(control(AGENT_SCHEDULER_CONTROL_START_ITEM_NAME));
	ASSERT_TRUE(wait_message("All tasks finished", 1, 30));
	ASSERT_TRUE(started_before("Setting", "Rising"));
	// the altitude bonus prefers the higher target: Rising is moved to 75 degrees
	target_at(-1, 0, target, sizeof(target));
	snprintf(text, sizeof(text), "// @task Rising\n// @target %s\n// @priority normal 50\n// @duration 5\n" BODY_WAIT(1), target);
	REQUIRE(change_text("AGENT_SCHEDULER_TASK_0", AGENT_SCHEDULER_TASK_TASK_ITEM_NAME, text, INDIGO_OK_STATE, NULL));
	REQUIRE(set_setting(AGENT_SCHEDULER_SETTINGS_ALTITUDE_WEIGHT_ITEM_NAME, 2));
	REQUIRE(all_command(AGENT_SCHEDULER_TASK_COMMAND_RESET_ALL_ITEM_NAME, INDIGO_OK_STATE, NULL));
	memset(messages, 0, sizeof(messages));
	REQUIRE(control(AGENT_SCHEDULER_CONTROL_START_ITEM_NAME));
	ASSERT_TRUE(wait_message("All tasks finished", 1, 30));
	ASSERT_TRUE(started_before("Rising", "Setting"));
}

static void largest_task_text_is_stored_and_restored(void) {
	static char text[SCHEDULER_TASK_TEXT_LIMIT + 2];
	const char *head = "// @task Big\n" BODY_WAIT(1) "//";
	strcpy(text, head);
	size_t length = strlen(text);
	memset(text + length, 'x', SCHEDULER_TASK_TEXT_LIMIT - length - 1);
	text[SCHEDULER_TASK_TEXT_LIMIT - 1] = 'y';
	text[SCHEDULER_TASK_TEXT_LIMIT] = 0;
	ASSERT_EQ_INT(SCHEDULER_TASK_TEXT_LIMIT, (int)strlen(text));
	REQUIRE(upload(text));
	// one byte more is rejected
	char message[INDIGO_VALUE_SIZE];
	text[SCHEDULER_TASK_TEXT_LIMIT - 1] = 'x';
	text[SCHEDULER_TASK_TEXT_LIMIT] = '\n';
	text[SCHEDULER_TASK_TEXT_LIMIT + 1] = 0;
	memcpy(text, "// @task Bigger", 15);
	REQUIRE(change_text(AGENT_SCHEDULER_ADD_TASK_PROPERTY_NAME, AGENT_SCHEDULER_ADD_TASK_TASK_ITEM_NAME, text, INDIGO_ALERT_STATE, message));
	ASSERT_TRUE(strstr(message, "longer than 16384 bytes") != NULL);
	// the full text is published, saved, restored and run
	stop_scheduler();
	memset(messages, 0, sizeof(messages));
	REQUIRE(start_scheduler());
	indigo_property *task = snapshot("AGENT_SCHEDULER_TASK_0");
	REQUIRE(task != NULL);
	ASSERT_STREQ("Big", task->label);
	ASSERT_EQ_INT(SCHEDULER_TASK_TEXT_LIMIT, (int)strlen(indigo_get_text_item_value(task->items)));
	indigo_release_property(task);
	REQUIRE(control(AGENT_SCHEDULER_CONTROL_START_ITEM_NAME));
	ASSERT_TRUE(wait_task_state("Big", "DONE", 15));
}

static void task_count_limit(void) {
	char text[128], message[INDIGO_VALUE_SIZE];
	for (int i = 1; i <= 128; i++) {
		snprintf(text, sizeof(text), "// @task T%03d\n" BODY_WAIT(1), i);
		REQUIRE(upload(text));
	}
	ASSERT_TRUE(wait_counter(AGENT_SCHEDULER_STATE_TOTAL_ITEM_NAME, 128, 5));
	REQUIRE(change_text(AGENT_SCHEDULER_ADD_TASK_PROPERTY_NAME, AGENT_SCHEDULER_ADD_TASK_TASK_ITEM_NAME, "// @task T129\n" BODY_WAIT(1), INDIGO_ALERT_STATE, message));
	ASSERT_TRUE(strstr(message, "at most 128 tasks") != NULL);
	REQUIRE(change_text(AGENT_SCHEDULER_URGENT_TASK_PROPERTY_NAME, AGENT_SCHEDULER_URGENT_TASK_TASK_ITEM_NAME, "// @task Rush\n" BODY_WAIT(1), INDIGO_ALERT_STATE, message));
	ASSERT_TRUE(strstr(message, "too many tasks") != NULL);
	ASSERT_EQ_INT(128, state_counter(AGENT_SCHEDULER_STATE_TOTAL_ITEM_NAME));
	// a deleted task frees a place
	REQUIRE(change_text(AGENT_SCHEDULER_DELETE_TASK_PROPERTY_NAME, AGENT_SCHEDULER_DELETE_TASK_NAME_ITEM_NAME, "T064", INDIGO_OK_STATE, NULL));
	REQUIRE(urgent("// @task Rush\n" BODY_WAIT(1)));
	ASSERT_TRUE(wait_counter(AGENT_SCHEDULER_STATE_TOTAL_ITEM_NAME, 128, 5));
}

static void repeat_interval_and_retry_delay(void) {
	REQUIRE(upload("// @task Paced\n// @repeat 2 every 1\n" BODY_WAIT(1)));
	REQUIRE(upload("// @task Patient\n// @priority low\n// @retry 1 after 1\nif (!scheduler_task.estimate) { throw new Error(\"not yet\"); }\n" BODY_WAIT(1)));
	REQUIRE(control(AGENT_SCHEDULER_CONTROL_START_ITEM_NAME));
	ASSERT_TRUE(wait_message("Task 'Paced' completed run 1 of 2", 1, 15));
	time_t paced_end = time(NULL);
	ASSERT_TRUE(wait_task_state("Paced", "REPEAT", 5));
	ASSERT_TRUE(wait_message("Task 'Patient' failed: Error: not yet, it will be retried", 1, 15));
	time_t patient_end = time(NULL);
	ASSERT_TRUE(wait_task_state("Patient", "RETRY", 5));
	// the second starts follow the pauses, each seen when it happens
	time_t paced_start = 0, patient_start = 0;
	for (int i = 0; i < 1000 && (paced_start == 0 || patient_start == 0); i++) {
		if (paced_start == 0 && count_messages("Starting task 'Paced'") >= 2) {
			paced_start = time(NULL);
		}
		if (patient_start == 0 && count_messages("Starting task 'Patient'") >= 2) {
			patient_start = time(NULL);
		}
		indigo_usleep(100000);
	}
	REQUIRE(paced_start > 0 && patient_start > 0);
	ASSERT_TRUE(paced_start - paced_end >= 55 && paced_start - paced_end <= 80);
	ASSERT_TRUE(patient_start - patient_end >= 55 && patient_start - patient_end <= 80);
	ASSERT_TRUE(wait_task_state("Paced", "DONE, run 2/2", 15));
	ASSERT_TRUE(wait_task_state("Patient", "FAILED", 15));
}

static void start_waits_for_pending_estimates(void) {
	// the estimate of the low task takes two seconds; the high task, uploaded right after it, waits for its own estimate
	REQUIRE(upload("// @task Low first\n// @priority low\nif (scheduler_task.estimate) { var t0 = Date.now(); while (Date.now() - t0 < 2000) { } }\n" BODY_WAIT(1)));
	REQUIRE(upload("// @task High second\n// @priority high\n" BODY_WAIT(1)));
	REQUIRE(control(AGENT_SCHEDULER_CONTROL_START_ITEM_NAME));
	ASSERT_TRUE(wait_message("All tasks finished", 1, 30));
	ASSERT_TRUE(started_before("High second", "Low first"));
}

static void history_records_runs(void) {
	REQUIRE(upload("// @task Good\n" BODY_WAIT(1)));
	REQUIRE(upload("// @task Bad\n// @priority low\nif (!scheduler_task.estimate) { throw new Error(\"broken\"); }\n" BODY_WAIT(1)));
	REQUIRE(upload("// @task Victim\n// @priority low 10\n" BODY_WAIT(30)));
	REQUIRE(control(AGENT_SCHEDULER_CONTROL_START_ITEM_NAME));
	ASSERT_TRUE(wait_task_state("Victim", "RUNNING", 30));
	REQUIRE(urgent("// @task Rush\n" BODY_WAIT(1)));
	ASSERT_TRUE(wait_message("Task 'Rush' completed", 1, 15));
	ASSERT_TRUE(wait_task_state("Victim", "RUNNING", 15));
	REQUIRE(control(AGENT_SCHEDULER_CONTROL_ABORT_ITEM_NAME));
	ASSERT_TRUE(wait_scheduler_state(INDIGO_ALERT_STATE, 15));
	char label[INDIGO_VALUE_SIZE];
	ASSERT_TRUE(history_label("Good #1", 0, label) && strstr(label, "succeeded"));
	ASSERT_TRUE(history_label("Bad #1", 0, label) && strstr(label, "failed: Error: broken"));
	ASSERT_TRUE(history_label("Victim #1", 1, label) && strstr(label, "preempted: by Rush"));
	ASSERT_TRUE(history_label("Rush (urgent) #1", 0, label) && strstr(label, "succeeded"));
	ASSERT_TRUE(history_label("Victim #1", 0, label) && strstr(label, "aborted"));
	ASSERT_EQ_INT(5, history_count());
	// newest first
	indigo_property *history = snapshot(AGENT_SCHEDULER_HISTORY_PROPERTY_NAME);
	REQUIRE(history != NULL);
	ASSERT_TRUE(strstr(history->items[0].label, "Victim") && strstr(history->items[0].label, "aborted"));
	ASSERT_EQ_INT(INDIGO_ALERT_STATE, history->items[history->count - 2].light.value);
	indigo_release_property(history);
	stop_scheduler();
	REQUIRE(start_scheduler());
	ASSERT_EQ_INT(5, history_count());
	ASSERT_TRUE(history_label("Rush (urgent) #1", 0, label) && strstr(label, "succeeded"));
	unsigned before = revision(AGENT_SCHEDULER_CLEAR_HISTORY_PROPERTY_NAME);
	indigo_change_switch_property_1(&observer, AGENT, AGENT_SCHEDULER_CLEAR_HISTORY_PROPERTY_NAME, AGENT_SCHEDULER_CLEAR_HISTORY_CLEAR_ITEM_NAME, true);
	ASSERT_TRUE(wait_property_state(AGENT_SCHEDULER_CLEAR_HISTORY_PROPERTY_NAME, before, INDIGO_OK_STATE, NULL));
	ASSERT_EQ_INT(0, history_count());
	// clients cannot write the history
	char message[INDIGO_VALUE_SIZE];
	ASSERT_TRUE(change_text(AGENT_SCHEDULER_RESTORE_HISTORY_PROPERTY_NAME, AGENT_SCHEDULER_RESTORE_HISTORY_ENTRIES_ITEM_NAME, "Fake\t1\t0\t0\tsucceeded\t \t\n", INDIGO_ALERT_STATE, message));
	ASSERT_EQ_INT(0, history_count());
}

static void duration_estimated_measured_and_set(void) {
	// 2 frames of 30 s with 10 s overhead each, one slew with 120 s, a 15 s wait: 215 s, 4 minutes
	REQUIRE(upload("// @task Estimated\nvar sequence = new Sequence(scheduler_task.name);\nif (scheduler_task.estimate) { sequence.slew(1, 2); sequence.capture_batch(2, 30); sequence.wait(15); } else { sequence.wait(1); }\nsequence.start();\n"));
	ASSERT_TRUE(wait_task_state("Estimated", "0h04 estimated", 15));
	REQUIRE(upload("// @task Unknown\n// @priority low\nvar sequence = new Sequence(scheduler_task.name);\nsequence.wait_until_solar_altitude_below(91);\nsequence.start();\n"));
	ASSERT_TRUE(wait_task_state("Unknown", "1h00 default", 15));
	ASSERT_TRUE(wait_message("The duration of task 'Unknown' cannot be estimated", 1, 5));
	REQUIRE(upload("// @task Set\n// @priority low 10\n// @duration 7\n" BODY_WAIT(1)));
	ASSERT_TRUE(wait_task_state("Set", "0h07 set", 15));
	REQUIRE(command("Unknown", AGENT_SCHEDULER_TASK_COMMAND_DISABLE_ITEM_NAME));
	REQUIRE(command("Set", AGENT_SCHEDULER_TASK_COMMAND_DISABLE_ITEM_NAME));
	REQUIRE(control(AGENT_SCHEDULER_CONTROL_START_ITEM_NAME));
	// the measured 1 s run counts as the 1 minute minimum
	ASSERT_TRUE(wait_task_state("Estimated", "0h01 measured", 15));
	stop_scheduler();
	REQUIRE(start_scheduler());
	ASSERT_TRUE(wait_task_state("Estimated", "0h01 measured", 5));
	// an edit discards the measurement and estimates again
	ASSERT_TRUE(change_text("AGENT_SCHEDULER_TASK_0", AGENT_SCHEDULER_TASK_TASK_ITEM_NAME, "// @task Estimated\nvar sequence = new Sequence(scheduler_task.name);\nsequence.capture_batch(10, 60);\nsequence.start();\n", INDIGO_OK_STATE, NULL));
	ASSERT_TRUE(wait_task_state("Estimated", "0h12 estimated", 15));
}

static void library_without_estimate_uses_the_default(void) {
	REQUIRE(control(AGENT_SCHEDULER_CONTROL_START_ITEM_NAME));
	ASSERT_TRUE(wait_sequence_state(INDIGO_OK_STATE, 15) || wait_sequence_state(INDIGO_IDLE_STATE, 1));
	REQUIRE(control(AGENT_SCHEDULER_CONTROL_STOP_ITEM_NAME));
	const char *items[] = { AGENT_SCRIPTING_RUN_SCRIPT_ITEM_NAME };
	const char *values[] = { "delete Sequence.prototype.estimate;" };
	indigo_change_text_property(&observer, SCRIPTING_AGENT_NAME, AGENT_SCRIPTING_RUN_SCRIPT_PROPERTY_NAME, 1, items, values);
	indigo_usleep(500000);
	REQUIRE(upload("// @task Old library\nvar sequence = new Sequence(scheduler_task.name);\nsequence.capture_batch(10, 60);\nsequence.start();\n"));
	ASSERT_TRUE(wait_task_state("Old library", "1h00 default", 15));
}

// -------------------------------------------------------------------------------- Runner

static void plan_lists_the_night(void) {
	site_at_evening();
	REQUIRE(upload("// @task Low\n// @priority low 90\n// @duration 10\n" BODY_WAIT(1)));
	REQUIRE(upload("// @task Normal\n// @priority normal 10\n// @duration 5\n" BODY_WAIT(1)));
	REQUIRE(upload("// @task High\n// @priority high 0\n// @duration 20\n" BODY_WAIT(1)));
	REQUIRE(upload("// @task Twice\n// @priority low 0\n// @repeat 2\n// @duration 1\n" BODY_WAIT(1)));
	REQUIRE(upload("// @task Off\n// @duration 1\n" BODY_WAIT(1)));
	REQUIRE(command("Off", AGENT_SCHEDULER_TASK_COMMAND_DISABLE_ITEM_NAME));
	REQUIRE(upload("// @task South\n// @target 06:00:00 -89:00:00\n// @duration 1\n" BODY_WAIT(1)));
	// the plan is a preview, it is shown before the scheduler starts
	ASSERT_TRUE(wait_plan(7, "High", 10));
	char labels[16][INDIGO_VALUE_SIZE];
	indigo_property_state states[16];
	REQUIRE(plan_items(labels, states, 16) == 7);
	const char *expected[] = { "  High (high 0)", "  Normal (normal 10)", "  Low (low 90)", "  Twice #1 (low 0)", "  Twice #2 (low 0)", "Off \xe2\x80\x94 disabled", "South \xe2\x80\x94 target below the horizon" };
	const int durations[] = { 20, 5, 10, 1, 1 };
	for (int i = 0; i < 7; i++) {
		ASSERT_TRUE(strstr(labels[i], expected[i]) != NULL);
		ASSERT_EQ_INT(i < 5 ? INDIGO_IDLE_STATE : INDIGO_ALERT_STATE, states[i]);
	}
	// the runs follow each other from now on
	struct tm now;
	time_t t = time(NULL);
	gmtime_r(&t, &now);
	int previous_end = -1;
	for (int i = 0; i < 5; i++) {
		int start, end;
		REQUIRE(plan_times(labels[i], &start, &end));
		ASSERT_EQ_INT(durations[i], minutes_between(start, end));
		if (i == 0) {
			ASSERT_TRUE(minutes_between(start, now.tm_hour * 60 + now.tm_min) <= 1);
		} else {
			ASSERT_EQ_INT(previous_end, start);
		}
		previous_end = end;
	}
	// an upload and an urgent submission change the plan at once
	REQUIRE(upload("// @task Top\n// @priority high 50\n// @duration 1\n" BODY_WAIT(1)));
	ASSERT_TRUE(wait_plan(8, "  Top (high 50)", 5));
	REQUIRE(urgent("// @task Rush\n// @priority low\n// @duration 1\n" BODY_WAIT(1)));
	ASSERT_TRUE(wait_plan(9, "  Rush (urgent)", 5));
	REQUIRE(command("Off", AGENT_SCHEDULER_TASK_COMMAND_ENABLE_ITEM_NAME));
	ASSERT_TRUE(wait_plan_item(9, 8, "South \xe2\x80\x94", 5));
	REQUIRE(plan_items(labels, states, 16) == 9);
	ASSERT_TRUE(strstr(labels[0], "  Rush (urgent)") != NULL);
	ASSERT_TRUE(strstr(labels[3], "  Off (normal 50)") != NULL);
	for (int i = 0; i < 8; i++) {
		ASSERT_EQ_INT(INDIGO_IDLE_STATE, states[i]);
	}
}

static void plan_follows_the_run(void) {
	site_at_evening();
	REQUIRE(upload("// @task First\n// @priority high\n// @duration 5\n" BODY_WAIT(5)));
	REQUIRE(upload("// @task Second\n// @duration 3\n" BODY_WAIT(30)));
	REQUIRE(control(AGENT_SCHEDULER_CONTROL_START_ITEM_NAME));
	ASSERT_TRUE(wait_task_state("First", "RUNNING", 15));
	ASSERT_TRUE(wait_plan_first("  First (high 50)", INDIGO_BUSY_STATE, 5));
	char labels[16][INDIGO_VALUE_SIZE];
	indigo_property_state states[16];
	REQUIRE(plan_items(labels, states, 16) == 2);
	ASSERT_EQ_INT(INDIGO_BUSY_STATE, states[0]);
	ASSERT_EQ_INT(INDIGO_IDLE_STATE, states[1]);
	int first_start, first_end, second_start, second_end;
	REQUIRE(plan_times(labels[0], &first_start, &first_end));
	REQUIRE(plan_times(labels[1], &second_start, &second_end));
	ASSERT_EQ_INT(5, minutes_between(first_start, first_end));
	ASSERT_EQ_INT(first_end, second_start);
	// the first task ends early, the done task leaves the plan and the next one runs
	ASSERT_TRUE(wait_task_state("Second", "RUNNING", 15));
	ASSERT_TRUE(wait_plan_first("  Second (normal 50)", INDIGO_BUSY_STATE, 5));
	REQUIRE(plan_items(labels, states, 16) == 1);
	ASSERT_EQ_INT(INDIGO_BUSY_STATE, states[0]);
	REQUIRE(control(AGENT_SCHEDULER_CONTROL_ABORT_ITEM_NAME));
	ASSERT_TRUE(wait_scheduler_state(INDIGO_ALERT_STATE, 15));
	// the aborted task is marked RETRY and stays in the plan, no longer running
	ASSERT_TRUE(wait_plan_first("  Second (normal 50)", INDIGO_IDLE_STATE, 5));
}

static void plan_gives_the_reasons(void) {
	site_at_evening();
	REQUIRE(upload("// @task Thrown\n// @duration 1\nthrow new Error(\"always\");\n"));
	// a run may start before the end of the night and last beyond it, a second one then finds no time
	REQUIRE(upload("// @task Endless\n// @priority high\n// @duration 1380\n" BODY_WAIT(1)));
	REQUIRE(upload("// @task Later\n// @duration 1380\n" BODY_WAIT(1)));
	ASSERT_TRUE(wait_plan_item(3, 1, "Thrown \xe2\x80\x94 script error", 15));
	char labels[16][INDIGO_VALUE_SIZE];
	indigo_property_state states[16];
	REQUIRE(plan_items(labels, states, 16) == 3);
	ASSERT_TRUE(strstr(labels[0], "  Endless (high 50)") != NULL);
	ASSERT_EQ_INT(INDIGO_IDLE_STATE, states[0]);
	ASSERT_TRUE(strstr(labels[2], "Later \xe2\x80\x94 no time left tonight") != NULL);
	ASSERT_EQ_INT(INDIGO_ALERT_STATE, states[1]);
	ASSERT_EQ_INT(INDIGO_ALERT_STATE, states[2]);
}

// waits until the plan is exactly the given items, read from one snapshot so that a run ending in between cannot mix two plans
static bool wait_plan_exactly(int count, const char **texts, const indigo_property_state *expected, double timeout) {
	char labels[16][INDIGO_VALUE_SIZE];
	indigo_property_state states[16];
	int found = -1;
	for (double t = 0; t < timeout; t += 0.01) {
		found = plan_items(labels, states, 16);
		bool match = found == count;
		for (int i = 0; match && i < count; i++) {
			match = strstr(labels[i], texts[i]) != NULL && states[i] == expected[i];
		}
		if (match) {
			return true;
		}
		indigo_usleep(10000);
	}
	fprintf(stderr, "Timeout waiting for a plan of %d items, found %d:\n", count, found);
	for (int i = 0; i < found && i < 16; i++) {
		fprintf(stderr, "  %s [%d]\n", labels[i], states[i]);
	}
	return false;
}

// waits until the task list is defined and no longer lists the task, a redefine deletes it for a moment
static bool wait_task_removed(const char *name, double timeout) {
	char label[INDIGO_VALUE_SIZE];
	for (double t = 0; t < timeout; t += 0.01) {
		indigo_property *property = snapshot(AGENT_SCHEDULER_TASK_STATE_PROPERTY_NAME);
		bool defined = property != NULL;
		indigo_release_property(property);
		if (defined && !task_label(name, label, NULL)) {
			return true;
		}
		indigo_usleep(10000);
	}
	fprintf(stderr, "Timeout waiting for task '%s' to be removed\n", name);
	return false;
}

// an urgent task inserted while a task runs and another one waits: it preempts the running task and runs first,
// then the scheduler selects by the normal rules, so a retried task gets no advantage over a waiting task of higher priority
static void urgent_insertion(bool fail) {
	site_at_evening();
	REQUIRE(upload(fail ? "// @task Long\n// @preempted fail\n// @retry 1\n// @duration 5\n" BODY_WAIT(30) : "// @task Long\n// @retry 1\n// @duration 5\n" BODY_WAIT(30)));
	REQUIRE(control(AGENT_SCHEDULER_CONTROL_START_ITEM_NAME));
	ASSERT_TRUE(wait_task_state("Long", "RUNNING", 15));
	ASSERT_TRUE(wait_sequence_state(INDIGO_BUSY_STATE, 15));
	// a task uploaded during the run waits for it even with a higher priority
	REQUIRE(upload("// @task Queued\n// @priority normal 60\n// @duration 1\n" BODY_WAIT(2)));
	const char *before[] = { "  Long (normal 50)", "  Queued (normal 60)" };
	const indigo_property_state before_states[] = { INDIGO_BUSY_STATE, INDIGO_IDLE_STATE };
	ASSERT_TRUE(wait_plan_exactly(2, before, before_states, 5));
	REQUIRE(urgent("// @task Flash\n// @priority low\n// @duration 1\n" BODY_WAIT(10)));
	ASSERT_TRUE(wait_message(fail ? "Task 'Long' preempted by an urgent task and failed" : "Task 'Long' preempted by an urgent task, it will be retried", 1, 10));
	ASSERT_TRUE(wait_task_state("Flash", "RUNNING", 10));
	ASSERT_TRUE(message_position("Starting task 'Flash'") > message_position("Task 'Long' preempted"));
	// the urgent task runs first; a retried task is planned again after the waiting one of higher priority, a failed one leaves the plan
	const char *during[] = { "  Flash (urgent)", "  Queued (normal 60)", "  Long (normal 50)" };
	const indigo_property_state during_states[] = { INDIGO_BUSY_STATE, INDIGO_IDLE_STATE, INDIGO_IDLE_STATE };
	ASSERT_TRUE(wait_plan_exactly(fail ? 2 : 3, during, during_states, 5));
	// without a retry delay the retried task is queued again at once
	ASSERT_TRUE(wait_task_state("Long", fail ? "FAILED" : "QUEUED", 5));
	// the preemption does not use a retry in either case
	ASSERT_TRUE(wait_task_state("Long", "retries left 1", 5));
	ASSERT_TRUE(wait_message("Task 'Flash' completed", 1, 20));
	char label[INDIGO_VALUE_SIZE];
	ASSERT_TRUE(history_label("Long #1", 0, label) && strstr(label, "preempted: by Flash"));
	ASSERT_TRUE(history_label("Flash (urgent) #1", 0, label) && strstr(label, "succeeded"));
	ASSERT_TRUE(wait_message("Task 'Queued' completed", 1, 20));
	ASSERT_TRUE(message_position("Starting task 'Queued'") > message_position("Task 'Flash' completed"));
	if (fail) {
		// the failed task is never started again, the scheduler stops when nothing is left
		ASSERT_TRUE(wait_message("All tasks finished", 1, 10));
		ASSERT_EQ_INT(1, count_messages("Starting task 'Long'"));
		ASSERT_TRUE(wait_task_state("Long", "FAILED", 5));
	} else {
		// the retried task starts again after the waiting one, its retry still unused
		ASSERT_TRUE(wait_message("Starting task 'Long'", 2, 15));
		ASSERT_TRUE(message_position_last("Starting task 'Long'") > message_position("Task 'Queued' completed"));
		ASSERT_TRUE(wait_task_state("Long", "retries left 1", 5));
		ASSERT_TRUE(wait_plan_first("  Long (normal 50)", INDIGO_BUSY_STATE, 5));
	}
	ASSERT_TRUE(wait_task_removed("Flash", 5));
	if (!fail) {
		REQUIRE(control(AGENT_SCHEDULER_CONTROL_ABORT_ITEM_NAME));
		ASSERT_TRUE(wait_scheduler_state(INDIGO_ALERT_STATE, 15));
	}
}

static void urgent_insertion_retries_the_preempted_task(void) {
	urgent_insertion(false);
}

static void urgent_insertion_fails_the_preempted_task(void) {
	urgent_insertion(true);
}

// requests still queued when the agent shuts down are released; the sanitizer build reports them as leaks otherwise
static void commands_queued_at_shutdown_are_released(void) {
	REQUIRE(upload("// @task Kept\n" BODY_WAIT(1)));
	const char *items[] = { AGENT_SCHEDULER_TASK_NAME_NAME_ITEM_NAME };
	const char *values[] = { "Kept" };
	// every handler also runs a scheduling pass, so many requests are still queued when the shutdown starts
	for (int i = 0; i < 2000; i++) {
		indigo_change_text_property(&observer, AGENT, AGENT_SCHEDULER_TASK_NAME_PROPERTY_NAME, 1, items, values);
	}
	stop_scheduler();
	// a request sent after the agent is gone does not reach it
	indigo_change_text_property(&observer, AGENT, AGENT_SCHEDULER_TASK_NAME_PROPERTY_NAME, 1, items, values);
#if defined(__SANITIZE_ADDRESS__)
	// the case runs in a child that ends with _exit(), so the leak check is made here
	ASSERT_EQ_INT(0, __lsan_do_recoverable_leak_check());
#endif
	REQUIRE(start_scheduler());
	char label[INDIGO_VALUE_SIZE];
	ASSERT_TRUE(task_label("Kept", label, NULL));
}

static const indigo_test_case cases[] = {
	{ "store_edit_and_delete", store_edit_and_delete },
	{ "commands_and_order", commands_and_order },
	{ "run_order_by_priority", run_order_by_priority },
	{ "window_wait_and_expiry", window_wait_and_expiry },
	{ "target_below_horizon_waits", target_below_horizon_waits },
	{ "repeat_retry_and_failures", repeat_retry_and_failures },
	{ "quoted_name_reaches_the_body", quoted_name_reaches_the_body },
	{ "urgent_preempts_and_task_is_retried", urgent_preempts_and_task_is_retried },
	{ "preempted_task_fails_when_asked", preempted_task_fails_when_asked },
	{ "urgent_waits_for_eligibility", urgent_waits_for_eligibility },
	{ "second_urgent_waits_for_the_first", second_urgent_waits_for_the_first },
	{ "urgent_submitted_while_stopped", urgent_submitted_while_stopped },
	{ "stop_lets_the_task_finish", stop_lets_the_task_finish },
	{ "abort_and_delete_running_task", abort_and_delete_running_task },
	{ "edit_of_running_task_is_deferred", edit_of_running_task_is_deferred },
	{ "stop_timeout_stops_the_scheduler", stop_timeout_stops_the_scheduler },
	{ "persistence_across_restart", persistence_across_restart },
	{ "running_task_restored_without_using_a_retry", running_task_restored_without_using_a_retry },
	{ "failure_after_start_aborts_the_sequence", failure_after_start_aborts_the_sequence },
	{ "hand_started_sequence_blocks_all_but_urgent", hand_started_sequence_blocks_all_but_urgent },
	{ "stop_request_blocks_preemption", stop_request_blocks_preemption },
	{ "pending_rename_reserves_the_name", pending_rename_reserves_the_name },
	{ "library_reload_keeps_scheduled_task", library_reload_keeps_scheduled_task },
	{ "hooks_run_at_start_idle_and_stop", hooks_run_at_start_idle_and_stop },
	{ "failed_startup_hook_stops_the_scheduler", failed_startup_hook_stops_the_scheduler },
	{ "abort_runs_the_shutdown_hook", abort_runs_the_shutdown_hook },
	{ "start_during_shutdown_hook_continues", start_during_shutdown_hook_continues },
	{ "history_records_runs", history_records_runs },
	{ "duration_estimated_measured_and_set", duration_estimated_measured_and_set },
	{ "library_without_estimate_uses_the_default", library_without_estimate_uses_the_default },
	{ "plan_lists_the_night", plan_lists_the_night },
	{ "plan_follows_the_run", plan_follows_the_run },
	{ "plan_gives_the_reasons", plan_gives_the_reasons },
	{ "urgent_insertion_retries_the_preempted_task", urgent_insertion_retries_the_preempted_task },
	{ "urgent_insertion_fails_the_preempted_task", urgent_insertion_fails_the_preempted_task },
	{ "commands_queued_at_shutdown_are_released", commands_queued_at_shutdown_are_released },
	{ "night_hooks_run_at_dusk_and_dawn", night_hooks_run_at_dusk_and_dawn },
	{ "night_without_work_skips_the_hooks", night_without_work_skips_the_hooks },
	{ "night_without_work_and_without_hooks_ends_quietly", night_without_work_and_without_hooks_ends_quietly },
	{ "hooks_named_during_a_night_without_work", hooks_named_during_a_night_without_work },
	{ "resume_hook_after_idle", resume_hook_after_idle },
	{ "idle_without_resume_behaves_as_before", idle_without_resume_behaves_as_before },
	{ "failed_night_start_runs_the_shutdown_hook", failed_night_start_runs_the_shutdown_hook },
	{ "failed_resume_runs_the_shutdown_hook", failed_resume_runs_the_shutdown_hook },
	{ "shared_hook_task_runs_once", shared_hook_task_runs_once },
	{ "missing_night_hook_task_is_reported", missing_night_hook_task_is_reported },
	{ "no_night_is_reported", no_night_is_reported },
	{ "urgent_tasks_are_counted", urgent_tasks_are_counted },
	{ "reset_all_keeps_running_task_and_urgent_order", reset_all_keeps_running_task_and_urgent_order },
	{ "delete_all_keeps_hooks_and_needs_a_stopped_scheduler", delete_all_keeps_hooks_and_needs_a_stopped_scheduler },
	{ "reset_all_runs_finished_work_again", reset_all_runs_finished_work_again },
	{ "delete_all_waits_for_the_shutdown_hook", delete_all_waits_for_the_shutdown_hook },
	{ "altitude_limit_decides_and_follows_the_sky", altitude_limit_decides_and_follows_the_sky },
	{ "airmass_limit_decides_and_follows_the_sky", airmass_limit_decides_and_follows_the_sky },
	{ "hour_angle_ranges_including_wrapped", hour_angle_ranges_including_wrapped },
	{ "twilight_limit_follows_the_sun", twilight_limit_follows_the_sun },
	{ "moon_separation_and_brightness", moon_separation_and_brightness },
	{ "nightly_windows", nightly_windows },
	{ "duration_must_fit_before_the_target_sets", duration_must_fit_before_the_target_sets },
	{ "unknown_site_blocks_only_sky_constraints", unknown_site_blocks_only_sky_constraints },
	{ "disabled_in_the_header_stays_disabled", disabled_in_the_header_stays_disabled },
	{ "sky_bonuses_order_equal_priorities", sky_bonuses_order_equal_priorities },
	{ "largest_task_text_is_stored_and_restored", largest_task_text_is_stored_and_restored },
	{ "task_count_limit", task_count_limit },
	{ "repeat_interval_and_retry_delay", repeat_interval_and_retry_delay },
	{ "start_waits_for_pending_estimates", start_waits_for_pending_estimates },
	{ "night_end_and_shutdown_share_a_task", night_end_and_shutdown_share_a_task },
	{ "stop_at_night_runs_only_the_shutdown_hook", stop_at_night_runs_only_the_shutdown_hook },
	{ "failed_night_end_is_reported", failed_night_end_is_reported },
	{ "resume_before_an_urgent_task", resume_before_an_urgent_task },
	{ "plan_lasts_until_a_late_night_end", plan_lasts_until_a_late_night_end },
};

static const char *case_filter = NULL;

static const char *case_name(int index) {
	return cases[index].name;
}

static bool case_selected(int index) {
	return case_filter == NULL || strstr(cases[index].name, case_filter) != NULL;
}

static unsigned case_timeout(int index) {
	return 150;
}

static int case_child(int index, const char *fixture) {
	char home[512];
	snprintf(home, sizeof(home), "%s/home", fixture);
	mkdir(home, 0700);
	if (!indigo_test_set_private_home(home)) {
		return 2;
	}
	int result = setup() ? indigo_run_tests("test_agent_scheduler", cases + index, 1) : 1;
	cleanup();
	fflush(NULL);
	return result || indigo_test_failures ? 1 : 0;
}

static int remove_entry(const char *path, const struct stat *info, int flag, struct FTW *ftw) {
	return remove(path);
}

int main(int argc, char **argv) {
	setvbuf(stdout, NULL, _IOLBF, 0);
	case_filter = argc > 1 ? argv[1] : getenv("SCHEDULER_TEST_FILTER");
	snprintf(fixture_dir, sizeof(fixture_dir), "/tmp/indigo-scheduler.XXXXXX");
	if (!mkdtemp(fixture_dir)) {
		perror("mkdtemp");
		return 1;
	}
	const parallel_case_runner runner = {
		"Scheduler Agent", fixture_dir, (int)ARRAY_SIZE(cases), 0, case_name, case_selected, case_timeout, case_child, NULL
	};
	int run = 0, passed = 0, failed = 0;
	run_parallel_cases(&runner, &run, &passed, &failed);
	if (!getenv("SCHEDULER_KEEP_FIXTURE")) {
		nftw(fixture_dir, remove_entry, 16, FTW_DEPTH | FTW_PHYS);
	}
	printf("Scheduler Agent: %d run, %d passed, %d failed\n", run, passed, failed);
	return failed || run == 0 ? 1 : 0;
}
