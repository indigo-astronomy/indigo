// Copyright (c) 2026 INDIGO initiative
// All rights reserved.
//
// You may use this software under the terms of 'INDIGO Astronomy
// open-source license' (see LICENSE.md).
//
// THIS SOFTWARE IS PROVIDED BY THE AUTHORS 'AS IS' AND ANY EXPRESS
// OR IMPLIED WARRANTIES, INCLUDING, BUT NOT LIMITED TO, THE IMPLIED
// WARRANTIES OF MERCHANTABILITY AND FITNESS FOR A PARTICULAR PURPOSE
// ARE DISCLAIMED. IN NO EVENT SHALL THE AUTHOR BE LIABLE FOR ANY
// DIRECT, INDIRECT, INCIDENTAL, SPECIAL, EXEMPLARY, OR CONSEQUENTIAL
// DAMAGES (INCLUDING, BUT NOT LIMITED TO, PROCUREMENT OF SUBSTITUTE
// GOODS OR SERVICES; LOSS OF USE, DATA, OR PROFITS; OR BUSINESS
// INTERRUPTION) HOWEVER CAUSED AND ON ANY THEORY OF LIABILITY,
// WHETHER IN CONTRACT, STRICT LIABILITY, OR TORT (INCLUDING
// NEGLIGENCE OR OTHERWISE) ARISING IN ANY WAY OUT OF THE USE OF THIS
// SOFTWARE, EVEN IF ADVISED OF THE POSSIBILITY OF SUCH DAMAGE.

// Code is generated by AI

#include <dirent.h>
#include <errno.h>
#include <fcntl.h>
#include <pthread.h>
#include <stdarg.h>
#include <stdatomic.h>
#include <stdbool.h>
#include <stdint.h>
#include <stdio.h>
#include <string.h>
#include <sys/types.h>

#include <indigo/indigo_usb_utils.h>
#include <indigo_drivers/aux_joystick/indigo_aux_joystick.h>
#include <linux/joystick.h>

#include "simulator_test_common.h"

#define FAKE_DEVICE_COUNT 5
#define FAKE_EVENT_COUNT 512
#define JOYSTICK_DEVICE_NAME "Fake Joystick #00000000"

typedef struct {
	bool present;
	bool descriptor_error;
	bool fd_open;
	int axes;
	int buttons;
	char name[80];
	struct js_event events[FAKE_EVENT_COUNT];
	int event_head;
	int event_count;
	int open_count;
	int close_count;
	int read_count;
} fake_joystick;

static fake_joystick fake_devices[FAKE_DEVICE_COUNT];
static pthread_mutex_t fake_mutex = PTHREAD_MUTEX_INITIALIZER;
static pthread_cond_t fake_condition = PTHREAD_COND_INITIALIZER;
static libusb_hotplug_callback_fn usb_callback;
static atomic_int attached_count;
static atomic_int scan_count;
static bool include_invalid_entries;
static bool fail_next_open;
static bool fail_next_fcntl;
static bool hold_next_open;
static bool open_entered;
static int directory_cursor;
static bool bus_started;
static bool client_attached;
static bool driver_initialized;

static const simulator_driver_case driver = { "HID Joystick", "indigo_joystick", JOYSTICK_DEVICE_NAME, indigo_aux_joystick, true, NULL, 0, NULL, 0, NULL, 0, NULL, 0 };

static void reset_fake() {
	pthread_mutex_lock(&fake_mutex);
	memset(fake_devices, 0, sizeof(fake_devices));
	fake_devices[0].present = true;
	fake_devices[0].axes = 4;
	fake_devices[0].buttons = 8;
	snprintf(fake_devices[0].name, sizeof(fake_devices[0].name), "Fake Joystick");
	include_invalid_entries = false;
	fail_next_open = false;
	fail_next_fcntl = false;
	hold_next_open = false;
	open_entered = false;
	directory_cursor = 0;
	usb_callback = NULL;
	atomic_store(&attached_count, 0);
	atomic_store(&scan_count, 0);
	pthread_mutex_unlock(&fake_mutex);
}

static int path_index(const char *path) {
	int index = -1;
	char extra = 0;
	if (sscanf(path, "/dev/input/js%d%c", &index, &extra) != 1 || index < 0 || index >= FAKE_DEVICE_COUNT) {
		return -1;
	}
	return index;
}

int joystick_test_open(const char *path, int flags, ...) {
	int index = path_index(path);
	pthread_mutex_lock(&fake_mutex);
	if (index < 0 || !fake_devices[index].present || fail_next_open) {
		fail_next_open = false;
		pthread_mutex_unlock(&fake_mutex);
		errno = ENOENT;
		return -1;
	}
	if (hold_next_open) {
		open_entered = true;
		pthread_cond_broadcast(&fake_condition);
		while (hold_next_open) {
			pthread_cond_wait(&fake_condition, &fake_mutex);
		}
	}
	fake_devices[index].fd_open = true;
	fake_devices[index].open_count++;
	pthread_mutex_unlock(&fake_mutex);
	return 100 + index;
}

int joystick_test_close(int fd) {
	int index = fd - 100;
	pthread_mutex_lock(&fake_mutex);
	if (index >= 0 && index < FAKE_DEVICE_COUNT) {
		fake_devices[index].fd_open = false;
		fake_devices[index].close_count++;
	}
	pthread_cond_broadcast(&fake_condition);
	pthread_mutex_unlock(&fake_mutex);
	return 0;
}

int joystick_test_fcntl(int fd, int command, ...) {
	pthread_mutex_lock(&fake_mutex);
	bool fail = fail_next_fcntl;
	fail_next_fcntl = false;
	pthread_mutex_unlock(&fake_mutex);
	if (fail) {
		errno = EIO;
		return -1;
	}
	return 0;
}

int joystick_test_ioctl(int fd, unsigned long request, ...) {
	int index = fd - 100;
	va_list args;
	va_start(args, request);
	void *value = va_arg(args, void *);
	va_end(args);
	pthread_mutex_lock(&fake_mutex);
	if (index < 0 || index >= FAKE_DEVICE_COUNT || fake_devices[index].descriptor_error) {
		pthread_mutex_unlock(&fake_mutex);
		errno = EIO;
		return -1;
	}
	if (request == JSIOCGAXES) {
		*(int *)value = fake_devices[index].axes;
	} else if (request == JSIOCGBUTTONS) {
		*(int *)value = fake_devices[index].buttons;
	} else if (request == JSIOCGNAME(80)) {
		snprintf(value, 80, "%s", fake_devices[index].name);
	} else {
		pthread_mutex_unlock(&fake_mutex);
		errno = EINVAL;
		return -1;
	}
	pthread_mutex_unlock(&fake_mutex);
	return 0;
}

ssize_t joystick_test_read(int fd, void *buffer, size_t size) {
	int index = fd - 100;
	pthread_mutex_lock(&fake_mutex);
	if (index < 0 || index >= FAKE_DEVICE_COUNT || !fake_devices[index].fd_open) {
		pthread_mutex_unlock(&fake_mutex);
		errno = EBADF;
		return -1;
	}
	fake_devices[index].read_count++;
	if (fake_devices[index].event_count == 0) {
		pthread_mutex_unlock(&fake_mutex);
		errno = EAGAIN;
		return -1;
	}
	struct js_event event = fake_devices[index].events[fake_devices[index].event_head];
	fake_devices[index].event_head = (fake_devices[index].event_head + 1) % FAKE_EVENT_COUNT;
	fake_devices[index].event_count--;
	pthread_mutex_unlock(&fake_mutex);
	if (size < sizeof(event)) {
		errno = EINVAL;
		return -1;
	}
	memcpy(buffer, &event, sizeof(event));
	return sizeof(event);
}

DIR *joystick_test_opendir(const char *path) {
	if (strcmp(path, "/dev/input")) {
		errno = ENOENT;
		return NULL;
	}
	pthread_mutex_lock(&fake_mutex);
	directory_cursor = 0;
	atomic_fetch_add(&scan_count, 1);
	pthread_mutex_unlock(&fake_mutex);
	return (DIR *)(uintptr_t)1;
}

struct dirent *joystick_test_readdir(DIR *directory) {
	static struct dirent entry;
	pthread_mutex_lock(&fake_mutex);
	while (directory_cursor < FAKE_DEVICE_COUNT + 2) {
		int cursor = directory_cursor++;
		if (cursor == 0 && include_invalid_entries) {
			snprintf(entry.d_name, sizeof(entry.d_name), "js99");
			pthread_mutex_unlock(&fake_mutex);
			return &entry;
		}
		if (cursor == 1 && include_invalid_entries) {
			snprintf(entry.d_name, sizeof(entry.d_name), "js0junk");
			pthread_mutex_unlock(&fake_mutex);
			return &entry;
		}
		int index = cursor - 2;
		if (index >= 0 && fake_devices[index].present) {
			snprintf(entry.d_name, sizeof(entry.d_name), "js%d", index);
			pthread_mutex_unlock(&fake_mutex);
			return &entry;
		}
	}
	pthread_mutex_unlock(&fake_mutex);
	return NULL;
}

#ifdef __APPLE__
DIR *joystick_test_opendir_inode64(const char *path) __asm("_joystick_test_opendir$INODE64");
DIR *joystick_test_opendir_inode64(const char *path) {
	return joystick_test_opendir(path);
}

struct dirent *joystick_test_readdir_inode64(DIR *directory) __asm("_joystick_test_readdir$INODE64");
struct dirent *joystick_test_readdir_inode64(DIR *directory) {
	return joystick_test_readdir(directory);
}
#endif

int joystick_test_closedir(DIR *directory) {
	return 0;
}

void joystick_test_usb_start(void) {
}

int LIBUSB_CALL joystick_test_usb_register(libusb_context *context, int events, int flags, int vid, int pid, int device_class, libusb_hotplug_callback_fn callback, void *data, libusb_hotplug_callback_handle *handle) {
	usb_callback = callback;
	*handle = 1;
	return LIBUSB_SUCCESS;
}

int joystick_test_usb_register_sim(libusb_context *context, libusb_hotplug_event events, libusb_hotplug_flag flags, int vid, int pid, int device_class, libusb_hotplug_callback_fn callback, void *data, libusb_hotplug_callback_handle *handle) {
	return joystick_test_usb_register(context, events, flags, vid, pid, device_class, callback, data, handle);
}

void LIBUSB_CALL joystick_test_usb_deregister(libusb_context *context, libusb_hotplug_callback_handle handle) {
	usb_callback = NULL;
}

int joystick_test_usb_deregister_poll(libusb_context *context, libusb_hotplug_callback_handle handle) {
	joystick_test_usb_deregister(context, handle);
	return LIBUSB_SUCCESS;
}

indigo_result joystick_test_attach(indigo_device *device) {
	indigo_result result = indigo_attach_device(device);
	if (result == INDIGO_OK) {
		atomic_fetch_add(&attached_count, 1);
	}
	return result;
}

indigo_result joystick_test_detach(indigo_device *device) {
	indigo_result result = indigo_detach_device(device);
	if (result == INDIGO_OK) {
		atomic_fetch_sub(&attached_count, 1);
	}
	return result;
}

static bool wait_for_bool(bool *value) {
	for (int i = 0; i < 200; i++) {
		pthread_mutex_lock(&fake_mutex);
		bool result = *value;
		pthread_mutex_unlock(&fake_mutex);
		if (result) {
			return true;
		}
		indigo_usleep(5000);
	}
	return false;
}

static bool wait_for_attached_count(int expected) {
	for (int i = 0; i < 200; i++) {
		if (atomic_load(&attached_count) == expected) {
			return true;
		}
		indigo_usleep(5000);
	}
	return false;
}

static void fake_set_present(int index, bool present) {
	pthread_mutex_lock(&fake_mutex);
	fake_devices[index].present = present;
	pthread_mutex_unlock(&fake_mutex);
}

static void fake_push_event(int index, uint8_t type, uint8_t number, int16_t value) {
	pthread_mutex_lock(&fake_mutex);
	ASSERT_TRUE(fake_devices[index].event_count < FAKE_EVENT_COUNT);
	int tail = (fake_devices[index].event_head + fake_devices[index].event_count) % FAKE_EVENT_COUNT;
	fake_devices[index].events[tail] = (struct js_event){ 0, value, type, number };
	fake_devices[index].event_count++;
	pthread_mutex_unlock(&fake_mutex);
}

static void trigger_hotplug(libusb_hotplug_event event) {
	ASSERT_TRUE(usb_callback != NULL);
	if (usb_callback != NULL) {
		usb_callback(NULL, (libusb_device *)(uintptr_t)1, event, NULL);
	}
}

static bool start_driver(bool present) {
	reset_fake();
	fake_set_present(0, present);
	reset_simulator_context(&driver);
	if (indigo_start() != INDIGO_OK) {
		return false;
	}
	bus_started = true;
	if (indigo_attach_client(&simulator_test_client) != INDIGO_OK) {
		return false;
	}
	client_attached = true;
	if (driver.entry(INDIGO_DRIVER_INIT, NULL) != INDIGO_OK) {
		return false;
	}
	driver_initialized = true;
	if (present) {
		enumerate_simulator_device();
	}
	return true;
}

static bool connect_driver() {
	unsigned int revision = property_revision(CONNECTION_PROPERTY_NAME);
	if (indigo_change_switch_property_1(&simulator_test_client, driver.device_name, CONNECTION_PROPERTY_NAME, CONNECTION_CONNECTED_ITEM_NAME, true) != INDIGO_OK) {
		return false;
	}
	return wait_for_property_state_seen_after(CONNECTION_PROPERTY_NAME, INDIGO_BUSY_STATE, revision) && wait_for_simulator_connection_state(true);
}

static void stop_driver() {
	if (find_cached_property(CONNECTION_PROPERTY_NAME) != NULL && context.connected) {
		ASSERT_EQ_INT(INDIGO_OK, indigo_change_switch_property_1(&simulator_test_client, driver.device_name, CONNECTION_PROPERTY_NAME, CONNECTION_DISCONNECTED_ITEM_NAME, true));
		ASSERT_TRUE(wait_for_simulator_connection_state(false));
	}
	ASSERT_EQ_INT(INDIGO_OK, driver.entry(INDIGO_DRIVER_SHUTDOWN, NULL));
	driver_initialized = false;
	ASSERT_EQ_INT(INDIGO_OK, indigo_detach_client(&simulator_test_client));
	client_attached = false;
	ASSERT_EQ_INT(INDIGO_OK, indigo_stop());
	bus_started = false;
	release_cached_properties();
}

static void force_cleanup() {
	if (driver_initialized) {
		if (find_cached_property(CONNECTION_PROPERTY_NAME) != NULL && context.connected) {
			indigo_change_switch_property_1(&simulator_test_client, driver.device_name, CONNECTION_PROPERTY_NAME, CONNECTION_DISCONNECTED_ITEM_NAME, true);
			wait_for_simulator_connection_state(false);
		}
		if (driver.entry(INDIGO_DRIVER_SHUTDOWN, NULL) != INDIGO_OK && usb_callback != NULL) {
			fake_set_present(0, false);
			trigger_hotplug(LIBUSB_HOTPLUG_EVENT_DEVICE_LEFT);
			wait_for_attached_count(0);
			driver.entry(INDIGO_DRIVER_SHUTDOWN, NULL);
		}
		driver_initialized = false;
	}
	if (client_attached) {
		indigo_detach_client(&simulator_test_client);
		client_attached = false;
	}
	if (bus_started) {
		indigo_stop();
		bus_started = false;
	}
	release_cached_properties();
}

static void joystick_exposes_complete_properties(void) {
	ASSERT_TRUE(start_driver(true));
	ASSERT_EQ_INT(1, atomic_load(&attached_count));
	assert_device_interface(INDIGO_INTERFACE_AUX_JOYSTICK);
	assert_defined_property(INFO_PROPERTY_NAME);
	assert_defined_property(CONNECTION_PROPERTY_NAME);
	assert_not_defined_property(JOYSTICK_AXES_PROPERTY_NAME);
	ASSERT_TRUE(connect_driver());
	const char *properties[] = { JOYSTICK_AXES_PROPERTY_NAME, JOYSTICK_BUTTONS_PROPERTY_NAME, JOYSTICK_MAPPING_PROPERTY_NAME, JOYSTICK_OPTIONS_PROPERTY_NAME, MOUNT_PARK_PROPERTY_NAME, MOUNT_HOME_PROPERTY_NAME, MOUNT_SLEW_RATE_PROPERTY_NAME, MOUNT_MOTION_DEC_PROPERTY_NAME, MOUNT_MOTION_RA_PROPERTY_NAME, MOUNT_TRACKING_PROPERTY_NAME, MOUNT_ABORT_MOTION_PROPERTY_NAME };
	assert_defined_properties(properties, ARRAY_SIZE(properties));
	ASSERT_EQ_INT(4, find_cached_property(JOYSTICK_AXES_PROPERTY_NAME)->count);
	ASSERT_EQ_INT(8, find_cached_property(JOYSTICK_BUTTONS_PROPERTY_NAME)->count);
	ASSERT_EQ_INT(12, find_cached_property(JOYSTICK_MAPPING_PROPERTY_NAME)->count);
	stop_driver();
}

static void reported_counts_are_bounded(void) {
	reset_fake();
	fake_devices[0].axes = 255;
	fake_devices[0].buttons = 255;
	reset_simulator_context(&driver);
	ASSERT_EQ_INT(INDIGO_OK, indigo_start());
	bus_started = true;
	ASSERT_EQ_INT(INDIGO_OK, indigo_attach_client(&simulator_test_client));
	client_attached = true;
	ASSERT_EQ_INT(INDIGO_OK, driver.entry(INDIGO_DRIVER_INIT, NULL));
	driver_initialized = true;
	enumerate_simulator_device();
	ASSERT_TRUE(connect_driver());
	ASSERT_EQ_INT(16, find_cached_property(JOYSTICK_AXES_PROPERTY_NAME)->count);
	ASSERT_EQ_INT(64, find_cached_property(JOYSTICK_BUTTONS_PROPERTY_NAME)->count);
	stop_driver();
}

static void connection_is_queued_and_reports_busy(void) {
	ASSERT_TRUE(start_driver(true));
	pthread_mutex_lock(&fake_mutex);
	hold_next_open = true;
	pthread_mutex_unlock(&fake_mutex);
	unsigned int revision = property_revision(CONNECTION_PROPERTY_NAME);
	double started = indigo_monotonic_time();
	ASSERT_EQ_INT(INDIGO_OK, indigo_change_switch_property_1(&simulator_test_client, driver.device_name, CONNECTION_PROPERTY_NAME, CONNECTION_CONNECTED_ITEM_NAME, true));
	ASSERT_TRUE(indigo_monotonic_time() - started < 0.1);
	ASSERT_TRUE(wait_for_property_state_seen_after(CONNECTION_PROPERTY_NAME, INDIGO_BUSY_STATE, revision));
	ASSERT_TRUE(wait_for_bool(&open_entered));
	ASSERT_EQ_INT(INDIGO_BUSY_STATE, find_cached_property(CONNECTION_PROPERTY_NAME)->state);
	pthread_mutex_lock(&fake_mutex);
	hold_next_open = false;
	pthread_cond_broadcast(&fake_condition);
	pthread_mutex_unlock(&fake_mutex);
	ASSERT_TRUE(wait_for_simulator_connection_state(true));
	stop_driver();
}

static void connection_busy_guard_preserves_the_active_request(void) {
	ASSERT_TRUE(start_driver(true));
	pthread_mutex_lock(&fake_mutex);
	hold_next_open = true;
	pthread_mutex_unlock(&fake_mutex);
	ASSERT_EQ_INT(INDIGO_OK, indigo_change_switch_property_1(&simulator_test_client, driver.device_name, CONNECTION_PROPERTY_NAME, CONNECTION_CONNECTED_ITEM_NAME, true));
	ASSERT_TRUE(wait_for_bool(&open_entered));
	ASSERT_EQ_INT(INDIGO_OK, indigo_change_switch_property_1(&simulator_test_client, driver.device_name, CONNECTION_PROPERTY_NAME, CONNECTION_DISCONNECTED_ITEM_NAME, true));
	pthread_mutex_lock(&fake_mutex);
	hold_next_open = false;
	pthread_cond_broadcast(&fake_condition);
	pthread_mutex_unlock(&fake_mutex);
	ASSERT_TRUE(wait_for_simulator_connection_state(true));
	ASSERT_EQ_INT(INDIGO_OK, indigo_change_switch_property_1(&simulator_test_client, driver.device_name, CONNECTION_PROPERTY_NAME, CONNECTION_DISCONNECTED_ITEM_NAME, true));
	ASSERT_TRUE(wait_for_simulator_connection_state(false));
	pthread_mutex_lock(&fake_mutex);
	ASSERT_FALSE(fake_devices[0].fd_open);
	pthread_mutex_unlock(&fake_mutex);
	ASSERT_TRUE(connect_driver());
	stop_driver();
}

static void open_and_configuration_failures_recover(void) {
	ASSERT_TRUE(start_driver(true));
	pthread_mutex_lock(&fake_mutex);
	fail_next_open = true;
	pthread_mutex_unlock(&fake_mutex);
	unsigned int revision = property_revision(CONNECTION_PROPERTY_NAME);
	ASSERT_EQ_INT(INDIGO_OK, indigo_change_switch_property_1(&simulator_test_client, driver.device_name, CONNECTION_PROPERTY_NAME, CONNECTION_CONNECTED_ITEM_NAME, true));
	ASSERT_TRUE(wait_for_property_state_after(CONNECTION_PROPERTY_NAME, INDIGO_ALERT_STATE, revision));
	ASSERT_TRUE(context.disconnected);
	ASSERT_TRUE(connect_driver());
	ASSERT_EQ_INT(INDIGO_OK, indigo_change_switch_property_1(&simulator_test_client, driver.device_name, CONNECTION_PROPERTY_NAME, CONNECTION_DISCONNECTED_ITEM_NAME, true));
	ASSERT_TRUE(wait_for_simulator_connection_state(false));
	pthread_mutex_lock(&fake_mutex);
	fail_next_fcntl = true;
	pthread_mutex_unlock(&fake_mutex);
	revision = property_revision(CONNECTION_PROPERTY_NAME);
	ASSERT_EQ_INT(INDIGO_OK, indigo_change_switch_property_1(&simulator_test_client, driver.device_name, CONNECTION_PROPERTY_NAME, CONNECTION_CONNECTED_ITEM_NAME, true));
	ASSERT_TRUE(wait_for_property_state_after(CONNECTION_PROPERTY_NAME, INDIGO_ALERT_STATE, revision));
	ASSERT_TRUE(connect_driver());
	stop_driver();
}

static void axis_and_button_events_drive_public_properties(void) {
	ASSERT_TRUE(start_driver(true));
	ASSERT_TRUE(connect_driver());
	ASSERT_EQ_INT(INDIGO_OK, indigo_change_switch_property_1(&simulator_test_client, driver.device_name, JOYSTICK_OPTIONS_PROPERTY_NAME, JOYSTICK_OPTIONS_ANALOG_STICK_ITEM_NAME, true));
	ASSERT_TRUE(wait_for_property_state(JOYSTICK_OPTIONS_PROPERTY_NAME, INDIGO_OK_STATE));
	fake_push_event(0, JS_EVENT_AXIS, 0, 20000);
	ASSERT_TRUE(wait_for_number_item_value(JOYSTICK_AXES_PROPERTY_NAME, "AXIS_1", 40000, 0));
	for (int i = 0; i < 200 && !find_cached_item(MOUNT_MOTION_RA_PROPERTY_NAME, MOUNT_MOTION_EAST_ITEM_NAME)->sw.value; i++) {
		indigo_usleep(5000);
	}
	ASSERT_TRUE(find_cached_item(MOUNT_MOTION_RA_PROPERTY_NAME, MOUNT_MOTION_EAST_ITEM_NAME)->sw.value);
	for (int i = 0; i < 200 && !find_cached_item(MOUNT_SLEW_RATE_PROPERTY_NAME, MOUNT_SLEW_RATE_CENTERING_ITEM_NAME)->sw.value; i++) {
		indigo_usleep(5000);
	}
	ASSERT_TRUE(find_cached_item(MOUNT_SLEW_RATE_PROPERTY_NAME, MOUNT_SLEW_RATE_CENTERING_ITEM_NAME)->sw.value);
	fake_push_event(0, JS_EVENT_AXIS, 0, 0);
	ASSERT_TRUE(wait_for_number_item_value(JOYSTICK_AXES_PROPERTY_NAME, "AXIS_1", 0, 0));
	ASSERT_FALSE(find_cached_item(MOUNT_MOTION_RA_PROPERTY_NAME, MOUNT_MOTION_EAST_ITEM_NAME)->sw.value);
	fake_push_event(0, JS_EVENT_BUTTON, 4, 1);
	for (int i = 0; i < 200 && !find_cached_item(MOUNT_PARK_PROPERTY_NAME, MOUNT_PARK_PARKED_ITEM_NAME)->sw.value; i++) {
		indigo_usleep(5000);
	}
	ASSERT_TRUE(find_cached_item(JOYSTICK_BUTTONS_PROPERTY_NAME, "BUTTON_5")->sw.value);
	ASSERT_TRUE(find_cached_item(MOUNT_PARK_PROPERTY_NAME, MOUNT_PARK_PARKED_ITEM_NAME)->sw.value);
	fake_push_event(0, JS_EVENT_BUTTON, 4, 0);
	for (int i = 0; i < 200 && find_cached_item(JOYSTICK_BUTTONS_PROPERTY_NAME, "BUTTON_5")->sw.value; i++) {
		indigo_usleep(5000);
	}
	ASSERT_FALSE(find_cached_item(JOYSTICK_BUTTONS_PROPERTY_NAME, "BUTTON_5")->sw.value);
	stop_driver();
}

static void mapping_validation_and_axis_swap_work(void) {
	ASSERT_TRUE(start_driver(true));
	ASSERT_TRUE(connect_driver());
	unsigned int revision = property_revision(JOYSTICK_MAPPING_PROPERTY_NAME);
	ASSERT_EQ_INT(INDIGO_OK, indigo_change_number_property_1(&simulator_test_client, driver.device_name, JOYSTICK_MAPPING_PROPERTY_NAME, JOYSTICK_MAPPING_MOTION_DEC_ITEM_NAME, 1));
	ASSERT_TRUE(wait_for_property_state_after(JOYSTICK_MAPPING_PROPERTY_NAME, INDIGO_ALERT_STATE, revision));
	ASSERT_EQ_INT(INDIGO_OK, indigo_change_number_property_1(&simulator_test_client, driver.device_name, JOYSTICK_MAPPING_PROPERTY_NAME, JOYSTICK_MAPPING_MOTION_DEC_ITEM_NAME, 2));
	ASSERT_TRUE(wait_for_property_state(JOYSTICK_MAPPING_PROPERTY_NAME, INDIGO_OK_STATE));
	ASSERT_EQ_INT(INDIGO_OK, indigo_change_switch_property_1(&simulator_test_client, driver.device_name, JOYSTICK_OPTIONS_PROPERTY_NAME, JOYSTICK_OPTIONS_SWAP_RA_ITEM_NAME, true));
	ASSERT_TRUE(wait_for_property_state(JOYSTICK_OPTIONS_PROPERTY_NAME, INDIGO_OK_STATE));
	fake_push_event(0, JS_EVENT_AXIS, 0, 32767);
	for (int i = 0; i < 200 && !find_cached_item(MOUNT_MOTION_RA_PROPERTY_NAME, MOUNT_MOTION_WEST_ITEM_NAME)->sw.value; i++) {
		indigo_usleep(5000);
	}
	assert_switch_item_value(MOUNT_MOTION_RA_PROPERTY_NAME, MOUNT_MOTION_WEST_ITEM_NAME, true);
	stop_driver();
}

static void invalid_events_are_ignored(void) {
	ASSERT_TRUE(start_driver(true));
	ASSERT_TRUE(connect_driver());
	unsigned int axis_revision = property_revision(JOYSTICK_AXES_PROPERTY_NAME);
	unsigned int button_revision = property_revision(JOYSTICK_BUTTONS_PROPERTY_NAME);
	fake_push_event(0, JS_EVENT_AXIS, 15, 1234);
	fake_push_event(0, JS_EVENT_BUTTON, 63, 1);
	indigo_usleep(100000);
	ASSERT_EQ_INT(axis_revision, property_revision(JOYSTICK_AXES_PROPERTY_NAME));
	ASSERT_EQ_INT(button_revision, property_revision(JOYSTICK_BUTTONS_PROPERTY_NAME));
	stop_driver();
}

static void disconnect_reconnect_stops_the_old_poller(void) {
	ASSERT_TRUE(start_driver(true));
	ASSERT_TRUE(connect_driver());
	fake_push_event(0, JS_EVENT_AXIS, 0, 1000);
	ASSERT_TRUE(wait_for_number_item_value(JOYSTICK_AXES_PROPERTY_NAME, "AXIS_1", 2000, 0));
	ASSERT_EQ_INT(INDIGO_OK, indigo_change_switch_property_1(&simulator_test_client, driver.device_name, CONNECTION_PROPERTY_NAME, CONNECTION_DISCONNECTED_ITEM_NAME, true));
	ASSERT_TRUE(wait_for_simulator_connection_state(false));
	int reads_after_disconnect;
	pthread_mutex_lock(&fake_mutex);
	reads_after_disconnect = fake_devices[0].read_count;
	pthread_mutex_unlock(&fake_mutex);
	indigo_usleep(50000);
	pthread_mutex_lock(&fake_mutex);
	ASSERT_EQ_INT(reads_after_disconnect, fake_devices[0].read_count);
	pthread_mutex_unlock(&fake_mutex);
	ASSERT_TRUE(connect_driver());
	fake_push_event(0, JS_EVENT_AXIS, 0, -2000);
	ASSERT_TRUE(wait_for_number_item_value(JOYSTICK_AXES_PROPERTY_NAME, "AXIS_1", -4000, 0));
	stop_driver();
}

static void hotplug_is_nonblocking_and_coalesced(void) {
	ASSERT_TRUE(start_driver(false));
	ASSERT_EQ_INT(0, atomic_load(&attached_count));
	fake_set_present(0, true);
	double started = indigo_monotonic_time();
	trigger_hotplug(LIBUSB_HOTPLUG_EVENT_DEVICE_ARRIVED);
	trigger_hotplug(LIBUSB_HOTPLUG_EVENT_DEVICE_ARRIVED);
	trigger_hotplug(LIBUSB_HOTPLUG_EVENT_DEVICE_ARRIVED);
	ASSERT_TRUE(indigo_monotonic_time() - started < 0.05);
	ASSERT_TRUE(wait_for_attached_count(1));
	ASSERT_EQ_INT(2, atomic_load(&scan_count));
	stop_driver();
}

static void invalid_discovery_entries_and_descriptor_failure_recover(void) {
	reset_fake();
	include_invalid_entries = true;
	fake_devices[0].descriptor_error = true;
	reset_simulator_context(&driver);
	ASSERT_EQ_INT(INDIGO_OK, indigo_start());
	bus_started = true;
	ASSERT_EQ_INT(INDIGO_OK, indigo_attach_client(&simulator_test_client));
	client_attached = true;
	ASSERT_EQ_INT(INDIGO_OK, driver.entry(INDIGO_DRIVER_INIT, NULL));
	driver_initialized = true;
	ASSERT_EQ_INT(0, atomic_load(&attached_count));
	pthread_mutex_lock(&fake_mutex);
	fake_devices[0].descriptor_error = false;
	pthread_mutex_unlock(&fake_mutex);
	trigger_hotplug(LIBUSB_HOTPLUG_EVENT_DEVICE_ARRIVED);
	ASSERT_TRUE(wait_for_attached_count(1));
	enumerate_simulator_device();
	ASSERT_TRUE(find_cached_property(INFO_PROPERTY_NAME) != NULL);
	stop_driver();
}

static void multiple_devices_attach_remove_and_survive(void) {
	reset_fake();
	for (int i = 0; i < FAKE_DEVICE_COUNT; i++) {
		fake_devices[i].present = true;
		fake_devices[i].axes = 2;
		fake_devices[i].buttons = 4;
		snprintf(fake_devices[i].name, sizeof(fake_devices[i].name), "Fake Joystick");
	}
	include_invalid_entries = true;
	reset_simulator_context(&driver);
	ASSERT_EQ_INT(INDIGO_OK, indigo_start());
	bus_started = true;
	ASSERT_EQ_INT(INDIGO_OK, indigo_attach_client(&simulator_test_client));
	client_attached = true;
	ASSERT_EQ_INT(INDIGO_OK, driver.entry(INDIGO_DRIVER_INIT, NULL));
	driver_initialized = true;
	ASSERT_EQ_INT(FAKE_DEVICE_COUNT, atomic_load(&attached_count));
	enumerate_simulator_device();
	ASSERT_TRUE(connect_driver());
	fake_set_present(2, false);
	trigger_hotplug(LIBUSB_HOTPLUG_EVENT_DEVICE_LEFT);
	ASSERT_TRUE(wait_for_attached_count(FAKE_DEVICE_COUNT - 1));
	fake_push_event(0, JS_EVENT_AXIS, 0, 1500);
	ASSERT_TRUE(wait_for_number_item_value(JOYSTICK_AXES_PROPERTY_NAME, "AXIS_1", 3000, 0));
	stop_driver();
}

static void unplug_connected_device_is_quiescent(void) {
	ASSERT_TRUE(start_driver(true));
	ASSERT_TRUE(connect_driver());
	fake_push_event(0, JS_EVENT_AXIS, 0, 3000);
	fake_set_present(0, false);
	trigger_hotplug(LIBUSB_HOTPLUG_EVENT_DEVICE_LEFT);
	ASSERT_TRUE(wait_for_attached_count(0));
	pthread_mutex_lock(&fake_mutex);
	ASSERT_FALSE(fake_devices[0].fd_open);
	pthread_mutex_unlock(&fake_mutex);
	ASSERT_EQ_INT(INDIGO_OK, driver.entry(INDIGO_DRIVER_SHUTDOWN, NULL));
	driver_initialized = false;
	ASSERT_EQ_INT(INDIGO_OK, indigo_detach_client(&simulator_test_client));
	client_attached = false;
	ASSERT_EQ_INT(INDIGO_OK, indigo_stop());
	bus_started = false;
	release_cached_properties();
}

static void shutdown_rejects_connected_device_and_drains_hotplug(void) {
	ASSERT_TRUE(start_driver(true));
	ASSERT_TRUE(connect_driver());
	ASSERT_EQ_INT(INDIGO_BUSY, driver.entry(INDIGO_DRIVER_SHUTDOWN, NULL));
	ASSERT_TRUE(usb_callback != NULL);
	ASSERT_EQ_INT(INDIGO_OK, indigo_change_switch_property_1(&simulator_test_client, driver.device_name, CONNECTION_PROPERTY_NAME, CONNECTION_DISCONNECTED_ITEM_NAME, true));
	ASSERT_TRUE(wait_for_simulator_connection_state(false));
	trigger_hotplug(LIBUSB_HOTPLUG_EVENT_DEVICE_ARRIVED);
	ASSERT_EQ_INT(INDIGO_OK, driver.entry(INDIGO_DRIVER_SHUTDOWN, NULL));
	driver_initialized = false;
	ASSERT_TRUE(usb_callback == NULL);
	ASSERT_EQ_INT(0, atomic_load(&attached_count));
	ASSERT_EQ_INT(INDIGO_OK, indigo_detach_client(&simulator_test_client));
	client_attached = false;
	ASSERT_EQ_INT(INDIGO_OK, indigo_stop());
	bus_started = false;
	release_cached_properties();
	ASSERT_TRUE(start_driver(true));
	ASSERT_TRUE(connect_driver());
	stop_driver();
}

#define WRAP_TEST(name) static void name##_with_cleanup(void) { name(); force_cleanup(); }

WRAP_TEST(joystick_exposes_complete_properties)
WRAP_TEST(reported_counts_are_bounded)
WRAP_TEST(connection_is_queued_and_reports_busy)
WRAP_TEST(connection_busy_guard_preserves_the_active_request)
WRAP_TEST(open_and_configuration_failures_recover)
WRAP_TEST(axis_and_button_events_drive_public_properties)
WRAP_TEST(mapping_validation_and_axis_swap_work)
WRAP_TEST(invalid_events_are_ignored)
WRAP_TEST(disconnect_reconnect_stops_the_old_poller)
WRAP_TEST(hotplug_is_nonblocking_and_coalesced)
WRAP_TEST(invalid_discovery_entries_and_descriptor_failure_recover)
WRAP_TEST(multiple_devices_attach_remove_and_survive)
WRAP_TEST(unplug_connected_device_is_quiescent)
WRAP_TEST(shutdown_rejects_connected_device_and_drains_hotplug)

int main(void) {
	const indigo_test_case tests[] = {
		{ "joystick_exposes_complete_properties", joystick_exposes_complete_properties_with_cleanup },
		{ "reported_counts_are_bounded", reported_counts_are_bounded_with_cleanup },
		{ "connection_is_queued_and_reports_busy", connection_is_queued_and_reports_busy_with_cleanup },
		{ "connection_busy_guard_preserves_the_active_request", connection_busy_guard_preserves_the_active_request_with_cleanup },
		{ "open_and_configuration_failures_recover", open_and_configuration_failures_recover_with_cleanup },
		{ "axis_and_button_events_drive_public_properties", axis_and_button_events_drive_public_properties_with_cleanup },
		{ "mapping_validation_and_axis_swap_work", mapping_validation_and_axis_swap_work_with_cleanup },
		{ "invalid_events_are_ignored", invalid_events_are_ignored_with_cleanup },
		{ "disconnect_reconnect_stops_the_old_poller", disconnect_reconnect_stops_the_old_poller_with_cleanup },
		{ "hotplug_is_nonblocking_and_coalesced", hotplug_is_nonblocking_and_coalesced_with_cleanup },
		{ "invalid_discovery_entries_and_descriptor_failure_recover", invalid_discovery_entries_and_descriptor_failure_recover_with_cleanup },
		{ "multiple_devices_attach_remove_and_survive", multiple_devices_attach_remove_and_survive_with_cleanup },
		{ "unplug_connected_device_is_quiescent", unplug_connected_device_is_quiescent_with_cleanup },
		{ "shutdown_rejects_connected_device_and_drains_hotplug", shutdown_rejects_connected_device_and_drains_hotplug_with_cleanup }
	};
	return indigo_run_tests("HID Joystick fake HID integration tests", tests, ARRAY_SIZE(tests));
}
