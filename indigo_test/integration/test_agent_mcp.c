// Copyright (c) 2026 INDIGO initiative
// All rights reserved.
//
// You may use this software under the terms of 'INDIGO Astronomy
// open-source license' (see LICENSE.md).
//
// THIS SOFTWARE IS PROVIDED BY THE AUTHORS 'AS IS' AND ANY EXPRESS
// OR IMPLIED WARRANTIES, INCLUDING, BUT NOT LIMITED TO, THE IMPLIED
// WARRANTIES OF MERCHANTABILITY AND FITNESS FOR A PARTICULAR PURPOSE
// ARE DISCLAIMED. IN NO EVENT SHALL THE AUTHOR BE LIABLE FOR ANY
// DIRECT, INDIRECT, INCIDENTAL, SPECIAL, EXEMPLARY, OR CONSEQUENTIAL
// DAMAGES (INCLUDING, BUT NOT LIMITED TO, PROCUREMENT OF SUBSTITUTE
// GOODS OR SERVICES; LOSS OF USE, DATA, OR PROFITS; OR BUSINESS
// INTERRUPTION) HOWEVER CAUSED AND ON ANY THEORY OF LIABILITY,
// WHETHER IN CONTRACT, STRICT LIABILITY, OR TORT (INCLUDING
// NEGLIGENCE OR OTHERWISE) ARISING IN ANY WAY OUT OF THE USE OF THIS
// SOFTWARE, EVEN IF ADVISED OF THE POSSIBILITY OF SUCH DAMAGE.

// Code is generated by AI

#include <arpa/inet.h>
#include <errno.h>
#include <locale.h>
#include <netinet/in.h>
#include <netinet/tcp.h>
#include <pthread.h>
#include <signal.h>
#include <stdatomic.h>
#include <stdio.h>
#include <string.h>
#include <sys/socket.h>
#include <sys/time.h>
#include <unistd.h>

#include <indigo/indigo_bus.h>
#include <indigo/indigo_names.h>
#include <indigo/indigo_server_tcp.h>
#include <indigo/indigo_timer.h>
#include <indigo/indigo_token.h>
#include <agent_mcp/indigo_agent_mcp.h>

#include "../test_runner.h"

#define JSMN_STATIC
#include <externals/jsmn/jsmn.h>

#define WAIT_UNTIL(condition, timeout) ({ double end_ = indigo_monotonic_time() + (timeout); bool ready_ = (condition); while (!ready_ && indigo_monotonic_time() < end_) { indigo_usleep(1000); ready_ = (condition); } ready_; })
#define MCP_HEADERS "Content-Type: application/json\r\nAccept: application/json, text/event-stream\r\nMCP-Protocol-Version: 2025-11-25\r\n"

static const char ping_request[] = "{\"jsonrpc\":\"2.0\",\"id\":1,\"method\":\"ping\"}";
static atomic_bool listening;
static atomic_bool server_finished;
static atomic_int clients;
static bool bus_started;
static bool server_started;
static bool agent_started;
static pthread_t server_thread;

static void server_callback(int count) {
	atomic_store(&clients, count);
	atomic_store(&listening, true);
}

static void *run_server(void *data) {
	indigo_server_start(server_callback);
	atomic_store(&server_finished, true);
	return NULL;
}

static int connect_client(void) {
	int fd = socket(AF_INET, SOCK_STREAM, 0);
	if (fd < 0) {
		return -1;
	}
	struct sockaddr_in address = { 0 };
	address.sin_family = AF_INET;
	address.sin_port = htons(indigo_server_tcp_port);
	address.sin_addr.s_addr = htonl(INADDR_LOOPBACK);
	struct timeval timeout = { 3, 0 };
	setsockopt(fd, SOL_SOCKET, SO_RCVTIMEO, &timeout, sizeof(timeout));
	setsockopt(fd, SOL_SOCKET, SO_SNDTIMEO, &timeout, sizeof(timeout));
	int value = 1;
	setsockopt(fd, IPPROTO_TCP, TCP_NODELAY, &value, sizeof(value));
	if (connect(fd, (struct sockaddr *)&address, sizeof(address))) {
		close(fd);
		return -1;
	}
	return fd;
}

static bool send_bytes(int fd, const void *bytes, size_t size) {
	const char *cursor = bytes;
	while (size) {
		ssize_t count = write(fd, cursor, size);
		if (count <= 0) {
			return false;
		}
		cursor += count;
		size -= count;
	}
	return true;
}

static bool receive_closed(int fd, char *response, size_t capacity) {
	size_t size = 0;
	while (size + 1 < capacity) {
		ssize_t count = read(fd, response + size, capacity - size - 1);
		if (count == 0 || (count < 0 && errno == ECONNRESET)) {
			response[size] = 0;
			return true;
		}
		if (count < 0) {
			response[size] = 0;
			return false;
		}
		size += count;
	}
	response[size] = 0;
	return false;
}

static bool exchange(const void *request, size_t size, char *response, size_t capacity) {
	int fd = connect_client();
	if (fd < 0) {
		return false;
	}
	bool sent = send_bytes(fd, request, size);
	shutdown(fd, SHUT_WR);
	bool closed = receive_closed(fd, response, capacity);
	close(fd);
	return sent && closed;
}

static int response_status(const char *response) {
	int status = 0;
	sscanf(response, "HTTP/1.1 %d", &status);
	return status;
}

static bool body_contains(const char *response, const char *fragment) {
	const char *body = strstr(response, "\r\n\r\n");
	if (!body) {
		return false;
	}
	char compact[4096];
	size_t used = 0;
	bool quoted = false;
	bool escaped = false;
	for (const char *p = body + 4; *p && used + 1 < sizeof(compact); p++) {
		if (quoted || (*p != ' ' && *p != '\n' && *p != '\r' && *p != '\t')) {
			compact[used++] = *p;
		}
		if (*p == '"' && !escaped) {
			quoted = !quoted;
		}
		escaped = quoted && *p == '\\' && !escaped;
	}
	compact[used] = 0;
	return strstr(compact, fragment) != NULL;
}

static bool post_body(const void *body, size_t size, const char *headers, char *response, size_t capacity) {
	char *request = malloc(size + 1024);
	if (!request) {
		return false;
	}
	int length = snprintf(request, 1024, "POST /mcp HTTP/1.1\r\n%sContent-Length: %zu\r\n\r\n", headers, size);
	memcpy(request + length, body, size);
	bool passed = exchange(request, length + size, response, capacity);
	free(request);
	return passed;
}

static bool ensure_fixture(void) {
	if (!bus_started) {
		indigo_start();
		bus_started = true;
	}
	if (!agent_started) {
		if (indigo_agent_mcp(INDIGO_DRIVER_INIT, NULL) != INDIGO_OK) {
			return false;
		}
		agent_started = true;
	}
	if (!server_started) {
		indigo_use_bonjour = false;
		indigo_server_tcp_port = 0;
		atomic_store(&listening, false);
		atomic_store(&server_finished, false);
		if (pthread_create(&server_thread, NULL, run_server, NULL)) {
			return false;
		}
		server_started = true;
		if (!WAIT_UNTIL(atomic_load(&listening) && indigo_server_tcp_port, 5)) {
			return false;
		}
	}
	return true;
}

static void initialization_requires_started_bus(void) {
	ASSERT_FALSE(bus_started);
	ASSERT_EQ_INT(INDIGO_FAILED, indigo_agent_mcp(INDIGO_DRIVER_INIT, NULL));
	ASSERT_EQ_INT(INDIGO_OK, indigo_agent_mcp(INDIGO_DRIVER_SHUTDOWN, NULL));
}

static void lifecycle_is_idempotent_and_starts_immediately(void) {
	ASSERT_TRUE(ensure_fixture());
	indigo_driver_info info;
	ASSERT_EQ_INT(INDIGO_OK, indigo_agent_mcp(INDIGO_DRIVER_INFO, &info));
	ASSERT_EQ_INT(0x03000003, info.version);
	char response[4096];
	ASSERT_TRUE(post_body(ping_request, sizeof(ping_request) - 1, MCP_HEADERS, response, sizeof(response)));
	ASSERT_EQ_INT(200, response_status(response));
	ASSERT_EQ_INT(INDIGO_OK, indigo_agent_mcp(INDIGO_DRIVER_INIT, NULL));
	ASSERT_EQ_INT(INDIGO_OK, indigo_agent_mcp(INDIGO_DRIVER_INIT, NULL));
	ASSERT_TRUE(post_body(ping_request, sizeof(ping_request) - 1, MCP_HEADERS, response, sizeof(response)));
	ASSERT_EQ_INT(200, response_status(response));
	ASSERT_EQ_INT(INDIGO_OK, indigo_agent_mcp(INDIGO_DRIVER_SHUTDOWN, NULL));
	agent_started = false;
	ASSERT_EQ_INT(INDIGO_OK, indigo_agent_mcp(INDIGO_DRIVER_SHUTDOWN, NULL));
	ASSERT_TRUE(post_body(ping_request, sizeof(ping_request) - 1, MCP_HEADERS, response, sizeof(response)));
	ASSERT_EQ_INT(404, response_status(response));
	ASSERT_TRUE(ensure_fixture());
	ASSERT_TRUE(post_body(ping_request, sizeof(ping_request) - 1, MCP_HEADERS, response, sizeof(response)));
	ASSERT_EQ_INT(200, response_status(response));
}

static void initialize_and_initialized_notification(void) {
	ASSERT_TRUE(ensure_fixture());
	const char request[] = "{\"jsonrpc\":\"2.0\",\"id\":7,\"method\":\"initialize\",\"params\":{\"protocolVersion\":\"2025-11-25\",\"capabilities\":{},\"clientInfo\":{\"name\":\"fixture\",\"version\":\"1\"}}}";
	char response[65536];
	ASSERT_TRUE(post_body(request, sizeof(request) - 1, "Content-Type: application/json; charset=utf-8\r\nAccept: application/json, text/event-stream\r\n", response, sizeof(response)));
	ASSERT_EQ_INT(200, response_status(response));
	ASSERT_TRUE(body_contains(response, "\"id\":7"));
	ASSERT_TRUE(body_contains(response, "\"protocolVersion\":\"2025-11-25\""));
	ASSERT_TRUE(body_contains(response, "\"serverInfo\":"));
	ASSERT_TRUE(body_contains(response, "\"tools\":{}"));
	ASSERT_TRUE(strstr(response, "Mcp-Session-Id:") == NULL);
	const char ready[] = "{\"jsonrpc\":\"2.0\",\"method\":\"notifications/initialized\"}";
	ASSERT_TRUE(post_body(ready, sizeof(ready) - 1, MCP_HEADERS, response, sizeof(response)));
	ASSERT_EQ_INT(202, response_status(response));
	const char *body = strstr(response, "\r\n\r\n");
	ASSERT_TRUE(body != NULL && body[4] == 0);
}

static void ping_and_catalog_preserve_ids(void) {
	ASSERT_TRUE(ensure_fixture());
	const char *requests[] = {
		"{\"jsonrpc\":\"2.0\",\"id\":-7,\"method\":\"ping\"}",
		"{\"jsonrpc\":\"2.0\",\"id\":\"\\u0041\\\"id\",\"m\\u0065thod\":\"p\\u0069ng\"}",
		"{\"jsonrpc\":\"2.0\",\"id\":1,\"method\":\"tools/list\"}"
	};
	char response[65536];
	for (size_t i = 0; i < sizeof(requests) / sizeof(requests[0]); i++) {
		ASSERT_TRUE(post_body(requests[i], strlen(requests[i]), MCP_HEADERS, response, sizeof(response)));
		ASSERT_EQ_INT(200, response_status(response));
		ASSERT_TRUE(body_contains(response, "\"result\":"));
		ASSERT_FALSE(body_contains(response, "\"error\":"));
		ASSERT_TRUE(body_contains(response, i == 0 ? "\"id\":-7" : i == 1 ? "\"id\":\"\\u0041\\\"id\"" : "\"name\":\"list_devices\""));
		if (i == 2) {
			ASSERT_TRUE(body_contains(response, "\"name\":\"list_properties\""));
			ASSERT_TRUE(body_contains(response, "\"name\":\"get_property\""));
		}
	}
}

static void unknown_methods_and_tools_return_rpc_errors(void) {
	ASSERT_TRUE(ensure_fixture());
	const char *requests[] = { "{\"jsonrpc\":\"2.0\",\"id\":2,\"method\":\"does/not/exist\"}", "{\"jsonrpc\":\"2.0\",\"id\":3,\"method\":\"tools/call\",\"params\":{\"name\":\"missing\",\"arguments\":{}}}" };
	char response[4096];
	for (int i = 0; i < 2; i++) {
		ASSERT_TRUE(post_body(requests[i], strlen(requests[i]), MCP_HEADERS, response, sizeof(response)));
		ASSERT_EQ_INT(200, response_status(response));
		ASSERT_TRUE(body_contains(response, i == 0 ? "\"code\":-32601" : "\"code\":-32602"));
	}
}

static void exact_path_and_get_rejection(void) {
	ASSERT_TRUE(ensure_fixture());
	const char *requests[] = { "GET /mcp HTTP/1.1\r\nConnection: close\r\n\r\n", "POST /mcp-extra HTTP/1.1\r\nContent-Length: 0\r\n\r\n", "POST /mcp/ HTTP/1.1\r\nContent-Length: 0\r\n\r\n" };
	char response[4096];
	for (int i = 0; i < 3; i++) {
		ASSERT_TRUE(exchange(requests[i], strlen(requests[i]), response, sizeof(response)));
		ASSERT_EQ_INT(i ? 404 : 405, response_status(response));
	}
}

static void invalid_envelopes_and_duplicate_reserved_fields(void) {
	ASSERT_TRUE(ensure_fixture());
	const char *requests[] = {
		"[]", "null", "{\"jsonrpc\":\"1.0\",\"id\":1,\"method\":\"ping\"}",
		"{\"jsonrpc\":\"2.0\",\"id\":null,\"method\":\"ping\"}",
		"{\"jsonrpc\":\"2.0\",\"id\":true,\"method\":\"ping\"}",
		"{\"jsonrpc\":\"2.0\",\"id\":1.5,\"method\":\"ping\"}",
		"{\"jsonrpc\":\"2.0\",\"id\":1,\"method\":7}",
		"{\"jsonrpc\":\"2.0\",\"id\":1,\"method\":\"ping\",\"method\":\"tools/list\"}",
		"{\"jsonrpc\":\"2.0\",\"id\":1,\"method\":\"ping\",\"m\\u0065thod\":\"tools/list\"}",
		"{\"jsonrpc\":\"2.0\",\"id\":1,\"id\":2,\"method\":\"ping\"}"
	};
	char response[4096];
	for (size_t i = 0; i < sizeof(requests) / sizeof(requests[0]); i++) {
		ASSERT_TRUE(post_body(requests[i], strlen(requests[i]), MCP_HEADERS, response, sizeof(response)));
		if (!body_contains(response, "\"code\":-32600")) {
			fprintf(stderr, "Invalid envelope fixture %zu: %s\n", i, response);
			ASSERT_TRUE(false);
		}
	}
}

static void malformed_json_and_utf8_are_rejected(void) {
	ASSERT_TRUE(ensure_fixture());
	const char *requests[] = {
		"{jsonrpc:\"2.0\",\"id\":1,\"method\":\"ping\"}",
		"{\"jsonrpc\":\"2.0\" \"id\":1,\"method\":\"ping\"}",
		"{\"jsonrpc\":\"2.0\",\"id\":1 \"method\":\"ping\"}",
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		"{\"jsonrpc\":\"2.0\",\"id\":\"\xc0\xaf\",\"method\":\"ping\"}"
	};
	char response[4096];
	for (size_t i = 0; i < sizeof(requests) / sizeof(requests[0]); i++) {
		ASSERT_TRUE(post_body(requests[i], strlen(requests[i]), MCP_HEADERS, response, sizeof(response)));
		if (!body_contains(response, "\"code\":-32700")) {
			fprintf(stderr, "Malformed JSON fixture %zu: %s\n", i, response);
			ASSERT_TRUE(false);
		}
	}
	const char raw_nul[] = "{\"jsonrpc\":\"2.0\",\"id\":1,\"method\":\"ping\"}\0";
	ASSERT_TRUE(post_body(raw_nul, sizeof(raw_nul) - 1, MCP_HEADERS, response, sizeof(response)));
	ASSERT_TRUE(body_contains(response, "\"code\":-32700"));
}

static void malformed_http_headers_are_rejected(void) {
	ASSERT_TRUE(ensure_fixture());
	const char *headers[] = {
		MCP_HEADERS "Content-Length: 0\r\n",
		MCP_HEADERS "Transfer-Encoding: chunked\r\n",
		MCP_HEADERS "Expect: 100-continue\r\n",
		MCP_HEADERS "Origin: https://untrusted.example\r\n",
		"Content-Type: text/plain\r\nAccept: application/json, text/event-stream\r\n",
		"Content-Type: application/json\r\nAccept: text/plain\r\n",
		"Content-Type: application/json\r\nAccept: application/json, text/event-stream\r\nMCP-Protocol-Version: unknown\r\n",
		"Content-Type: application/json\r\nAccept: application/json, text/event-stream\r\nMCP-Protocol-Version: \t\r\n"
	};
	const int statuses[] = { 400, 400, 417, 403, 415, 406, 400, 400 };
	char response[4096];
	for (size_t i = 0; i < sizeof(headers) / sizeof(headers[0]); i++) {
		ASSERT_TRUE(post_body(ping_request, sizeof(ping_request) - 1, headers[i], response, sizeof(response)));
		ASSERT_EQ_INT(statuses[i], response_status(response));
	}
	const char absent_length[] = "POST /mcp HTTP/1.1\r\n" MCP_HEADERS "\r\n";
	ASSERT_TRUE(exchange(absent_length, sizeof(absent_length) - 1, response, sizeof(response)));
	ASSERT_EQ_INT(411, response_status(response));
}

static void body_limits_and_partial_eof_are_bounded(void) {
	ASSERT_TRUE(ensure_fixture());
	char response[4096];
	const char too_large[] = "POST /mcp HTTP/1.1\r\n" MCP_HEADERS "Content-Length: 65537\r\n\r\n";
	ASSERT_TRUE(exchange(too_large, sizeof(too_large) - 1, response, sizeof(response)));
	ASSERT_EQ_INT(413, response_status(response));
	const char partial[] = "POST /mcp HTTP/1.1\r\n" MCP_HEADERS "Content-Length: 32\r\n\r\n{}";
	ASSERT_TRUE(exchange(partial, sizeof(partial) - 1, response, sizeof(response)));
	ASSERT_TRUE(response_status(response) >= 400);
	char *body = malloc(65536);
	ASSERT_TRUE(body != NULL);
	memset(body, ' ', 65536);
	memcpy(body, ping_request, sizeof(ping_request) - 1);
	bool accepted = post_body(body, 65536, MCP_HEADERS, response, sizeof(response));
	free(body);
	ASSERT_TRUE(accepted);
	ASSERT_EQ_INT(200, response_status(response));
}

static void fragmented_body_and_pipeline_close(void) {
	ASSERT_TRUE(ensure_fixture());
	int fd = connect_client();
	ASSERT_TRUE(fd >= 0);
	char head[512];
	int size = snprintf(head, sizeof(head), "POST /mcp HTTP/1.1\r\n%sContent-Length: %zu\r\n\r\n", MCP_HEADERS, sizeof(ping_request) - 1);
	bool sent = send_bytes(fd, head, size) && send_bytes(fd, ping_request, 3) && send_bytes(fd, ping_request + 3, sizeof(ping_request) - 4);
	char response[4096];
	bool closed = receive_closed(fd, response, sizeof(response));
	close(fd);
	ASSERT_TRUE(sent && closed);
	ASSERT_EQ_INT(200, response_status(response));
	char request[1024];
	size = snprintf(request, sizeof(request), "POST /mcp HTTP/1.1\r\n%sContent-Length: %zu\r\n\r\n%sGET /mcp HTTP/1.1\r\n\r\n", MCP_HEADERS, sizeof(ping_request) - 1, ping_request);
	ASSERT_TRUE(exchange(request, size, response, sizeof(response)));
	ASSERT_EQ_INT(200, response_status(response));
	ASSERT_TRUE(strstr(response + 1, "HTTP/1.1") == NULL);
}

static void stalled_body_times_out(void) {
	ASSERT_TRUE(ensure_fixture());
	int fd = connect_client();
	ASSERT_TRUE(fd >= 0);
	const char request[] = "POST /mcp HTTP/1.1\r\n" MCP_HEADERS "Content-Length: 20\r\n\r\n{";
	bool sent = send_bytes(fd, request, sizeof(request) - 1);
	char response[4096];
	double began = indigo_monotonic_time();
	bool closed = receive_closed(fd, response, sizeof(response));
	double elapsed = indigo_monotonic_time() - began;
	close(fd);
	ASSERT_TRUE(sent && closed && elapsed < 2.5);
	ASSERT_EQ_INT(408, response_status(response));
}

static void nested_and_token_heavy_json_is_bounded(void) {
	ASSERT_TRUE(ensure_fixture());
	char body[8192];
	size_t used = snprintf(body, sizeof(body), "{\"jsonrpc\":\"2.0\",\"id\":1,\"method\":\"ping\",\"params\":{\"x\":");
	for (int i = 0; i < 20; i++) {
		body[used++] = '[';
	}
	body[used++] = '0';
	for (int i = 0; i < 20; i++) {
		body[used++] = ']';
	}
	memcpy(body + used, "}}", 3);
	used += 2;
	char response[4096];
	ASSERT_TRUE(post_body(body, used, MCP_HEADERS, response, sizeof(response)));
	ASSERT_TRUE(response_status(response) >= 400);
	used = snprintf(body, sizeof(body), "{\"jsonrpc\":\"2.0\",\"id\":1,\"method\":\"ping\",\"params\":{");
	for (int i = 0; i < 150; i++) {
		used += snprintf(body + used, sizeof(body) - used, "%s\"k%d\":0", i ? "," : "", i);
	}
	memcpy(body + used, "}}", 3);
	used += 2;
	ASSERT_TRUE(post_body(body, used, MCP_HEADERS, response, sizeof(response)));
	ASSERT_TRUE(response_status(response) >= 400);
}

static atomic_bool shutdown_done;

static void *shutdown_agent(void *data) {
	indigo_agent_mcp(INDIGO_DRIVER_SHUTDOWN, NULL);
	atomic_store(&shutdown_done, true);
	return NULL;
}

static void incomplete_requests_are_admitted_then_drained_on_unload(void) {
	ASSERT_TRUE(ensure_fixture());
	int fds[8];
	const char partial[] = "POST /mcp HTTP/1.1\r\n" MCP_HEADERS "Content-Length: 32\r\n\r\n{";
	bool sent = true;
	for (int i = 0; i < 8; i++) {
		fds[i] = connect_client();
		sent = fds[i] >= 0 && send_bytes(fds[i], partial, sizeof(partial) - 1) && sent;
	}
	char response[4096];
	bool saturated = false;
	double end = indigo_monotonic_time() + 0.2;
	while (!saturated && indigo_monotonic_time() < end) {
		saturated = post_body(ping_request, sizeof(ping_request) - 1, MCP_HEADERS, response, sizeof(response)) && response_status(response) == 503;
	}
	atomic_store(&shutdown_done, false);
	pthread_t worker;
	bool spawned = saturated && pthread_create(&worker, NULL, shutdown_agent, NULL) == 0;
	bool withdrawn = false;
	end = indigo_monotonic_time() + 0.2;
	while (spawned && !withdrawn && indigo_monotonic_time() < end) {
		const char get[] = "GET /mcp HTTP/1.1\r\nConnection: close\r\n\r\n";
		withdrawn = exchange(get, sizeof(get) - 1, response, sizeof(response)) && response_status(response) == 404;
	}
	bool waited = withdrawn && !atomic_load(&shutdown_done);
	bool drained = true;
	for (int i = 0; i < 8; i++) {
		if (fds[i] >= 0) {
			drained = receive_closed(fds[i], response, sizeof(response)) && response_status(response) == 408 && drained;
			close(fds[i]);
		}
	}
	if (spawned) {
		pthread_join(worker, NULL);
		agent_started = false;
	}
	ASSERT_TRUE(sent && saturated && spawned && withdrawn && waited && drained && atomic_load(&shutdown_done));
	ASSERT_TRUE(ensure_fixture());
}

#define READ_FIXTURE_NAME "MCP Reader Fixture @ Remote"

static indigo_property *read_properties[16];
static bool read_fixture_attached;
static atomic_int read_fixture_writes;
static bool write_capture;
static bool write_self_unload;
static indigo_result write_unload_result;
static indigo_property *write_request;
static indigo_token write_token;

static indigo_result read_fixture_enumerate(indigo_device *device, indigo_client *client, indigo_property *filter) {
	for (size_t i = 0; i < sizeof(read_properties) / sizeof(read_properties[0]); i++) {
		if (read_properties[i] && indigo_property_match(read_properties[i], filter)) {
			indigo_define_property(device, read_properties[i], NULL);
		}
	}
	return INDIGO_OK;
}

static indigo_result read_fixture_change(indigo_device *device, indigo_client *client, indigo_property *property) {
	atomic_fetch_add(&read_fixture_writes, 1);
	if (write_capture) {
		indigo_release_property(write_request);
		write_request = indigo_copy_property(NULL, property);
		write_token = property->access_token;
		if (write_self_unload) {
			write_unload_result = indigo_agent_mcp(INDIGO_DRIVER_SHUTDOWN, NULL);
		}
		for (size_t i = 0; i < sizeof(read_properties) / sizeof(read_properties[0]); i++) {
			if (read_properties[i] && !strcmp(read_properties[i]->name, property->name)) {
				read_properties[i]->state = INDIGO_BUSY_STATE;
				indigo_update_property(device, read_properties[i], NULL);
			}
		}
	}
	return INDIGO_OK;
}

static indigo_result read_fixture_detach(indigo_device *device) {
	return INDIGO_OK;
}

static indigo_device read_fixture = INDIGO_DEVICE_INITIALIZER(READ_FIXTURE_NAME, NULL, read_fixture_enumerate, read_fixture_change, NULL, read_fixture_detach);

static void read_fixture_end(void) {
	write_capture = false;
	write_self_unload = false;
	read_fixture.access_token = 0;
	indigo_set_master_token(0);
	indigo_release_property(write_request);
	write_request = NULL;
	if (read_fixture_attached) {
		indigo_detach_device(&read_fixture);
		read_fixture_attached = false;
	}
	for (size_t i = 0; i < sizeof(read_properties) / sizeof(read_properties[0]); i++) {
		if (read_properties[i] && read_properties[i]->type == INDIGO_BLOB_VECTOR && read_properties[i]->perm == INDIGO_RO_PERM) {
			for (int item = 0; item < read_properties[i]->count; item++) {
				free(read_properties[i]->items[item].blob.value);
				read_properties[i]->items[item].blob.value = NULL;
			}
		}
		indigo_release_property(read_properties[i]);
		read_properties[i] = NULL;
	}
}

static bool read_fixture_begin(void) {
	read_fixture_end();
	if (!ensure_fixture()) {
		return false;
	}
	atomic_store(&read_fixture_writes, 0);
	read_fixture_attached = indigo_attach_device(&read_fixture) == INDIGO_OK;
	atomic_store(&read_fixture_writes, 0);
	return read_fixture_attached && ensure_fixture();
}

static bool read_define(indigo_property *property) {
	for (size_t i = 0; i < sizeof(read_properties) / sizeof(read_properties[0]); i++) {
		if (!read_properties[i]) {
			read_properties[i] = property;
			return indigo_define_property(&read_fixture, property, NULL) == INDIGO_OK;
		}
	}
	return false;
}

static indigo_property *read_text(const char *name, indigo_property_perm permission, const char *value) {
	indigo_property *property = indigo_init_text_property(NULL, READ_FIXTURE_NAME, name, "Read fixture", "Readable text", INDIGO_OK_STATE, permission, 1);
	indigo_init_text_item_raw(property->items, "VALUE", "Text value", value);
	return property;
}

typedef struct {
	char *wire;
	const char *json;
	jsmntok_t *tokens;
	int count;
	int result;
	int structured;
} read_reply;

static int read_json_next(const jsmntok_t *tokens, int count, int index) {
	int next = index + 1;
	while (next < count && tokens[next].start < tokens[index].end) {
		next++;
	}
	return next;
}

static int read_json_member(const char *json, const jsmntok_t *tokens, int count, int object, const char *name) {
	if (object < 0 || tokens[object].type != JSMN_OBJECT) {
		return -1;
	}
	int key = object + 1;
	while (key + 1 < count && tokens[key].start < tokens[object].end) {
		if (tokens[key].type == JSMN_STRING && (size_t)(tokens[key].end - tokens[key].start) == strlen(name) && !memcmp(json + tokens[key].start, name, strlen(name))) {
			return key + 1;
		}
		key = read_json_next(tokens, count, key + 1);
	}
	return -1;
}

static bool read_json_is(const read_reply *reply, int index, const char *value) {
	return index >= 0 && (size_t)(reply->tokens[index].end - reply->tokens[index].start) == strlen(value) && !memcmp(reply->json + reply->tokens[index].start, value, strlen(value));
}

static int read_json_named(const read_reply *reply, int array, const char *key, const char *name) {
	if (array < 0 || reply->tokens[array].type != JSMN_ARRAY) {
		return -1;
	}
	for (int item = array + 1; item < reply->count && reply->tokens[item].start < reply->tokens[array].end; item = read_json_next(reply->tokens, reply->count, item)) {
		int field = read_json_member(reply->json, reply->tokens, reply->count, item, key);
		if (read_json_is(reply, field, name)) {
			return item;
		}
	}
	return -1;
}

static int read_json_parse(const char *json, jsmntok_t **tokens) {
	for (unsigned size = 128; size <= 32768; size *= 2) {
		jsmntok_t *next = realloc(*tokens, size * sizeof(jsmntok_t));
		if (!next) {
			return -1;
		}
		*tokens = next;
		jsmn_parser parser;
		jsmn_init(&parser);
		int count = jsmn_parse(&parser, json, strlen(json), *tokens, size);
		if (count != JSMN_ERROR_NOMEM) {
			return count;
		}
	}
	return -1;
}

static unsigned read_json_hex(const char *text) {
	unsigned value = 0;
	for (int i = 0; i < 4; i++) {
		unsigned c = (unsigned char)text[i];
		value = value * 16 + (c >= '0' && c <= '9' ? c - '0' : c >= 'a' && c <= 'f' ? c - 'a' + 10 : c - 'A' + 10);
	}
	return value;
}

static char *read_json_string(const char *json, const jsmntok_t *token) {
	if (token->type != JSMN_STRING) {
		return NULL;
	}
	char *result = malloc((size_t)(token->end - token->start) + 1);
	if (!result) {
		return NULL;
	}
	size_t used = 0;
	for (int i = token->start; i < token->end; i++) {
		unsigned c = (unsigned char)json[i];
		bool unicode = false;
		if (c == '\\') {
			c = (unsigned char)json[++i];
			if (c == 'u') {
				unicode = true;
				c = read_json_hex(json + i + 1);
				i += 4;
				if (c >= 0xd800 && c <= 0xdbff) {
					unsigned low = read_json_hex(json + i + 3);
					i += 6;
					c = 0x10000 + ((c - 0xd800) << 10) + low - 0xdc00;
				}
			} else if (c == 'b') {
				c = '\b';
			} else if (c == 'f') {
				c = '\f';
			} else if (c == 'n') {
				c = '\n';
			} else if (c == 'r') {
				c = '\r';
			} else if (c == 't') {
				c = '\t';
			}
		}
		if (!unicode || c < 0x80) {
			result[used++] = (char)c;
		} else if (c < 0x800) {
			result[used++] = (char)(0xc0 | (c >> 6));
			result[used++] = (char)(0x80 | (c & 63));
		} else if (c < 0x10000) {
			result[used++] = (char)(0xe0 | (c >> 12));
			result[used++] = (char)(0x80 | ((c >> 6) & 63));
			result[used++] = (char)(0x80 | (c & 63));
		} else if (c > 0xffff) {
			result[used++] = (char)(0xf0 | (c >> 18));
			result[used++] = (char)(0x80 | ((c >> 12) & 63));
			result[used++] = (char)(0x80 | ((c >> 6) & 63));
			result[used++] = (char)(0x80 | (c & 63));
		} else {
			result[used++] = (char)c;
		}
	}
	result[used] = 0;
	return result;
}

static char *read_json_compact(const char *text, size_t size) {
	char *result = malloc(size + 1);
	if (!result) {
		return NULL;
	}
	size_t used = 0;
	bool quoted = false, escaped = false;
	for (size_t i = 0; i < size; i++) {
		unsigned char c = text[i];
		if (quoted || (c != ' ' && c != '\n' && c != '\r' && c != '\t')) {
			result[used++] = (char)c;
		}
		if (c == '"' && !escaped) {
			quoted = !quoted;
		}
		escaped = quoted && c == '\\' && !escaped;
	}
	result[used] = 0;
	return result;
}

static void read_reply_free(read_reply *reply) {
	free(reply->tokens);
	free(reply->wire);
	memset(reply, 0, sizeof(*reply));
}

static bool read_rpc(const char *method, const char *params, read_reply *reply) {
	memset(reply, 0, sizeof(*reply));
	size_t capacity = strlen(params) + strlen(method) + 128;
	char *request = malloc(capacity);
	if (!request) {
		return false;
	}
	int length = snprintf(request, capacity, "{\"jsonrpc\":\"2.0\",\"id\":31,\"method\":\"%s\",\"params\":%s}", method, params);
	reply->wire = malloc(3 * 1024 * 1024);
	bool sent = reply->wire && post_body(request, length, MCP_HEADERS, reply->wire, 3 * 1024 * 1024);
	free(request);
	if (!sent || (response_status(reply->wire) != 200 && response_status(reply->wire) != 400)) {
		read_reply_free(reply);
		return false;
	}
	const char *body = strstr(reply->wire, "\r\n\r\n");
	if (!body) {
		read_reply_free(reply);
		return false;
	}
	const char *content_length = strstr(reply->wire, "\r\nContent-Length: ");
	if (!content_length || strtoull(content_length + 18, NULL, 10) != strlen(body + 4)) {
		read_reply_free(reply);
		return false;
	}
	reply->json = body + 4;
	reply->count = read_json_parse(reply->json, &reply->tokens);
	if (reply->count <= 0) {
		read_reply_free(reply);
		return false;
	}
	reply->result = read_json_member(reply->json, reply->tokens, reply->count, 0, "result");
	reply->structured = read_json_member(reply->json, reply->tokens, reply->count, reply->result, "structuredContent");
	return true;
}

static bool read_tool(const char *name, const char *arguments, read_reply *reply) {
	size_t capacity = strlen(name) + strlen(arguments) + 64;
	char *params = malloc(capacity);
	if (!params) {
		return false;
	}
	snprintf(params, capacity, "{\"name\":\"%s\",\"arguments\":%s}", name, arguments);
	bool result = read_rpc("tools/call", params, reply) && response_status(reply->wire) == 200;
	free(params);
	return result;
}

static bool read_success_is_consistent(const read_reply *reply) {
	if (reply->result < 0 || reply->structured < 0 || reply->tokens[reply->structured].type != JSMN_OBJECT) {
		return false;
	}
	int content = read_json_member(reply->json, reply->tokens, reply->count, reply->result, "content");
	if (content < 0 || reply->tokens[content].type != JSMN_ARRAY || reply->tokens[content].size != 1) {
		return false;
	}
	int type = read_json_member(reply->json, reply->tokens, reply->count, content + 1, "type");
	if (!read_json_is(reply, type, "text")) {
		return false;
	}
	int text = read_json_member(reply->json, reply->tokens, reply->count, content + 1, "text");
	if (text < 0 || reply->tokens[text].type != JSMN_STRING) {
		return false;
	}
	char *decoded = read_json_string(reply->json, reply->tokens + text);
	jsmntok_t *tokens = NULL;
	int parsed = decoded ? read_json_parse(decoded, &tokens) : -1;
	char *plain = decoded ? read_json_compact(decoded, strlen(decoded)) : NULL;
	char *structured = read_json_compact(reply->json + reply->tokens[reply->structured].start, (size_t)(reply->tokens[reply->structured].end - reply->tokens[reply->structured].start));
	bool same = parsed > 0 && plain && structured && !strcmp(plain, structured);
	free(tokens);
	free(decoded);
	free(plain);
	free(structured);
	return same;
}

static bool read_is_error(const read_reply *reply) {
	int field = read_json_member(reply->json, reply->tokens, reply->count, reply->result, "isError");
	return read_json_is(reply, field, "true");
}

static int read_field(const read_reply *reply, int object, const char *name) {
	return read_json_member(reply->json, reply->tokens, reply->count, object, name);
}

static bool read_get(const char *property, read_reply *reply) {
	char arguments[256];
	snprintf(arguments, sizeof(arguments), "{\"device\":\"%s\",\"property\":\"%s\"}", READ_FIXTURE_NAME, property);
	return read_tool("get_property", arguments, reply);
}

static void readable_visibility_and_names_are_preserved(void) {
	ASSERT_TRUE(read_fixture_begin());
	indigo_property *hidden = read_text("X_HIDDEN", INDIGO_RO_PERM, "hidden sentinel");
	hidden->hidden = true;
	ASSERT_TRUE(read_define(hidden));
	ASSERT_TRUE(read_define(read_text("X_WRITE_ONLY", INDIGO_WO_PERM, "write-only sentinel")));
	read_reply reply;
	ASSERT_TRUE(read_tool("list_devices", "{}", &reply));
	ASSERT_TRUE(read_success_is_consistent(&reply));
	int devices = read_field(&reply, reply.structured, "devices");
	ASSERT_TRUE(read_json_named(&reply, devices, "name", READ_FIXTURE_NAME) >= 0);
	read_reply_free(&reply);
	ASSERT_TRUE(read_define(read_text("X_PASSWORD", INDIGO_RO_PERM, "owner-visible password")));
	ASSERT_TRUE(read_define(read_text("X_TOKEN", INDIGO_RW_PERM, "owner-visible token")));
	ASSERT_TRUE(read_tool("list_devices", "{}", &reply));
	ASSERT_TRUE(read_success_is_consistent(&reply));
	devices = read_field(&reply, reply.structured, "devices");
	ASSERT_TRUE(read_json_named(&reply, devices, "name", READ_FIXTURE_NAME) >= 0);
	read_reply_free(&reply);
	ASSERT_TRUE(read_tool("list_properties", "{\"device\":\"" READ_FIXTURE_NAME "\"}", &reply));
	ASSERT_TRUE(read_success_is_consistent(&reply));
	int properties = read_field(&reply, reply.structured, "properties");
	ASSERT_TRUE(read_json_named(&reply, properties, "name", "X_PASSWORD") >= 0);
	ASSERT_TRUE(read_json_named(&reply, properties, "name", "X_TOKEN") >= 0);
	ASSERT_EQ_INT(-1, read_json_named(&reply, properties, "name", "X_HIDDEN"));
	int wo = read_json_named(&reply, properties, "name", "X_WRITE_ONLY");
	ASSERT_TRUE(wo >= 0);
	ASSERT_TRUE(read_json_is(&reply, read_field(&reply, wo, "permission"), "wo"));
	int wo_items = read_field(&reply, wo, "items");
	int wo_item = read_json_named(&reply, wo_items, "name", "VALUE");
	ASSERT_TRUE(wo_item >= 0);
	ASSERT_EQ_INT(-1, read_field(&reply, wo_item, "value"));
	ASSERT_TRUE(strstr(reply.json, "write-only sentinel") == NULL);
	int schema = read_json_named(&reply, properties, "name", "X_PASSWORD");
	int schema_items = read_field(&reply, schema, "items");
	int schema_item = read_json_named(&reply, schema_items, "name", "VALUE");
	ASSERT_TRUE(schema_item >= 0);
	ASSERT_EQ_INT(-1, read_field(&reply, schema_item, "value"));
	read_reply_free(&reply);
	ASSERT_TRUE(read_get("X_PASSWORD", &reply));
	ASSERT_TRUE(read_success_is_consistent(&reply));
	int items = read_field(&reply, reply.structured, "items");
	int item = read_json_named(&reply, items, "name", "VALUE");
	ASSERT_TRUE(read_json_is(&reply, read_field(&reply, item, "value"), "owner-visible password"));
	read_reply_free(&reply);
	ASSERT_TRUE(read_get("X_TOKEN", &reply));
	ASSERT_TRUE(read_success_is_consistent(&reply));
	items = read_field(&reply, reply.structured, "items");
	item = read_json_named(&reply, items, "name", "VALUE");
	ASSERT_TRUE(read_json_is(&reply, read_field(&reply, item, "value"), "owner-visible token"));
	read_reply_free(&reply);
	ASSERT_TRUE(read_get("X_WRITE_ONLY", &reply));
	ASSERT_TRUE(read_is_error(&reply));
	read_reply_free(&reply);
	ASSERT_TRUE(read_get("X_HIDDEN", &reply));
	ASSERT_TRUE(read_is_error(&reply));
	read_reply_free(&reply);
	ASSERT_EQ_INT(0, atomic_load(&read_fixture_writes));
	read_fixture_end();
}

static void number_partial_updates_preserve_schema_and_targets(void) {
	ASSERT_TRUE(read_fixture_begin());
	indigo_property *property = indigo_init_number_property(NULL, READ_FIXTURE_NAME, "X_NUMBERS", "Read fixture", "Number metadata", INDIGO_OK_STATE, INDIGO_RO_PERM, 2);
	indigo_init_number_item(property->items, "FIRST", "First label", -10, 100, 0.5, 1);
	indigo_init_number_item(property->items + 1, "SECOND", "Second label", -10, 100, 0.5, 2);
	strcpy(property->items[0].number.format, "%.2f");
	strcpy(property->items[1].number.format, "%.2f");
	property->items[0].number.target = 11;
	property->items[1].number.target = 22;
	ASSERT_TRUE(read_define(property));
	indigo_property *update = indigo_init_number_property(NULL, READ_FIXTURE_NAME, "X_NUMBERS", "", "", INDIGO_BUSY_STATE, INDIGO_RO_PERM, 1);
	indigo_init_number_item(update->items, "SECOND", "", 0, 0, 0, 9);
	update->items[0].number.target = 33;
	ASSERT_EQ_INT(INDIGO_OK, indigo_update_property(&read_fixture, update, NULL));
	indigo_release_property(update);
	read_reply reply;
	ASSERT_TRUE(read_get("X_NUMBERS", &reply));
	ASSERT_TRUE(read_success_is_consistent(&reply));
	ASSERT_TRUE(read_json_is(&reply, read_field(&reply, reply.structured, "type"), "number"));
	ASSERT_TRUE(read_json_is(&reply, read_field(&reply, reply.structured, "permission"), "ro"));
	ASSERT_TRUE(read_json_is(&reply, read_field(&reply, reply.structured, "state"), "Busy"));
	int items = read_field(&reply, reply.structured, "items");
	ASSERT_EQ_INT(2, reply.tokens[items].size);
	int first = read_json_named(&reply, items, "name", "FIRST");
	int second = read_json_named(&reply, items, "name", "SECOND");
	ASSERT_TRUE(read_json_is(&reply, read_field(&reply, first, "value"), "1"));
	ASSERT_TRUE(read_json_is(&reply, read_field(&reply, first, "target"), "11"));
	ASSERT_TRUE(read_json_is(&reply, read_field(&reply, second, "value"), "9"));
	ASSERT_TRUE(read_json_is(&reply, read_field(&reply, second, "target"), "33"));
	ASSERT_EQ_INT(JSMN_PRIMITIVE, reply.tokens[read_field(&reply, second, "value")].type);
	ASSERT_EQ_INT(JSMN_PRIMITIVE, reply.tokens[read_field(&reply, second, "target")].type);
	ASSERT_TRUE(read_json_is(&reply, read_field(&reply, second, "label"), "Second label"));
	ASSERT_TRUE(read_json_is(&reply, read_field(&reply, second, "min"), "-10"));
	ASSERT_TRUE(read_json_is(&reply, read_field(&reply, second, "max"), "100"));
	ASSERT_TRUE(read_json_is(&reply, read_field(&reply, second, "step"), "0.5"));
	ASSERT_TRUE(read_json_is(&reply, read_field(&reply, second, "format"), "%.2f"));
	read_reply_free(&reply);
	ASSERT_TRUE(read_tool("list_properties", "{\"device\":\"" READ_FIXTURE_NAME "\"}", &reply));
	ASSERT_TRUE(read_success_is_consistent(&reply));
	int properties = read_field(&reply, reply.structured, "properties");
	int schema = read_json_named(&reply, properties, "name", "X_NUMBERS");
	items = read_field(&reply, schema, "items");
	second = read_json_named(&reply, items, "name", "SECOND");
	ASSERT_TRUE(read_json_is(&reply, read_field(&reply, second, "min"), "-10"));
	ASSERT_TRUE(read_json_is(&reply, read_field(&reply, second, "max"), "100"));
	ASSERT_EQ_INT(-1, read_field(&reply, second, "value"));
	ASSERT_EQ_INT(-1, read_field(&reply, second, "target"));
	read_reply_free(&reply);
	update = indigo_init_number_property(NULL, READ_FIXTURE_NAME, "X_NUMBERS", "", "", INDIGO_OK_STATE, INDIGO_RO_PERM, 1);
	indigo_init_number_item(update->items, "SECOND", "", 0, 0, 0, 10);
	update->items[0].number.target = 0;
	ASSERT_EQ_INT(INDIGO_OK, indigo_update_property(&read_fixture, update, NULL));
	indigo_release_property(update);
	ASSERT_TRUE(read_get("X_NUMBERS", &reply));
	ASSERT_TRUE(read_success_is_consistent(&reply));
	items = read_field(&reply, reply.structured, "items");
	first = read_json_named(&reply, items, "name", "FIRST");
	second = read_json_named(&reply, items, "name", "SECOND");
	ASSERT_TRUE(read_json_is(&reply, read_field(&reply, first, "target"), "11"));
	ASSERT_TRUE(read_json_is(&reply, read_field(&reply, second, "value"), "10"));
	ASSERT_TRUE(read_json_is(&reply, read_field(&reply, second, "target"), "0"));
	read_reply_free(&reply);
	read_fixture_end();
}

static void large_dynamic_text_has_owned_untruncated_snapshots(void) {
	ASSERT_TRUE(read_fixture_begin());
	size_t size = 600 * 1024;
	char *text = malloc(size + 1);
	ASSERT_TRUE(text != NULL);
	memset(text, 'q', size);
	memcpy(text, "quote:\"\\newline:\n", 17);
	memcpy(text + size - 8, "TAIL-END", 8);
	text[size] = 0;
	indigo_property *property = read_text("X_LONG_TEXT", INDIGO_RO_PERM, text);
	ASSERT_TRUE(read_define(property));
	indigo_set_text_item_value(property->items, "mutated without update");
	read_reply reply;
	ASSERT_TRUE(read_get("X_LONG_TEXT", &reply));
	ASSERT_TRUE(read_success_is_consistent(&reply));
	int items = read_field(&reply, reply.structured, "items");
	int item = read_json_named(&reply, items, "name", "VALUE");
	int value = read_field(&reply, item, "value");
	char *decoded = value >= 0 ? read_json_string(reply.json, reply.tokens + value) : NULL;
	bool matches = decoded && strlen(decoded) == size && !memcmp(decoded, text, size);
	free(decoded);
	free(text);
	ASSERT_TRUE(matches);
	ASSERT_TRUE(strlen(reply.wire) > 1024 * 1024);
	read_reply_free(&reply);
	read_fixture_end();
}

static atomic_int blob_fetches;

static bool blob_probe_handler(indigo_uni_handle *handle, char *method, char *path, char *params) {
	atomic_fetch_add(&blob_fetches, 1);
	indigo_uni_printf(handle, "HTTP/1.1 200 OK\r\nContent-Length: 4\r\nConnection: close\r\n\r\ndata");
	return false;
}

static void blobs_are_urls_without_payload_copy_or_fetch(void) {
	ASSERT_TRUE(read_fixture_begin());
	indigo_property *property = indigo_init_blob_property(NULL, READ_FIXTURE_NAME, "X_BLOB_URL", "Read fixture", "BLOB metadata", INDIGO_OK_STATE, 1);
	property->perm = INDIGO_RO_PERM;
	indigo_init_blob_item(property->items, "IMAGE", "Image");
	strcpy(property->items[0].blob.format, ".fits");
	property->items[0].blob.size = 262144;
	property->items[0].blob.value = (void *)(uintptr_t)1;
	char expected[256];
	snprintf(expected, sizeof(expected), "/blob/%p.fits", property->items);
	bool defined = read_define(property);
	property->items[0].blob.value = NULL;
	ASSERT_TRUE(defined);
	read_reply reply;
	ASSERT_TRUE(read_get("X_BLOB_URL", &reply));
	ASSERT_TRUE(read_success_is_consistent(&reply));
	int items = read_field(&reply, reply.structured, "items");
	int item = read_json_named(&reply, items, "name", "IMAGE");
	ASSERT_TRUE(read_json_is(&reply, read_field(&reply, item, "url"), expected));
	ASSERT_TRUE(read_json_is(&reply, read_field(&reply, item, "format"), ".fits"));
	ASSERT_TRUE(read_json_is(&reply, read_field(&reply, item, "size"), "262144"));
	ASSERT_EQ_INT(JSMN_STRING, reply.tokens[read_field(&reply, item, "url")].type);
	ASSERT_EQ_INT(JSMN_PRIMITIVE, reply.tokens[read_field(&reply, item, "size")].type);
	ASSERT_EQ_INT(-1, read_field(&reply, item, "value"));
	ASSERT_EQ_INT(-1, read_field(&reply, item, "encoding"));
	read_reply_free(&reply);
	indigo_server_add_handler("/blob-probe", blob_probe_handler);
	atomic_store(&blob_fetches, 0);
	snprintf(property->items[0].blob.url, sizeof(property->items[0].blob.url), "http://127.0.0.1:%d/blob-probe", indigo_server_tcp_port);
	ASSERT_EQ_INT(INDIGO_OK, indigo_define_property(&read_fixture, property, NULL));
	ASSERT_TRUE(read_get("X_BLOB_URL", &reply));
	ASSERT_TRUE(read_success_is_consistent(&reply));
	items = read_field(&reply, reply.structured, "items");
	item = read_json_named(&reply, items, "name", "IMAGE");
	ASSERT_TRUE(read_json_is(&reply, read_field(&reply, item, "url"), property->items[0].blob.url));
	ASSERT_EQ_INT(0, atomic_load(&blob_fetches));
	read_reply_free(&reply);
	indigo_server_remove_resource("/blob-probe");
	bool previous_caching = indigo_use_blob_caching;
	indigo_use_blob_caching = true;
	indigo_property *local = indigo_init_blob_property(NULL, READ_FIXTURE_NAME, "X_BLOB_LOCAL", "Read fixture", "Local BLOB", INDIGO_OK_STATE, 1);
	local->perm = INDIGO_RO_PERM;
	indigo_init_blob_item(local->items, "IMAGE", "Image");
	strcpy(local->items[0].blob.format, ".fits");
	local->items[0].blob.size = 6;
	local->items[0].blob.value = malloc(6);
	ASSERT_TRUE(local->items[0].blob.value != NULL);
	memcpy(local->items[0].blob.value, "pixels", 6);
	ASSERT_TRUE(read_define(local));
	ASSERT_EQ_INT(INDIGO_OK, indigo_update_property(&read_fixture, local, NULL));
	ASSERT_TRUE(read_get("X_BLOB_LOCAL", &reply));
	ASSERT_TRUE(read_success_is_consistent(&reply));
	items = read_field(&reply, reply.structured, "items");
	item = read_json_named(&reply, items, "name", "IMAGE");
	snprintf(expected, sizeof(expected), "/blob/%p.fits", local->items);
	ASSERT_TRUE(read_json_is(&reply, read_field(&reply, item, "url"), expected));
	read_reply_free(&reply);
	char get[512], response[1024];
	int length = snprintf(get, sizeof(get), "GET %s HTTP/1.1\r\nConnection: close\r\n\r\n", expected);
	ASSERT_TRUE(exchange(get, length, response, sizeof(response)));
	ASSERT_EQ_INT(200, response_status(response));
	const char *blob = strstr(response, "\r\n\r\n");
	ASSERT_TRUE(blob != NULL && !strcmp(blob + 4, "pixels"));
	read_fixture_end();
	indigo_use_blob_caching = previous_caching;
}

static void switches_lights_and_schema_redefinition_are_typed(void) {
	ASSERT_TRUE(read_fixture_begin());
	indigo_property *property = indigo_init_switch_property(NULL, READ_FIXTURE_NAME, "X_TYPED", "Read fixture", "Switches", INDIGO_ALERT_STATE, INDIGO_RW_PERM, INDIGO_ANY_OF_MANY_RULE, 2);
	indigo_init_switch_item(property->items, "ON", "On", true);
	indigo_init_switch_item(property->items + 1, "OFF", "Off", false);
	ASSERT_TRUE(read_define(property));
	read_reply reply;
	ASSERT_TRUE(read_get("X_TYPED", &reply));
	ASSERT_TRUE(read_success_is_consistent(&reply));
	ASSERT_TRUE(read_json_is(&reply, read_field(&reply, reply.structured, "type"), "switch"));
	ASSERT_TRUE(read_json_is(&reply, read_field(&reply, reply.structured, "rule"), "AnyOfMany"));
	int items = read_field(&reply, reply.structured, "items");
	int on = read_json_named(&reply, items, "name", "ON");
	int off = read_json_named(&reply, items, "name", "OFF");
	ASSERT_EQ_INT(JSMN_PRIMITIVE, reply.tokens[read_field(&reply, on, "value")].type);
	ASSERT_TRUE(read_json_is(&reply, read_field(&reply, on, "value"), "true"));
	ASSERT_TRUE(read_json_is(&reply, read_field(&reply, off, "value"), "false"));
	read_reply_free(&reply);
	indigo_property *replacement = indigo_init_light_property(NULL, READ_FIXTURE_NAME, "X_TYPED", "Read fixture", "Lights", INDIGO_OK_STATE, 1);
	indigo_init_light_item(replacement->items, "LAMP", "Lamp", INDIGO_ALERT_STATE);
	read_properties[0] = replacement;
	ASSERT_EQ_INT(INDIGO_OK, indigo_define_property(&read_fixture, replacement, NULL));
	indigo_release_property(property);
	ASSERT_TRUE(read_get("X_TYPED", &reply));
	ASSERT_TRUE(read_success_is_consistent(&reply));
	ASSERT_TRUE(read_json_is(&reply, read_field(&reply, reply.structured, "type"), "light"));
	ASSERT_EQ_INT(-1, read_field(&reply, reply.structured, "rule"));
	items = read_field(&reply, reply.structured, "items");
	ASSERT_EQ_INT(1, reply.tokens[items].size);
	int lamp = read_json_named(&reply, items, "name", "LAMP");
	ASSERT_TRUE(read_json_is(&reply, read_field(&reply, lamp, "value"), "Alert"));
	ASSERT_EQ_INT(-1, read_json_named(&reply, items, "name", "ON"));
	read_reply_free(&reply);
	read_fixture_end();
}

static void deletion_and_reload_refresh_the_bus_view(void) {
	ASSERT_TRUE(read_fixture_begin());
	indigo_property *property = read_text("X_DELETE", INDIGO_RO_PERM, "before reload");
	ASSERT_TRUE(read_define(property));
	read_reply reply;
	ASSERT_TRUE(read_get("X_DELETE", &reply));
	ASSERT_TRUE(read_success_is_consistent(&reply));
	read_reply_free(&reply);
	indigo_set_text_item_value(property->items, "after reload");
	ASSERT_EQ_INT(INDIGO_OK, indigo_agent_mcp(INDIGO_DRIVER_SHUTDOWN, NULL));
	agent_started = false;
	ASSERT_TRUE(ensure_fixture());
	ASSERT_TRUE(read_get("X_DELETE", &reply));
	ASSERT_TRUE(read_success_is_consistent(&reply));
	int items = read_field(&reply, reply.structured, "items");
	int item = read_json_named(&reply, items, "name", "VALUE");
	ASSERT_TRUE(read_json_is(&reply, read_field(&reply, item, "value"), "after reload"));
	read_reply_free(&reply);
	ASSERT_EQ_INT(INDIGO_OK, indigo_delete_property(&read_fixture, property, NULL));
	read_properties[0] = NULL;
	indigo_release_property(property);
	ASSERT_TRUE(read_get("X_DELETE", &reply));
	ASSERT_TRUE(read_is_error(&reply));
	read_reply_free(&reply);
	ASSERT_TRUE(read_define(read_text("X_DEVICE_DELETE", INDIGO_RO_PERM, "will disappear")));
	read_fixture_end();
	ASSERT_TRUE(read_tool("list_devices", "{}", &reply));
	ASSERT_TRUE(read_success_is_consistent(&reply));
	int devices = read_field(&reply, reply.structured, "devices");
	ASSERT_EQ_INT(-1, read_json_named(&reply, devices, "name", READ_FIXTURE_NAME));
	read_reply_free(&reply);
	ASSERT_TRUE(read_get("X_DEVICE_DELETE", &reply));
	ASSERT_TRUE(read_is_error(&reply));
	read_reply_free(&reply);
}

static void unicode_argument_names_are_decoded(void) {
	ASSERT_TRUE(read_fixture_begin());
	ASSERT_TRUE(read_define(read_text("X_Café_😀", INDIGO_RO_PERM, "café 😀")));
	read_reply reply;
	ASSERT_TRUE(read_tool("get_property", "{\"device\":\"MCP Reader Fixture @ Rem\\u006fte\",\"property\":\"X_Caf\\u00e9_\\ud83d\\ude00\"}", &reply));
	ASSERT_TRUE(read_success_is_consistent(&reply));
	int name = read_field(&reply, reply.structured, "name");
	char *decoded = name >= 0 ? read_json_string(reply.json, reply.tokens + name) : NULL;
	bool matches = decoded && !strcmp(decoded, "X_Café_😀");
	free(decoded);
	ASSERT_TRUE(matches);
	int items = read_field(&reply, reply.structured, "items");
	int item = read_json_named(&reply, items, "name", "VALUE");
	int value = read_field(&reply, item, "value");
	decoded = value >= 0 ? read_json_string(reply.json, reply.tokens + value) : NULL;
	matches = decoded && !strcmp(decoded, "café 😀");
	free(decoded);
	ASSERT_TRUE(matches);
	read_reply_free(&reply);
	read_fixture_end();
}

typedef struct {
	pthread_mutex_t mutex;
	pthread_cond_t condition;
	int requested;
	int finished;
	bool done;
	bool passed;
} read_race;

static void *read_snapshots_during_updates(void *data) {
	read_race *race = data;
	for (int i = 1; i <= 20; i++) {
		pthread_mutex_lock(&race->mutex);
		race->requested = i;
		pthread_cond_broadcast(&race->condition);
		pthread_mutex_unlock(&race->mutex);
		read_reply reply;
		bool passed = read_get("X_RACE_NUMBER", &reply);
		if (passed) {
			passed = read_success_is_consistent(&reply);
			int items = read_field(&reply, reply.structured, "items");
			int item = read_json_named(&reply, items, "name", "VALUE");
			int value = read_field(&reply, item, "value");
			passed = passed && value >= 0 && reply.tokens[value].type == JSMN_PRIMITIVE && read_json_is(&reply, read_field(&reply, item, "target"), "0");
			read_reply_free(&reply);
		}
		bool text_passed = read_get("X_RACE_TEXT", &reply);
		if (text_passed) {
			text_passed = read_success_is_consistent(&reply);
			int items = read_field(&reply, reply.structured, "items");
			int item = read_json_named(&reply, items, "name", "VALUE");
			int value = read_field(&reply, item, "value");
			text_passed = text_passed && value >= 0 && reply.tokens[value].type == JSMN_STRING;
			read_reply_free(&reply);
		}
		pthread_mutex_lock(&race->mutex);
		race->passed = race->passed && passed && text_passed;
		race->finished = i;
		pthread_cond_broadcast(&race->condition);
		pthread_mutex_unlock(&race->mutex);
	}
	pthread_mutex_lock(&race->mutex);
	race->done = true;
	pthread_cond_broadcast(&race->condition);
	pthread_mutex_unlock(&race->mutex);
	return NULL;
}

static void reads_are_consistent_during_bus_updates(void) {
	ASSERT_TRUE(read_fixture_begin());
	indigo_property *number = indigo_init_number_property(NULL, READ_FIXTURE_NAME, "X_RACE_NUMBER", "Read fixture", "Concurrent number", INDIGO_OK_STATE, INDIGO_RO_PERM, 1);
	indigo_init_number_item(number->items, "VALUE", "Value", 0, 100, 1, 0);
	indigo_property *text = read_text("X_RACE_TEXT", INDIGO_RO_PERM, "initial");
	ASSERT_TRUE(read_define(number));
	ASSERT_TRUE(read_define(text));
	read_race race = { .mutex = PTHREAD_MUTEX_INITIALIZER, .condition = PTHREAD_COND_INITIALIZER, .passed = true };
	pthread_t reader;
	ASSERT_EQ_INT(0, pthread_create(&reader, NULL, read_snapshots_during_updates, &race));
	bool changed = true;
	for (int i = 1; i <= 20; i++) {
		pthread_mutex_lock(&race.mutex);
		while (race.requested < i && !race.done) {
			pthread_cond_wait(&race.condition, &race.mutex);
		}
		pthread_mutex_unlock(&race.mutex);
		number->items[0].number.value = i;
		char value[32];
		snprintf(value, sizeof(value), "round-%d", i);
		indigo_set_text_item_value(text->items, value);
		changed = indigo_update_property(&read_fixture, number, NULL) == INDIGO_OK && indigo_update_property(&read_fixture, text, NULL) == INDIGO_OK && changed;
		pthread_mutex_lock(&race.mutex);
		while (race.finished < i && !race.done) {
			pthread_cond_wait(&race.condition, &race.mutex);
		}
		pthread_mutex_unlock(&race.mutex);
	}
	pthread_join(reader, NULL);
	pthread_cond_destroy(&race.condition);
	pthread_mutex_destroy(&race.mutex);
	ASSERT_TRUE(changed && race.passed && race.finished == 20);
	ASSERT_EQ_INT(0, atomic_load(&read_fixture_writes));
	read_fixture_end();
}

static void tool_argument_and_lookup_failures_are_distinct(void) {
	ASSERT_TRUE(read_fixture_begin());
	ASSERT_TRUE(read_define(read_text("X_CASE", INDIGO_RO_PERM, "case-sensitive")));
	read_reply reply;
	const char *names[] = { "list_properties", "get_property", "list_properties" };
	const char *arguments[] = { "{}", "{\"device\":\"" READ_FIXTURE_NAME "\"}", "{\"device\":7}" };
	for (int i = 0; i < 3; i++) {
		ASSERT_TRUE(read_tool(names[i], arguments[i], &reply));
		int error = read_field(&reply, 0, "error");
		ASSERT_TRUE(read_json_is(&reply, read_field(&reply, error, "code"), "-32602"));
		read_reply_free(&reply);
	}
	ASSERT_TRUE(read_get("x_case", &reply));
	ASSERT_TRUE(read_is_error(&reply));
	read_reply_free(&reply);
	ASSERT_TRUE(read_tool("list_properties", "{\"device\":\"mcp reader fixture @ Remote\"}", &reply));
	ASSERT_TRUE(read_is_error(&reply));
	read_reply_free(&reply);
	ASSERT_EQ_INT(0, atomic_load(&read_fixture_writes));
	read_fixture_end();
}

static bool write_set(const char *property, const char *items, const char *extra, read_reply *reply) {
	size_t size = strlen(property) + strlen(items) + strlen(extra) + 256;
	char *arguments = malloc(size);
	if (!arguments) {
		return false;
	}
	snprintf(arguments, size, "{\"device\":\"" READ_FIXTURE_NAME "\",\"property\":\"%s\",\"items\":%s%s}", property, items, extra);
	bool result = read_tool("set_property", arguments, reply);
	free(arguments);
	return result;
}

static bool write_dispatched(const read_reply *reply) {
	return read_success_is_consistent(reply) && read_json_is(reply, read_field(reply, reply->structured, "dispatched"), "true") && read_json_is(reply, read_field(reply, reply->structured, "completion"), "not_confirmed");
}

static void partial_number_writes_report_dispatch_only(void) {
	ASSERT_TRUE(read_fixture_begin());
	indigo_property *property = indigo_init_number_property(NULL, READ_FIXTURE_NAME, "X_WRITE_NUMBER", "Write fixture", "Writable numbers", INDIGO_OK_STATE, INDIGO_RW_PERM, 2);
	indigo_init_number_item(property->items, "FIRST", "First", -10, 100, 1, 1);
	indigo_init_number_item(property->items + 1, "SECOND", "Second", -10, 100, 1, 2);
	ASSERT_TRUE(read_define(property));
	write_capture = true;
	read_reply reply;
	const char *invalid_values[] = { "{\"SECOND\":\"7\"}", "{\"SECOND\":true}", "{\"SECOND\":1e999}" };
	for (int i = 0; i < 3; i++) {
		ASSERT_TRUE(write_set("X_WRITE_NUMBER", invalid_values[i], "", &reply));
		int error = read_field(&reply, 0, "error");
		ASSERT_TRUE(read_json_is(&reply, read_field(&reply, error, "code"), "-32602"));
		read_reply_free(&reply);
	}
	ASSERT_EQ_INT(0, atomic_load(&read_fixture_writes));
	ASSERT_TRUE(write_set("X_WRITE_NUMBER", "{\"SECOND\":7.5}", "", &reply));
	ASSERT_TRUE(write_dispatched(&reply));
	ASSERT_EQ_INT(1, atomic_load(&read_fixture_writes));
	ASSERT_EQ_INT(1, write_request->count);
	ASSERT_STREQ("SECOND", write_request->items[0].name);
	ASSERT_TRUE(write_request->items[0].number.value == 7.5);
	ASSERT_TRUE(write_request->items[0].number.target == 7.5);
	read_reply_free(&reply);
	ASSERT_TRUE(write_set("X_WRITE_NUMBER", "{\"SECOND\":0.1e309}", "", &reply));
	ASSERT_TRUE(write_dispatched(&reply));
	ASSERT_TRUE(write_request->items[0].number.target == 1e308);
	read_reply_free(&reply);
	char compensated[450];
	memcpy(compensated, "{\"SECOND\":0.", 12);
	memset(compensated + 12, '0', 399);
	strcpy(compensated + 411, "1e400}");
	ASSERT_TRUE(write_set("X_WRITE_NUMBER", compensated, "", &reply));
	ASSERT_TRUE(write_dispatched(&reply));
	ASSERT_TRUE(write_request->items[0].number.target == 1);
	read_reply_free(&reply);
	char *saved_locale = strdup(setlocale(LC_NUMERIC, NULL));
	ASSERT_TRUE(saved_locale != NULL);
	const char *locales[] = { "fr_FR.UTF-8", "cs_CZ.UTF-8", "sk_SK.UTF-8", "fr_FR", "de_DE.UTF-8" };
	bool comma_locale = false;
	for (size_t i = 0; i < sizeof(locales) / sizeof(locales[0]); i++) {
		if (setlocale(LC_NUMERIC, locales[i]) && !strcmp(localeconv()->decimal_point, ",")) {
			comma_locale = true;
			break;
		}
	}
	bool locale_passed = true;
	if (comma_locale) {
		locale_passed = write_set("X_WRITE_NUMBER", "{\"SECOND\":1.25}", "", &reply);
		locale_passed = locale_passed && write_dispatched(&reply) && write_request->items[0].number.target == 1.25;
		read_reply_free(&reply);
	} else {
		fprintf(stderr, "Comma-decimal locale unavailable; optional locale check not executed\n");
	}
	bool locale_restored = setlocale(LC_NUMERIC, saved_locale) != NULL;
	free(saved_locale);
	ASSERT_TRUE(locale_passed && locale_restored);
	ASSERT_TRUE(read_get("X_WRITE_NUMBER", &reply));
	ASSERT_TRUE(read_json_is(&reply, read_field(&reply, reply.structured, "state"), "Busy"));
	read_reply_free(&reply);
	property->items[1].number.value = 7.5;
	property->state = INDIGO_OK_STATE;
	ASSERT_EQ_INT(INDIGO_OK, indigo_update_property(&read_fixture, property, NULL));
	ASSERT_TRUE(read_get("X_WRITE_NUMBER", &reply));
	ASSERT_TRUE(read_json_is(&reply, read_field(&reply, reply.structured, "state"), "Ok"));
	read_reply_free(&reply);
	read_fixture_end();
}

static void write_only_and_switch_values_are_dispatched(void) {
	ASSERT_TRUE(read_fixture_begin());
	ASSERT_TRUE(read_define(read_text("X_WRITE_ONLY", INDIGO_WO_PERM, "never expose this")));
	write_capture = true;
	read_reply reply;
	ASSERT_TRUE(write_set("X_WRITE_ONLY", "{\"VALUE\":\"new secret\"}", "", &reply));
	ASSERT_TRUE(write_dispatched(&reply));
	ASSERT_STREQ("new secret", indigo_get_text_item_value(write_request->items));
	read_reply_free(&reply);
	ASSERT_TRUE(read_get("X_WRITE_ONLY", &reply));
	ASSERT_TRUE(read_is_error(&reply));
	ASSERT_TRUE(strstr(reply.json, "new secret") == NULL);
	read_reply_free(&reply);
	indigo_property *property = indigo_init_switch_property(NULL, READ_FIXTURE_NAME, "X_WRITE_SWITCH", "Write fixture", "Switch", INDIGO_OK_STATE, INDIGO_RW_PERM, INDIGO_ANY_OF_MANY_RULE, 2);
	indigo_init_switch_item(property->items, "ON", "On", false);
	indigo_init_switch_item(property->items + 1, "OFF", "Off", true);
	ASSERT_TRUE(read_define(property));
	ASSERT_TRUE(write_set("X_WRITE_SWITCH", "{\"ON\":true,\"OFF\":false}", "", &reply));
	ASSERT_TRUE(write_dispatched(&reply));
	ASSERT_EQ_INT(2, write_request->count);
	ASSERT_TRUE(write_request->items[0].sw.value);
	ASSERT_FALSE(write_request->items[1].sw.value);
	ASSERT_EQ_INT(2, atomic_load(&read_fixture_writes));
	read_reply_free(&reply);
	read_fixture_end();
}

static void unicode_and_long_text_writes_keep_exact_values(void) {
	ASSERT_TRUE(read_fixture_begin());
	ASSERT_TRUE(read_define(read_text("X_Café_😀", INDIGO_RW_PERM, "old")));
	write_capture = true;
	char *items = malloc(24064);
	ASSERT_TRUE(items != NULL);
	memcpy(items, "{\"VALUE\":\"", 10);
	memset(items + 10, 'q', 24000);
	strcpy(items + 24010, "\\n\\u00e9\\ud83d\\ude00\"}");
	read_reply reply;
	ASSERT_TRUE(write_set("X_Caf\\u00e9_\\ud83d\\ude00", items, "", &reply));
	ASSERT_TRUE(write_dispatched(&reply));
	ASSERT_STREQ("X_Café_😀", write_request->name);
	const char *value = indigo_get_text_item_value(write_request->items);
	ASSERT_EQ_INT(24007, strlen(value));
	ASSERT_TRUE(!memcmp(value, items + 10, 24000));
	ASSERT_STREQ("\né😀", value + 24000);
	free(items);
	read_reply_free(&reply);
	read_fixture_end();
}

static void invalid_writes_have_no_bus_effects(void) {
	ASSERT_TRUE(read_fixture_begin());
	ASSERT_TRUE(read_define(read_text("X_WRITE", INDIGO_RW_PERM, "old")));
	ASSERT_TRUE(read_define(read_text("X_READ_ONLY", INDIGO_RO_PERM, "old")));
	indigo_property *hidden = read_text("X_HIDDEN", INDIGO_RW_PERM, "old");
	hidden->hidden = true;
	ASSERT_TRUE(read_define(hidden));
	write_capture = true;
	const char *invalid[] = { "{}", "{\"device\":\"\",\"property\":\"X_WRITE\",\"items\":{\"VALUE\":\"x\"}}", "{\"device\":\"" READ_FIXTURE_NAME "\",\"property\":\"X_WRITE\",\"items\":{}}", "{\"device\":\"" READ_FIXTURE_NAME "\",\"property\":\"X_WRITE\",\"items\":{\"VALUE\":1}}", "{\"device\":\"" READ_FIXTURE_NAME "\",\"property\":\"X_WRITE\",\"items\":{\"VALUE\":\"a\",\"VALUE\":\"b\"}}", "{\"device\":\"" READ_FIXTURE_NAME "\",\"property\":\"X_WRITE\",\"items\":{\"UNKNOWN\":\"x\"}}" };
	read_reply reply;
	for (size_t i = 0; i < sizeof(invalid) / sizeof(invalid[0]); i++) {
		ASSERT_TRUE(read_tool("set_property", invalid[i], &reply));
		int error = read_field(&reply, 0, "error");
		ASSERT_TRUE(read_json_is(&reply, read_field(&reply, error, "code"), "-32602"));
		read_reply_free(&reply);
	}
	const char *denied[] = { "X_READ_ONLY", "X_HIDDEN", "X_MISSING" };
	for (int i = 0; i < 3; i++) {
		ASSERT_TRUE(write_set(denied[i], "{\"VALUE\":\"x\"}", "", &reply));
		ASSERT_TRUE(read_is_error(&reply));
		read_reply_free(&reply);
	}
	const char *tokens[] = { ",\"token\":1", ",\"token\":\"xyz\"", ",\"token\":\"\"", ",\"token\":\"10000000000000000\"" };
	for (int i = 0; i < 4; i++) {
		ASSERT_TRUE(write_set("X_WRITE", "{\"VALUE\":\"x\"}", tokens[i], &reply));
		int error = read_field(&reply, 0, "error");
		ASSERT_TRUE(read_json_is(&reply, read_field(&reply, error, "code"), "-32602"));
		read_reply_free(&reply);
	}
	ASSERT_EQ_INT(0, atomic_load(&read_fixture_writes));
	read_fixture_end();
}

static void explicit_tokens_respect_native_locking(void) {
	ASSERT_TRUE(read_fixture_begin());
	ASSERT_TRUE(read_define(read_text("X_LOCKED", INDIGO_RW_PERM, "old")));
	write_capture = true;
	read_fixture.access_token = 0x123456789abcdef0ULL;
	indigo_set_master_token(0xfedcba9876543210ULL);
	const char *tokens[] = { "", ",\"token\":\"abcd\"", ",\"token\":\"123456789abcdef0\"", ",\"token\":\"fedcba9876543210\"" };
	read_reply reply;
	for (int i = 0; i < 4; i++) {
		ASSERT_TRUE(write_set("X_LOCKED", "{\"VALUE\":\"x\"}", tokens[i], &reply));
		ASSERT_TRUE(write_dispatched(&reply));
		ASSERT_EQ_INT(i < 2 ? 0 : i - 1, atomic_load(&read_fixture_writes));
		read_reply_free(&reply);
	}
	ASSERT_TRUE(write_token == 0xfedcba9876543210ULL);
	read_fixture_end();
}

static void unsupported_write_types_never_dispatch(void) {
	ASSERT_TRUE(read_fixture_begin());
	indigo_property *blob = indigo_init_blob_property(NULL, READ_FIXTURE_NAME, "X_WRITE_BLOB", "Write fixture", "Blob", INDIGO_OK_STATE, 1);
	blob->perm = INDIGO_WO_PERM;
	indigo_init_blob_item(blob->items, "VALUE", "Blob");
	ASSERT_TRUE(read_define(blob));
	indigo_property *light = indigo_init_light_property(NULL, READ_FIXTURE_NAME, "X_WRITE_LIGHT", "Write fixture", "Light", INDIGO_OK_STATE, 1);
	indigo_init_light_item(light->items, "VALUE", "Light", INDIGO_OK_STATE);
	ASSERT_TRUE(read_define(light));
	write_capture = true;
	read_reply reply;
	ASSERT_TRUE(write_set("X_WRITE_BLOB", "{\"VALUE\":\"http://127.0.0.1/no-fetch\"}", "", &reply));
	ASSERT_TRUE(read_is_error(&reply));
	read_reply_free(&reply);
	ASSERT_TRUE(write_set("X_WRITE_LIGHT", "{\"VALUE\":\"Ok\"}", "", &reply));
	ASSERT_TRUE(read_is_error(&reply));
	read_reply_free(&reply);
	ASSERT_EQ_INT(0, atomic_load(&read_fixture_writes));
	read_fixture_end();
}

static void self_unload_is_busy_and_connection_is_unavailable(void) {
	ASSERT_TRUE(read_fixture_begin());
	ASSERT_TRUE(read_define(read_text("X_SELF_UNLOAD", INDIGO_RW_PERM, "old")));
	write_capture = true;
	write_self_unload = true;
	write_unload_result = INDIGO_OK;
	read_reply reply;
	ASSERT_TRUE(write_set("X_SELF_UNLOAD", "{\"VALUE\":\"x\"}", "", &reply));
	ASSERT_TRUE(write_dispatched(&reply));
	ASSERT_EQ_INT(INDIGO_BUSY, write_unload_result);
	read_reply_free(&reply);
	ASSERT_TRUE(read_get("X_SELF_UNLOAD", &reply));
	ASSERT_TRUE(read_success_is_consistent(&reply));
	read_reply_free(&reply);
	ASSERT_TRUE(read_tool("list_properties", "{\"device\":\"" MCP_AGENT_NAME "\"}", &reply));
	ASSERT_TRUE(read_success_is_consistent(&reply));
	int properties = read_field(&reply, reply.structured, "properties");
	ASSERT_EQ_INT(-1, read_json_named(&reply, properties, "name", CONNECTION_PROPERTY_NAME));
	read_reply_free(&reply);
	ASSERT_TRUE(read_tool("get_property", "{\"device\":\"" MCP_AGENT_NAME "\",\"property\":\"CONNECTION\"}", &reply));
	ASSERT_TRUE(read_is_error(&reply));
	read_reply_free(&reply);
	ASSERT_TRUE(read_tool("set_property", "{\"device\":\"" MCP_AGENT_NAME "\",\"property\":\"CONNECTION\",\"items\":{\"DISCONNECTED\":true}}", &reply));
	ASSERT_TRUE(read_is_error(&reply));
	read_reply_free(&reply);
	char response[4096];
	ASSERT_TRUE(post_body(ping_request, strlen(ping_request), MCP_HEADERS, response, sizeof(response)));
	ASSERT_EQ_INT(200, response_status(response));
	read_fixture_end();
}

static const char *help_topics[] = {
	"README.md", "instructions.md", "server-and-devices.md", "agent-catalog.md", "acceptance-scenarios.md",
	"agents/imager.md", "agents/guider.md", "agents/mount.md", "agents/platesolver.md", "agents/astrometry.md",
	"agents/configuration.md", "agents/auxiliary.md", "agents/scripting.md", "agents/sequencer.md", "agents/alpaca.md", "agents/mcp.md", "agents/test.md", "reference/sequencer.md"
};

static char *help_reply_text(const read_reply *reply, bool resource) {
	int contents = read_field(reply, reply->result, resource ? "contents" : "content");
	if (contents < 0 || reply->tokens[contents].type != JSMN_ARRAY || reply->tokens[contents].size != 1) {
		return NULL;
	}
	if (!resource && (!read_json_is(reply, read_field(reply, contents + 1, "type"), "text") || reply->structured >= 0)) {
		return NULL;
	}
	int text = read_field(reply, contents + 1, "text");
	return text >= 0 ? read_json_string(reply->json, reply->tokens + text) : NULL;
}

static bool help_all_resources_match_tool(void) {
	bool unicode_seen = false;
	for (size_t i = 0; i < sizeof(help_topics) / sizeof(help_topics[0]); i++) {
		char uri[160], params[256];
		snprintf(uri, sizeof(uri), "indigo://help/%s", help_topics[i]);
		snprintf(params, sizeof(params), "{\"uri\":\"%s\"}", uri);
		read_reply reply;
		if (!read_rpc("resources/read", params, &reply)) {
			return false;
		}
		char *resource = help_reply_text(&reply, true);
		int contents = read_field(&reply, reply.result, "contents");
		bool valid = resource && strlen(resource) > 100 && strstr(resource, "# ") && read_json_is(&reply, read_field(&reply, contents + 1, "uri"), uri) && read_json_is(&reply, read_field(&reply, contents + 1, "mimeType"), "text/markdown");
		read_reply_free(&reply);
		for (const unsigned char *p = (const unsigned char *)resource; p && *p; p++) {
			unicode_seen |= *p >= 0x80;
		}
		for (int alias = 0; valid && alias < 2; alias++) {
			snprintf(params, sizeof(params), "{\"topic\":\"%s\"}", alias ? uri : help_topics[i]);
			valid = read_tool("get_help", params, &reply);
			char *text = valid ? help_reply_text(&reply, false) : NULL;
			valid = valid && !read_is_error(&reply) && text && !strcmp(text, resource);
			free(text);
			read_reply_free(&reply);
		}
		if (valid && i == 0) {
			valid = read_tool("get_help", "{}", &reply);
			char *text = valid ? help_reply_text(&reply, false) : NULL;
			valid = valid && text && !strcmp(text, resource);
			free(text);
			read_reply_free(&reply);
		}
		free(resource);
		if (!valid) {
			fprintf(stderr, "Embedded resource/help mismatch: %s\n", uri);
			return false;
		}
	}
	return unicode_seen;
}

static void embedded_help_is_discoverable_on_initialize(void) {
	ASSERT_TRUE(ensure_fixture());
	read_reply reply;
	ASSERT_TRUE(read_rpc("initialize", "{\"protocolVersion\":\"2025-11-25\",\"capabilities\":{},\"clientInfo\":{\"name\":\"help-fixture\",\"version\":\"1\"}}", &reply));
	int instructions = read_field(&reply, reply.result, "instructions");
	char *text = instructions >= 0 ? read_json_string(reply.json, reply.tokens + instructions) : NULL;
	bool guidance = text && strlen(text) > 200 && strstr(text, "agent") && strstr(text, "get_help") && strstr(text, "indigo://help/");
	free(text);
	ASSERT_TRUE(guidance);
	int capabilities = read_field(&reply, reply.result, "capabilities");
	int resources = read_field(&reply, capabilities, "resources");
	ASSERT_TRUE(resources >= 0 && reply.tokens[resources].type == JSMN_OBJECT);
	read_reply_free(&reply);
	ASSERT_TRUE(read_rpc("tools/list", "{}", &reply));
	int tools = read_field(&reply, reply.result, "tools");
	ASSERT_TRUE(read_json_named(&reply, tools, "name", "get_help") >= 0);
	read_reply_free(&reply);
}

static void all_embedded_resources_are_listed_and_readable(void) {
	ASSERT_TRUE(ensure_fixture());
	read_reply reply;
	ASSERT_TRUE(read_rpc("resources/list", "{}", &reply));
	int resources = read_field(&reply, reply.result, "resources");
	ASSERT_TRUE(resources >= 0 && reply.tokens[resources].type == JSMN_ARRAY);
	ASSERT_EQ_INT(sizeof(help_topics) / sizeof(help_topics[0]), reply.tokens[resources].size);
	ASSERT_EQ_INT(-1, read_field(&reply, reply.result, "nextCursor"));
	for (size_t i = 0; i < sizeof(help_topics) / sizeof(help_topics[0]); i++) {
		char uri[160];
		snprintf(uri, sizeof(uri), "indigo://help/%s", help_topics[i]);
		int entry = read_json_named(&reply, resources, "uri", uri);
		ASSERT_TRUE(entry >= 0);
		ASSERT_TRUE(read_json_is(&reply, read_field(&reply, entry, "mimeType"), "text/markdown"));
	}
	read_reply_free(&reply);
	ASSERT_TRUE(read_rpc("resources/list", "{\"_meta\":{\"progressToken\":\"help-fixture\"}}", &reply));
	resources = read_field(&reply, reply.result, "resources");
	ASSERT_TRUE(resources >= 0 && reply.tokens[resources].size == sizeof(help_topics) / sizeof(help_topics[0]));
	read_reply_free(&reply);
	ASSERT_TRUE(read_rpc("resources/read", "{\"uri\":\"indigo://help/README.md\",\"_meta\":{\"unrecognized\":{\"value\":\"ignored\"}}}", &reply));
	char *metadata_text = help_reply_text(&reply, true);
	ASSERT_TRUE(metadata_text != NULL);
	free(metadata_text);
	read_reply_free(&reply);
	ASSERT_TRUE(help_all_resources_match_tool());
	ASSERT_TRUE(read_rpc("resources/read", "{\"uri\":\"indigo://help/agents/mou\\u006et.md\"}", &reply));
	char *resource = help_reply_text(&reply, true);
	bool unicode = resource && strstr(resource, "J2000→JNow");
	free(resource);
	read_reply_free(&reply);
	ASSERT_TRUE(unicode);
	ASSERT_TRUE(read_tool("get_help", "{\"topic\":\"instructions\\u002emd\"}", &reply));
	char *text = help_reply_text(&reply, false);
	ASSERT_TRUE(text != NULL);
	read_reply_free(&reply);
	ASSERT_TRUE(read_tool("get_help", "{\"topic\":\"instructions.md#unknown-fragment\"}", &reply));
	char *anchored = help_reply_text(&reply, false);
	ASSERT_TRUE(anchored && !strcmp(text, anchored));
	free(anchored);
	read_reply_free(&reply);
	ASSERT_TRUE(read_rpc("resources/read", "{\"uri\":\"indigo://help/instructions.md#agent-first-workflow\"}", &reply));
	anchored = help_reply_text(&reply, true);
	ASSERT_TRUE(anchored && !strcmp(text, anchored));
	int contents = read_field(&reply, reply.result, "contents");
	ASSERT_TRUE(read_json_is(&reply, read_field(&reply, contents + 1, "uri"), "indigo://help/instructions.md"));
	free(anchored);
	free(text);
	read_reply_free(&reply);
}

static void embedded_help_rejects_invalid_targets_and_arguments(void) {
	ASSERT_TRUE(ensure_fixture());
	read_reply reply;
	const char *invalid_uris[] = { "indigo://help/missing.md", "indigo://help/../README.md", "indigo://help/agents/../../README.md", "file:///etc/passwd", "README.md", "indigo://help/README.md?x=1", "indigo://help/missing.md#heading", "indigo://help/%52EADME.md" };
	for (size_t i = 0; i < sizeof(invalid_uris) / sizeof(invalid_uris[0]); i++) {
		char params[256];
		snprintf(params, sizeof(params), "{\"uri\":\"%s\"}", invalid_uris[i]);
		ASSERT_TRUE(read_rpc("resources/read", params, &reply));
		int error = read_field(&reply, 0, "error");
		ASSERT_TRUE(read_json_is(&reply, read_field(&reply, error, "code"), "-32002"));
		read_reply_free(&reply);
		if (i != 4) {
			snprintf(params, sizeof(params), "{\"topic\":\"%s\"}", invalid_uris[i]);
			ASSERT_TRUE(read_tool("get_help", params, &reply));
			ASSERT_TRUE(read_is_error(&reply));
			read_reply_free(&reply);
		}
	}
	const char *methods[] = { "resources/list", "resources/list", "resources/read", "resources/read", "resources/read", "resources/read", "resources/read", "resources/list", "resources/read", "resources/list", "resources/read" };
	const char *params[] = { "{\"cursor\":\"x\"}", "[]", "{}", "{\"uri\":7}", "{\"uri\":\"indigo://help/README.md\",\"uri\":\"indigo://help/instructions.md\"}", "{\"uri\":\"indigo://help/README.md\",\"extra\":true}", "{\"uri\":null}", "{\"_meta\":7}", "{\"uri\":\"indigo://help/README.md\",\"_meta\":null}", "{\"_meta\":{},\"_meta\":{}}", "{\"uri\":\"indigo://help/README.md\",\"_meta\":{},\"_meta\":{}}" };
	for (size_t i = 0; i < sizeof(methods) / sizeof(methods[0]); i++) {
		ASSERT_TRUE(read_rpc(methods[i], params[i], &reply));
		int error = read_field(&reply, 0, "error");
		ASSERT_TRUE(read_json_is(&reply, read_field(&reply, error, "code"), i == 1 ? "-32600" : "-32602"));
		read_reply_free(&reply);
	}
	const char *invalid_topics[] = { "{\"topic\":7}", "{\"topic\":null}", "{\"topic\":\"README.md\",\"topic\":\"instructions.md\"}", "{\"topic\":\"README.md\",\"extra\":true}" };
	for (size_t i = 0; i < sizeof(invalid_topics) / sizeof(invalid_topics[0]); i++) {
		ASSERT_TRUE(read_tool("get_help", invalid_topics[i], &reply));
		int error = read_field(&reply, 0, "error");
		ASSERT_TRUE(read_json_is(&reply, read_field(&reply, error, "code"), "-32602"));
		read_reply_free(&reply);
	}
	ASSERT_TRUE(read_tool("get_help", "{\"topic\":\"mount\"}", &reply));
	ASSERT_TRUE(read_is_error(&reply));
	read_reply_free(&reply);
	const char *notifications[] = { "{\"jsonrpc\":\"2.0\",\"method\":\"resources/list\"}", "{\"jsonrpc\":\"2.0\",\"method\":\"resources/read\",\"params\":{\"uri\":\"indigo://help/README.md\"}}" };
	char response[65536];
	for (size_t i = 0; i < sizeof(notifications) / sizeof(notifications[0]); i++) {
		ASSERT_TRUE(post_body(notifications[i], strlen(notifications[i]), MCP_HEADERS, response, sizeof(response)));
		ASSERT_EQ_INT(400, response_status(response));
		ASSERT_TRUE(body_contains(response, "\"code\":-32600"));
	}
	const char absent[] = "{\"jsonrpc\":\"2.0\",\"id\":81,\"method\":\"resources/list\"}";
	ASSERT_TRUE(post_body(absent, sizeof(absent) - 1, MCP_HEADERS, response, sizeof(response)));
	ASSERT_EQ_INT(200, response_status(response));
	ASSERT_TRUE(body_contains(response, "\"resources\":["));
}

static void embedded_help_survives_reload_in_an_empty_directory(void) {
	ASSERT_TRUE(ensure_fixture());
	char original[PATH_MAX];
	ASSERT_TRUE(getcwd(original, sizeof(original)) != NULL);
	char empty[] = "/tmp/indigo-mcp-help.XXXXXX";
	ASSERT_TRUE(mkdtemp(empty) != NULL);
	ASSERT_EQ_INT(INDIGO_OK, indigo_agent_mcp(INDIGO_DRIVER_SHUTDOWN, NULL));
	agent_started = false;
	bool isolated = chdir(empty) == 0;
	bool initialized = isolated && indigo_agent_mcp(INDIGO_DRIVER_INIT, NULL) == INDIGO_OK;
	agent_started = initialized;
	bool readable = initialized && help_all_resources_match_tool();
	bool restored = chdir(original) == 0;
	bool removed = rmdir(empty) == 0;
	ASSERT_TRUE(isolated && initialized && readable && restored && removed);
}

static void cleanup_fixture(void) {
	read_fixture_end();
	if (agent_started) {
		indigo_agent_mcp(INDIGO_DRIVER_SHUTDOWN, NULL);
		agent_started = false;
	}
	if (server_started) {
		WAIT_UNTIL(atomic_load(&clients) == 0, 3);
		int port = indigo_server_tcp_port;
		indigo_server_shutdown();
		if (!WAIT_UNTIL(atomic_load(&server_finished), 1)) {
			int fd = connect_client();
			if (fd >= 0) {
				close(fd);
			}
		}
		if (WAIT_UNTIL(atomic_load(&server_finished), 3)) {
			pthread_join(server_thread, NULL);
		} else {
			fprintf(stderr, "TCP server did not finish on port %d\n", port);
			indigo_test_failures++;
			pthread_detach(server_thread);
		}
	}
	indigo_server_remove_resources();
	if (bus_started) {
		indigo_stop();
	}
}

int main(void) {
	indigo_test_use_private_home();
	signal(SIGPIPE, SIG_IGN);
	const indigo_test_case tests[] = {
		{ "initialization requires bus", initialization_requires_started_bus },
		{ "idempotent automatic lifecycle", lifecycle_is_idempotent_and_starts_immediately },
		{ "initialize and ready notification", initialize_and_initialized_notification },
		{ "ping catalog and IDs", ping_and_catalog_preserve_ids },
		{ "unknown method and tool errors", unknown_methods_and_tools_return_rpc_errors },
		{ "exact path and GET rejection", exact_path_and_get_rejection },
		{ "invalid envelopes and duplicate fields", invalid_envelopes_and_duplicate_reserved_fields },
		{ "strict JSON grammar and UTF8", malformed_json_and_utf8_are_rejected },
		{ "HTTP framing media and origin", malformed_http_headers_are_rejected },
		{ "body size and EOF bounds", body_limits_and_partial_eof_are_bounded },
		{ "fragmented body and pipeline close", fragmented_body_and_pipeline_close },
		{ "stalled body timeout", stalled_body_times_out },
		{ "JSON depth and token bounds", nested_and_token_heavy_json_is_bounded },
		{ "admission and unload draining", incomplete_requests_are_admitted_then_drained_on_unload },
		{ "read visibility and full device names", readable_visibility_and_names_are_preserved },
		{ "partial numbers preserve schema and targets", number_partial_updates_preserve_schema_and_targets },
		{ "large dynamic text ownership", large_dynamic_text_has_owned_untruncated_snapshots },
		{ "BLOB URL without payload or fetch", blobs_are_urls_without_payload_copy_or_fetch },
		{ "typed switch light and redefinition", switches_lights_and_schema_redefinition_are_typed },
		{ "deletion and reload refresh view", deletion_and_reload_refresh_the_bus_view },
		{ "Unicode names through escaped arguments", unicode_argument_names_are_decoded },
		{ "concurrent reads and bus updates", reads_are_consistent_during_bus_updates },
		{ "tool argument and lookup errors", tool_argument_and_lookup_failures_are_distinct },
		{ "partial writes report dispatch only", partial_number_writes_report_dispatch_only },
		{ "write only and switch dispatch", write_only_and_switch_values_are_dispatched },
		{ "Unicode and long text writes", unicode_and_long_text_writes_keep_exact_values },
		{ "invalid writes have no effects", invalid_writes_have_no_bus_effects },
		{ "explicit tokens and native locking", explicit_tokens_respect_native_locking },
		{ "unsupported write types", unsupported_write_types_never_dispatch },
		{ "self unload and unavailable connection", self_unload_is_busy_and_connection_is_unavailable },
		{ "embedded help discovery", embedded_help_is_discoverable_on_initialize },
		{ "all embedded resources and help aliases", all_embedded_resources_are_listed_and_readable },
		{ "embedded help argument boundaries", embedded_help_rejects_invalid_targets_and_arguments },
		{ "embedded help reload without files", embedded_help_survives_reload_in_an_empty_directory }
	};
	int result = indigo_run_tests("MCP agent integration", tests, sizeof(tests) / sizeof(tests[0]));
	cleanup_fixture();
	indigo_test_remove_private_home();
	return result || indigo_test_failures;
}
