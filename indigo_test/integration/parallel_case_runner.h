// Copyright (c) 2026 INDIGO initiative
// All rights reserved.
//
// You may use this software under the terms of 'INDIGO Astronomy
// open-source license' (see LICENSE.md).
//
// THIS SOFTWARE IS PROVIDED BY THE AUTHORS 'AS IS' AND ANY EXPRESS
// OR IMPLIED WARRANTIES, INCLUDING, BUT NOT LIMITED TO, THE IMPLIED
// WARRANTIES OF MERCHANTABILITY AND FITNESS FOR A PARTICULAR PURPOSE
// ARE DISCLAIMED. IN NO EVENT SHALL THE AUTHOR BE LIABLE FOR ANY
// DIRECT, INDIRECT, INCIDENTAL, SPECIAL, EXEMPLARY, OR CONSEQUENTIAL
// DAMAGES (INCLUDING, BUT NOT LIMITED TO, PROCUREMENT OF SUBSTITUTE
// GOODS OR SERVICES; LOSS OF USE, DATA, OR PROFITS; OR BUSINESS
// INTERRUPTION) HOWEVER CAUSED AND ON ANY THEORY OF LIABILITY,
// WHETHER IN CONTRACT, STRICT LIABILITY, OR TORT (INCLUDING
// NEGLIGENCE OR OTHERWISE) ARISING IN ANY WAY OUT OF THE USE OF THIS
// SOFTWARE, EVEN IF ADVISED OF THE POSSIBILITY OF SUCH DAMAGE.

// Code is generated by AI

// Shared runner for suites that execute every registered case in its own forked
// child, each with its own simulator and its own INDIGO bus.
//
// Such a suite is dominated by per case start-up cost - simulator hand-shake,
// driver bring-up, the connect delay a driver preserves from its hardware
// protocol - rather than by the simulated motion itself, so the cases are run
// several at a time. Each case gets its own fixture directory below the
// caller's fixture root, so concurrent cases never share an event log, a fault
// file or a HOME directory. The child's output is captured per case and the
// parent replays it in registration order, which keeps a parallel run as
// readable as a serial one.
//
// The degree of parallelism comes from INDIGO_TEST_JOBS, or from the runner's
// own `jobs` field when it is set; 1 restores fully serial execution, which is
// what a timing measurement or a bisect of a flaky case wants.

#ifndef PARALLEL_CASE_RUNNER_H
#define PARALLEL_CASE_RUNNER_H

#include <errno.h>
#include <fcntl.h>
#include <limits.h>
#include <signal.h>
#include <stdbool.h>
#include <stdio.h>
#include <stdlib.h>
#include <string.h>
#include <sys/stat.h>
#include <sys/types.h>
#include <sys/wait.h>
#include <time.h>
#include <unistd.h>

#define PARALLEL_CASE_RUNNER_MIN_JOBS 2
#define PARALLEL_CASE_RUNNER_MAX_JOBS 32
// The cases wait on simulator hand-shakes, connect delays and driver timeouts
// far more than they compute, so the default follows the processor count only
// as a rough bound on the concurrent INDIGO buses.
#define PARALLEL_CASE_RUNNER_DEFAULT_JOBS_CAP 8

typedef struct {
	// Suite label, used only in the runner's own diagnostics.
	const char *label;
	// Directory the per case fixture directories are created in. It must exist.
	const char *fixture_root;
	// Number of registered cases.
	int count;
	// Cases run at a time; 0 takes the value from INDIGO_TEST_JOBS.
	int jobs;
	// Case name for the reports.
	const char *(*name)(int index);
	// Cases to run; NULL runs all of them.
	bool (*selected)(int index);
	// Watchdog for one case in seconds; NULL or 0 lets the case run freely.
	unsigned (*timeout)(int index);
	// The case body. It runs in the forked child with `fixture` as its private
	// fixture directory and returns the child's exit code.
	int (*child)(int index, const char *fixture);
	// Optional per case report, emitted right after that case's own output. NULL
	// prints "FAIL <name> (<seconds> s)" for a failed case and nothing otherwise,
	// which is what a suite whose cases are all expected to pass wants.
	void (*report)(int index, bool failed, double seconds);
} parallel_case_runner;

typedef struct {
	pid_t pid;
	int index;
	double started;
} parallel_case_slot;

static double parallel_case_now(void) {
	struct timespec now;
	clock_gettime(CLOCK_MONOTONIC, &now);
	return now.tv_sec + now.tv_nsec / 1e9;
}

static int parallel_case_runner_default_jobs(void) {
	long processors = sysconf(_SC_NPROCESSORS_ONLN);
	int jobs = processors > 0 ? (int)processors : PARALLEL_CASE_RUNNER_MIN_JOBS;
	if (jobs < PARALLEL_CASE_RUNNER_MIN_JOBS) {
		jobs = PARALLEL_CASE_RUNNER_MIN_JOBS;
	}
	if (jobs > PARALLEL_CASE_RUNNER_DEFAULT_JOBS_CAP) {
		jobs = PARALLEL_CASE_RUNNER_DEFAULT_JOBS_CAP;
	}
	return jobs;
}

static int parallel_case_runner_jobs(const parallel_case_runner *runner) {
	int jobs = runner->jobs;
	if (jobs <= 0) {
		const char *configured = getenv("INDIGO_TEST_JOBS");
		jobs = configured != NULL ? atoi(configured) : parallel_case_runner_default_jobs();
	}
	if (jobs <= 0) {
		jobs = 1;
	}
	if (jobs > PARALLEL_CASE_RUNNER_MAX_JOBS) {
		jobs = PARALLEL_CASE_RUNNER_MAX_JOBS;
	}
	return jobs;
}

static void parallel_case_fixture(const parallel_case_runner *runner, int index, char *buffer, size_t size) {
	snprintf(buffer, size, "%s/case-%d", runner->fixture_root, index);
}

static void parallel_case_output(const parallel_case_runner *runner, int index, char *buffer, size_t size) {
	snprintf(buffer, size, "%s/case-%d/output", runner->fixture_root, index);
}

// Copy one finished case's captured output to stdout and remove the file, so a
// parallel run prints the same ordered log a serial run would.
static void parallel_case_replay(const parallel_case_runner *runner, int index) {
	char path[PATH_MAX];
	parallel_case_output(runner, index, path, sizeof(path));
	FILE *file = fopen(path, "r");
	if (file == NULL) {
		return;
	}
	char line[4096];
	while (fgets(line, sizeof(line), file) != NULL) {
		fputs(line, stdout);
	}
	fclose(file);
	fflush(stdout);
	unlink(path);
}

static void parallel_case_report(const parallel_case_runner *runner, int index, bool failed, double seconds) {
	if (runner->report != NULL) {
		runner->report(index, failed, seconds);
	} else if (failed) {
		printf("FAIL %s (%.1f s)\n", runner->name(index), seconds);
	}
	fflush(stdout);
}

static void parallel_case_start(const parallel_case_runner *runner, parallel_case_slot *slot, int index) {
	char fixture[PATH_MAX], output[PATH_MAX];
	parallel_case_fixture(runner, index, fixture, sizeof(fixture));
	parallel_case_output(runner, index, output, sizeof(output));
	mkdir(fixture, 0700);
	fflush(NULL);
	slot->index = index;
	slot->started = parallel_case_now();
	slot->pid = fork();
	if (slot->pid == 0) {
		// The child owns a process group of its own, so the parent can clean up
		// a simulator the case left behind without touching its siblings.
		setpgid(0, 0);
		int handle = open(output, O_WRONLY | O_CREAT | O_TRUNC, 0600);
		if (handle >= 0) {
			dup2(handle, STDOUT_FILENO);
			dup2(handle, STDERR_FILENO);
			close(handle);
		}
		setvbuf(stdout, NULL, _IOLBF, 0);
		if (runner->timeout != NULL) {
			unsigned seconds = runner->timeout(index);
			if (seconds > 0) {
				alarm(seconds);
			}
		}
		_exit(runner->child(index, fixture));
	}
}

// Run every selected case, at most `jobs` at a time, and report the results in
// registration order. Returns the number of failed cases; the optional counters
// receive the number of cases that ran, passed and failed.
static int run_parallel_cases(const parallel_case_runner *runner, int *run_count, int *passed_count, int *failed_count) {
	int jobs = parallel_case_runner_jobs(runner);
	parallel_case_slot slots[PARALLEL_CASE_RUNNER_MAX_JOBS];
	bool *finished = calloc((size_t)runner->count, sizeof(bool));
	bool *failure = calloc((size_t)runner->count, sizeof(bool));
	double *duration = calloc((size_t)runner->count, sizeof(double));
	if (finished == NULL || failure == NULL || duration == NULL) {
		free(finished);
		free(failure);
		free(duration);
		fprintf(stderr, "%s: cannot allocate the case results\n", runner->label);
		return runner->count;
	}
	for (int slot = 0; slot < jobs; slot++) {
		slots[slot].pid = 0;
		slots[slot].index = -1;
	}
	int next = 0, active = 0, run = 0, passed = 0, failed = 0, reported = 0;
	while (true) {
		while (active < jobs && next < runner->count) {
			int index = next++;
			if (runner->selected != NULL && !runner->selected(index)) {
				finished[index] = true;
				continue;
			}
			int slot = 0;
			while (slot < jobs && slots[slot].pid != 0) {
				slot++;
			}
			parallel_case_start(runner, slots + slot, index);
			if (slots[slot].pid < 0) {
				fprintf(stderr, "%s: cannot fork %s\n", runner->label, runner->name(index));
				slots[slot].pid = 0;
				finished[index] = true;
				failure[index] = true;
				run++;
				failed++;
				continue;
			}
			active++;
		}
		if (active == 0) {
			if (next >= runner->count) {
				break;
			}
			continue;
		}
		int status = 0;
		pid_t child = waitpid(-1, &status, 0);
		if (child < 0) {
			if (errno == EINTR) {
				continue;
			}
			break;
		}
		for (int slot = 0; slot < jobs; slot++) {
			if (slots[slot].pid != child) {
				continue;
			}
			int index = slots[slot].index;
			// The case may have left its simulator running; it shares the child's
			// process group, so one signal collects whatever is left.
			kill(-child, SIGTERM);
			duration[index] = parallel_case_now() - slots[slot].started;
			failure[index] = !WIFEXITED(status) || WEXITSTATUS(status) != 0;
			finished[index] = true;
			slots[slot].pid = 0;
			slots[slot].index = -1;
			active--;
			run++;
			if (failure[index]) {
				failed++;
			} else {
				passed++;
			}
			break;
		}
		// Emit every case whose predecessors have all finished, so the log keeps
		// the registration order however the children interleave.
		while (reported < runner->count && finished[reported]) {
			if (runner->selected == NULL || runner->selected(reported)) {
				parallel_case_replay(runner, reported);
				parallel_case_report(runner, reported, failure[reported], duration[reported]);
			}
			reported++;
		}
	}
	while (reported < runner->count) {
		if (finished[reported] && (runner->selected == NULL || runner->selected(reported))) {
			parallel_case_replay(runner, reported);
			parallel_case_report(runner, reported, failure[reported], duration[reported]);
		}
		reported++;
	}
	if (run_count != NULL) {
		*run_count = run;
	}
	if (passed_count != NULL) {
		*passed_count = passed;
	}
	if (failed_count != NULL) {
		*failed_count = failed;
	}
	free(finished);
	free(failure);
	free(duration);
	return failed;
}

#endif
