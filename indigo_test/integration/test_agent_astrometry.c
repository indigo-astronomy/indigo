// Copyright (c) 2026 INDIGO initiative
// All rights reserved.
//
// You may use this software under the terms of 'INDIGO Astronomy
// open-source license' (see LICENSE.md).
//
// THIS SOFTWARE IS PROVIDED BY THE AUTHORS 'AS IS' AND ANY EXPRESS
// OR IMPLIED WARRANTIES, INCLUDING, BUT NOT LIMITED TO, THE IMPLIED
// WARRANTIES OF MERCHANTABILITY AND FITNESS FOR A PARTICULAR PURPOSE
// ARE DISCLAIMED. IN NO EVENT SHALL THE AUTHOR BE LIABLE FOR ANY
// DIRECT, INDIRECT, INCIDENTAL, SPECIAL, EXEMPLARY, OR CONSEQUENTIAL
// DAMAGES (INCLUDING, BUT NOT LIMITED TO, PROCUREMENT OF SUBSTITUTE
// GOODS OR SERVICES; LOSS OF USE, DATA, OR PROFITS; OR BUSINESS
// INTERRUPTION) HOWEVER CAUSED AND ON ANY THEORY OF LIABILITY,
// WHETHER IN CONTRACT, STRICT LIABILITY, OR TORT (INCLUDING
// NEGLIGENCE OR OTHERWISE) ARISING IN ANY WAY OUT OF THE USE OF THIS
// SOFTWARE, EVEN IF ADVISED OF THE POSSIBILITY OF SUCH DAMAGE.

// Code is generated by AI

#include <pthread.h>
#include <signal.h>
#include <stdatomic.h>
#include <stdint.h>
#include <stdio.h>
#include <stdlib.h>
#include <sys/stat.h>
#include <sys/wait.h>
#include <unistd.h>

#include <jpeglib.h>

#include <indigo/indigo_filter.h>
#include <indigo/indigo_platesolver.h>
#include <indigo_drivers/agent_astrometry/indigo_agent_astrometry.h>

#include "../test_runner.h"

#define AGENT ASTROMETRY_AGENT_NAME
#define IMAGER "Imager Agent Astrometry Test"
#define MOUNT "Mount Agent Astrometry Test"
#define INDEX_41 "AGENT_ASTROMETRY_INDEX_41XX"
#define INDEX_42 "AGENT_ASTROMETRY_INDEX_42XX"
#define ARRAY_SIZE(a) (sizeof(a) / sizeof((a)[0]))
#define REQUIRE(c) do { if (!(c)) { fprintf(stderr, "%s:%d: %s\n", __FILE__, __LINE__, #c); indigo_test_failures++; return false; } } while (0)

typedef struct {
	char device[INDIGO_NAME_SIZE];
	char name[INDIGO_NAME_SIZE];
	indigo_property *property;
	void *blob_data;
	unsigned revision;
} observation;

static observation cache[1024];
static pthread_mutex_t cache_mutex = PTHREAD_MUTEX_INITIALIZER;
static indigo_client observer;
static indigo_device imager_device;
static indigo_device mount_device;
static indigo_property *imager_properties[5];
static indigo_property *mount_properties[6];
static char test_root[256];
static char astrometry_folder[352];
static char fake_bin[320];
static char fake_log[320];
static char messages[32768];
static atomic_int imager_capture_requests;
static atomic_int imager_abort_requests;
static atomic_int mount_start_requests;
static atomic_int mount_abort_requests;
static atomic_bool fail_imager_capture;
static atomic_bool hold_imager_capture;
static atomic_bool fail_mount_start;
static atomic_bool hold_mount_start;
static bool running;
static bool peers_attached;

static observation *find_observation(const char *device, const char *name) {
	observation *free_entry = NULL;
	for (unsigned i = 0; i < ARRAY_SIZE(cache); i++) {
		if (!*cache[i].name) {
			if (!free_entry) {
				free_entry = cache + i;
			}
		} else if (!strcmp(cache[i].device, device) && !strcmp(cache[i].name, name)) {
			return cache + i;
		}
	}
	if (free_entry) {
		INDIGO_COPY_NAME(free_entry->device, device);
		INDIGO_COPY_NAME(free_entry->name, name);
	}
	return free_entry;
}

static indigo_result observe(indigo_property *property) {
	pthread_mutex_lock(&cache_mutex);
	observation *entry = find_observation(property->device, property->name);
	if (entry) {
		free(entry->blob_data);
		entry->blob_data = NULL;
		indigo_release_property(entry->property);
		entry->property = indigo_copy_property(NULL, property);
		if (property->type == INDIGO_BLOB_VECTOR && property->count == 1 && property->items[0].blob.value && property->items[0].blob.size > 0) {
			entry->blob_data = malloc(property->items[0].blob.size);
			memcpy(entry->blob_data, property->items[0].blob.value, property->items[0].blob.size);
			entry->property->items[0].blob.value = entry->blob_data;
		}
		entry->revision++;
	}
	pthread_mutex_unlock(&cache_mutex);
	return INDIGO_OK;
}

static indigo_result defined(indigo_client *client, indigo_device *device, indigo_property *property, const char *message) {
	return observe(property);
}

static void observe_message(const char *message) {
	pthread_mutex_lock(&cache_mutex);
	if (message && strlen(messages) + strlen(message) + 2 < sizeof(messages)) {
		strcat(messages, message);
		strcat(messages, "\n");
	}
	pthread_mutex_unlock(&cache_mutex);
}

static indigo_result updated(indigo_client *client, indigo_device *device, indigo_property *property, const char *message) {
	observe_message(message);
	return observe(property);
}

static indigo_result deleted(indigo_client *client, indigo_device *device, indigo_property *property, const char *message) {
	pthread_mutex_lock(&cache_mutex);
	for (unsigned i = 0; i < ARRAY_SIZE(cache); i++) {
		if (*cache[i].name && !strcmp(cache[i].device, property->device) && (!*property->name || !strcmp(cache[i].name, property->name))) {
			free(cache[i].blob_data);
			cache[i].blob_data = NULL;
			indigo_release_property(cache[i].property);
			cache[i].property = NULL;
			cache[i].revision++;
		}
	}
	pthread_mutex_unlock(&cache_mutex);
	return INDIGO_OK;
}

static indigo_result message_received(indigo_client *client, indigo_device *device, indigo_property *property, const char *message) {
	observe_message(message);
	return INDIGO_OK;
}

static indigo_property *snapshot(const char *device, const char *name) {
	pthread_mutex_lock(&cache_mutex);
	observation *entry = find_observation(device, name);
	indigo_property *result = entry && entry->property ? indigo_copy_property(NULL, entry->property) : NULL;
	pthread_mutex_unlock(&cache_mutex);
	return result;
}

static unsigned revision_for(const char *device, const char *name) {
	pthread_mutex_lock(&cache_mutex);
	observation *entry = find_observation(device, name);
	unsigned result = entry ? entry->revision : 0;
	pthread_mutex_unlock(&cache_mutex);
	return result;
}

static unsigned revision(const char *name) {
	return revision_for(AGENT, name);
}

static int property_state(const char *name) {
	indigo_property *property = snapshot(AGENT, name);
	int result = property ? property->state : -1;
	indigo_release_property(property);
	return result;
}

static bool wait_defined(const char *device, const char *name) {
	for (int i = 0; i < 5000; i++) {
		indigo_property *property = snapshot(device, name);
		if (property) {
			indigo_release_property(property);
			return true;
		}
		indigo_usleep(1000);
	}
	fprintf(stderr, "Timeout waiting for %s.%s\n", device, name);
	return false;
}

static bool wait_state_after(const char *name, unsigned before, indigo_property_state expected) {
	for (int i = 0; i < 15000; i++) {
		indigo_property *property = snapshot(AGENT, name);
		bool ready = property && property->state == expected && revision(name) > before;
		indigo_release_property(property);
		if (ready) {
			return true;
		}
		indigo_usleep(1000);
	}
	fprintf(stderr, "Timeout waiting for %s state %d after %u; got %d revision %u\n", name, expected, before, property_state(name), revision(name));
	return false;
}

static bool wait_device_state_after(const char *device, const char *name, unsigned before, indigo_property_state expected) {
	for (int i = 0; i < 15000; i++) {
		indigo_property *property = snapshot(device, name);
		bool ready = property && property->state == expected && revision_for(device, name) > before;
		indigo_release_property(property);
		if (ready) {
			return true;
		}
		indigo_usleep(1000);
	}
	fprintf(stderr, "Timeout waiting for %s.%s state %d after %u\n", device, name, expected, before);
	return false;
}

static bool wait_not_busy_after(const char *name, unsigned before) {
	for (int i = 0; i < 15000; i++) {
		indigo_property *property = snapshot(AGENT, name);
		bool ready = property && property->state != INDIGO_BUSY_STATE && revision(name) > before;
		indigo_release_property(property);
		if (ready) {
			return true;
		}
		indigo_usleep(1000);
	}
	return false;
}

static indigo_item *item(indigo_property *property, const char *name) {
	return property ? indigo_get_item(property, name) : NULL;
}

static bool has_message(const char *text) {
	pthread_mutex_lock(&cache_mutex);
	bool result = strstr(messages, text) != NULL;
	pthread_mutex_unlock(&cache_mutex);
	return result;
}

static bool file_contains(const char *path, const char *text) {
	FILE *file = fopen(path, "r");
	if (!file) {
		return false;
	}
	char buffer[16384];
	size_t length = fread(buffer, 1, sizeof(buffer) - 1, file);
	fclose(file);
	buffer[length] = 0;
	return strstr(buffer, text) != NULL;
}

static bool wait_deleted(const char *device, const char *name) {
	for (int i = 0; i < 5000; i++) {
		indigo_property *property = snapshot(device, name);
		if (!property) {
			return true;
		}
		indigo_release_property(property);
		indigo_usleep(1000);
	}
	return false;
}

static void write_executable(const char *name, const char *body) {
	char path[512];
	snprintf(path, sizeof(path), "%s/%s", fake_bin, name);
	FILE *file = fopen(path, "w");
	if (!file) {
		perror(path);
		exit(1);
	}
	fputs(body, file);
	fclose(file);
	chmod(path, 0700);
}

static void create_fake_tools(void) {
	mkdir(fake_bin, 0700);
	write_executable("image2xy",
		"#!/bin/sh\n"
		"echo image2xy \"$@\" >> \"$ASTROMETRY_FAKE_LOG\"\n"
		"case \"$ASTROMETRY_FAKE_MODE\" in\n"
		"  image_exit) exit 7 ;;\n"
		"  image_not_found) echo 'image2xy: not found'; exit 127 ;;\n"
		"  image_slow) sleep 30 ;;\n"
		"esac\n"
		"echo 'simplexy: nx=100, ny=50'\n"
		"exit 0\n");
	write_executable("solve-field",
		"#!/bin/sh\n"
		"echo solve-field \"$@\" >> \"$ASTROMETRY_FAKE_LOG\"\n"
		"case \"$ASTROMETRY_FAKE_MODE\" in\n"
		"  solve_exit) exit 9 ;;\n"
		"  solve_not_found) echo 'solve-field: not found'; exit 127 ;;\n"
		"  no_solution) echo 'Did not solve'; exit 0 ;;\n"
		"  no_index) echo 'You must list at least one index'; exit 0 ;;\n"
		"  cpu_limit) echo 'Total CPU time limit reached'; exit 0 ;;\n"
		"  solve_slow) sleep 30 ;;\n"
		"esac\n"
		"echo 'message: fake solver running'\n"
		"echo 'Field center: (RA,Dec) = (180, -30)'\n"
		"case \"$ASTROMETRY_FAKE_MODE\" in\n"
		"  arcminutes) echo 'Field size: 120 x 60 arcminutes' ;;\n"
		"  arcseconds) echo 'Field size: 7200 x 3600 arcseconds' ;;\n"
		"  *) echo 'Field size: 2 x 1 degrees' ;;\n"
		"esac\n"
		"echo 'Field rotation angle: up is 42.5 degrees E of N'\n"
		"echo 'Field 1: solved with index index-4205'\n"
		"case \"$ASTROMETRY_FAKE_MODE\" in parity_neg) echo 'Field parity: neg' ;; *) echo 'Field parity: pos' ;; esac\n"
		"exit 0\n");
	write_executable("curl",
		"#!/bin/sh\n"
		"echo curl \"$@\" >> \"$ASTROMETRY_FAKE_LOG\"\n"
		"out=''\n"
		"while [ $# -gt 0 ]; do if [ \"$1\" = '-o' ]; then shift; out=$1; fi; shift; done\n"
		"case \"$ASTROMETRY_FAKE_MODE\" in curl_exit) exit 22 ;; curl_bad) printf 'ERROR' > \"$out\"; exit 0 ;; curl_slow) sleep 1 ;; esac\n"
		"printf 'SIMPLE' > \"$out\"\n"
		"exit 0\n");
}

static indigo_result peer_enumerate(indigo_device *device, indigo_client *client, indigo_property *match) {
	indigo_property **properties = device == &imager_device ? imager_properties : mount_properties;
	int count = device == &imager_device ? ARRAY_SIZE(imager_properties) : ARRAY_SIZE(mount_properties);
	for (int i = 0; i < count; i++) {
		if (properties[i] && indigo_property_match(properties[i], match)) {
			indigo_define_property(device, properties[i], NULL);
		}
	}
	return INDIGO_OK;
}

static unsigned char peer_fits[2880];

static void finish_capture(indigo_device *device) {
	imager_properties[4]->state = INDIGO_OK_STATE;
	imager_properties[4]->items[0].blob.value = peer_fits;
	imager_properties[4]->items[0].blob.size = sizeof(peer_fits);
	INDIGO_COPY_NAME(imager_properties[4]->items[0].blob.format, ".fits");
	indigo_update_property(device, imager_properties[4], NULL);
	imager_properties[1]->state = INDIGO_OK_STATE;
	indigo_update_property(device, imager_properties[1], NULL);
}

static void finish_mount(indigo_device *device) {
	mount_properties[3]->state = INDIGO_OK_STATE;
	for (int i = 0; i < mount_properties[3]->count; i++) {
		mount_properties[3]->items[i].sw.value = false;
	}
	indigo_update_property(device, mount_properties[3], NULL);
}

static indigo_result peer_change(indigo_device *device, indigo_client *client, indigo_property *request) {
	if (device == &imager_device) {
		if (!strcmp(request->name, AGENT_IMAGER_CAPTURE_PROPERTY_NAME)) {
			atomic_fetch_add(&imager_capture_requests, 1);
			indigo_property_copy_values(imager_properties[1], request, false);
			if (atomic_load(&fail_imager_capture)) {
				imager_properties[1]->state = INDIGO_ALERT_STATE;
				indigo_update_property(device, imager_properties[1], NULL);
				return INDIGO_OK;
			}
			imager_properties[1]->state = INDIGO_BUSY_STATE;
			indigo_update_property(device, imager_properties[1], NULL);
			imager_properties[4]->state = INDIGO_BUSY_STATE;
			indigo_update_property(device, imager_properties[4], NULL);
			if (!atomic_load(&hold_imager_capture)) {
				indigo_set_timer(device, 0.02, finish_capture, NULL);
			}
		} else if (!strcmp(request->name, CCD_ABORT_EXPOSURE_PROPERTY_NAME)) {
			atomic_fetch_add(&imager_abort_requests, 1);
			imager_properties[3]->state = INDIGO_OK_STATE;
			indigo_update_property(device, imager_properties[3], NULL);
			imager_properties[1]->state = INDIGO_ALERT_STATE;
			indigo_update_property(device, imager_properties[1], NULL);
			imager_properties[4]->state = INDIGO_ALERT_STATE;
			indigo_update_property(device, imager_properties[4], NULL);
		}
		return INDIGO_OK;
	}
	if (!strcmp(request->name, AGENT_MOUNT_TARGET_COORDINATES_PROPERTY_NAME)) {
		indigo_property_copy_values(mount_properties[2], request, false);
		mount_properties[2]->state = INDIGO_OK_STATE;
		indigo_update_property(device, mount_properties[2], NULL);
	} else if (!strcmp(request->name, AGENT_START_PROCESS_PROPERTY_NAME)) {
		atomic_fetch_add(&mount_start_requests, 1);
		indigo_property_copy_values(mount_properties[3], request, false);
		if (atomic_load(&fail_mount_start)) {
			mount_properties[3]->state = INDIGO_ALERT_STATE;
			indigo_update_property(device, mount_properties[3], NULL);
			return INDIGO_OK;
		}
		mount_properties[3]->state = INDIGO_BUSY_STATE;
		indigo_update_property(device, mount_properties[3], NULL);
		if (!atomic_load(&hold_mount_start)) {
			indigo_set_timer(device, 0.01, finish_mount, NULL);
		}
	} else if (!strcmp(request->name, MOUNT_ABORT_MOTION_PROPERTY_NAME)) {
		atomic_fetch_add(&mount_abort_requests, 1);
		mount_properties[4]->state = INDIGO_OK_STATE;
		indigo_update_property(device, mount_properties[4], NULL);
		mount_properties[3]->state = INDIGO_ALERT_STATE;
		indigo_update_property(device, mount_properties[3], NULL);
	} else if (!strcmp(request->name, AGENT_MOUNT_FOV_PROPERTY_NAME)) {
		indigo_property_copy_values(mount_properties[5], request, false);
		mount_properties[5]->state = INDIGO_OK_STATE;
		indigo_update_property(device, mount_properties[5], NULL);
	}
	return INDIGO_OK;
}

static void init_info(indigo_property **property, const char *device_name) {
	char interface[32];
	snprintf(interface, sizeof(interface), "%d", INDIGO_INTERFACE_AGENT);
	*property = indigo_init_text_property(NULL, device_name, INFO_PROPERTY_NAME, "Main", "Info", INDIGO_OK_STATE, INDIGO_RO_PERM, 1);
	indigo_init_text_item((*property)->items, INFO_DEVICE_INTERFACE_ITEM_NAME, "Interface", interface);
}

static void init_peers(void) {
	memset(peer_fits, ' ', sizeof(peer_fits));
	memcpy(peer_fits, "SIMPLE", 6);
	imager_device = (indigo_device)INDIGO_DEVICE_INITIALIZER(IMAGER, NULL, peer_enumerate, peer_change, NULL, NULL);
	mount_device = (indigo_device)INDIGO_DEVICE_INITIALIZER(MOUNT, NULL, peer_enumerate, peer_change, NULL, NULL);
	init_info(imager_properties, IMAGER);
	imager_properties[1] = indigo_init_number_property(NULL, IMAGER, AGENT_IMAGER_CAPTURE_PROPERTY_NAME, "Agent", "Capture", INDIGO_OK_STATE, INDIGO_RW_PERM, 1);
	indigo_init_number_item(imager_properties[1]->items, AGENT_IMAGER_CAPTURE_ITEM_NAME, "Capture", 0, 60, 1, 0);
	imager_properties[2] = indigo_init_switch_property(NULL, IMAGER, AGENT_PAUSE_PROCESS_PROPERTY_NAME, "Agent", "Pause", INDIGO_OK_STATE, INDIGO_RW_PERM, INDIGO_AT_MOST_ONE_RULE, 1);
	indigo_init_switch_item(imager_properties[2]->items, AGENT_PAUSE_PROCESS_ITEM_NAME, "Pause", false);
	imager_properties[3] = indigo_init_switch_property(NULL, IMAGER, CCD_ABORT_EXPOSURE_PROPERTY_NAME, "Camera", "Abort", INDIGO_OK_STATE, INDIGO_RW_PERM, INDIGO_AT_MOST_ONE_RULE, 1);
	indigo_init_switch_item(imager_properties[3]->items, CCD_ABORT_EXPOSURE_ITEM_NAME, "Abort", false);
	imager_properties[4] = indigo_init_blob_property(NULL, IMAGER, CCD_IMAGE_PROPERTY_NAME, "Camera", "Image", INDIGO_OK_STATE, 1);
	indigo_init_blob_item(imager_properties[4]->items, CCD_IMAGE_ITEM_NAME, "Image");
	init_info(mount_properties, MOUNT);
	mount_properties[1] = indigo_init_number_property(NULL, MOUNT, MOUNT_EQUATORIAL_COORDINATES_PROPERTY_NAME, "Mount", "Coordinates", INDIGO_OK_STATE, INDIGO_RW_PERM, 2);
	indigo_init_number_item(mount_properties[1]->items, MOUNT_EQUATORIAL_COORDINATES_RA_ITEM_NAME, "RA", 0, 24, 0, 5);
	indigo_init_number_item(mount_properties[1]->items + 1, MOUNT_EQUATORIAL_COORDINATES_DEC_ITEM_NAME, "DEC", -90, 90, 0, 20);
	mount_properties[2] = indigo_init_number_property(NULL, MOUNT, AGENT_MOUNT_TARGET_COORDINATES_PROPERTY_NAME, "Mount", "Target", INDIGO_OK_STATE, INDIGO_RW_PERM, 2);
	indigo_init_number_item(mount_properties[2]->items, AGENT_MOUNT_TARGET_COORDINATES_RA_ITEM_NAME, "RA", 0, 24, 0, 0);
	indigo_init_number_item(mount_properties[2]->items + 1, AGENT_MOUNT_TARGET_COORDINATES_DEC_ITEM_NAME, "DEC", -90, 90, 0, 0);
	mount_properties[3] = indigo_init_switch_property(NULL, MOUNT, AGENT_START_PROCESS_PROPERTY_NAME, "Agent", "Start", INDIGO_OK_STATE, INDIGO_RW_PERM, INDIGO_AT_MOST_ONE_RULE, 2);
	indigo_init_switch_item(mount_properties[3]->items, AGENT_MOUNT_START_SLEW_ITEM_NAME, "Slew", false);
	indigo_init_switch_item(mount_properties[3]->items + 1, AGENT_MOUNT_START_SYNC_ITEM_NAME, "Sync", false);
	mount_properties[4] = indigo_init_switch_property(NULL, MOUNT, MOUNT_ABORT_MOTION_PROPERTY_NAME, "Mount", "Abort", INDIGO_OK_STATE, INDIGO_RW_PERM, INDIGO_AT_MOST_ONE_RULE, 1);
	indigo_init_switch_item(mount_properties[4]->items, MOUNT_ABORT_MOTION_ITEM_NAME, "Abort", false);
	mount_properties[5] = indigo_init_number_property(NULL, MOUNT, AGENT_MOUNT_FOV_PROPERTY_NAME, "Mount", "FOV", INDIGO_OK_STATE, INDIGO_RW_PERM, 3);
	indigo_init_number_item(mount_properties[5]->items, AGENT_MOUNT_FOV_ANGLE_ITEM_NAME, "Angle", 0, 360, 0, 0);
	indigo_init_number_item(mount_properties[5]->items + 1, AGENT_MOUNT_FOV_WIDTH_ITEM_NAME, "Width", 0, 360, 0, 0);
	indigo_init_number_item(mount_properties[5]->items + 2, AGENT_MOUNT_FOV_HEIGHT_ITEM_NAME, "Height", 0, 360, 0, 0);
}

static bool setup(void) {
	indigo_set_log_level(getenv("INDIGO_TEST_DEBUG") ? INDIGO_LOG_DEBUG : INDIGO_LOG_ERROR);
	init_peers();
	REQUIRE(indigo_start() == INDIGO_OK);
	observer = (indigo_client){ .name = "Astrometry integration observer", .version = INDIGO_VERSION_CURRENT, .define_property = defined, .update_property = updated, .delete_property = deleted, .send_message = message_received };
	REQUIRE(indigo_attach_client(&observer) == INDIGO_OK);
	REQUIRE(indigo_attach_device(&imager_device) == INDIGO_OK);
	REQUIRE(indigo_attach_device(&mount_device) == INDIGO_OK);
	peers_attached = true;
	REQUIRE(indigo_agent_astrometry(INDIGO_DRIVER_INIT, NULL) == INDIGO_OK);
	running = true;
	REQUIRE(wait_defined(AGENT, AGENT_PLATESOLVER_WCS_PROPERTY_NAME));
	REQUIRE(wait_defined(AGENT, INDEX_41));
	REQUIRE(wait_defined(AGENT, FILTER_RELATED_AGENT_LIST_PROPERTY_NAME));
	return true;
}

static void cleanup(void) {
	if (running) {
		indigo_agent_astrometry(INDIGO_DRIVER_SHUTDOWN, NULL);
		running = false;
	}
	if (peers_attached) {
		indigo_detach_device(&mount_device);
		indigo_detach_device(&imager_device);
		peers_attached = false;
	}
	indigo_detach_client(&observer);
	indigo_stop();
	for (unsigned i = 0; i < ARRAY_SIZE(cache); i++) {
		free(cache[i].blob_data);
		indigo_release_property(cache[i].property);
	}
	for (unsigned i = 0; i < ARRAY_SIZE(imager_properties); i++) {
		indigo_release_property(imager_properties[i]);
	}
	for (unsigned i = 0; i < ARRAY_SIZE(mount_properties); i++) {
		indigo_release_property(mount_properties[i]);
	}
}

// Replace a filesystem entry with a placeholder of the other kind, so that the production code
// fails on it deterministically even when the tests run as root and permission bits are ignored.
// A regular file in place of a directory makes creating anything below it fail with ENOTDIR, a
// directory in place of a regular file stays readable but makes unlink() fail.
static bool replace_with_placeholder(const char *path, char *saved, size_t size, bool directory) {
	snprintf(saved, size, "%s.saved", path);
	if (rename(path, saved) != 0) {
		perror(path);
		return false;
	}
	bool created = false;
	if (directory) {
		created = mkdir(path, 0700) == 0;
	} else {
		FILE *file = fopen(path, "w");
		if (file) {
			fclose(file);
			created = true;
		}
	}
	if (!created) {
		perror(path);
		rename(saved, path);
	}
	return created;
}

static bool restore_from_placeholder(const char *path, const char *saved) {
	if (remove(path) != 0 || rename(saved, path) != 0) {
		perror(path);
		return false;
	}
	return true;
}

static bool select_related(const char *name) {
	REQUIRE(wait_defined(AGENT, FILTER_RELATED_AGENT_LIST_PROPERTY_NAME));
	REQUIRE(indigo_change_switch_property_1(&observer, AGENT, FILTER_RELATED_AGENT_LIST_PROPERTY_NAME, name, true) == INDIGO_OK);
	REQUIRE(wait_defined(AGENT, FILTER_RELATED_AGENT_LIST_PROPERTY_NAME));
	return true;
}

static bool upload(const void *data, long size, const char *format, indigo_property_state expected) {
	unsigned before = revision(AGENT_PLATESOLVER_WCS_PROPERTY_NAME);
	REQUIRE(indigo_change_blob_property_1(&observer, AGENT, AGENT_PLATESOLVER_IMAGE_PROPERTY_NAME, AGENT_PLATESOLVER_IMAGE_ITEM_NAME, (void *)data, size, format, "") == INDIGO_OK);
	if (!wait_state_after(AGENT_PLATESOLVER_WCS_PROPERTY_NAME, before, expected)) {
		fprintf(stderr, "%s", messages);
		REQUIRE(false);
	}
	return true;
}

static void make_fits(unsigned char *data, size_t size) {
	memset(data, ' ', size);
	memcpy(data, "SIMPLE", 6);
}

static unsigned char *make_raw(uint32_t signature, int width, int height, size_t *size) {
	int components = signature == INDIGO_RAW_RGB24 || signature == INDIGO_RAW_RGB48 ? 3 : 1;
	int bytes = signature == INDIGO_RAW_MONO16 || signature == INDIGO_RAW_RGB48 ? 2 : 1;
	*size = sizeof(indigo_raw_header) + (size_t)width * height * components * bytes;
	indigo_raw_header *raw = calloc(1, *size);
	raw->signature = signature;
	raw->width = width;
	raw->height = height;
	for (size_t i = sizeof(indigo_raw_header); i < *size; i++) {
		((unsigned char *)raw)[i] = (unsigned char)i;
	}
	return (unsigned char *)raw;
}

static unsigned char *make_jpeg(size_t *size) {
	struct jpeg_compress_struct cinfo = { 0 };
	struct jpeg_error_mgr error;
	cinfo.err = jpeg_std_error(&error);
	jpeg_create_compress(&cinfo);
	unsigned char *output = NULL;
	unsigned long output_size = 0;
	jpeg_mem_dest(&cinfo, &output, &output_size);
	cinfo.image_width = 2;
	cinfo.image_height = 2;
	cinfo.input_components = 3;
	cinfo.in_color_space = JCS_RGB;
	jpeg_set_defaults(&cinfo);
	jpeg_start_compress(&cinfo, TRUE);
	unsigned char row[6] = { 20, 30, 40, 50, 60, 70 };
	while (cinfo.next_scanline < cinfo.image_height) {
		JSAMPROW rows[] = { row };
		jpeg_write_scanlines(&cinfo, rows, 1);
	}
	jpeg_finish_compress(&cinfo);
	jpeg_destroy_compress(&cinfo);
	*size = output_size;
	return output;
}

static void schema_and_metadata(void) {
	indigo_driver_info info = { 0 };
	ASSERT_EQ_INT(INDIGO_OK, indigo_agent_astrometry(INDIGO_DRIVER_INFO, &info));
	ASSERT_STREQ("indigo_agent_astrometry", info.name);
	ASSERT_EQ_INT(INDIGO_DRIVER_API_2, INDIGO_DRIVER_API_GENERATION(info.version));
	const struct { const char *name; int type; int perm; int count; } expected[] = {
		{ INDEX_41, INDIGO_SWITCH_VECTOR, INDIGO_RW_PERM, 13 },
		{ INDEX_42, INDIGO_SWITCH_VECTOR, INDIGO_RW_PERM, 20 },
		{ AGENT_PLATESOLVER_USE_INDEX_PROPERTY_NAME, INDIGO_SWITCH_VECTOR, INDIGO_RW_PERM, 0 },
		{ AGENT_PLATESOLVER_HINTS_PROPERTY_NAME, INDIGO_NUMBER_VECTOR, INDIGO_RW_PERM, 9 },
		{ AGENT_PLATESOLVER_WCS_PROPERTY_NAME, INDIGO_NUMBER_VECTOR, INDIGO_RO_PERM, 10 },
		{ AGENT_PLATESOLVER_SYNC_PROPERTY_NAME, INDIGO_SWITCH_VECTOR, INDIGO_RW_PERM, 5 },
		{ AGENT_START_PROCESS_PROPERTY_NAME, INDIGO_SWITCH_VECTOR, INDIGO_RW_PERM, 7 },
		{ AGENT_ABORT_PROCESS_PROPERTY_NAME, INDIGO_SWITCH_VECTOR, INDIGO_RW_PERM, 1 },
		{ AGENT_PLATESOLVER_SOLVE_IMAGES_PROPERTY_NAME, INDIGO_SWITCH_VECTOR, INDIGO_RW_PERM, 2 },
		{ AGENT_PLATESOLVER_EXPOSURE_SETTINGS_PROPERTY_NAME, INDIGO_NUMBER_VECTOR, INDIGO_RW_PERM, 1 },
		{ AGENT_PLATESOLVER_PA_SETTINGS_PROPERTY_NAME, INDIGO_NUMBER_VECTOR, INDIGO_RW_PERM, 3 },
		{ AGENT_PLATESOLVER_GOTO_SETTINGS_PROPERTY_NAME, INDIGO_NUMBER_VECTOR, INDIGO_RW_PERM, 2 },
		{ AGENT_PLATESOLVER_MOUNT_SETTLE_TIME_PROPERTY_NAME, INDIGO_NUMBER_VECTOR, INDIGO_RW_PERM, 1 },
		{ AGENT_PLATESOLVER_IMAGE_PROPERTY_NAME, INDIGO_BLOB_VECTOR, INDIGO_WO_PERM, 1 },
		{ AGENT_PLATESOLVER_IMAGE_OUTPUT_PROPERTY_NAME, INDIGO_BLOB_VECTOR, INDIGO_RO_PERM, 1 },
		{ AGENT_PLATESOLVER_PA_STATE_PROPERTY_NAME, INDIGO_NUMBER_VECTOR, INDIGO_RO_PERM, 13 },
		{ AGENT_PLATESOLVER_ABORT_PROPERTY_NAME, INDIGO_SWITCH_VECTOR, INDIGO_RW_PERM, 1 },
		{ CCD_PREVIEW_PROPERTY_NAME, INDIGO_SWITCH_VECTOR, INDIGO_RW_PERM, 3 },
		{ CCD_PREVIEW_IMAGE_PROPERTY_NAME, INDIGO_BLOB_VECTOR, INDIGO_RO_PERM, 1 },
		{ CCD_JPEG_SETTINGS_PROPERTY_NAME, INDIGO_NUMBER_VECTOR, INDIGO_RW_PERM, 4 },
		{ CCD_JPEG_STRETCH_PRESETS_PROPERTY_NAME, INDIGO_SWITCH_VECTOR, INDIGO_RW_PERM, 4 }
	};
	for (unsigned i = 0; i < ARRAY_SIZE(expected); i++) {
		indigo_property *property = snapshot(AGENT, expected[i].name);
		ASSERT_TRUE(property != NULL);
		ASSERT_EQ_INT(expected[i].type, property->type);
		ASSERT_EQ_INT(expected[i].perm, property->perm);
		ASSERT_EQ_INT(expected[i].count, property->count);
		indigo_release_property(property);
	}
	const struct { const char *property; const char *name; } required_items[] = {
		{ AGENT_PLATESOLVER_HINTS_PROPERTY_NAME, AGENT_PLATESOLVER_HINTS_RADIUS_ITEM_NAME },
		{ AGENT_PLATESOLVER_HINTS_PROPERTY_NAME, AGENT_PLATESOLVER_HINTS_RA_ITEM_NAME },
		{ AGENT_PLATESOLVER_HINTS_PROPERTY_NAME, AGENT_PLATESOLVER_HINTS_DEC_ITEM_NAME },
		{ AGENT_PLATESOLVER_HINTS_PROPERTY_NAME, AGENT_PLATESOLVER_HINTS_EPOCH_ITEM_NAME },
		{ AGENT_PLATESOLVER_HINTS_PROPERTY_NAME, AGENT_PLATESOLVER_HINTS_SCALE_ITEM_NAME },
		{ AGENT_PLATESOLVER_HINTS_PROPERTY_NAME, AGENT_PLATESOLVER_HINTS_PARITY_ITEM_NAME },
		{ AGENT_PLATESOLVER_HINTS_PROPERTY_NAME, AGENT_PLATESOLVER_HINTS_DOWNSAMPLE_ITEM_NAME },
		{ AGENT_PLATESOLVER_HINTS_PROPERTY_NAME, AGENT_PLATESOLVER_HINTS_DEPTH_ITEM_NAME },
		{ AGENT_PLATESOLVER_HINTS_PROPERTY_NAME, AGENT_PLATESOLVER_HINTS_CPU_LIMIT_ITEM_NAME },
		{ AGENT_START_PROCESS_PROPERTY_NAME, AGENT_PLATESOLVER_START_SOLVE_ITEM_NAME },
		{ AGENT_START_PROCESS_PROPERTY_NAME, AGENT_PLATESOLVER_START_SYNC_ITEM_NAME },
		{ AGENT_START_PROCESS_PROPERTY_NAME, AGENT_PLATESOLVER_START_CENTER_ITEM_NAME },
		{ AGENT_START_PROCESS_PROPERTY_NAME, AGENT_PLATESOLVER_START_PRECISE_GOTO_ITEM_NAME },
		{ AGENT_START_PROCESS_PROPERTY_NAME, AGENT_PLATESOLVER_START_CALCULATE_PA_ERROR_ITEM_NAME },
		{ AGENT_START_PROCESS_PROPERTY_NAME, AGENT_PLATESOLVER_START_RECALCULATE_PA_ERROR_ITEM_NAME },
		{ AGENT_START_PROCESS_PROPERTY_NAME, AGENT_RESET_ITEM_NAME },
		{ AGENT_ABORT_PROCESS_PROPERTY_NAME, AGENT_ABORT_PROCESS_ITEM_NAME },
		{ CCD_PREVIEW_PROPERTY_NAME, CCD_PREVIEW_DISABLED_ITEM_NAME },
		{ CCD_PREVIEW_PROPERTY_NAME, CCD_PREVIEW_ENABLED_ITEM_NAME },
		{ CCD_PREVIEW_PROPERTY_NAME, CCD_PREVIEW_ENABLED_WITH_HISTOGRAM_ITEM_NAME }
	};
	for (unsigned i = 0; i < ARRAY_SIZE(required_items); i++) {
		indigo_property *property = snapshot(AGENT, required_items[i].property);
		ASSERT_TRUE(item(property, required_items[i].name) != NULL);
		indigo_release_property(property);
	}
}

static void settings_and_reset(void) {
	ASSERT_EQ_INT(INDIGO_OK, indigo_change_number_property_1(&observer, AGENT, AGENT_PLATESOLVER_HINTS_PROPERTY_NAME, AGENT_PLATESOLVER_HINTS_EPOCH_ITEM_NAME, 1999));
	indigo_property *hints = snapshot(AGENT, AGENT_PLATESOLVER_HINTS_PROPERTY_NAME);
	ASSERT_NEAR(2000, item(hints, AGENT_PLATESOLVER_HINTS_EPOCH_ITEM_NAME)->number.value, 0.001);
	indigo_release_property(hints);
	ASSERT_EQ_INT(INDIGO_OK, indigo_change_number_property_1(&observer, AGENT, AGENT_PLATESOLVER_EXPOSURE_SETTINGS_PROPERTY_NAME, AGENT_PLATESOLVER_EXPOSURE_SETTINGS_EXPOSURE_ITEM_NAME, 7));
	indigo_property *pa = snapshot(AGENT, AGENT_PLATESOLVER_PA_SETTINGS_PROPERTY_NAME);
	ASSERT_NEAR(7, item(pa, AGENT_PLATESOLVER_PA_SETTINGS_EXPOSURE_ITEM_NAME)->number.value, 0.001);
	indigo_release_property(pa);
	ASSERT_EQ_INT(INDIGO_OK, indigo_change_switch_property_1(&observer, AGENT, AGENT_START_PROCESS_PROPERTY_NAME, AGENT_RESET_ITEM_NAME, true));
	ASSERT_TRUE(wait_state_after(AGENT_START_PROCESS_PROPERTY_NAME, 0, INDIGO_OK_STATE));
	hints = snapshot(AGENT, AGENT_PLATESOLVER_HINTS_PROPERTY_NAME);
	ASSERT_NEAR(2000, item(hints, AGENT_PLATESOLVER_HINTS_EPOCH_ITEM_NAME)->number.value, 0.001);
	indigo_release_property(hints);
}

static void shared_controls_preview_and_mirror(void) {
	ASSERT_EQ_INT(INDIGO_OK, indigo_change_switch_property_1(&observer, AGENT, AGENT_PLATESOLVER_SOLVE_IMAGES_PROPERTY_NAME, AGENT_PLATESOLVER_SOLVE_IMAGES_DISABLED_ITEM_NAME, true));
	indigo_property *property = snapshot(AGENT, AGENT_PLATESOLVER_SOLVE_IMAGES_PROPERTY_NAME);
	ASSERT_TRUE(item(property, AGENT_PLATESOLVER_SOLVE_IMAGES_DISABLED_ITEM_NAME)->sw.value);
	indigo_release_property(property);
	ASSERT_EQ_INT(INDIGO_OK, indigo_change_switch_property_1(&observer, AGENT, AGENT_PLATESOLVER_SYNC_PROPERTY_NAME, AGENT_PLATESOLVER_SYNC_CENTER_ITEM_NAME, true));
	property = snapshot(AGENT, AGENT_PLATESOLVER_SYNC_PROPERTY_NAME);
	ASSERT_TRUE(item(property, AGENT_PLATESOLVER_SYNC_CENTER_ITEM_NAME)->sw.value);
	indigo_release_property(property);
	ASSERT_EQ_INT(INDIGO_OK, indigo_change_switch_property_1(&observer, AGENT, AGENT_PLATESOLVER_SYNC_PROPERTY_NAME, AGENT_PLATESOLVER_SYNC_DISABLED_ITEM_NAME, true));
	ASSERT_EQ_INT(INDIGO_OK, indigo_change_number_property_1(&observer, AGENT, AGENT_PLATESOLVER_PA_SETTINGS_PROPERTY_NAME, AGENT_PLATESOLVER_PA_SETTINGS_EXPOSURE_ITEM_NAME, 9));
	property = snapshot(AGENT, AGENT_PLATESOLVER_EXPOSURE_SETTINGS_PROPERTY_NAME);
	ASSERT_NEAR(9, item(property, AGENT_PLATESOLVER_EXPOSURE_SETTINGS_EXPOSURE_ITEM_NAME)->number.value, 0.001);
	indigo_release_property(property);
	ASSERT_EQ_INT(INDIGO_OK, indigo_change_switch_property_1(&observer, AGENT, CCD_JPEG_STRETCH_PRESETS_PROPERTY_NAME, CCD_JPEG_STRETCH_PRESETS_HARD_ITEM_NAME, true));
	property = snapshot(AGENT, CCD_JPEG_SETTINGS_PROPERTY_NAME);
	ASSERT_NEAR(0.40, item(property, CCD_JPEG_SETTINGS_TARGET_BACKGROUND_ITEM_NAME)->number.value, 0.001);
	ASSERT_NEAR(-2.5, item(property, CCD_JPEG_SETTINGS_CLIPPING_POINT_ITEM_NAME)->number.value, 0.001);
	indigo_release_property(property);
	const char *setting_names[] = { CCD_JPEG_SETTINGS_TARGET_BACKGROUND_ITEM_NAME, CCD_JPEG_SETTINGS_CLIPPING_POINT_ITEM_NAME, CCD_JPEG_SETTINGS_REF_CHANNEL_ITEM_NAME };
	double setting_values[] = { 0.37, -1.7, 2.8 };
	ASSERT_EQ_INT(INDIGO_OK, indigo_change_number_property(&observer, AGENT, CCD_JPEG_SETTINGS_PROPERTY_NAME, ARRAY_SIZE(setting_names), setting_names, setting_values));
	property = snapshot(AGENT, CCD_JPEG_SETTINGS_PROPERTY_NAME);
	ASSERT_EQ_INT(2, item(property, CCD_JPEG_SETTINGS_REF_CHANNEL_ITEM_NAME)->number.value);
	indigo_release_property(property);
	property = snapshot(AGENT, CCD_JPEG_STRETCH_PRESETS_PROPERTY_NAME);
	for (int i = 0; i < property->count; i++) {
		ASSERT_TRUE(!property->items[i].sw.value);
	}
	indigo_release_property(property);
	ASSERT_EQ_INT(INDIGO_OK, indigo_change_switch_property_1(&observer, AGENT, CCD_PREVIEW_PROPERTY_NAME, CCD_PREVIEW_ENABLED_ITEM_NAME, true));
	size_t size;
	unsigned char *raw = make_raw(INDIGO_RAW_MONO8, 32, 24, &size);
	ASSERT_TRUE(upload(raw, size, ".raw", INDIGO_OK_STATE));
	property = snapshot(AGENT, AGENT_PLATESOLVER_IMAGE_OUTPUT_PROPERTY_NAME);
	ASSERT_EQ_INT(size, item(property, AGENT_PLATESOLVER_IMAGE_OUTPUT_ITEM_NAME)->blob.size);
	ASSERT_STREQ(".raw", item(property, AGENT_PLATESOLVER_IMAGE_OUTPUT_ITEM_NAME)->blob.format);
	ASSERT_TRUE(!memcmp(raw, item(property, AGENT_PLATESOLVER_IMAGE_OUTPUT_ITEM_NAME)->blob.value, size));
	indigo_release_property(property);
	property = snapshot(AGENT, CCD_PREVIEW_IMAGE_PROPERTY_NAME);
	ASSERT_EQ_INT(INDIGO_OK_STATE, property->state);
	ASSERT_TRUE(item(property, CCD_PREVIEW_IMAGE_ITEM_NAME)->blob.size > 0);
	ASSERT_STREQ(".jpeg", item(property, CCD_PREVIEW_IMAGE_ITEM_NAME)->blob.format);
	indigo_release_property(property);
	free(raw);
}

static void fits_solution_and_arguments(void) {
	unsigned char data[2880];
	make_fits(data, sizeof(data));
	setenv("ASTROMETRY_FAKE_MODE", "success", 1);
	ASSERT_TRUE(upload(data, sizeof(data), ".fits", INDIGO_OK_STATE));
	indigo_property *wcs = snapshot(AGENT, AGENT_PLATESOLVER_WCS_PROPERTY_NAME);
	ASSERT_NEAR(12, item(wcs, AGENT_PLATESOLVER_WCS_RA_ITEM_NAME)->number.value, 0.001);
	ASSERT_NEAR(-30, item(wcs, AGENT_PLATESOLVER_WCS_DEC_ITEM_NAME)->number.value, 0.001);
	ASSERT_NEAR(2, item(wcs, AGENT_PLATESOLVER_WCS_WIDTH_ITEM_NAME)->number.value, 0.001);
	ASSERT_NEAR(1, item(wcs, AGENT_PLATESOLVER_WCS_HEIGHT_ITEM_NAME)->number.value, 0.001);
	ASSERT_NEAR(42.5, item(wcs, AGENT_PLATESOLVER_WCS_ANGLE_ITEM_NAME)->number.value, 0.001);
	ASSERT_NEAR(4205, item(wcs, AGENT_PLATESOLVER_WCS_INDEX_ITEM_NAME)->number.value, 0.001);
	ASSERT_NEAR(1, item(wcs, AGENT_PLATESOLVER_WCS_PARITY_ITEM_NAME)->number.value, 0.001);
	indigo_release_property(wcs);
	ASSERT_TRUE(has_message("fake solver running"));
}

static void solver_hints_and_config(void) {
	const char *names[] = {
		AGENT_PLATESOLVER_HINTS_RADIUS_ITEM_NAME,
		AGENT_PLATESOLVER_HINTS_RA_ITEM_NAME,
		AGENT_PLATESOLVER_HINTS_DEC_ITEM_NAME,
		AGENT_PLATESOLVER_HINTS_SCALE_ITEM_NAME,
		AGENT_PLATESOLVER_HINTS_PARITY_ITEM_NAME,
		AGENT_PLATESOLVER_HINTS_DOWNSAMPLE_ITEM_NAME,
		AGENT_PLATESOLVER_HINTS_DEPTH_ITEM_NAME,
		AGENT_PLATESOLVER_HINTS_CPU_LIMIT_ITEM_NAME
	};
	double values[] = { 5, 2, -10, 0.001, -1, 4, 20, 30 };
	ASSERT_EQ_INT(INDIGO_OK, indigo_change_number_property(&observer, AGENT, AGENT_PLATESOLVER_HINTS_PROPERTY_NAME, ARRAY_SIZE(names), names, values));
	unsigned char data[2880];
	make_fits(data, sizeof(data));
	ASSERT_TRUE(upload(data, sizeof(data), ".fits", INDIGO_OK_STATE));
	ASSERT_TRUE(file_contains(fake_log, "image2xy -O -v -d 4"));
	ASSERT_TRUE(file_contains(fake_log, "--ra 30 --dec -10 --radius 5"));
	ASSERT_TRUE(file_contains(fake_log, "--parity neg"));
	ASSERT_TRUE(file_contains(fake_log, "--depth 20"));
	ASSERT_TRUE(file_contains(fake_log, "--scale-units arcsecperpix --scale-low 3.060 --scale-high 4.140"));
	ASSERT_TRUE(file_contains(fake_log, "--cpulimit 30"));
	char config[512];
	snprintf(config, sizeof(config), "%s/astrometry.cfg", astrometry_folder);
	ASSERT_TRUE(file_contains(config, "add_path"));
}

static void solver_units_and_parity(void) {
	unsigned char data[2880];
	make_fits(data, sizeof(data));
	const char *modes[] = { "arcminutes", "arcseconds", "parity_neg" };
	for (unsigned i = 0; i < ARRAY_SIZE(modes); i++) {
		setenv("ASTROMETRY_FAKE_MODE", modes[i], 1);
		ASSERT_TRUE(upload(data, sizeof(data), ".fits", INDIGO_OK_STATE));
		indigo_property *wcs = snapshot(AGENT, AGENT_PLATESOLVER_WCS_PROPERTY_NAME);
		ASSERT_NEAR(2, item(wcs, AGENT_PLATESOLVER_WCS_WIDTH_ITEM_NAME)->number.value, 0.001);
		ASSERT_NEAR(1, item(wcs, AGENT_PLATESOLVER_WCS_HEIGHT_ITEM_NAME)->number.value, 0.001);
		ASSERT_NEAR(i == 2 ? -1 : 1, item(wcs, AGENT_PLATESOLVER_WCS_PARITY_ITEM_NAME)->number.value, 0.001);
		indigo_release_property(wcs);
	}
}

static void raw_formats(void) {
	const uint32_t formats[] = { INDIGO_RAW_MONO8, INDIGO_RAW_MONO16, INDIGO_RAW_RGB24, INDIGO_RAW_RGB48 };
	for (unsigned i = 0; i < ARRAY_SIZE(formats); i++) {
		size_t size;
		unsigned char *raw = make_raw(formats[i], 4, 3, &size);
		setenv("ASTROMETRY_FAKE_MODE", "success", 1);
		ASSERT_TRUE(upload(raw, size, ".raw", INDIGO_OK_STATE));
		free(raw);
	}
}

static void jpeg_format(void) {
	size_t size;
	unsigned char *jpeg = make_jpeg(&size);
	setenv("ASTROMETRY_FAKE_MODE", "success", 1);
	ASSERT_TRUE(upload(jpeg, size, ".jpeg", INDIGO_OK_STATE));
	free(jpeg);
}

static void invalid_short_images(void) {
	unsigned char short_data[] = { 'R', 'A', 'W' };
	ASSERT_TRUE(upload(short_data, sizeof(short_data), ".raw", INDIGO_ALERT_STATE));
	indigo_raw_header truncated = { .signature = INDIGO_RAW_MONO16, .width = 100, .height = 100 };
	ASSERT_TRUE(upload(&truncated, sizeof(truncated), ".raw", INDIGO_ALERT_STATE));
	unsigned char bad_jpeg[] = { 0xff, 0xd8, 0xff, 0x00 };
	ASSERT_TRUE(upload(bad_jpeg, sizeof(bad_jpeg), ".jpeg", INDIGO_ALERT_STATE));
}

static void invalid_raw_dimensions(void) {
	indigo_raw_header raw = { .signature = INDIGO_RAW_RGB48, .width = INT32_MAX, .height = INT32_MAX };
	ASSERT_TRUE(upload(&raw, sizeof(raw), ".raw", INDIGO_ALERT_STATE));
}

static void image_filesystem_failures(void) {
	unsigned char data[2880];
	make_fits(data, sizeof(data));
	char saved[512];
	ASSERT_TRUE(replace_with_placeholder(astrometry_folder, saved, sizeof(saved), false));
	bool uploaded = upload(data, sizeof(data), ".fits", INDIGO_ALERT_STATE);
	bool restored = restore_from_placeholder(astrometry_folder, saved);
	ASSERT_TRUE(uploaded);
	ASSERT_TRUE(restored);
	ASSERT_TRUE(has_message("Can't create temporary image file"));
	char config[512];
	snprintf(config, sizeof(config), "%s/astrometry.cfg", astrometry_folder);
	ASSERT_EQ_INT(0, mkdir(config, 0700));
	ASSERT_TRUE(upload(data, sizeof(data), ".fits", INDIGO_ALERT_STATE));
	ASSERT_TRUE(has_message("Can't create astrometry.cfg"));
}

static void solver_reported_failures(void) {
	unsigned char data[2880];
	make_fits(data, sizeof(data));
	const char *modes[] = { "no_solution", "no_index", "cpu_limit", "solve_not_found" };
	const char *expected[] = { "No solution found", "select at least one index", "CPU time limit reached", "Execution of solve-field failed" };
	for (unsigned i = 0; i < ARRAY_SIZE(modes); i++) {
		setenv("ASTROMETRY_FAKE_MODE", modes[i], 1);
		ASSERT_TRUE(upload(data, sizeof(data), ".fits", INDIGO_ALERT_STATE));
		ASSERT_TRUE(has_message(expected[i]));
	}
}

static void child_exit_status(void) {
	unsigned char data[2880];
	make_fits(data, sizeof(data));
	setenv("ASTROMETRY_FAKE_MODE", "image_exit", 1);
	ASSERT_TRUE(upload(data, sizeof(data), ".fits", INDIGO_ALERT_STATE));
	ASSERT_TRUE(has_message("Execution of image2xy failed"));
	setenv("ASTROMETRY_FAKE_MODE", "solve_exit", 1);
	ASSERT_TRUE(upload(data, sizeof(data), ".fits", INDIGO_ALERT_STATE));
	ASSERT_TRUE(has_message("Execution of solve-field failed"));
}

static void empty_upload(void) {
	ASSERT_EQ_INT(INDIGO_OK, indigo_change_blob_property_1(&observer, AGENT, AGENT_PLATESOLVER_IMAGE_PROPERTY_NAME, AGENT_PLATESOLVER_IMAGE_ITEM_NAME, NULL, 0, ".fits", ""));
	ASSERT_EQ_INT(INDIGO_ALERT_STATE, property_state(AGENT_PLATESOLVER_IMAGE_PROPERTY_NAME));
}

static void abort_and_recover(void) {
	unsigned char data[2880];
	make_fits(data, sizeof(data));
	setenv("ASTROMETRY_FAKE_MODE", "image_slow", 1);
	unsigned before = revision(AGENT_PLATESOLVER_WCS_PROPERTY_NAME);
	ASSERT_EQ_INT(INDIGO_OK, indigo_change_blob_property_1(&observer, AGENT, AGENT_PLATESOLVER_IMAGE_PROPERTY_NAME, AGENT_PLATESOLVER_IMAGE_ITEM_NAME, data, sizeof(data), ".fits", ""));
	ASSERT_TRUE(wait_state_after(AGENT_PLATESOLVER_WCS_PROPERTY_NAME, before, INDIGO_BUSY_STATE));
	ASSERT_EQ_INT(INDIGO_OK, indigo_change_switch_property_1(&observer, AGENT, AGENT_ABORT_PROCESS_PROPERTY_NAME, AGENT_ABORT_PROCESS_ITEM_NAME, true));
	ASSERT_TRUE(wait_not_busy_after(AGENT_PLATESOLVER_WCS_PROPERTY_NAME, before));
	ASSERT_EQ_INT(INDIGO_ALERT_STATE, property_state(AGENT_PLATESOLVER_WCS_PROPERTY_NAME));
	setenv("ASTROMETRY_FAKE_MODE", "success", 1);
	ASSERT_TRUE(upload(data, sizeof(data), ".fits", INDIGO_OK_STATE));
}

static void overlapping_solve_rejected(void) {
	unsigned char data[2880];
	make_fits(data, sizeof(data));
	setenv("ASTROMETRY_FAKE_MODE", "image_slow", 1);
	unsigned wcs_before = revision(AGENT_PLATESOLVER_WCS_PROPERTY_NAME);
	ASSERT_EQ_INT(INDIGO_OK, indigo_change_blob_property_1(&observer, AGENT, AGENT_PLATESOLVER_IMAGE_PROPERTY_NAME, AGENT_PLATESOLVER_IMAGE_ITEM_NAME, data, sizeof(data), ".fits", ""));
	ASSERT_TRUE(wait_state_after(AGENT_PLATESOLVER_WCS_PROPERTY_NAME, wcs_before, INDIGO_BUSY_STATE));
	unsigned image_before = revision(AGENT_PLATESOLVER_IMAGE_PROPERTY_NAME);
	ASSERT_EQ_INT(INDIGO_OK, indigo_change_blob_property_1(&observer, AGENT, AGENT_PLATESOLVER_IMAGE_PROPERTY_NAME, AGENT_PLATESOLVER_IMAGE_ITEM_NAME, data, sizeof(data), ".fits", ""));
	ASSERT_TRUE(wait_state_after(AGENT_PLATESOLVER_IMAGE_PROPERTY_NAME, image_before, INDIGO_ALERT_STATE));
	ASSERT_EQ_INT(INDIGO_BUSY_STATE, property_state(AGENT_PLATESOLVER_WCS_PROPERTY_NAME));
	ASSERT_EQ_INT(INDIGO_OK, indigo_change_switch_property_1(&observer, AGENT, AGENT_ABORT_PROCESS_PROPERTY_NAME, AGENT_ABORT_PROCESS_ITEM_NAME, true));
	ASSERT_TRUE(wait_not_busy_after(AGENT_PLATESOLVER_WCS_PROPERTY_NAME, wcs_before));
	setenv("ASTROMETRY_FAKE_MODE", "success", 1);
	ASSERT_TRUE(upload(data, sizeof(data), ".fits", INDIGO_OK_STATE));
}

static void direct_upload_copies_target(void) {
	unsigned char data[2880];
	make_fits(data, sizeof(data));
	ASSERT_TRUE(upload(data, sizeof(data), ".fits", INDIGO_OK_STATE));
	indigo_property *target = snapshot(AGENT, AGENT_PLATESOLVER_GOTO_SETTINGS_PROPERTY_NAME);
	ASSERT_NEAR(12, item(target, AGENT_PLATESOLVER_GOTO_SETTINGS_RA_ITEM_NAME)->number.value, 0.001);
	ASSERT_NEAR(-30, item(target, AGENT_PLATESOLVER_GOTO_SETTINGS_DEC_ITEM_NAME)->number.value, 0.001);
	indigo_release_property(target);
}

static void related_agent_capture(void) {
	ASSERT_TRUE(select_related(IMAGER));
	unsigned before = revision(AGENT_START_PROCESS_PROPERTY_NAME);
	ASSERT_EQ_INT(INDIGO_OK, indigo_change_switch_property_1(&observer, AGENT, AGENT_START_PROCESS_PROPERTY_NAME, AGENT_PLATESOLVER_START_SOLVE_ITEM_NAME, true));
	ASSERT_TRUE(wait_state_after(AGENT_START_PROCESS_PROPERTY_NAME, before, INDIGO_OK_STATE));
	ASSERT_EQ_INT(1, atomic_load(&imager_capture_requests));
	ASSERT_EQ_INT(INDIGO_OK_STATE, property_state(AGENT_PLATESOLVER_WCS_PROPERTY_NAME));
}

static void peer_failures_and_abort_forwarding(void) {
	ASSERT_TRUE(select_related(IMAGER));
	ASSERT_TRUE(select_related(MOUNT));
	atomic_store(&fail_imager_capture, true);
	unsigned before = revision(AGENT_START_PROCESS_PROPERTY_NAME);
	ASSERT_EQ_INT(INDIGO_OK, indigo_change_switch_property_1(&observer, AGENT, AGENT_START_PROCESS_PROPERTY_NAME, AGENT_PLATESOLVER_START_SOLVE_ITEM_NAME, true));
	ASSERT_TRUE(wait_state_after(AGENT_START_PROCESS_PROPERTY_NAME, before, INDIGO_ALERT_STATE));
	atomic_store(&fail_imager_capture, false);
	atomic_store(&fail_mount_start, true);
	before = revision(AGENT_START_PROCESS_PROPERTY_NAME);
	ASSERT_EQ_INT(INDIGO_OK, indigo_change_switch_property_1(&observer, AGENT, AGENT_START_PROCESS_PROPERTY_NAME, AGENT_PLATESOLVER_START_SYNC_ITEM_NAME, true));
	ASSERT_TRUE(wait_state_after(AGENT_START_PROCESS_PROPERTY_NAME, before, INDIGO_ALERT_STATE));
	atomic_store(&fail_mount_start, false);
	atomic_store(&hold_imager_capture, true);
	before = revision(AGENT_START_PROCESS_PROPERTY_NAME);
	ASSERT_EQ_INT(INDIGO_OK, indigo_change_switch_property_1(&observer, AGENT, AGENT_START_PROCESS_PROPERTY_NAME, AGENT_PLATESOLVER_START_SOLVE_ITEM_NAME, true));
	ASSERT_TRUE(wait_state_after(AGENT_START_PROCESS_PROPERTY_NAME, before, INDIGO_BUSY_STATE));
	ASSERT_EQ_INT(INDIGO_OK, indigo_change_switch_property_1(&observer, AGENT, AGENT_ABORT_PROCESS_PROPERTY_NAME, AGENT_ABORT_PROCESS_ITEM_NAME, true));
	ASSERT_TRUE(wait_state_after(AGENT_START_PROCESS_PROPERTY_NAME, before, INDIGO_ALERT_STATE));
	ASSERT_EQ_INT(1, atomic_load(&imager_abort_requests));
	atomic_store(&hold_imager_capture, false);
}

static void mount_abort_forwarding(void) {
	ASSERT_TRUE(select_related(IMAGER));
	ASSERT_TRUE(select_related(MOUNT));
	atomic_store(&hold_mount_start, true);
	ASSERT_EQ_INT(INDIGO_OK, indigo_change_number_property_1(&observer, AGENT, AGENT_PLATESOLVER_MOUNT_SETTLE_TIME_PROPERTY_NAME, AGENT_PLATESOLVER_MOUNT_SETTLE_TIME_ITEM_NAME, 0));
	unsigned before = revision(AGENT_START_PROCESS_PROPERTY_NAME);
	ASSERT_EQ_INT(INDIGO_OK, indigo_change_switch_property_1(&observer, AGENT, AGENT_START_PROCESS_PROPERTY_NAME, AGENT_PLATESOLVER_START_PRECISE_GOTO_ITEM_NAME, true));
	ASSERT_TRUE(wait_state_after(AGENT_START_PROCESS_PROPERTY_NAME, before, INDIGO_BUSY_STATE));
	for (int i = 0; i < 5000 && atomic_load(&mount_start_requests) < 1; i++) {
		indigo_usleep(1000);
	}
	ASSERT_TRUE(atomic_load(&mount_start_requests) >= 1);
	ASSERT_EQ_INT(INDIGO_OK, indigo_change_switch_property_1(&observer, AGENT, AGENT_ABORT_PROCESS_PROPERTY_NAME, AGENT_ABORT_PROCESS_ITEM_NAME, true));
	ASSERT_TRUE(wait_state_after(AGENT_START_PROCESS_PROPERTY_NAME, before, INDIGO_ALERT_STATE));
	ASSERT_TRUE(atomic_load(&mount_abort_requests) >= 1);
}

static void missing_image_source(void) {
	unsigned before = revision(AGENT_START_PROCESS_PROPERTY_NAME);
	ASSERT_EQ_INT(INDIGO_OK, indigo_change_switch_property_1(&observer, AGENT, AGENT_START_PROCESS_PROPERTY_NAME, AGENT_PLATESOLVER_START_SOLVE_ITEM_NAME, true));
	ASSERT_TRUE(wait_state_after(AGENT_START_PROCESS_PROPERTY_NAME, before, INDIGO_ALERT_STATE));
	ASSERT_TRUE(has_message("no image source agent selected"));
}

static void sync_and_center(void) {
	ASSERT_TRUE(select_related(IMAGER));
	ASSERT_TRUE(select_related(MOUNT));
	ASSERT_EQ_INT(INDIGO_OK, indigo_change_number_property_1(&observer, AGENT, AGENT_PLATESOLVER_MOUNT_SETTLE_TIME_PROPERTY_NAME, AGENT_PLATESOLVER_MOUNT_SETTLE_TIME_ITEM_NAME, 0));
	const char *operations[] = { AGENT_PLATESOLVER_START_SYNC_ITEM_NAME, AGENT_PLATESOLVER_START_CENTER_ITEM_NAME };
	for (unsigned i = 0; i < ARRAY_SIZE(operations); i++) {
		unsigned before = revision(AGENT_START_PROCESS_PROPERTY_NAME);
		ASSERT_EQ_INT(INDIGO_OK, indigo_change_switch_property_1(&observer, AGENT, AGENT_START_PROCESS_PROPERTY_NAME, operations[i], true));
		ASSERT_TRUE(wait_state_after(AGENT_START_PROCESS_PROPERTY_NAME, before, INDIGO_OK_STATE));
	}
	ASSERT_EQ_INT(3, atomic_load(&mount_start_requests));
	indigo_property *fov = snapshot(MOUNT, AGENT_MOUNT_FOV_PROPERTY_NAME);
	ASSERT_NEAR(42.5, item(fov, AGENT_MOUNT_FOV_ANGLE_ITEM_NAME)->number.value, 0.001);
	indigo_release_property(fov);
}

static void precise_goto(void) {
	ASSERT_TRUE(select_related(IMAGER));
	ASSERT_TRUE(select_related(MOUNT));
	ASSERT_EQ_INT(INDIGO_OK, indigo_change_number_property_1(&observer, AGENT, AGENT_PLATESOLVER_MOUNT_SETTLE_TIME_PROPERTY_NAME, AGENT_PLATESOLVER_MOUNT_SETTLE_TIME_ITEM_NAME, 0));
	const char *names[] = { AGENT_PLATESOLVER_GOTO_SETTINGS_RA_ITEM_NAME, AGENT_PLATESOLVER_GOTO_SETTINGS_DEC_ITEM_NAME };
	double values[] = { 13, 25 };
	ASSERT_EQ_INT(INDIGO_OK, indigo_change_number_property(&observer, AGENT, AGENT_PLATESOLVER_GOTO_SETTINGS_PROPERTY_NAME, 2, names, values));
	unsigned before = revision(AGENT_START_PROCESS_PROPERTY_NAME);
	ASSERT_EQ_INT(INDIGO_OK, indigo_change_switch_property_1(&observer, AGENT, AGENT_START_PROCESS_PROPERTY_NAME, AGENT_PLATESOLVER_START_PRECISE_GOTO_ITEM_NAME, true));
	ASSERT_TRUE(wait_state_after(AGENT_START_PROCESS_PROPERTY_NAME, before, INDIGO_OK_STATE));
	ASSERT_EQ_INT(3, atomic_load(&mount_start_requests));
}

static void polar_alignment_failures(void) {
	ASSERT_TRUE(select_related(IMAGER));
	ASSERT_TRUE(select_related(MOUNT));
	ASSERT_EQ_INT(INDIGO_OK, indigo_change_number_property_1(&observer, AGENT, AGENT_PLATESOLVER_MOUNT_SETTLE_TIME_PROPERTY_NAME, AGENT_PLATESOLVER_MOUNT_SETTLE_TIME_ITEM_NAME, 0));
	atomic_store(&fail_mount_start, true);
	unsigned before = revision(AGENT_START_PROCESS_PROPERTY_NAME);
	ASSERT_EQ_INT(INDIGO_OK, indigo_change_switch_property_1(&observer, AGENT, AGENT_START_PROCESS_PROPERTY_NAME, AGENT_PLATESOLVER_START_CALCULATE_PA_ERROR_ITEM_NAME, true));
	ASSERT_TRUE(wait_state_after(AGENT_START_PROCESS_PROPERTY_NAME, before, INDIGO_ALERT_STATE));
	indigo_property *state = snapshot(AGENT, AGENT_PLATESOLVER_PA_STATE_PROPERTY_NAME);
	ASSERT_EQ_INT(INDIGO_POLAR_ALIGN_IDLE, item(state, AGENT_PLATESOLVER_PA_STATE_ITEM_NAME)->number.value);
	ASSERT_EQ_INT(INDIGO_ALERT_STATE, state->state);
	indigo_release_property(state);
	atomic_store(&fail_mount_start, false);
	before = revision(AGENT_START_PROCESS_PROPERTY_NAME);
	ASSERT_EQ_INT(INDIGO_OK, indigo_change_switch_property_1(&observer, AGENT, AGENT_START_PROCESS_PROPERTY_NAME, AGENT_PLATESOLVER_START_RECALCULATE_PA_ERROR_ITEM_NAME, true));
	ASSERT_TRUE(wait_state_after(AGENT_START_PROCESS_PROPERTY_NAME, before, INDIGO_ALERT_STATE));
	ASSERT_TRUE(has_message("Polar alignment is not in progress"));
}

static void polar_alignment_and_recalculation(void) {
	ASSERT_TRUE(select_related(IMAGER));
	ASSERT_TRUE(select_related(MOUNT));
	ASSERT_EQ_INT(INDIGO_OK, indigo_change_number_property_1(&observer, AGENT, AGENT_PLATESOLVER_MOUNT_SETTLE_TIME_PROPERTY_NAME, AGENT_PLATESOLVER_MOUNT_SETTLE_TIME_ITEM_NAME, 0));
	unsigned before = revision(AGENT_START_PROCESS_PROPERTY_NAME);
	ASSERT_EQ_INT(INDIGO_OK, indigo_change_switch_property_1(&observer, AGENT, AGENT_START_PROCESS_PROPERTY_NAME, AGENT_PLATESOLVER_START_CALCULATE_PA_ERROR_ITEM_NAME, true));
	ASSERT_TRUE(wait_state_after(AGENT_START_PROCESS_PROPERTY_NAME, before, INDIGO_OK_STATE));
	ASSERT_EQ_INT(3, atomic_load(&imager_capture_requests));
	ASSERT_EQ_INT(2, atomic_load(&mount_start_requests));
	indigo_property *state = snapshot(AGENT, AGENT_PLATESOLVER_PA_STATE_PROPERTY_NAME);
	ASSERT_EQ_INT(INDIGO_POLAR_ALIGN_IN_PROGRESS, item(state, AGENT_PLATESOLVER_PA_STATE_ITEM_NAME)->number.value);
	ASSERT_EQ_INT(INDIGO_OK_STATE, state->state);
	indigo_release_property(state);
	before = revision(AGENT_START_PROCESS_PROPERTY_NAME);
	ASSERT_EQ_INT(INDIGO_OK, indigo_change_switch_property_1(&observer, AGENT, AGENT_START_PROCESS_PROPERTY_NAME, AGENT_PLATESOLVER_START_RECALCULATE_PA_ERROR_ITEM_NAME, true));
	ASSERT_TRUE(wait_state_after(AGENT_START_PROCESS_PROPERTY_NAME, before, INDIGO_OK_STATE));
	ASSERT_EQ_INT(4, atomic_load(&imager_capture_requests));
	state = snapshot(AGENT, AGENT_PLATESOLVER_PA_STATE_PROPERTY_NAME);
	ASSERT_EQ_INT(INDIGO_POLAR_ALIGN_IN_PROGRESS, item(state, AGENT_PLATESOLVER_PA_STATE_ITEM_NAME)->number.value);
	ASSERT_EQ_INT(INDIGO_OK_STATE, state->state);
	indigo_release_property(state);
}

static void index_install_remove(void) {
	setenv("ASTROMETRY_FAKE_MODE", "success", 1);
	unsigned before = revision(INDEX_42);
	ASSERT_EQ_INT(INDIGO_OK, indigo_change_switch_property_1(&observer, AGENT, INDEX_42, "4219", true));
	ASSERT_TRUE(wait_state_after(INDEX_42, before, INDIGO_OK_STATE));
	char path[512];
	snprintf(path, sizeof(path), "%s/index-4219.fits", astrometry_folder);
	ASSERT_EQ_INT(0, access(path, R_OK));
	indigo_property *use = snapshot(AGENT, AGENT_PLATESOLVER_USE_INDEX_PROPERTY_NAME);
	ASSERT_TRUE(item(use, "4219") != NULL);
	indigo_release_property(use);
	before = revision(INDEX_42);
	ASSERT_EQ_INT(INDIGO_OK, indigo_change_switch_property_1(&observer, AGENT, INDEX_42, "4219", false));
	ASSERT_TRUE(wait_state_after(INDEX_42, before, INDIGO_OK_STATE));
	ASSERT_TRUE(access(path, F_OK) != 0);
}

static void index_download_failures(void) {
	const char *modes[] = { "curl_exit", "curl_bad" };
	for (unsigned i = 0; i < ARRAY_SIZE(modes); i++) {
		setenv("ASTROMETRY_FAKE_MODE", modes[i], 1);
		unsigned before = revision(INDEX_41);
		ASSERT_EQ_INT(INDIGO_OK, indigo_change_switch_property_1(&observer, AGENT, INDEX_41, "4119", true));
		ASSERT_TRUE(wait_state_after(INDEX_41, before, INDIGO_ALERT_STATE));
		char path[512];
		snprintf(path, sizeof(path), "%s/index-4119.fits", astrometry_folder);
		ASSERT_TRUE(access(path, F_OK) != 0);
	}
}

static void index_remove_failure_and_recovery(void) {
	setenv("ASTROMETRY_FAKE_MODE", "success", 1);
	unsigned before = revision(INDEX_42);
	ASSERT_EQ_INT(INDIGO_OK, indigo_change_switch_property_1(&observer, AGENT, INDEX_42, "4219", true));
	ASSERT_TRUE(wait_state_after(INDEX_42, before, INDIGO_OK_STATE));
	char path[512];
	snprintf(path, sizeof(path), "%s/index-4219.fits", astrometry_folder);
	char saved[512];
	ASSERT_TRUE(replace_with_placeholder(path, saved, sizeof(saved), true));
	before = revision(INDEX_42);
	bool requested = indigo_change_switch_property_1(&observer, AGENT, INDEX_42, "4219", false) == INDIGO_OK;
	bool failed = requested && wait_state_after(INDEX_42, before, INDIGO_ALERT_STATE);
	bool restored = restore_from_placeholder(path, saved);
	ASSERT_TRUE(requested);
	ASSERT_TRUE(failed);
	ASSERT_TRUE(restored);
	ASSERT_EQ_INT(0, access(path, R_OK));
	before = revision(INDEX_42);
	ASSERT_EQ_INT(INDIGO_OK, indigo_change_switch_property_1(&observer, AGENT, INDEX_42, "4219", false));
	ASSERT_TRUE(wait_state_after(INDEX_42, before, INDIGO_OK_STATE));
	ASSERT_TRUE(access(path, F_OK) != 0);
}

static void additional_instances_lifecycle(void) {
	ASSERT_EQ_INT(INDIGO_OK, indigo_change_number_property_1(&observer, AGENT, ADDITIONAL_INSTANCES_PROPERTY_NAME, ADDITIONAL_INSTANCES_COUNT_ITEM_NAME, 1));
	ASSERT_TRUE(wait_defined("Astrometry Agent #2", AGENT_PLATESOLVER_WCS_PROPERTY_NAME));
	ASSERT_TRUE(wait_defined("Astrometry Agent #2", INDEX_41));
	setenv("ASTROMETRY_FAKE_MODE", "curl_slow", 1);
	unsigned first_before = revision_for(AGENT, INDEX_42);
	unsigned second_before = revision_for("Astrometry Agent #2", INDEX_42);
	ASSERT_EQ_INT(INDIGO_OK, indigo_change_switch_property_1(&observer, AGENT, INDEX_42, "4219", true));
	ASSERT_EQ_INT(INDIGO_OK, indigo_change_switch_property_1(&observer, "Astrometry Agent #2", INDEX_42, "4218", true));
	ASSERT_TRUE(wait_device_state_after(AGENT, INDEX_42, first_before, INDIGO_OK_STATE));
	ASSERT_TRUE(wait_device_state_after("Astrometry Agent #2", INDEX_42, second_before, INDIGO_OK_STATE));
	setenv("ASTROMETRY_FAKE_MODE", "success", 1);
	ASSERT_EQ_INT(INDIGO_OK, indigo_change_number_property_1(&observer, AGENT, ADDITIONAL_INSTANCES_PROPERTY_NAME, ADDITIONAL_INSTANCES_COUNT_ITEM_NAME, 0));
	ASSERT_TRUE(wait_deleted("Astrometry Agent #2", AGENT_PLATESOLVER_WCS_PROPERTY_NAME));
	ASSERT_EQ_INT(INDIGO_OK, indigo_change_number_property_1(&observer, AGENT, ADDITIONAL_INSTANCES_PROPERTY_NAME, ADDITIONAL_INSTANCES_COUNT_ITEM_NAME, 1));
	ASSERT_TRUE(wait_defined("Astrometry Agent #2", AGENT_PLATESOLVER_WCS_PROPERTY_NAME));
	ASSERT_EQ_INT(INDIGO_OK, indigo_change_number_property_1(&observer, AGENT, ADDITIONAL_INSTANCES_PROPERTY_NAME, ADDITIONAL_INSTANCES_COUNT_ITEM_NAME, 0));
	ASSERT_TRUE(wait_deleted("Astrometry Agent #2", AGENT_PLATESOLVER_WCS_PROPERTY_NAME));
}

static void repeated_driver_lifecycle(void) {
	ASSERT_EQ_INT(INDIGO_OK, indigo_change_number_property_1(&observer, AGENT, AGENT_PLATESOLVER_HINTS_PROPERTY_NAME, AGENT_PLATESOLVER_HINTS_RADIUS_ITEM_NAME, 7));
	ASSERT_EQ_INT(INDIGO_OK, indigo_change_number_property_1(&observer, AGENT, AGENT_PLATESOLVER_MOUNT_SETTLE_TIME_PROPERTY_NAME, AGENT_PLATESOLVER_MOUNT_SETTLE_TIME_ITEM_NAME, 4));
	ASSERT_EQ_INT(INDIGO_OK, indigo_agent_astrometry(INDIGO_DRIVER_SHUTDOWN, NULL));
	running = false;
	ASSERT_TRUE(wait_deleted(AGENT, AGENT_PLATESOLVER_WCS_PROPERTY_NAME));
	ASSERT_EQ_INT(INDIGO_OK, indigo_agent_astrometry(INDIGO_DRIVER_INIT, NULL));
	running = true;
	ASSERT_TRUE(wait_defined(AGENT, AGENT_PLATESOLVER_WCS_PROPERTY_NAME));
	indigo_property *property = snapshot(AGENT, AGENT_PLATESOLVER_HINTS_PROPERTY_NAME);
	ASSERT_NEAR(7, item(property, AGENT_PLATESOLVER_HINTS_RADIUS_ITEM_NAME)->number.value, 0.001);
	indigo_release_property(property);
	property = snapshot(AGENT, AGENT_PLATESOLVER_MOUNT_SETTLE_TIME_PROPERTY_NAME);
	ASSERT_NEAR(4, item(property, AGENT_PLATESOLVER_MOUNT_SETTLE_TIME_ITEM_NAME)->number.value, 0.001);
	indigo_release_property(property);
	unsigned char data[2880];
	make_fits(data, sizeof(data));
	ASSERT_TRUE(upload(data, sizeof(data), ".fits", INDIGO_OK_STATE));
}

static void shutdown_during_solve(void) {
	unsigned char data[2880];
	make_fits(data, sizeof(data));
	setenv("ASTROMETRY_FAKE_MODE", "image_slow", 1);
	unsigned before = revision(AGENT_PLATESOLVER_WCS_PROPERTY_NAME);
	ASSERT_EQ_INT(INDIGO_OK, indigo_change_blob_property_1(&observer, AGENT, AGENT_PLATESOLVER_IMAGE_PROPERTY_NAME, AGENT_PLATESOLVER_IMAGE_ITEM_NAME, data, sizeof(data), ".fits", ""));
	ASSERT_TRUE(wait_state_after(AGENT_PLATESOLVER_WCS_PROPERTY_NAME, before, INDIGO_BUSY_STATE));
	ASSERT_EQ_INT(INDIGO_OK, indigo_agent_astrometry(INDIGO_DRIVER_SHUTDOWN, NULL));
	running = false;
}

static const indigo_test_case tests[] = {
	{ "schema and metadata", schema_and_metadata },
	{ "settings synchronization and reset", settings_and_reset },
	{ "shared controls preview and image mirror", shared_controls_preview_and_mirror },
	{ "FITS solution and parsed WCS", fits_solution_and_arguments },
	{ "solver hints and generated config", solver_hints_and_config },
	{ "solver size units and parity", solver_units_and_parity },
	{ "RAW1 RAW2 RAW3 RAW6 conversion", raw_formats },
	{ "JPEG conversion", jpeg_format },
	{ "short truncated and broken images", invalid_short_images },
	{ "invalid RAW dimensions", invalid_raw_dimensions },
	{ "image filesystem failures", image_filesystem_failures },
	{ "reported solver failures", solver_reported_failures },
	{ "child process exit status", child_exit_status },
	{ "empty image upload", empty_upload },
	{ "abort and recovery", abort_and_recover },
	{ "overlapping solve rejection and recovery", overlapping_solve_rejected },
	{ "direct upload copies GOTO target", direct_upload_copies_target },
	{ "related Imager Agent capture", related_agent_capture },
	{ "peer failures and Imager abort forwarding", peer_failures_and_abort_forwarding },
	{ "Mount abort forwarding", mount_abort_forwarding },
	{ "missing image source", missing_image_source },
	{ "mount sync and center", sync_and_center },
	{ "precise GOTO", precise_goto },
	{ "polar alignment failures", polar_alignment_failures },
	{ "polar alignment and recalculation", polar_alignment_and_recalculation },
	{ "index install and remove", index_install_remove },
	{ "index download failures", index_download_failures },
	{ "index remove failure and recovery", index_remove_failure_and_recovery },
	{ "additional instances lifecycle", additional_instances_lifecycle },
	{ "repeated driver lifecycle", repeated_driver_lifecycle },
	{ "shutdown during solve", shutdown_during_solve }
};

int main(int argc, char **argv) {
	setvbuf(stdout, NULL, _IONBF, 0);
	int failed = 0;
	int executed = 0;
	for (unsigned i = 0; i < ARRAY_SIZE(tests); i++) {
		if (argc > 1 && !strstr(tests[i].name, argv[1])) {
			continue;
		}
		executed++;
		strcpy(test_root, "/tmp/indigo_astrometry_test_XXXXXX");
		if (!mkdtemp(test_root)) {
			return 1;
		}
		snprintf(astrometry_folder, sizeof(astrometry_folder), "%s/cache/astrometry", test_root);
		snprintf(fake_bin, sizeof(fake_bin), "%s/bin", test_root);
		snprintf(fake_log, sizeof(fake_log), "%s/commands.log", test_root);
		char cache_base[320];
		snprintf(cache_base, sizeof(cache_base), "%s/cache", test_root);
		mkdir(cache_base, 0700);
		create_fake_tools();
		const char *old_path = getenv("PATH");
		char path[4096];
		snprintf(path, sizeof(path), "%s:%s", fake_bin, old_path ? old_path : "");
		setenv("PATH", path, 1);
		setenv("INDIGO_CACHE_BASE", cache_base, 1);
		setenv("ASTROMETRY_FAKE_LOG", fake_log, 1);
		setenv("ASTROMETRY_FAKE_MODE", "success", 1);
		pid_t child = fork();
		if (child == 0) {
			alarm(60);
			if (!indigo_test_set_private_home(test_root)) {
				exit(1);
			}
			int status = setup() ? indigo_run_tests("Astrometry Agent integration", tests + i, 1) : 1;
			cleanup();
			exit(status || indigo_test_failures ? 1 : 0);
		}
		int status = -1;
		if (child < 0 || waitpid(child, &status, 0) != child || !WIFEXITED(status) || WEXITSTATUS(status)) {
			fprintf(stderr, "FAILED %s (status %d)\n", tests[i].name, status);
			failed++;
		}
		if (getenv("INDIGO_TEST_KEEP_OUTPUT")) {
			printf("Kept test output in %s\n", test_root);
		} else {
			indigo_test_remove_tree(test_root);
		}
	}
	printf("Astrometry Agent: %d/%d passed (including cleanup)\n", executed - failed, executed);
	return executed ? (failed ? 1 : 0) : 2;
}
