// Copyright (c) 2026 INDIGO initiative
// All rights reserved.
//
// You may use this software under the terms of 'INDIGO Astronomy
// open-source license' (see LICENSE.md).
//
// THIS SOFTWARE IS PROVIDED BY THE AUTHORS 'AS IS' AND ANY EXPRESS
// OR IMPLIED WARRANTIES, INCLUDING, BUT NOT LIMITED TO, THE IMPLIED
// WARRANTIES OF MERCHANTABILITY AND FITNESS FOR A PARTICULAR PURPOSE
// ARE DISCLAIMED. IN NO EVENT SHALL THE AUTHOR BE LIABLE FOR ANY
// DIRECT, INDIRECT, INCIDENTAL, SPECIAL, EXEMPLARY, OR CONSEQUENTIAL
// DAMAGES (INCLUDING, BUT NOT LIMITED TO, PROCUREMENT OF SUBSTITUTE
// GOODS OR SERVICES; LOSS OF USE, DATA, OR PROFITS; OR BUSINESS
// INTERRUPTION) HOWEVER CAUSED AND ON ANY THEORY OF LIABILITY,
// WHETHER IN CONTRACT, STRICT LIABILITY, OR TORT (INCLUDING
// NEGLIGENCE OR OTHERWISE) ARISING IN ANY WAY OUT OF THE USE OF THIS
// SOFTWARE, EVEN IF ADVISED OF THE POSSIBILITY OF SUCH DAMAGE.

// Code is generated by AI

// Transport-level coverage shared by the drivers whose whole device interaction is one line of
// text: TEST_KIND 1 is the LX200 guide pulse of guider_cgusbst4, TEST_KIND 2 is the Alnitak light
// box of aux_geoptikflat. The indigo_uni_io entry points are replaced at compile time, which is the
// only place the open/close balance and an injected write failure can be observed.

#include <stdatomic.h>
#include <stdarg.h>
#include <indigo/indigo_driver.h>
#include <indigo/indigo_uni_io.h>
#include "serial_simulator_test_common.h"

extern indigo_result TEST_ENTRY(indigo_driver_action, indigo_driver_info *);
static const simulator_driver_case driver = { TEST_NAME, "test", TEST_NAME, TEST_ENTRY, false, NULL, 0, NULL, 0, NULL, 0, NULL, 0 };
static atomic_int opens, closes, writes, invalid_io, fail_open, fail_write, fail_read, bad_reply;
static atomic_int brightness;
static char command[80];
static const char *fail_command;
static indigo_uni_handle handle;

indigo_uni_handle *output_open(const char *port, int level) {
	if (atomic_exchange(&fail_open, 0)) {
		return NULL;
	}
	atomic_fetch_add(&opens, 1);
	return &handle;
}

void output_close(indigo_uni_handle **port) {
	if (*port) {
		atomic_fetch_add(&closes, 1);
		*port = NULL;
	}
}

long output_discard(indigo_uni_handle *port) {
	if (port != &handle || opens == closes) {
		atomic_fetch_add(&invalid_io, 1);
		return -1;
	}
	return 0;
}

long output_write(indigo_uni_handle *port, const char *format, va_list args) {
	if (output_discard(port) < 0 || atomic_exchange(&fail_write, 0)) {
		return -1;
	}
	int size = vsnprintf(command, sizeof(command), format, args);
	if (fail_command && !strcmp(command, fail_command)) {
		fail_command = NULL;
		return -1;
	}
	if (TEST_KIND == 2 && !strncmp(command, ">B", 2)) {
		atomic_store(&brightness, atoi(command + 2));
	}
	atomic_fetch_add(&writes, 1);
	return size;
}

long output_write_line(indigo_uni_handle *port, const char *format, va_list args, char *terminator) {
	if (TEST_KIND == 2 && strcmp(terminator, "\r")) {
		atomic_fetch_add(&invalid_io, 1);
		return -1;
	}
	return output_write(port, format, args);
}

long output_read(indigo_uni_handle *port, char *buffer, long length, const char *terminators, const char *ignore, long timeout) {
	if (output_discard(port) < 0 || atomic_exchange(&fail_read, 0)) {
		return -1;
	}
#if TEST_KIND == 2
	// The Alnitak generic reply echoes the operation that was sent as "*Xiizzz", and the driver
	// uses that echo to tell the answer to this command from a stale or foreign reply.
	char echo[16];
	snprintf(echo, sizeof(echo), "*%c19000", command[0] == '>' ? command[1] : 'P');
	const char *reply = atomic_exchange(&bad_reply, 0) ? "!invalid" : echo;
#else
	// The CG-USB-ST4 adapter acknowledges a guide pulse with a single character.
	const char *reply = atomic_exchange(&bad_reply, 0) ? "!invalid" : "A";
#endif
	long size = strlen(reply);
	// indigo_uni_read_section() treats length as the payload capacity and stores the
	// terminating NUL at buffer[length], so a reply of exactly length bytes still fits.
	if (size > length) {
		size = length;
	}
	memcpy(buffer, reply, size);
	buffer[size] = 0;
	return size;
}

static bool wait_write(int before) {
	for (int i = 0; i < 2000; i++) {
		if (writes > before) {
			return true;
		}
		indigo_usleep(1000);
	}
	return false;
}

static void connect_failure_and_recovery(void) {
	SERIAL_CHECK_TRUE(bring_up_serial_driver(&driver));
	atomic_store(&fail_open, 1);
	SERIAL_CHECK_TRUE(!connect_serial_device(&driver, "fake-output"));
	SERIAL_CHECK_TRUE(wait_for_property_state(CONNECTION_PROPERTY_NAME, INDIGO_ALERT_STATE));
#if TEST_KIND == 2
	fail_command = ">VOOO";
	SERIAL_CHECK_TRUE(!connect_serial_device(&driver, "fake-output"));
	SERIAL_CHECK_EQ_INT(opens, closes);
#endif
	SERIAL_CHECK_TRUE(connect_serial_device(&driver, "fake-output"));
	SERIAL_CHECK_EQ_INT(INDIGO_BUSY, TEST_ENTRY(INDIGO_DRIVER_SHUTDOWN, NULL));
	SERIAL_CHECK_EQ_INT(1, opens - closes);
cleanup:
	stop_serial_driver(&driver);
	ASSERT_EQ_INT(opens, closes);
	ASSERT_EQ_INT(0, invalid_io);
}

static void output_commands_and_failures(void) {
	SERIAL_CHECK_TRUE(start_serial_driver(&driver, "fake-output"));
	assert_device_interface(TEST_KIND == 1 ? INDIGO_INTERFACE_GUIDER : INDIGO_INTERFACE_AUX_LIGHTBOX);
	// The AUX class defines no base properties, so the concrete driver's own set is the contract.
#if TEST_KIND == 1
	static const char *class_properties[] = { GUIDER_GUIDE_RA_PROPERTY_NAME, GUIDER_GUIDE_DEC_PROPERTY_NAME };
#else
	static const char *class_properties[] = { AUX_LIGHT_SWITCH_PROPERTY_NAME, AUX_LIGHT_INTENSITY_PROPERTY_NAME };
#endif
	assert_defined_properties(class_properties, ARRAY_SIZE(class_properties));
#if TEST_KIND == 2
	assert_property_has_item(AUX_LIGHT_SWITCH_PROPERTY_NAME, AUX_LIGHT_SWITCH_ON_ITEM_NAME);
	assert_property_has_item(AUX_LIGHT_SWITCH_PROPERTY_NAME, AUX_LIGHT_SWITCH_OFF_ITEM_NAME);
	assert_property_has_item(AUX_LIGHT_INTENSITY_PROPERTY_NAME, AUX_LIGHT_INTENSITY_ITEM_NAME);
	assert_number_item_in_range(AUX_LIGHT_INTENSITY_PROPERTY_NAME, AUX_LIGHT_INTENSITY_ITEM_NAME);
	// A flat panel has no cover and no outlets.
	assert_not_defined_property(AUX_COVER_PROPERTY_NAME);
	assert_not_defined_property(AUX_POWER_OUTLET_PROPERTY_NAME);
#endif
#if TEST_KIND == 1
	const char *properties[] = { "GUIDER_GUIDE_RA", "GUIDER_GUIDE_RA", "GUIDER_GUIDE_DEC", "GUIDER_GUIDE_DEC" };
	const char *items[] = { "EAST", "WEST", "NORTH", "SOUTH" };
	const char *commands[] = { ":Mge 100#", ":Mgw 100#", ":Mgn 100#", ":Mgs 100#" };
	for (int i = 0; i < 4; i++) {
		int before = writes;
		SERIAL_CHECK_EQ_INT(INDIGO_OK, indigo_change_number_property_1(&simulator_test_client, TEST_NAME, properties[i], items[i], 100));
		SERIAL_CHECK_TRUE(wait_for_property_state(properties[i], INDIGO_BUSY_STATE));
		SERIAL_CHECK_TRUE(wait_write(before));
		SERIAL_CHECK_TRUE(strcmp(command, commands[i]) == 0);
		SERIAL_CHECK_TRUE(wait_for_property_state(properties[i], INDIGO_OK_STATE));
		SERIAL_CHECK_TRUE(wait_for_number_item_value(properties[i], items[i], 0, 0));
	}
	atomic_store(&fail_write, 1);
	indigo_change_number_property_1(&simulator_test_client, TEST_NAME, "GUIDER_GUIDE_RA", "EAST", 100);
	SERIAL_CHECK_TRUE(wait_for_property_state("GUIDER_GUIDE_RA", INDIGO_ALERT_STATE));
#elif TEST_KIND == 2
	for (int level = 0; level <= 100; level += 50) {
		int before = writes;
		indigo_change_number_property_1(&simulator_test_client, TEST_NAME, "AUX_LIGHT_INTENSITY", "LIGHT_INTENSITY", level);
		SERIAL_CHECK_TRUE(wait_write(before));
		char expected[16];
		snprintf(expected, sizeof(expected), ">B%03d", 255 * level / 100);
		SERIAL_CHECK_TRUE(strcmp(command, expected) == 0);
		SERIAL_CHECK_TRUE(wait_for_property_state("AUX_LIGHT_INTENSITY", INDIGO_OK_STATE));
	}
	for (int failure = 0; failure < 2; failure++) {
		if (failure == 0) {
			atomic_store(&fail_write, 1);
		} else {
			atomic_store(&bad_reply, 1);
		}
		indigo_change_number_property_1(&simulator_test_client, TEST_NAME, "AUX_LIGHT_INTENSITY", "LIGHT_INTENSITY", 25);
		SERIAL_CHECK_TRUE(wait_for_property_state("AUX_LIGHT_INTENSITY", INDIGO_ALERT_STATE));
		indigo_change_number_property_1(&simulator_test_client, TEST_NAME, "AUX_LIGHT_INTENSITY", "LIGHT_INTENSITY", 75);
		SERIAL_CHECK_TRUE(wait_for_property_state("AUX_LIGHT_INTENSITY", INDIGO_OK_STATE));
	}
	indigo_change_switch_property_1(&simulator_test_client, TEST_NAME, "AUX_LIGHT_SWITCH", "ON", true);
	SERIAL_CHECK_TRUE(wait_for_property_state("AUX_LIGHT_SWITCH", INDIGO_OK_STATE));
	SERIAL_CHECK_TRUE(!strcmp(command, ">LOOO"));
	atomic_store(&fail_read, 1);
	indigo_change_switch_property_1(&simulator_test_client, TEST_NAME, "AUX_LIGHT_SWITCH", "ON", true);
	SERIAL_CHECK_TRUE(wait_for_property_state("AUX_LIGHT_SWITCH", INDIGO_ALERT_STATE));
	indigo_change_switch_property_1(&simulator_test_client, TEST_NAME, "AUX_LIGHT_SWITCH", "OFF", true);
	SERIAL_CHECK_TRUE(wait_for_property_state("AUX_LIGHT_SWITCH", INDIGO_OK_STATE));
	SERIAL_CHECK_TRUE(!strcmp(command, ">DOOO"));
	disconnect_serial_device(&driver);
	atomic_store(&brightness, 0);
	SERIAL_CHECK_TRUE(connect_serial_device(&driver, "fake-output"));
	SERIAL_CHECK_EQ_INT(191, brightness);
	SERIAL_CHECK_TRUE(wait_for_number_item_value("AUX_LIGHT_INTENSITY", "LIGHT_INTENSITY", 75, 0));
	SERIAL_CHECK_TRUE(!strcmp(command, ">DOOO"));
#endif
cleanup:
	stop_serial_driver(&driver);
	ASSERT_EQ_INT(opens, closes);
	ASSERT_EQ_INT(0, invalid_io);
}

int main(void) {
	const indigo_test_case tests[] = {
		{ "open rollback, reconnect and shutdown rejection", connect_failure_and_recovery },
		{ "command mapping, completion and transport errors", output_commands_and_failures }
	};
	return indigo_run_tests(TEST_NAME, tests, ARRAY_SIZE(tests));
}
