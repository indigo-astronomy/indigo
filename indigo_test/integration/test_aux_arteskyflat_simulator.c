// Copyright (c) 2026 INDIGO initiative
// All rights reserved.
//
// You may use this software under the terms of 'INDIGO Astronomy
// open-source license' (see LICENSE.md).
//
// THIS SOFTWARE IS PROVIDED BY THE AUTHORS 'AS IS' AND ANY EXPRESS
// OR IMPLIED WARRANTIES, INCLUDING, BUT NOT LIMITED TO, THE IMPLIED
// WARRANTIES OF MERCHANTABILITY AND FITNESS FOR A PARTICULAR PURPOSE
// ARE DISCLAIMED. IN NO EVENT SHALL THE AUTHOR BE LIABLE FOR ANY
// DIRECT, INDIRECT, INCIDENTAL, SPECIAL, EXEMPLARY, OR CONSEQUENTIAL
// DAMAGES (INCLUDING, BUT NOT LIMITED TO, PROCUREMENT OF SUBSTITUTE
// GOODS OR SERVICES; LOSS OF USE, DATA, OR PROFITS; OR BUSINESS
// INTERRUPTION) HOWEVER CAUSED AND ON ANY THEORY OF LIABILITY,
// WHETHER IN CONTRACT, STRICT LIABILITY, OR TORT (INCLUDING
// NEGLIGENCE OR OTHERWISE) ARISING IN ANY WAY OUT OF THE USE OF THIS
// SOFTWARE, EVEN IF ADVISED OF THE POSSIBILITY OF SUCH DAMAGE.

// Code is generated by AI

// AUX lightbox coverage for indigo_aux_arteskyflat against the standalone Artesky simulator over a
// real PTY. The Artesky Flat Box USB speaks the Alnitak generic command set documented in
// ../../indigo_drivers/aux_flipflat/Alnitak_GenericCommandsR4.pdf. Unlike the other Alnitak
// drivers in the tree this one validates the whole reply line - eight bytes, leading '*', echoed
// operation, two numeric id digits and the echoed three digit value - so reply framing is the
// central contract here, alongside the percent to 0-255 conversion and the rule that a rejected
// request leaves the last accepted intensity and light selection untouched.

#include <indigo_drivers/aux_arteskyflat/indigo_aux_arteskyflat.h>

#include "serial_simulator_test_common.h"

#ifndef AUX_ARTESKYFLAT_SIMULATOR_EXECUTABLE
#define AUX_ARTESKYFLAT_SIMULATOR_EXECUTABLE "build/integration/aux_arteskyflat_simulator"
#endif

static const simulator_driver_case arteskyflat_aux = {
	"Artesky Flat Box USB",
	"indigo_aux_arteskyflat",
	"Artesky Flat Box",
	indigo_aux_arteskyflat,
	false,
	NULL, 0, NULL, 0, NULL, 0, NULL, 0
};

static const char *arteskyflat_base_properties[] = {
	INFO_PROPERTY_NAME,
	CONFIG_PROPERTY_NAME,
	PROFILE_NAME_PROPERTY_NAME,
	PROFILE_PROPERTY_NAME,
	DEVICE_PORT_PROPERTY_NAME,
	DEVICE_PORTS_PROPERTY_NAME,
	ADDITIONAL_INSTANCES_PROPERTY_NAME,
	CONNECTION_PROPERTY_NAME
};

static const char *arteskyflat_hidden_properties[] = {
	SIMULATION_PROPERTY_NAME,
	DEVICE_BAUDRATE_PROPERTY_NAME,
	AUTHENTICATION_PROPERTY_NAME,
	AUX_COVER_PROPERTY_NAME,
	AUX_POWER_OUTLET_PROPERTY_NAME
};

static const char *arteskyflat_connected_properties[] = {
	AUX_LIGHT_SWITCH_PROPERTY_NAME,
	AUX_LIGHT_INTENSITY_PROPERTY_NAME
};

// -------------------------------------------------------------------------------- simulator glue

static void simulator_path(const external_serial_simulator *simulator, const char *suffix, char *path, size_t size) {
	snprintf(path, size, "%s.%s", simulator->ready_file, suffix);
}

// The simulator consumes one armed fault with the first command whose operation matches selector.
static bool arm_fault(const external_serial_simulator *simulator, const char *action, const char *selector) {
	char path[PATH_MAX];
	simulator_path(simulator, "control", path, sizeof(path));
	FILE *file = fopen(path, "w");
	if (file == NULL) {
		return false;
	}
	fprintf(file, "%s %s\n", action, selector);
	return fclose(file) == 0;
}

static void clear_events(const external_serial_simulator *simulator) {
	char path[PATH_MAX];
	simulator_path(simulator, "events", path, sizeof(path));
	unlink(path);
}

static int event_count(const external_serial_simulator *simulator, const char *command) {
	char path[PATH_MAX];
	char line[64];
	int count = 0;
	simulator_path(simulator, "events", path, sizeof(path));
	FILE *file = fopen(path, "r");
	if (file == NULL) {
		return 0;
	}
	while (fgets(line, sizeof(line), file) != NULL) {
		line[strcspn(line, "\r\n")] = '\0';
		if (!strcmp(line, command)) {
			count++;
		}
	}
	fclose(file);
	return count;
}

static bool wait_for_event(const external_serial_simulator *simulator, const char *command, int expected_count) {
	for (int i = 0; i < 100; i++) {
		if (event_count(simulator, command) >= expected_count) {
			return true;
		}
		indigo_usleep(100000);
	}
	fprintf(stderr, "'%s' was recorded %d times, expected %d\n", command, event_count(simulator, command), expected_count);
	return false;
}

// -------------------------------------------------------------------------------- request helpers

static double intensity_value(void) {
	return cached_number_value(AUX_LIGHT_INTENSITY_PROPERTY_NAME, AUX_LIGHT_INTENSITY_ITEM_NAME);
}

static bool change_intensity(double percent, indigo_property_state expected_state) {
	unsigned int revision = property_revision(AUX_LIGHT_INTENSITY_PROPERTY_NAME);
	if (indigo_change_number_property_1(&simulator_test_client, arteskyflat_aux.device_name, AUX_LIGHT_INTENSITY_PROPERTY_NAME, AUX_LIGHT_INTENSITY_ITEM_NAME, percent) != INDIGO_OK) {
		return false;
	}
	return wait_for_property_state_seen_after(AUX_LIGHT_INTENSITY_PROPERTY_NAME, INDIGO_BUSY_STATE, revision) && wait_for_property_state_after(AUX_LIGHT_INTENSITY_PROPERTY_NAME, expected_state, revision);
}

static bool change_light(const char *item_name, indigo_property_state expected_state) {
	unsigned int revision = property_revision(AUX_LIGHT_SWITCH_PROPERTY_NAME);
	if (indigo_change_switch_property_1(&simulator_test_client, arteskyflat_aux.device_name, AUX_LIGHT_SWITCH_PROPERTY_NAME, item_name, true) != INDIGO_OK) {
		return false;
	}
	return wait_for_property_state_seen_after(AUX_LIGHT_SWITCH_PROPERTY_NAME, INDIGO_BUSY_STATE, revision) && wait_for_property_state_after(AUX_LIGHT_SWITCH_PROPERTY_NAME, expected_state, revision);
}

// The harness keeps an append-only list of every property it has seen defined, so live visibility
// is read from the property cache, which does follow deletion.
static bool connected_properties_published(bool expected) {
	for (int i = 0; i < ARRAY_SIZE(arteskyflat_connected_properties); i++) {
		if ((find_cached_property(arteskyflat_connected_properties[i]) != NULL) != expected) {
			fprintf(stderr, "%s is %spublished\n", arteskyflat_connected_properties[i], expected ? "not " : "");
			return false;
		}
	}
	return true;
}

// AUX_LIGHT_INTENSITY is persistent; leave the saved configuration at the attach-time default so a
// case that saved one cannot decide what the next case starts from.
static bool restore_saved_defaults(void) {
	return change_intensity(0, INDIGO_OK_STATE) && save_configuration();
}

// -------------------------------------------------------------------------------- cases

// Driver metadata, the published property inventory before and after connection, and the shape of
// both driver properties.
static void identity_inventory_and_property_contract(void) {
	external_serial_simulator simulator = { 0 };
	bool online = false;
	indigo_driver_info info;
	memset(&info, 0, sizeof(info));
	assert_simulator_driver_info(&arteskyflat_aux);
	SERIAL_CHECK_TRUE(start_external_serial_simulator(&simulator, AUX_ARTESKYFLAT_SIMULATOR_EXECUTABLE));
	SERIAL_CHECK_TRUE(bring_up_serial_driver(&arteskyflat_aux));
	online = true;
	enumerate_simulator_device();
	assert_device_interface(INDIGO_INTERFACE_AUX_LIGHTBOX);
	assert_defined_properties(arteskyflat_base_properties, ARRAY_SIZE(arteskyflat_base_properties));
	assert_not_defined_properties(arteskyflat_hidden_properties, ARRAY_SIZE(arteskyflat_hidden_properties));
	assert_not_defined_properties(arteskyflat_connected_properties, ARRAY_SIZE(arteskyflat_connected_properties));
	assert_defined_property_count(ARRAY_SIZE(arteskyflat_base_properties));
	SERIAL_CHECK_TRUE(connect_serial_device(&arteskyflat_aux, simulator.port));
	SERIAL_CHECK_TRUE(context.connected && context.last_connection_state == INDIGO_OK_STATE);
	assert_serial_aux_class_property_completeness();
	assert_defined_properties(arteskyflat_connected_properties, ARRAY_SIZE(arteskyflat_connected_properties));
	assert_not_defined_properties(arteskyflat_hidden_properties, ARRAY_SIZE(arteskyflat_hidden_properties));
	assert_defined_property_count(ARRAY_SIZE(arteskyflat_base_properties) + ARRAY_SIZE(arteskyflat_connected_properties));
	indigo_property *light_property = find_cached_property(AUX_LIGHT_SWITCH_PROPERTY_NAME);
	indigo_property *intensity_property = find_cached_property(AUX_LIGHT_INTENSITY_PROPERTY_NAME);
	indigo_item *intensity_item = find_cached_item(AUX_LIGHT_INTENSITY_PROPERTY_NAME, AUX_LIGHT_INTENSITY_ITEM_NAME);
	SERIAL_CHECK_TRUE(light_property != NULL && light_property->type == INDIGO_SWITCH_VECTOR && light_property->perm == INDIGO_RW_PERM && light_property->rule == INDIGO_ONE_OF_MANY_RULE && light_property->count == 2);
	assert_property_has_item(AUX_LIGHT_SWITCH_PROPERTY_NAME, AUX_LIGHT_SWITCH_ON_ITEM_NAME);
	assert_property_has_item(AUX_LIGHT_SWITCH_PROPERTY_NAME, AUX_LIGHT_SWITCH_OFF_ITEM_NAME);
	SERIAL_CHECK_TRUE(intensity_property != NULL && intensity_property->type == INDIGO_NUMBER_VECTOR && intensity_property->perm == INDIGO_RW_PERM && intensity_property->count == 1);
	SERIAL_CHECK_TRUE(intensity_item != NULL && intensity_item->number.min == 0 && intensity_item->number.max == 100 && intensity_item->number.step == 1 && intensity_item->number.value == 0 && !strcmp(intensity_item->number.format, "%.0f"));
	assert_number_item_in_range(AUX_LIGHT_INTENSITY_PROPERTY_NAME, AUX_LIGHT_INTENSITY_ITEM_NAME);
	assert_switch_item_value(AUX_LIGHT_SWITCH_PROPERTY_NAME, AUX_LIGHT_SWITCH_ON_ITEM_NAME, false);
	assert_switch_item_value(AUX_LIGHT_SWITCH_PROPERTY_NAME, AUX_LIGHT_SWITCH_OFF_ITEM_NAME, true);
	SERIAL_CHECK_EQ_INT(INDIGO_OK, arteskyflat_aux.entry(INDIGO_DRIVER_INFO, &info));
	SERIAL_CHECK_EQ_INT(INDIGO_DRIVER_API_3, INDIGO_DRIVER_API_GENERATION(info.version));
	// The driver opens the port without a handshake, so connecting sends nothing at all.
	SERIAL_CHECK_EQ_INT(0, event_count(&simulator, ">L000"));
	SERIAL_CHECK_EQ_INT(0, event_count(&simulator, ">D000"));
	SERIAL_CHECK_EQ_INT(0, event_count(&simulator, ">B000"));
cleanup:
	if (online) {
		stop_serial_driver(&arteskyflat_aux);
	}
	stop_external_serial_simulator(&simulator);
}

// AUX_LIGHT_INTENSITY is a percentage; the device takes 0-255 in ">Bxxx".
static void intensity_maps_percent_to_the_device_scale(void) {
	external_serial_simulator simulator = { 0 };
	bool online = false;
	static const struct { double percent; const char *command; } steps[] = {
		{ 0, ">B000" },
		{ 25, ">B063" },
		{ 50, ">B127" },
		{ 75, ">B191" },
		{ 100, ">B255" }
	};
	SERIAL_CHECK_TRUE(start_external_serial_simulator(&simulator, AUX_ARTESKYFLAT_SIMULATOR_EXECUTABLE));
	SERIAL_CHECK_TRUE(start_serial_driver(&arteskyflat_aux, simulator.port));
	online = true;
	clear_events(&simulator);
	for (int i = 0; i < ARRAY_SIZE(steps); i++) {
		SERIAL_CHECK_TRUE(change_intensity(steps[i].percent, INDIGO_OK_STATE));
		SERIAL_CHECK_TRUE(wait_for_event(&simulator, steps[i].command, 1));
		SERIAL_CHECK_TRUE(intensity_value() == steps[i].percent);
	}
cleanup:
	if (online) {
		stop_serial_driver(&arteskyflat_aux);
	}
	stop_external_serial_simulator(&simulator);
}

// The one-of-many switch maps to the documented ">L000" and ">D000" commands.
static void light_switch_sends_the_documented_commands(void) {
	external_serial_simulator simulator = { 0 };
	bool online = false;
	SERIAL_CHECK_TRUE(start_external_serial_simulator(&simulator, AUX_ARTESKYFLAT_SIMULATOR_EXECUTABLE));
	SERIAL_CHECK_TRUE(start_serial_driver(&arteskyflat_aux, simulator.port));
	online = true;
	clear_events(&simulator);
	SERIAL_CHECK_TRUE(change_light(AUX_LIGHT_SWITCH_ON_ITEM_NAME, INDIGO_OK_STATE));
	SERIAL_CHECK_TRUE(wait_for_event(&simulator, ">L000", 1));
	assert_switch_item_value(AUX_LIGHT_SWITCH_PROPERTY_NAME, AUX_LIGHT_SWITCH_ON_ITEM_NAME, true);
	assert_switch_item_value(AUX_LIGHT_SWITCH_PROPERTY_NAME, AUX_LIGHT_SWITCH_OFF_ITEM_NAME, false);
	SERIAL_CHECK_TRUE(change_light(AUX_LIGHT_SWITCH_OFF_ITEM_NAME, INDIGO_OK_STATE));
	SERIAL_CHECK_TRUE(wait_for_event(&simulator, ">D000", 1));
	assert_switch_item_value(AUX_LIGHT_SWITCH_PROPERTY_NAME, AUX_LIGHT_SWITCH_ON_ITEM_NAME, false);
	assert_switch_item_value(AUX_LIGHT_SWITCH_PROPERTY_NAME, AUX_LIGHT_SWITCH_OFF_ITEM_NAME, true);
	// Selecting the item that is already set still goes to the device.
	SERIAL_CHECK_TRUE(change_light(AUX_LIGHT_SWITCH_OFF_ITEM_NAME, INDIGO_OK_STATE));
	SERIAL_CHECK_TRUE(wait_for_event(&simulator, ">D000", 2));
	SERIAL_CHECK_EQ_INT(0, event_count(&simulator, ">B000"));
cleanup:
	if (online) {
		stop_serial_driver(&arteskyflat_aux);
	}
	stop_external_serial_simulator(&simulator);
}

// Every documented part of the reply line is load bearing: the byte count, the leading '*', the
// echoed operation, the two numeric id digits and the echoed value.
static void malformed_replies_are_rejected(void) {
	external_serial_simulator simulator = { 0 };
	bool online = false;
	static const char *faults[] = { "drop", "short", "long", "malformed", "mismatch", "bad_id" };
	SERIAL_CHECK_TRUE(start_external_serial_simulator(&simulator, AUX_ARTESKYFLAT_SIMULATOR_EXECUTABLE));
	SERIAL_CHECK_TRUE(start_serial_driver(&arteskyflat_aux, simulator.port));
	online = true;
	for (int i = 0; i < ARRAY_SIZE(faults); i++) {
		SERIAL_CHECK_TRUE(change_intensity(25, INDIGO_OK_STATE));
		SERIAL_CHECK_TRUE(intensity_value() == 25);
		SERIAL_CHECK_TRUE(arm_fault(&simulator, faults[i], "B"));
		SERIAL_CHECK_TRUE(change_intensity(50, INDIGO_ALERT_STATE));
		// A rejected request must not publish the value it failed to set.
		SERIAL_CHECK_TRUE(intensity_value() == 25);
		SERIAL_CHECK_TRUE(change_intensity(50, INDIGO_OK_STATE));
		SERIAL_CHECK_TRUE(intensity_value() == 50);
		SERIAL_CHECK_TRUE(change_light(AUX_LIGHT_SWITCH_OFF_ITEM_NAME, INDIGO_OK_STATE));
		SERIAL_CHECK_TRUE(arm_fault(&simulator, faults[i], "L"));
		SERIAL_CHECK_TRUE(change_light(AUX_LIGHT_SWITCH_ON_ITEM_NAME, INDIGO_ALERT_STATE));
		// A rejected switch must fall back to the last selection the device acknowledged.
		assert_switch_item_value(AUX_LIGHT_SWITCH_PROPERTY_NAME, AUX_LIGHT_SWITCH_OFF_ITEM_NAME, true);
		SERIAL_CHECK_TRUE(change_light(AUX_LIGHT_SWITCH_ON_ITEM_NAME, INDIGO_OK_STATE));
	}
cleanup:
	if (online) {
		stop_serial_driver(&arteskyflat_aux);
	}
	stop_external_serial_simulator(&simulator);
}

// An unsolicited line ahead of the real reply desynchronizes the exchange; the leftover has to be
// drained by the discard that precedes the next command instead of answering it.
static void a_stale_reply_is_discarded_before_the_next_command(void) {
	external_serial_simulator simulator = { 0 };
	bool online = false;
	SERIAL_CHECK_TRUE(start_external_serial_simulator(&simulator, AUX_ARTESKYFLAT_SIMULATOR_EXECUTABLE));
	SERIAL_CHECK_TRUE(start_serial_driver(&arteskyflat_aux, simulator.port));
	online = true;
	SERIAL_CHECK_TRUE(change_intensity(20, INDIGO_OK_STATE));
	SERIAL_CHECK_TRUE(arm_fault(&simulator, "stale", "B"));
	SERIAL_CHECK_TRUE(change_intensity(40, INDIGO_ALERT_STATE));
	SERIAL_CHECK_TRUE(intensity_value() == 20);
	SERIAL_CHECK_TRUE(change_intensity(40, INDIGO_OK_STATE));
	SERIAL_CHECK_TRUE(intensity_value() == 40);
	SERIAL_CHECK_TRUE(change_light(AUX_LIGHT_SWITCH_ON_ITEM_NAME, INDIGO_OK_STATE));
cleanup:
	if (online) {
		stop_serial_driver(&arteskyflat_aux);
	}
	stop_external_serial_simulator(&simulator);
}

// AUX_LIGHT_INTENSITY is the one property this driver persists. The restore has to reach the
// device, because the driver sends nothing on connect and cannot read the panel back.
static void configuration_roundtrip_reaches_the_device(void) {
	external_serial_simulator simulator = { 0 };
	bool online = false;
	SERIAL_CHECK_TRUE(start_external_serial_simulator(&simulator, AUX_ARTESKYFLAT_SIMULATOR_EXECUTABLE));
	SERIAL_CHECK_TRUE(start_serial_driver(&arteskyflat_aux, simulator.port));
	online = true;
	SERIAL_CHECK_TRUE(change_intensity(60, INDIGO_OK_STATE));
	SERIAL_CHECK_TRUE(save_configuration());
	disconnect_serial_device(&arteskyflat_aux);
	tear_down_serial_driver(&arteskyflat_aux);
	online = false;
	clear_events(&simulator);
	SERIAL_CHECK_TRUE(start_serial_driver(&arteskyflat_aux, simulator.port));
	online = true;
	// A freshly attached device starts from the attach-time default, and connecting is silent.
	SERIAL_CHECK_TRUE(intensity_value() == 0);
	SERIAL_CHECK_EQ_INT(0, event_count(&simulator, ">B153"));
	unsigned int revision = property_revision(CONFIG_PROPERTY_NAME);
	SERIAL_CHECK_EQ_INT(INDIGO_OK, indigo_change_switch_property_1(&simulator_test_client, arteskyflat_aux.device_name, CONFIG_PROPERTY_NAME, CONFIG_LOAD_ITEM_NAME, true));
	SERIAL_CHECK_TRUE(wait_for_property_state_after(CONFIG_PROPERTY_NAME, INDIGO_OK_STATE, revision));
	SERIAL_CHECK_TRUE(wait_for_event(&simulator, ">B153", 1));
	SERIAL_CHECK_TRUE(wait_for_number_item_value(AUX_LIGHT_INTENSITY_PROPERTY_NAME, AUX_LIGHT_INTENSITY_ITEM_NAME, 60, 0));
	SERIAL_CHECK_TRUE(restore_saved_defaults());
cleanup:
	if (online) {
		stop_serial_driver(&arteskyflat_aux);
	}
	stop_external_serial_simulator(&simulator);
}

// A port that cannot be opened must leave the device disconnected with nothing published, and must
// not prevent a later connection from working.
static void failed_open_leaves_the_device_disconnected(void) {
	external_serial_simulator simulator = { 0 };
	bool online = false;
	SERIAL_CHECK_TRUE(start_external_serial_simulator(&simulator, AUX_ARTESKYFLAT_SIMULATOR_EXECUTABLE));
	SERIAL_CHECK_TRUE(bring_up_serial_driver(&arteskyflat_aux));
	online = true;
	enumerate_simulator_device();
	SERIAL_CHECK_EQ_INT(INDIGO_OK, indigo_change_text_property_1_raw(&simulator_test_client, arteskyflat_aux.device_name, DEVICE_PORT_PROPERTY_NAME, DEVICE_PORT_ITEM_NAME, "/dev/indigo-nonexistent-arteskyflat-test"));
	unsigned int revision = property_revision(CONNECTION_PROPERTY_NAME);
	SERIAL_CHECK_EQ_INT(INDIGO_OK, indigo_change_switch_property_1(&simulator_test_client, arteskyflat_aux.device_name, CONNECTION_PROPERTY_NAME, CONNECTION_CONNECTED_ITEM_NAME, true));
	SERIAL_CHECK_TRUE(wait_for_property_state_seen_after(CONNECTION_PROPERTY_NAME, INDIGO_ALERT_STATE, revision));
	SERIAL_CHECK_TRUE(!context.connected);
	assert_switch_item_value(CONNECTION_PROPERTY_NAME, CONNECTION_DISCONNECTED_ITEM_NAME, true);
	SERIAL_CHECK_TRUE(connected_properties_published(false));
	SERIAL_CHECK_TRUE(connect_serial_device(&arteskyflat_aux, simulator.port));
	SERIAL_CHECK_TRUE(connected_properties_published(true));
	SERIAL_CHECK_TRUE(change_intensity(20, INDIGO_OK_STATE));
cleanup:
	if (online) {
		disconnect_serial_device(&arteskyflat_aux);
		tear_down_serial_driver(&arteskyflat_aux);
	}
	stop_external_serial_simulator(&simulator);
}

// Losing the port while connected must be reported on the request that discovers it, and a fresh
// device on the same port must be usable again after a reconnect.
static void transport_loss_is_reported_and_reconnect_recovers(void) {
	external_serial_simulator simulator = { 0 };
	bool online = false;
	SERIAL_CHECK_TRUE(start_external_serial_simulator(&simulator, AUX_ARTESKYFLAT_SIMULATOR_EXECUTABLE));
	SERIAL_CHECK_TRUE(start_serial_driver(&arteskyflat_aux, simulator.port));
	online = true;
	SERIAL_CHECK_TRUE(change_light(AUX_LIGHT_SWITCH_ON_ITEM_NAME, INDIGO_OK_STATE));
	SERIAL_CHECK_TRUE(arm_fault(&simulator, "close", "B"));
	SERIAL_CHECK_TRUE(change_intensity(40, INDIGO_ALERT_STATE));
	SERIAL_CHECK_TRUE(change_light(AUX_LIGHT_SWITCH_OFF_ITEM_NAME, INDIGO_ALERT_STATE));
	assert_switch_item_value(AUX_LIGHT_SWITCH_PROPERTY_NAME, AUX_LIGHT_SWITCH_ON_ITEM_NAME, true);
	disconnect_serial_device(&arteskyflat_aux);
	stop_external_serial_simulator(&simulator);
	SERIAL_CHECK_TRUE(start_external_serial_simulator(&simulator, AUX_ARTESKYFLAT_SIMULATOR_EXECUTABLE));
	SERIAL_CHECK_TRUE(connect_serial_device(&arteskyflat_aux, simulator.port));
	SERIAL_CHECK_TRUE(change_intensity(40, INDIGO_OK_STATE));
	SERIAL_CHECK_TRUE(change_light(AUX_LIGHT_SWITCH_OFF_ITEM_NAME, INDIGO_OK_STATE));
cleanup:
	if (online) {
		disconnect_serial_device(&arteskyflat_aux);
		tear_down_serial_driver(&arteskyflat_aux);
	}
	stop_external_serial_simulator(&simulator);
}

// A redundant disconnect is a no-op, the connected properties are deleted and redefined, and the
// driver refuses to unload while a device is connected.
static void repeated_disconnect_and_refused_shutdown(void) {
	external_serial_simulator simulator = { 0 };
	bool online = false;
	SERIAL_CHECK_TRUE(start_external_serial_simulator(&simulator, AUX_ARTESKYFLAT_SIMULATOR_EXECUTABLE));
	SERIAL_CHECK_TRUE(start_serial_driver(&arteskyflat_aux, simulator.port));
	online = true;
	SERIAL_CHECK_EQ_INT(INDIGO_BUSY, arteskyflat_aux.entry(INDIGO_DRIVER_SHUTDOWN, NULL));
	SERIAL_CHECK_TRUE(context.connected);
	disconnect_serial_device(&arteskyflat_aux);
	SERIAL_CHECK_TRUE(!context.connected);
	SERIAL_CHECK_TRUE(connected_properties_published(false));
	disconnect_serial_device(&arteskyflat_aux);
	SERIAL_CHECK_TRUE(!context.connected);
	SERIAL_CHECK_TRUE(connect_serial_device(&arteskyflat_aux, simulator.port));
	SERIAL_CHECK_TRUE(connected_properties_published(true));
	SERIAL_CHECK_TRUE(change_light(AUX_LIGHT_SWITCH_OFF_ITEM_NAME, INDIGO_OK_STATE));
cleanup:
	if (online) {
		disconnect_serial_device(&arteskyflat_aux);
		tear_down_serial_driver(&arteskyflat_aux);
	}
	stop_external_serial_simulator(&simulator);
}

int main(void) {
	// AUX_LIGHT_INTENSITY is persistent, so without a private HOME the cases would save into, and
	// restore from, the user's own configuration folder.
	if (!indigo_test_use_private_home()) {
		return 1;
	}
	const indigo_test_case tests[] = {
		{ "identity_inventory_and_property_contract", identity_inventory_and_property_contract },
		{ "intensity_maps_percent_to_the_device_scale", intensity_maps_percent_to_the_device_scale },
		{ "light_switch_sends_the_documented_commands", light_switch_sends_the_documented_commands },
		{ "malformed_replies_are_rejected", malformed_replies_are_rejected },
		{ "a_stale_reply_is_discarded_before_the_next_command", a_stale_reply_is_discarded_before_the_next_command },
		{ "configuration_roundtrip_reaches_the_device", configuration_roundtrip_reaches_the_device },
		{ "failed_open_leaves_the_device_disconnected", failed_open_leaves_the_device_disconnected },
		{ "transport_loss_is_reported_and_reconnect_recovers", transport_loss_is_reported_and_reconnect_recovers },
		{ "repeated_disconnect_and_refused_shutdown", repeated_disconnect_and_refused_shutdown }
	};
	int result = indigo_run_tests("Artesky Flat Box serial simulator integration tests", tests, ARRAY_SIZE(tests));
	indigo_test_remove_private_home();
	return result;
}
