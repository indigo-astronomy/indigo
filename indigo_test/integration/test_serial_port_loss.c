// Copyright (c) 2026 INDIGO initiative
// All rights reserved.
//
// You may use this software under the terms of 'INDIGO Astronomy
// open-source license' (see LICENSE.md).
//
// THIS SOFTWARE IS PROVIDED BY THE AUTHORS 'AS IS' AND ANY EXPRESS
// OR IMPLIED WARRANTIES, INCLUDING, BUT NOT LIMITED TO, THE IMPLIED
// WARRANTIES OF MERCHANTABILITY AND FITNESS FOR A PARTICULAR PURPOSE
// ARE DISCLAIMED. IN NO EVENT SHALL THE AUTHOR BE LIABLE FOR ANY
// DIRECT, INDIRECT, INCIDENTAL, SPECIAL, EXEMPLARY, OR CONSEQUENTIAL
// DAMAGES (INCLUDING, BUT NOT LIMITED TO, PROCUREMENT OF SUBSTITUTE
// GOODS OR SERVICES; LOSS OF USE, DATA, OR PROFITS; OR BUSINESS
// INTERRUPTION) HOWEVER CAUSED AND ON ANY THEORY OF LIABILITY,
// WHETHER IN CONTRACT, STRICT LIABILITY, OR TORT (INCLUDING
// NEGLIGENCE OR OTHERWISE) ARISING IN ANY WAY OUT OF THE USE OF THIS
// SOFTWARE, EVEN IF ADVISED OF THE POSSIBILITY OF SUCH DAMAGE.

// Code is generated by AI

// The framework disconnects a device whose serial port disappears from the serial port list, without the driver
// noticing anything: MoonLite has no loss handling of its own. The binary carries its own copy of indigo_driver.c,
// built with indigo_enumerate_usbserial_devices() replaced by fake_usbserial_devices(), which lists the simulator's
// pseudo-terminal as a USB-serial adapter, so the test decides when the port is plugged in. A refresh of DEVICE_PORTS
// rescans the ports the way a USB hot-plug event does.

#include <pthread.h>
#include <signal.h>
#include <spawn.h>
#include <sys/wait.h>

#include <indigo/indigo_uni_io.h>
#include <indigo/indigo_usbserial_utils.h>
#include <indigo/indigo_focuser_driver.h>
#include <indigo_drivers/focuser_moonlite/indigo_focuser_moonlite.h>

#include "serial_simulator_test_common.h"

#ifndef FOCUSER_MOONLITE_SIMULATOR_EXECUTABLE
#define FOCUSER_MOONLITE_SIMULATOR_EXECUTABLE "build/integration/focuser_moonlite_simulator"
#endif

static const simulator_driver_case moonlite_focuser = {
	"MoonLite Focuser", "indigo_focuser_moonlite", "MoonLite", indigo_focuser_moonlite, false,
	NULL, 0, NULL, 0, NULL, 0, NULL, 0
};

static pthread_mutex_t fake_mutex = PTHREAD_MUTEX_INITIALIZER;
static char fake_port[PATH_MAX];
static char last_connection_message[INDIGO_VALUE_SIZE];

int fake_usbserial_devices(indigo_serial_info *serial_info, int num_serial_info) {
	int count = 0;
	pthread_mutex_lock(&fake_mutex);
	if (fake_port[0] && num_serial_info > 0) {
		memset(serial_info, 0, sizeof(indigo_serial_info));
		serial_info->vendor_id = 0x0403;
		serial_info->product_id = 0x6001;
		snprintf(serial_info->product_string, sizeof(serial_info->product_string), "Fake USB-serial");
		snprintf(serial_info->path, sizeof(serial_info->path), "%s", fake_port);
		count = 1;
	}
	pthread_mutex_unlock(&fake_mutex);
	return count;
}

// Lists the port as a USB-serial adapter, or nothing with NULL.
static void plug(const char *port) {
	pthread_mutex_lock(&fake_mutex);
	fake_port[0] = 0;
	if (port != NULL && realpath(port, fake_port) == NULL) {
		snprintf(fake_port, sizeof(fake_port), "%s", port);
	}
	pthread_mutex_unlock(&fake_mutex);
}

// the bus delivers the message of an update separately, through send_message
static indigo_result observe_message(indigo_client *client, indigo_device *device, indigo_property *property, const char *message) {
	if (property != NULL && message != NULL && !strcmp(property->device, moonlite_focuser.device_name) && !strcmp(property->name, CONNECTION_PROPERTY_NAME)) {
		snprintf(last_connection_message, sizeof(last_connection_message), "%s", message);
	}
	return simulator_client_send_message(client, device, property, message);
}

static bool refresh_ports(void) {
	return indigo_change_switch_property_1(&simulator_test_client, moonlite_focuser.device_name, DEVICE_PORTS_PROPERTY_NAME, DEVICE_PORTS_REFRESH_ITEM_NAME, true) == INDIGO_OK;
}

// A lost port disconnects the device: the regular disconnection ends OK and ALERT for the loss follows.
static bool wait_for_connection_lost(void) {
	for (int i = 0; i < 100; i++) {
		if (!context.connected && context.disconnected && context.last_connection_state == INDIGO_ALERT_STATE) {
			return true;
		}
		indigo_usleep(100000);
	}
	return false;
}

// While the port is listed a refresh changes nothing. Once it disappears the device disconnects with ALERT and names
// the lost port, and it connects again to the replugged focuser without a restart of the driver.
static void listed_port_loss_disconnects(void) {
	external_serial_simulator fixture = { 0 }, replugged = { 0 };
	bool started = false;
	SERIAL_CHECK_TRUE(start_external_serial_simulator(&fixture, FOCUSER_MOONLITE_SIMULATOR_EXECUTABLE));
	plug(fixture.port);
	SERIAL_CHECK_TRUE(bring_up_serial_driver(&moonlite_focuser));
	started = true;
	SERIAL_CHECK_TRUE(connect_serial_device(&moonlite_focuser, fixture.port));
	SERIAL_CHECK_TRUE(refresh_ports());
	indigo_usleep(1000000);
	SERIAL_CHECK_TRUE(context.connected && context.last_connection_state == INDIGO_OK_STATE);
	last_connection_message[0] = 0;
	stop_external_serial_simulator(&fixture);
	plug(NULL);
	SERIAL_CHECK_TRUE(refresh_ports());
	SERIAL_CHECK_TRUE(wait_for_connection_lost());
	SERIAL_CHECK_TRUE(strstr(last_connection_message, "lost") != NULL);
	SERIAL_CHECK_TRUE(start_external_serial_simulator(&replugged, FOCUSER_MOONLITE_SIMULATOR_EXECUTABLE));
	plug(replugged.port);
	SERIAL_CHECK_TRUE(connect_serial_device(&moonlite_focuser, replugged.port));
	SERIAL_CHECK_TRUE(find_cached_property(FOCUSER_POSITION_PROPERTY_NAME) != NULL);
cleanup:
	if (started) {
		disconnect_serial_device(&moonlite_focuser);
		tear_down_serial_driver(&moonlite_focuser);
	}
	plug(NULL);
	stop_external_serial_simulator(&fixture);
	stop_external_serial_simulator(&replugged);
}

// A port that was never listed is left alone when it goes away: the framework only acts on a port it saw disappear
// from the list, so a network URL or a port the scan does not know is the driver's business.
static void unlisted_port_is_left_alone(void) {
	external_serial_simulator fixture = { 0 };
	bool started = false;
	plug(NULL);
	SERIAL_CHECK_TRUE(start_external_serial_simulator(&fixture, FOCUSER_MOONLITE_SIMULATOR_EXECUTABLE));
	SERIAL_CHECK_TRUE(bring_up_serial_driver(&moonlite_focuser));
	started = true;
	SERIAL_CHECK_TRUE(connect_serial_device(&moonlite_focuser, fixture.port));
	stop_external_serial_simulator(&fixture);
	SERIAL_CHECK_TRUE(refresh_ports());
	indigo_usleep(1500000);
	SERIAL_CHECK_TRUE(context.connected && context.last_connection_state == INDIGO_OK_STATE);
cleanup:
	if (started) {
		disconnect_serial_device(&moonlite_focuser);
		tear_down_serial_driver(&moonlite_focuser);
	}
	stop_external_serial_simulator(&fixture);
}

// ---- a misbehaving driver: its detach does not disconnect the device first

extern char **environ;
static const char *test_executable;

static indigo_result bad_attach(indigo_device *device) {
	if (indigo_focuser_attach(device, "indigo_focuser_bad", 0x03000001) != INDIGO_OK) {
		return INDIGO_FAILED;
	}
	DEVICE_PORT_PROPERTY->hidden = false;
	return INDIGO_OK;
}

static indigo_result bad_change_property(indigo_device *device, indigo_client *client, indigo_property *property) {
	if (indigo_property_match_changeable(CONNECTION_PROPERTY, property)) {
		indigo_property_copy_values(CONNECTION_PROPERTY, property, false);
		CONNECTION_PROPERTY->state = INDIGO_OK_STATE;
		return indigo_focuser_change_property(device, NULL, CONNECTION_PROPERTY);
	}
	return indigo_focuser_change_property(device, client, property);
}

static indigo_result bad_detach(indigo_device *device) {
	return indigo_focuser_detach(device);
}

static indigo_device bad_focuser = INDIGO_DEVICE_INITIALIZER("Bad Focuser", bad_attach, indigo_focuser_enumerate_properties, bad_change_property, NULL, bad_detach);

static bool bad_focuser_connected(void) {
	indigo_device_context *device_context = (indigo_device_context *)bad_focuser.device_context;
	return device_context != NULL && device_context->connection_property->items[0].sw.value && device_context->connection_property->state == INDIGO_OK_STATE;
}

// Runs in the child process: connects the misbehaving focuser over the port and detaches it while still connected,
// which has to abort. Returning at all is a failure.
static int misbehaving_driver_child(const char *port) {
	if (indigo_start() != INDIGO_OK || indigo_attach_client(&simulator_test_client) != INDIGO_OK || indigo_attach_device(&bad_focuser) != INDIGO_OK) {
		fprintf(stderr, "misbehaving driver child: setup failed\n");
		return 2;
	}
	// a change request is only taken by a property the device has defined
	indigo_enumerate_properties(&simulator_test_client, &INDIGO_ALL_PROPERTIES);
	indigo_change_text_property_1_raw(&simulator_test_client, bad_focuser.name, DEVICE_PORT_PROPERTY_NAME, DEVICE_PORT_ITEM_NAME, port);
	indigo_change_switch_property_1(&simulator_test_client, bad_focuser.name, CONNECTION_PROPERTY_NAME, CONNECTION_CONNECTED_ITEM_NAME, true);
	if (!bad_focuser_connected()) {
		fprintf(stderr, "misbehaving driver child: the focuser did not connect\n");
		return 2;
	}
	indigo_detach_device(&bad_focuser);
	fprintf(stderr, "misbehaving driver child: the detach of a connected device did not abort\n");
	return 1;
}

// A driver that detaches a device still connected over a serial port is a bug the developer has to fix: the
// framework logs it, naming the driver, the device and the port probably left open, and the assertion aborts. The
// scenario runs in a child process, the binary started again with --misbehaving-driver, so the abort ends only it.
static void misbehaving_driver_is_asserted(void) {
	external_serial_simulator fixture = { 0 };
	char output[PATH_MAX] = "/tmp/indigo-serial-port-loss.XXXXXX";
	int output_fd = mkstemp(output);
	SERIAL_CHECK_TRUE(output_fd >= 0);
	close(output_fd);
	SERIAL_CHECK_TRUE(start_external_serial_simulator(&fixture, FOCUSER_MOONLITE_SIMULATOR_EXECUTABLE));
	posix_spawn_file_actions_t actions;
	posix_spawn_file_actions_init(&actions);
	posix_spawn_file_actions_addopen(&actions, STDOUT_FILENO, output, O_WRONLY | O_TRUNC, 0644);
	posix_spawn_file_actions_adddup2(&actions, STDOUT_FILENO, STDERR_FILENO);
	char *arguments[] = { (char *)test_executable, "--misbehaving-driver", fixture.port, NULL };
	pid_t child = 0;
	int spawned = posix_spawn(&child, test_executable, &actions, NULL, arguments, environ);
	posix_spawn_file_actions_destroy(&actions);
	SERIAL_CHECK_EQ_INT(0, spawned);
	int status = 0;
	while (waitpid(child, &status, 0) < 0 && errno == EINTR) {
	}
	char text[4096] = "";
	FILE *file = fopen(output, "r");
	if (file != NULL) {
		size_t length = fread(text, 1, sizeof(text) - 1, file);
		text[length] = 0;
		fclose(file);
	}
	const char *line = strstr(text, "Driver indigo_focuser_bad misbehaves");
	printf("    %.*s\n", line ? (int)strcspn(line, "\n") : 0, line ? line : "");
	SERIAL_CHECK_TRUE(WIFSIGNALED(status) && WTERMSIG(status) == SIGABRT);
	SERIAL_CHECK_TRUE(line != NULL);
	SERIAL_CHECK_TRUE(strstr(text, "'Bad Focuser' was detached while still connected") != NULL);
	SERIAL_CHECK_TRUE(strstr(text, "a driver must disconnect a device before it detaches it") != NULL);
cleanup:
	stop_external_serial_simulator(&fixture);
	unlink(output);
}

int main(int argc, char **argv) {
	if (argc == 3 && !strcmp(argv[1], "--misbehaving-driver")) {
		return misbehaving_driver_child(argv[2]);
	}
	test_executable = argv[0];
	setvbuf(stdout, NULL, _IOLBF, 0);
	alarm(120);
	simulator_test_client.send_message = observe_message;
	const indigo_test_case tests[] = {
		{ "listed_port_loss_disconnects", listed_port_loss_disconnects },
		{ "unlisted_port_is_left_alone", unlisted_port_is_left_alone },
		{ "misbehaving_driver_is_asserted", misbehaving_driver_is_asserted }
	};
	return indigo_run_tests("Framework disconnect on a lost serial port", tests, ARRAY_SIZE(tests));
}
