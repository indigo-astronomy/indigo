// Copyright (c) 2026 INDIGO initiative
// All rights reserved.
//
// You may use this software under the terms of 'INDIGO Astronomy
// open-source license' (see LICENSE.md).
//
// THIS SOFTWARE IS PROVIDED BY THE AUTHORS 'AS IS' AND ANY EXPRESS
// OR IMPLIED WARRANTIES, INCLUDING, BUT NOT LIMITED TO, THE IMPLIED
// WARRANTIES OF MERCHANTABILITY AND FITNESS FOR A PARTICULAR PURPOSE
// ARE DISCLAIMED. IN NO EVENT SHALL THE AUTHOR BE LIABLE FOR ANY
// DIRECT, INDIRECT, INCIDENTAL, SPECIAL, EXEMPLARY, OR CONSEQUENTIAL
// DAMAGES (INCLUDING, BUT NOT LIMITED TO, PROCUREMENT OF SUBSTITUTE
// GOODS OR SERVICES; LOSS OF USE, DATA, OR PROFITS; OR BUSINESS
// INTERRUPTION) HOWEVER CAUSED AND ON ANY THEORY OF LIABILITY,
// WHETHER IN CONTRACT, STRICT LIABILITY, OR TORT (INCLUDING
// NEGLIGENCE OR OTHERWISE) ARISING IN ANY WAY OUT OF THE USE OF THIS
// SOFTWARE, EVEN IF ADVISED OF THE POSSIBILITY OF SUCH DAMAGE.

// Code is generated by AI

// Coordination of several Imager Agent instances (the base agent and its ADDITIONAL_INSTANCES)
// over one in-process bus, each driving its own CCD simulator camera. Covered: the breakpoint
// barrier keeping members in lockstep, abort propagation from the leader, a member aborting while
// the others wait at the barrier, leader-only dithering through the real Guider Agent without
// member exposures overlapping the dither, and independent instances not interfering.

#include <math.h>
#include <pthread.h>
#include <stdatomic.h>
#include <stdlib.h>
#include <sys/wait.h>
#include <unistd.h>

#include <indigo/indigo_driver.h>
#include <indigo_drivers/agent_guider/indigo_agent_guider.h>
#include <indigo_drivers/agent_imager/indigo_agent_imager.h>
#include <indigo_drivers/ccd_simulator/indigo_ccd_simulator.h>

#include "../test_runner.h"

#define LEADER "Imager Agent"
#define MEMBER_2 "Imager Agent #2"
#define MEMBER_3 "Imager Agent #3"
#define GUIDER "Guider Agent"
#define IMAGER_CAMERA "CCD Imager Simulator"
#define BAHTINOV_CAMERA "CCD Bahtinov Mask Simulator"
#define GUIDER_CAMERA "CCD Guider Simulator"
#define GUIDER_OUTPUT "CCD Guider Simulator (guider)"
#define MAX_EVENTS 64
#define ARRAY_SIZE(a) (sizeof(a) / sizeof((a)[0]))
#define REQUIRE(c) do { if (!(c)) { fprintf(stderr, "%s:%d: %s\n", __FILE__, __LINE__, #c); indigo_test_failures++; return false; } } while (0)
#define WAIT_UNTIL(condition, timeout) ({ double deadline_ = indigo_monotonic_time() + (timeout); bool ready_ = (condition); while (!ready_ && indigo_monotonic_time() < deadline_) { indigo_usleep(5000); ready_ = (condition); } ready_; })

typedef struct {
	char device[INDIGO_NAME_SIZE];
	char name[INDIGO_NAME_SIZE];
	indigo_property *property;
	unsigned revision;
} observation;

// Start and end times of the BUSY periods of one property, e.g. the exposures of one camera.
typedef struct {
	const char *device;
	const char *name;
	int last_state;
	int count;
	double start[MAX_EVENTS];
	double end[MAX_EVENTS];
} busy_periods;

static observation cache[4096];
static pthread_mutex_t cache_mutex = PTHREAD_MUTEX_INITIALIZER;
static indigo_client observer;
static char messages[262144];
static busy_periods exposures[] = {
	{ IMAGER_CAMERA, CCD_EXPOSURE_PROPERTY_NAME, -1 },
	{ BAHTINOV_CAMERA, CCD_EXPOSURE_PROPERTY_NAME, -1 },
	{ GUIDER_CAMERA, CCD_EXPOSURE_PROPERTY_NAME, -1 }
};
static busy_periods dithers = { GUIDER, AGENT_GUIDER_DITHER_PROPERTY_NAME, -1 };
static atomic_uint member_phases;
static int max_frame_spread;
static bool track_spread;
static bool bus_started, observer_attached, ccd_started, imager_started, guider_started;

static observation *find_observation(const char *device, const char *name) {
	observation *free_entry = NULL;
	for (unsigned i = 0; i < ARRAY_SIZE(cache); i++) {
		if (!*cache[i].name) {
			if (!free_entry) {
				free_entry = cache + i;
			}
		} else if (!strcmp(cache[i].device, device) && !strcmp(cache[i].name, name)) {
			return cache + i;
		}
	}
	if (free_entry) {
		INDIGO_COPY_NAME(free_entry->device, device);
		INDIGO_COPY_NAME(free_entry->name, name);
	}
	return free_entry;
}

static double cached_number(const char *device, const char *name, const char *item_name) {
	observation *entry = find_observation(device, name);
	if (entry && entry->property) {
		for (int i = 0; i < entry->property->count; i++) {
			if (!strcmp(entry->property->items[i].name, item_name)) {
				return entry->property->items[i].number.value;
			}
		}
	}
	return NAN;
}

static void record_period(busy_periods *periods, indigo_property *property) {
	if (strcmp(periods->device, property->device) || strcmp(periods->name, property->name)) {
		return;
	}
	if (property->state == INDIGO_BUSY_STATE && periods->last_state != INDIGO_BUSY_STATE) {
		if (periods->count < MAX_EVENTS) {
			periods->start[periods->count] = indigo_monotonic_time();
			periods->end[periods->count] = NAN;
		}
	} else if (property->state != INDIGO_BUSY_STATE && periods->last_state == INDIGO_BUSY_STATE) {
		if (periods->count < MAX_EVENTS) {
			periods->end[periods->count] = indigo_monotonic_time();
		}
		periods->count++;
	}
	periods->last_state = property->state;
}

// Called with cache_mutex held after an update was cached.
static void record_transitions(indigo_property *property) {
	for (unsigned i = 0; i < ARRAY_SIZE(exposures); i++) {
		record_period(exposures + i, property);
	}
	record_period(&dithers, property);
	if (!strcmp(property->name, AGENT_IMAGER_STATS_PROPERTY_NAME)) {
		if (strcmp(property->device, LEADER)) {
			double phase = cached_number(property->device, property->name, AGENT_IMAGER_STATS_PHASE_ITEM_NAME);
			if (!isnan(phase)) {
				atomic_fetch_or(&member_phases, 1u << (int)phase);
			}
		}
		if (track_spread) {
			double frames[] = { cached_number(LEADER, property->name, AGENT_IMAGER_STATS_FRAME_ITEM_NAME), cached_number(MEMBER_2, property->name, AGENT_IMAGER_STATS_FRAME_ITEM_NAME), cached_number(MEMBER_3, property->name, AGENT_IMAGER_STATS_FRAME_ITEM_NAME) };
			double low = frames[0], high = frames[0];
			for (int i = 1; i < 3; i++) {
				low = fmin(low, frames[i]);
				high = fmax(high, frames[i]);
			}
			if (!isnan(low) && high - low > max_frame_spread) {
				max_frame_spread = (int)(high - low);
			}
		}
	}
}

static indigo_result observe(indigo_property *property, bool update) {
	pthread_mutex_lock(&cache_mutex);
	observation *entry = find_observation(property->device, property->name);
	if (entry) {
		indigo_release_property(entry->property);
		entry->property = indigo_copy_property(NULL, property);
		entry->revision++;
	}
	if (update) {
		record_transitions(property);
	}
	pthread_mutex_unlock(&cache_mutex);
	return INDIGO_OK;
}

static indigo_result defined(indigo_client *client, indigo_device *device, indigo_property *property, const char *message) {
	return observe(property, false);
}

static indigo_result updated(indigo_client *client, indigo_device *device, indigo_property *property, const char *message) {
	return observe(property, true);
}

static indigo_result deleted(indigo_client *client, indigo_device *device, indigo_property *property, const char *message) {
	pthread_mutex_lock(&cache_mutex);
	for (unsigned i = 0; i < ARRAY_SIZE(cache); i++) {
		observation *entry = cache + i;
		if (*entry->name && !strcmp(entry->device, property->device) && (!*property->name || !strcmp(entry->name, property->name))) {
			indigo_release_property(entry->property);
			memset(entry, 0, sizeof(*entry));
		}
	}
	pthread_mutex_unlock(&cache_mutex);
	return INDIGO_OK;
}

static indigo_result message_received(indigo_client *client, indigo_device *device, indigo_property *property, const char *message) {
	pthread_mutex_lock(&cache_mutex);
	if (message && strlen(messages) + strlen(device->name) + strlen(message) + 4 < sizeof(messages)) {
		strcat(messages, device->name);
		strcat(messages, ": ");
		strcat(messages, message);
		strcat(messages, "\n");
	}
	pthread_mutex_unlock(&cache_mutex);
	return INDIGO_OK;
}

static bool has_message(const char *text) {
	pthread_mutex_lock(&cache_mutex);
	bool result = strstr(messages, text) != NULL;
	pthread_mutex_unlock(&cache_mutex);
	return result;
}

static void dump_messages(void) {
	pthread_mutex_lock(&cache_mutex);
	fprintf(stderr, "---- agent messages ----\n%s------------------------\n", messages);
	pthread_mutex_unlock(&cache_mutex);
}

static bool exists(const char *device, const char *name) {
	pthread_mutex_lock(&cache_mutex);
	observation *entry = find_observation(device, name);
	bool result = entry && entry->property;
	pthread_mutex_unlock(&cache_mutex);
	return result;
}

static unsigned revision(const char *device, const char *name) {
	pthread_mutex_lock(&cache_mutex);
	observation *entry = find_observation(device, name);
	unsigned result = entry ? entry->revision : 0;
	pthread_mutex_unlock(&cache_mutex);
	return result;
}

static int state(const char *device, const char *name) {
	pthread_mutex_lock(&cache_mutex);
	observation *entry = find_observation(device, name);
	int result = entry && entry->property ? (int)entry->property->state : -1;
	pthread_mutex_unlock(&cache_mutex);
	return result;
}

static bool item_lookup(const char *device, const char *name, const char *item_name, indigo_item *result) {
	bool found = false;
	pthread_mutex_lock(&cache_mutex);
	observation *entry = find_observation(device, name);
	if (entry && entry->property) {
		for (int i = 0; i < entry->property->count; i++) {
			if (!strcmp(entry->property->items[i].name, item_name)) {
				*result = entry->property->items[i];
				found = true;
				break;
			}
		}
	}
	pthread_mutex_unlock(&cache_mutex);
	return found;
}

static double number(const char *device, const char *name, const char *item_name) {
	indigo_item item;
	return item_lookup(device, name, item_name, &item) ? item.number.value : NAN;
}

static bool switch_value(const char *device, const char *name, const char *item_name) {
	indigo_item item;
	return item_lookup(device, name, item_name, &item) && item.sw.value;
}

static bool has_item(const char *device, const char *name, const char *item_name) {
	indigo_item item;
	return item_lookup(device, name, item_name, &item);
}

static int light_value(const char *device, const char *name, const char *item_name) {
	indigo_item item;
	return item_lookup(device, name, item_name, &item) ? (int)item.light.value : -1;
}

static bool change_switch(const char *device, const char *name, const char *item_name, bool value) {
	REQUIRE(WAIT_UNTIL(has_item(device, name, item_name), 10));
	REQUIRE(indigo_change_switch_property_1(&observer, device, name, item_name, value) == INDIGO_OK);
	return true;
}

static bool set_switch(const char *device, const char *name, const char *item_name, bool value) {
	unsigned before = revision(device, name);
	REQUIRE(change_switch(device, name, item_name, value));
	if (!WAIT_UNTIL(revision(device, name) > before && state(device, name) == INDIGO_OK_STATE && switch_value(device, name, item_name) == value, 20)) {
		fprintf(stderr, "%s.%s.%s = %d did not settle (state %d)\n", device, name, item_name, value, state(device, name));
		dump_messages();
		return false;
	}
	return true;
}

static bool change_numbers(const char *device, const char *name, int count, const char **items, const double *values) {
	REQUIRE(WAIT_UNTIL(exists(device, name), 10));
	unsigned before = revision(device, name);
	REQUIRE(indigo_change_number_property(&observer, device, name, count, items, values) == INDIGO_OK);
	if (!WAIT_UNTIL(revision(device, name) > before && state(device, name) != INDIGO_BUSY_STATE, 10)) {
		fprintf(stderr, "%s.%s did not settle after a number change (state %d)\n", device, name, state(device, name));
		return false;
	}
	return true;
}

static bool configure_batch(const char *agent, double count, double exposure) {
	return change_numbers(agent, AGENT_IMAGER_BATCH_PROPERTY_NAME, 4, (const char *[]){ AGENT_IMAGER_BATCH_COUNT_ITEM_NAME, AGENT_IMAGER_BATCH_EXPOSURE_ITEM_NAME, AGENT_IMAGER_BATCH_DELAY_ITEM_NAME, AGENT_IMAGER_BATCH_FRAMES_TO_SKIP_BEFORE_DITHER_ITEM_NAME }, (double []){ count, exposure, 0, 0 });
}

// Selects the camera of one Imager Agent instance and keeps its frames in memory.
static bool prepare_instance(const char *agent, const char *camera) {
	REQUIRE(WAIT_UNTIL(has_item(agent, FILTER_CCD_LIST_PROPERTY_NAME, camera), 10));
	REQUIRE(set_switch(agent, FILTER_CCD_LIST_PROPERTY_NAME, camera, true));
	REQUIRE(set_switch(agent, CCD_UPLOAD_MODE_PROPERTY_NAME, CCD_UPLOAD_MODE_CLIENT_ITEM_NAME, true));
	REQUIRE(set_switch(agent, CCD_IMAGE_FORMAT_PROPERTY_NAME, CCD_IMAGE_FORMAT_RAW_ITEM_NAME, true));
	return true;
}

static bool running(const char *agent) {
	return state(agent, AGENT_START_PROCESS_PROPERTY_NAME) == INDIGO_BUSY_STATE;
}

static double frame(const char *agent) {
	return number(agent, AGENT_IMAGER_STATS_PROPERTY_NAME, AGENT_IMAGER_STATS_FRAME_ITEM_NAME);
}

static bool finished(const char *agent, indigo_property_state expected, double timeout) {
	if (!WAIT_UNTIL(!running(agent), timeout)) {
		fprintf(stderr, "%s still running (frame %g)\n", agent, frame(agent));
		dump_messages();
		return false;
	}
	if (state(agent, AGENT_START_PROCESS_PROPERTY_NAME) != (int)expected) {
		fprintf(stderr, "%s finished in state %d, expected %d\n", agent, state(agent, AGENT_START_PROCESS_PROPERTY_NAME), expected);
		dump_messages();
		return false;
	}
	return true;
}

static void reset_recording(void) {
	pthread_mutex_lock(&cache_mutex);
	for (unsigned i = 0; i < ARRAY_SIZE(exposures); i++) {
		exposures[i].count = 0;
	}
	dithers.count = 0;
	max_frame_spread = 0;
	pthread_mutex_unlock(&cache_mutex);
	atomic_store(&member_phases, 0);
}

static busy_periods *exposures_of(const char *camera) {
	for (unsigned i = 0; i < ARRAY_SIZE(exposures); i++) {
		if (!strcmp(exposures[i].device, camera)) {
			return exposures + i;
		}
	}
	return NULL;
}

// Makes the base agent the barrier leader of the given members: RESUME_CONDITION = BARRIER, the
// members related to it and the barrier breakpoints set, which the leader copies to its members.
static bool form_barrier(const char **members, int count, const char **breakpoints, int breakpoint_count) {
	REQUIRE(set_switch(LEADER, AGENT_IMAGER_RESUME_CONDITION_PROPERTY_NAME, AGENT_IMAGER_RESUME_CONDITION_BARRIER_ITEM_NAME, true));
	for (int i = 0; i < count; i++) {
		REQUIRE(set_switch(LEADER, FILTER_RELATED_AGENT_LIST_PROPERTY_NAME, members[i], true));
	}
	for (int b = 0; b < breakpoint_count; b++) {
		REQUIRE(set_switch(LEADER, AGENT_IMAGER_BREAKPOINT_PROPERTY_NAME, breakpoints[b], true));
	}
	for (int i = 0; i < count; i++) {
		for (int b = 0; b < breakpoint_count; b++) {
			REQUIRE(WAIT_UNTIL(switch_value(members[i], AGENT_IMAGER_BREAKPOINT_PROPERTY_NAME, breakpoints[b]), 10));
		}
		REQUIRE(WAIT_UNTIL(switch_value(members[i], AGENT_IMAGER_RESUME_CONDITION_PROPERTY_NAME, AGENT_IMAGER_RESUME_CONDITION_TRIGGER_ITEM_NAME), 10));
		REQUIRE(WAIT_UNTIL(light_value(LEADER, AGENT_IMAGER_BARRIER_STATE_PROPERTY_NAME, members[i]) >= 0, 10));
	}
	return true;
}

static bool start_leader(void) {
	reset_recording();
	REQUIRE(change_switch(LEADER, AGENT_START_PROCESS_PROPERTY_NAME, AGENT_IMAGER_START_EXPOSURE_ITEM_NAME, true));
	REQUIRE(WAIT_UNTIL(running(LEADER), 10));
	return true;
}

static bool setup(void) {
	indigo_set_log_level(getenv("INDIGO_TEST_DEBUG") ? INDIGO_LOG_DEBUG : INDIGO_LOG_ERROR);
	REQUIRE(indigo_start() == INDIGO_OK);
	bus_started = true;
	INDIGO_COPY_NAME(observer.name, "Imager instances observer");
	observer.version = INDIGO_VERSION_CURRENT;
	observer.define_property = defined;
	observer.update_property = updated;
	observer.delete_property = deleted;
	observer.send_message = message_received;
	REQUIRE(indigo_attach_client(&observer) == INDIGO_OK);
	observer_attached = true;
	REQUIRE(indigo_ccd_simulator(INDIGO_DRIVER_INIT, NULL) == INDIGO_OK);
	ccd_started = true;
	REQUIRE(indigo_agent_imager(INDIGO_DRIVER_INIT, NULL) == INDIGO_OK);
	imager_started = true;
	REQUIRE(change_numbers(LEADER, ADDITIONAL_INSTANCES_PROPERTY_NAME, 1, (const char *[]){ ADDITIONAL_INSTANCES_COUNT_ITEM_NAME }, (double []){ 2 }));
	REQUIRE(WAIT_UNTIL(exists(MEMBER_2, AGENT_START_PROCESS_PROPERTY_NAME) && exists(MEMBER_3, AGENT_START_PROCESS_PROPERTY_NAME), 10));
	REQUIRE(prepare_instance(LEADER, IMAGER_CAMERA));
	REQUIRE(prepare_instance(MEMBER_2, BAHTINOV_CAMERA));
	return true;
}

static void cleanup(void) {
	if (guider_started) {
		indigo_agent_guider(INDIGO_DRIVER_SHUTDOWN, NULL);
	}
	if (imager_started) {
		indigo_agent_imager(INDIGO_DRIVER_SHUTDOWN, NULL);
	}
	if (ccd_started) {
		indigo_ccd_simulator(INDIGO_DRIVER_SHUTDOWN, NULL);
	}
	if (observer_attached) {
		indigo_detach_client(&observer);
	}
	if (bus_started) {
		indigo_stop();
	}
}

// Three instances with different exposure times synchronised on PRE_CAPTURE: no instance ever runs
// more than one frame ahead, and every frame starts on all three cameras at the same moment,
// released together by the leader once all members reported themselves paused.
static void barrier_keeps_three_instances_in_lockstep(void) {
	const char *members[] = { MEMBER_2, MEMBER_3 };
	ASSERT_TRUE(prepare_instance(MEMBER_3, GUIDER_CAMERA));
	ASSERT_TRUE(configure_batch(LEADER, 3, 0.2));
	ASSERT_TRUE(configure_batch(MEMBER_2, 3, 1.5));
	ASSERT_TRUE(configure_batch(MEMBER_3, 3, 0.6));
	ASSERT_TRUE(form_barrier(members, 2, (const char *[]){ AGENT_IMAGER_BREAKPOINT_PRE_CAPTURE_ITEM_NAME }, 1));
	pthread_mutex_lock(&cache_mutex);
	track_spread = true;
	pthread_mutex_unlock(&cache_mutex);
	ASSERT_TRUE(start_leader());
	ASSERT_TRUE(WAIT_UNTIL(running(MEMBER_2) && running(MEMBER_3), 10));
	ASSERT_TRUE(finished(LEADER, INDIGO_OK_STATE, 60));
	ASSERT_TRUE(finished(MEMBER_2, INDIGO_OK_STATE, 20));
	ASSERT_TRUE(finished(MEMBER_3, INDIGO_OK_STATE, 20));
	pthread_mutex_lock(&cache_mutex);
	track_spread = false;
	int spread = max_frame_spread;
	busy_periods leader = *exposures_of(IMAGER_CAMERA), member_2 = *exposures_of(BAHTINOV_CAMERA), member_3 = *exposures_of(GUIDER_CAMERA);
	pthread_mutex_unlock(&cache_mutex);
	ASSERT_EQ_INT(3, (int)frame(LEADER));
	ASSERT_EQ_INT(3, (int)frame(MEMBER_2));
	ASSERT_EQ_INT(3, (int)frame(MEMBER_3));
	ASSERT_TRUE(spread <= 1);
	ASSERT_EQ_INT(3, leader.count);
	ASSERT_EQ_INT(3, member_2.count);
	ASSERT_EQ_INT(3, member_3.count);
	for (int i = 0; i < 3 && i < leader.count && i < member_2.count && i < member_3.count; i++) {
		double first = fmin(leader.start[i], fmin(member_2.start[i], member_3.start[i]));
		double last = fmax(leader.start[i], fmax(member_2.start[i], member_3.start[i]));
		if (last - first >= 0.5) {
			fprintf(stderr, "frame %d starts %.3f s apart\n", i + 1, last - first);
		}
		ASSERT_TRUE(last - first < 0.5);
		if (i > 0) {
			double previous_end = fmax(leader.end[i - 1], fmax(member_2.end[i - 1], member_3.end[i - 1]));
			ASSERT_TRUE(first >= previous_end);
		}
	}
	ASSERT_TRUE(light_value(LEADER, AGENT_IMAGER_BARRIER_STATE_PROPERTY_NAME, MEMBER_2) >= 0);
	ASSERT_TRUE(light_value(LEADER, AGENT_IMAGER_BARRIER_STATE_PROPERTY_NAME, MEMBER_3) >= 0);
}

// Aborting the leader of a running barrier group aborts every member as well.
static void leader_abort_stops_all_members(void) {
	const char *members[] = { MEMBER_2, MEMBER_3 };
	ASSERT_TRUE(prepare_instance(MEMBER_3, GUIDER_CAMERA));
	ASSERT_TRUE(configure_batch(LEADER, 20, 0.5));
	ASSERT_TRUE(configure_batch(MEMBER_2, 20, 0.5));
	ASSERT_TRUE(configure_batch(MEMBER_3, 20, 0.5));
	ASSERT_TRUE(form_barrier(members, 2, (const char *[]){ AGENT_IMAGER_BREAKPOINT_PRE_CAPTURE_ITEM_NAME }, 1));
	ASSERT_TRUE(start_leader());
	ASSERT_TRUE(WAIT_UNTIL(frame(LEADER) >= 2 && frame(MEMBER_2) >= 2 && frame(MEMBER_3) >= 2, 30));
	ASSERT_TRUE(change_switch(LEADER, AGENT_ABORT_PROCESS_PROPERTY_NAME, AGENT_ABORT_PROCESS_ITEM_NAME, true));
	ASSERT_TRUE(finished(LEADER, INDIGO_ALERT_STATE, 10));
	ASSERT_TRUE(finished(MEMBER_2, INDIGO_ALERT_STATE, 10));
	ASSERT_TRUE(finished(MEMBER_3, INDIGO_ALERT_STATE, 10));
	ASSERT_TRUE(frame(LEADER) < 20);
}

// A member aborted on its own while the leader and the other member wait for it at the barrier
// never reaches the barrier again, so the leader aborts the whole group instead of waiting for it
// forever.
static void member_abort_aborts_barrier_group(void) {
	const char *members[] = { MEMBER_2, MEMBER_3 };
	ASSERT_TRUE(prepare_instance(MEMBER_3, GUIDER_CAMERA));
	ASSERT_TRUE(configure_batch(LEADER, 3, 0.2));
	ASSERT_TRUE(configure_batch(MEMBER_2, 3, 5));
	ASSERT_TRUE(configure_batch(MEMBER_3, 3, 0.2));
	ASSERT_TRUE(form_barrier(members, 2, (const char *[]){ AGENT_IMAGER_BREAKPOINT_PRE_CAPTURE_ITEM_NAME }, 1));
	ASSERT_TRUE(start_leader());
	ASSERT_TRUE(WAIT_UNTIL(frame(LEADER) == 2 && frame(MEMBER_3) == 2 && state(LEADER, AGENT_PAUSE_PROCESS_PROPERTY_NAME) == INDIGO_BUSY_STATE && state(MEMBER_3, AGENT_PAUSE_PROCESS_PROPERTY_NAME) == INDIGO_BUSY_STATE && running(MEMBER_2), 20));
	ASSERT_TRUE(change_switch(MEMBER_2, AGENT_ABORT_PROCESS_PROPERTY_NAME, AGENT_ABORT_PROCESS_ITEM_NAME, true));
	ASSERT_TRUE(finished(MEMBER_2, INDIGO_ALERT_STATE, 10));
	ASSERT_TRUE(finished(LEADER, INDIGO_ALERT_STATE, 10));
	ASSERT_TRUE(finished(MEMBER_3, INDIGO_ALERT_STATE, 10));
	ASSERT_EQ_INT(2, (int)frame(LEADER));
	ASSERT_EQ_INT(2, (int)frame(MEMBER_3));
	ASSERT_TRUE(has_message(MEMBER_2 " stopped, aborting the barrier group"));
	ASSERT_TRUE(start_leader());
	ASSERT_TRUE(finished(LEADER, INDIGO_OK_STATE, 60));
	ASSERT_TRUE(finished(MEMBER_2, INDIGO_OK_STATE, 30));
	ASSERT_TRUE(finished(MEMBER_3, INDIGO_OK_STATE, 30));
}

// The leader dithers through the Guider Agent only once its member is paused on a barrier
// breakpoint: only the leader dithers, the member never enters the dithering phase and no member
// exposure overlaps a dither, whether the group synchronises on PRE_CAPTURE alone or on
// POST_CAPTURE and PRE_CAPTURE.
static void leader_dithers_while_members_wait(const char **breakpoints, int breakpoint_count) {
	const char *members[] = { MEMBER_2 };
	ASSERT_TRUE(indigo_agent_guider(INDIGO_DRIVER_INIT, NULL) == INDIGO_OK);
	guider_started = true;
	ASSERT_TRUE(WAIT_UNTIL(has_item(GUIDER, FILTER_CCD_LIST_PROPERTY_NAME, GUIDER_CAMERA), 10));
	ASSERT_TRUE(set_switch(GUIDER, FILTER_CCD_LIST_PROPERTY_NAME, GUIDER_CAMERA, true));
	ASSERT_TRUE(set_switch(GUIDER, FILTER_GUIDER_LIST_PROPERTY_NAME, GUIDER_OUTPUT, true));
	ASSERT_TRUE(change_numbers(GUIDER, AGENT_GUIDER_SETTINGS_PROPERTY_NAME, 5, (const char *[]){ AGENT_GUIDER_SETTINGS_EXPOSURE_ITEM_NAME, AGENT_GUIDER_SETTINGS_DELAY_ITEM_NAME, AGENT_GUIDER_SETTINGS_DITHERING_AMOUNT_ITEM_NAME, AGENT_GUIDER_SETTINGS_DITH_LIMIT_ITEM_NAME, AGENT_GUIDER_SETTINGS_DITHERING_TIME_LIMIT_ITEM_NAME }, (double []){ 0.1, 0, 2, 5, 60 }));
	ASSERT_TRUE(change_switch(GUIDER, AGENT_START_PROCESS_PROPERTY_NAME, AGENT_GUIDER_START_CALIBRATION_AND_GUIDING_ITEM_NAME, true));
	ASSERT_TRUE(WAIT_UNTIL(running(GUIDER) && number(GUIDER, AGENT_GUIDER_STATS_PROPERTY_NAME, AGENT_GUIDER_STATS_PHASE_ITEM_NAME) == INDIGO_GUIDER_PHASE_GUIDING && number(GUIDER, AGENT_GUIDER_STATS_PROPERTY_NAME, AGENT_GUIDER_STATS_FRAME_ITEM_NAME) > 5, 180));
	ASSERT_TRUE(set_switch(LEADER, FILTER_RELATED_AGENT_LIST_PROPERTY_NAME, GUIDER, true));
	ASSERT_TRUE(set_switch(LEADER, AGENT_PROCESS_FEATURES_PROPERTY_NAME, AGENT_IMAGER_ENABLE_DITHERING_FEATURE_ITEM_NAME, true));
	ASSERT_TRUE(set_switch(MEMBER_2, FILTER_RELATED_AGENT_LIST_PROPERTY_NAME, GUIDER, true));
	ASSERT_TRUE(set_switch(MEMBER_2, AGENT_PROCESS_FEATURES_PROPERTY_NAME, AGENT_IMAGER_ENABLE_DITHERING_FEATURE_ITEM_NAME, true));
	ASSERT_TRUE(configure_batch(LEADER, 3, 0.2));
	ASSERT_TRUE(configure_batch(MEMBER_2, 3, 0.5));
	ASSERT_TRUE(form_barrier(members, 1, breakpoints, breakpoint_count));
	ASSERT_TRUE(start_leader());
	ASSERT_TRUE(finished(LEADER, INDIGO_OK_STATE, 180));
	ASSERT_TRUE(finished(MEMBER_2, INDIGO_OK_STATE, 20));
	pthread_mutex_lock(&cache_mutex);
	busy_periods member = *exposures_of(BAHTINOV_CAMERA), dither = dithers;
	pthread_mutex_unlock(&cache_mutex);
	ASSERT_EQ_INT(2, dither.count);
	ASSERT_EQ_INT(3, member.count);
	ASSERT_FALSE(atomic_load(&member_phases) & (1u << INDIGO_IMAGER_PHASE_DITHERING));
	for (int d = 0; d < dither.count && d < MAX_EVENTS; d++) {
		for (int e = 0; e < member.count && e < MAX_EVENTS; e++) {
			bool overlaps = member.start[e] < dither.end[d] && member.end[e] > dither.start[d];
			if (overlaps) {
				fprintf(stderr, "member exposure %d [%.3f, %.3f] overlaps dither %d [%.3f, %.3f]\n", e + 1, member.start[e], member.end[e], d + 1, dither.start[d], dither.end[d]);
			}
			ASSERT_FALSE(overlaps);
		}
	}
	ASSERT_TRUE(running(GUIDER));
	ASSERT_TRUE(change_switch(GUIDER, AGENT_ABORT_PROCESS_PROPERTY_NAME, AGENT_ABORT_PROCESS_ITEM_NAME, true));
	ASSERT_TRUE(WAIT_UNTIL(!running(GUIDER), 20));
}

static void leader_dithers_with_pre_capture_barrier(void) {
	leader_dithers_while_members_wait((const char *[]){ AGENT_IMAGER_BREAKPOINT_PRE_CAPTURE_ITEM_NAME }, 1);
}

static void leader_dithers_with_post_and_pre_capture_barrier(void) {
	leader_dithers_while_members_wait((const char *[]){ AGENT_IMAGER_BREAKPOINT_POST_CAPTURE_ITEM_NAME, AGENT_IMAGER_BREAKPOINT_PRE_CAPTURE_ITEM_NAME }, 2);
}

// Instances that are not related run independently: aborting one leaves the other one running to
// its normal end.
static void independent_instances_do_not_interfere(void) {
	ASSERT_TRUE(configure_batch(LEADER, 4, 0.5));
	ASSERT_TRUE(configure_batch(MEMBER_2, 20, 0.5));
	ASSERT_TRUE(start_leader());
	ASSERT_TRUE(change_switch(MEMBER_2, AGENT_START_PROCESS_PROPERTY_NAME, AGENT_IMAGER_START_EXPOSURE_ITEM_NAME, true));
	ASSERT_TRUE(WAIT_UNTIL(running(MEMBER_2) && frame(MEMBER_2) >= 1 && frame(LEADER) >= 1, 10));
	ASSERT_TRUE(change_switch(MEMBER_2, AGENT_ABORT_PROCESS_PROPERTY_NAME, AGENT_ABORT_PROCESS_ITEM_NAME, true));
	ASSERT_TRUE(finished(MEMBER_2, INDIGO_ALERT_STATE, 10));
	ASSERT_TRUE(finished(LEADER, INDIGO_OK_STATE, 30));
	ASSERT_EQ_INT(4, (int)frame(LEADER));
	ASSERT_TRUE(frame(MEMBER_2) < 20);
}

static const indigo_test_case tests[] = {
	{ "barrier keeps three instances in lockstep", barrier_keeps_three_instances_in_lockstep },
	{ "leader abort stops all members", leader_abort_stops_all_members },
	{ "member abort aborts barrier group", member_abort_aborts_barrier_group },
	{ "leader dithers with PRE_CAPTURE barrier", leader_dithers_with_pre_capture_barrier },
	{ "leader dithers with POST_CAPTURE and PRE_CAPTURE barrier", leader_dithers_with_post_and_pre_capture_barrier },
	{ "independent instances do not interfere", independent_instances_do_not_interfere }
};

int main(int argc, char **argv) {
	setvbuf(stdout, NULL, _IONBF, 0);
	int result = 0, executed = 0, passed = 0;
	for (int i = 0; i < (int)ARRAY_SIZE(tests); i++) {
		if (argc > 1 && !strstr(tests[i].name, argv[1])) {
			continue;
		}
		executed++;
		pid_t child = fork();
		if (child == 0) {
			alarm(420);
			if (!indigo_test_use_private_home()) {
				exit(1);
			}
			bool ready = setup();
			int status = ready ? indigo_run_tests("Imager Agent instance coordination", tests + i, 1) : 1;
			cleanup();
			indigo_test_remove_private_home();
			exit(status || indigo_test_failures ? 1 : 0);
		}
		int status = -1;
		if (child < 0 || waitpid(child, &status, 0) != child || !WIFEXITED(status) || WEXITSTATUS(status)) {
			fprintf(stderr, "Failed case: %s (status %d)\n", tests[i].name, status);
			result = 1;
		} else {
			passed++;
		}
	}
	printf("Imager Agent instance coordination: %d/%d cases passed (including cleanup)\n", passed, executed);
	return executed ? result : 2;
}
