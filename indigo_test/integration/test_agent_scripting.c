// Copyright (c) 2026 INDIGO initiative
// All rights reserved.
//
// You may use this software under the terms of 'INDIGO Astronomy
// open-source license' (see LICENSE.md).
//
// THIS SOFTWARE IS PROVIDED BY THE AUTHORS 'AS IS' AND ANY EXPRESS
// OR IMPLIED WARRANTIES, INCLUDING, BUT NOT LIMITED TO, THE IMPLIED
// WARRANTIES OF MERCHANTABILITY AND FITNESS FOR A PARTICULAR PURPOSE
// ARE DISCLAIMED. IN NO EVENT SHALL THE AUTHOR BE LIABLE FOR ANY
// DIRECT, INDIRECT, INCIDENTAL, SPECIAL, EXEMPLARY, OR CONSEQUENTIAL
// DAMAGES (INCLUDING, BUT NOT LIMITED TO, PROCUREMENT OF SUBSTITUTE
// GOODS OR SERVICES; LOSS OF USE, DATA, OR PROFITS; OR BUSINESS
// INTERRUPTION) HOWEVER CAUSED AND ON ANY THEORY OF LIABILITY,
// WHETHER IN CONTRACT, STRICT LIABILITY, OR TORT (INCLUDING
// NEGLIGENCE OR OTHERWISE) ARISING IN ANY WAY OUT OF THE USE OF THIS
// SOFTWARE, EVEN IF ADVISED OF THE POSSIBILITY OF SUCH DAMAGE.

// Code is generated by AI

#include <pthread.h>
#include <stdatomic.h>
#include <stdlib.h>
#include <unistd.h>
#include <dirent.h>
#include <sys/wait.h>
#include <sys/stat.h>
#include <signal.h>
#include <indigo/indigo_driver.h>
#include <indigo/indigo_align.h>
#include <indigo/indigocat/indigocat_solar_system.h>
#include <indigo_drivers/agent_scripting/indigo_agent_scripting.h>
#include "../test_runner.h"

#define AGENT SCRIPTING_AGENT_NAME
#define PEER "Scripting test peer"
#define RUN AGENT_SCRIPTING_RUN_SCRIPT_PROPERTY_NAME
#define ADD AGENT_SCRIPTING_ADD_SCRIPT_PROPERTY_NAME
#define EXEC AGENT_SCRIPTING_EXECUTE_SCRIPT_PROPERTY_NAME
#define DELETE AGENT_SCRIPTING_DELETE_SCRIPT_PROPERTY_NAME
#define ON_LOAD AGENT_SCRIPTING_ON_LOAD_SCRIPT_PROPERTY_NAME
#define ON_UNLOAD AGENT_SCRIPTING_ON_UNLOAD_SCRIPT_PROPERTY_NAME
#define ARRAY_SIZE(a) (sizeof(a) / sizeof((a)[0]))
#define REQUIRE(c) do { if (!(c)) { fprintf(stderr, "%s:%d: %s\n", __FILE__, __LINE__, #c); indigo_test_failures++; return false; } } while (0)

typedef struct {
	char device[INDIGO_NAME_SIZE], name[INDIGO_NAME_SIZE];
	indigo_property *property;
	unsigned definitions, updates, deletions;
} observation;
static observation cache[512];
static pthread_mutex_t cache_mutex = PTHREAD_MUTEX_INITIALIZER;
static indigo_client observer;
static indigo_device *agent;
static bool running;
static char test_root[256], config_folder[300], messages[65536];
static atomic_int message_count, peer_changes, peer_enumerations, blob_enables, blob_downloads;
static atomic_bool fail_blob, fail_timer, gate_entered, gate_release;
static indigo_enable_blob_mode blob_mode;
static indigo_property *last_request, *peer_properties[5];
static time_t fixed_time = 1704112496;

const char *scripting_test_config_folder(void) {
	return config_folder;
}

time_t scripting_test_time(time_t *result) {
	if (result) {
		*result = fixed_time;
	}
	return fixed_time;
}

bool scripting_test_populate_blob(indigo_item *item) {
	blob_downloads++;
	if (fail_blob) {
		return false;
	}
	static unsigned char payload[] = { 0, 1, 2, 255, 37, 0, 42 };
	item->blob.value = payload;
	item->blob.size = sizeof(payload);
	return true;
}

bool scripting_test_set_timer(indigo_device *device, double delay, indigo_timer_with_data_callback callback, indigo_timer **timer, void *data) {
	return !fail_timer && indigo_set_timer_with_data(device, delay, callback, timer, data);
}

static observation *find(const char *device, const char *name) {
	observation *free_entry = NULL;
	for (unsigned i = 0; i < ARRAY_SIZE(cache); i++) {
		if (!*cache[i].name) {
			if (!free_entry) {
				free_entry = cache + i;
			}
		} else if (!strcmp(cache[i].device, device) && !strcmp(cache[i].name, name)) {
			return cache + i;
		}
	}
	if (free_entry) {
		INDIGO_COPY_NAME(free_entry->device, device);
		INDIGO_COPY_NAME(free_entry->name, name);
	}
	return free_entry;
}

static indigo_result observe(indigo_device *device, indigo_property *property, bool definition) {
	pthread_mutex_lock(&cache_mutex);
	observation *entry = find(property->device, property->name);
	if (entry) {
		indigo_release_property(entry->property);
		entry->property = indigo_copy_property(NULL, property);
		if (definition) {
			entry->definitions++;
		} else {
			entry->updates++;
		}
	}
	if (!strcmp(property->device, AGENT)) {
		agent = device;
	}
	pthread_mutex_unlock(&cache_mutex);
	return INDIGO_OK;
}

static indigo_result defined(indigo_client *client, indigo_device *device, indigo_property *property, const char *message) {
	return observe(device, property, true);
}

static indigo_result updated(indigo_client *client, indigo_device *device, indigo_property *property, const char *message) {
	return observe(device, property, false);
}

static indigo_result deleted(indigo_client *client, indigo_device *device, indigo_property *property, const char *message) {
	pthread_mutex_lock(&cache_mutex);
	for (unsigned i = 0; i < ARRAY_SIZE(cache); i++) {
		observation *entry = cache + i;
		if (!strcmp(entry->device, property->device) && (!*property->name || !strcmp(entry->name, property->name))) {
			indigo_release_property(entry->property);
			entry->property = NULL;
			entry->deletions++;
		}
	}
	pthread_mutex_unlock(&cache_mutex);
	return INDIGO_OK;
}

static indigo_result message_received(indigo_client *client, indigo_device *device, indigo_property *property, const char *message) {
	pthread_mutex_lock(&cache_mutex);
	if (message && strlen(messages) + strlen(message) + 2 < sizeof(messages)) {
		strcat(messages, message);
		strcat(messages, "\n");
	}
	message_count++;
	pthread_mutex_unlock(&cache_mutex);
	return INDIGO_OK;
}

static indigo_property *snapshot(const char *device, const char *name) {
	pthread_mutex_lock(&cache_mutex);
	observation *entry = find(device, name);
	indigo_property *result = entry && entry->property ? indigo_copy_property(NULL, entry->property) : NULL;
	pthread_mutex_unlock(&cache_mutex);
	return result;
}

static unsigned revision(const char *name) {
	pthread_mutex_lock(&cache_mutex);
	observation *entry = find(AGENT, name);
	unsigned result = entry ? entry->definitions + entry->updates : 0;
	pthread_mutex_unlock(&cache_mutex);
	return result;
}

static bool wait_property(const char *name, unsigned before, indigo_property_state state) {
	for (int i = 0; i < 3000; i++) {
		indigo_property *p = snapshot(AGENT, name);
		bool ready = p && p->state == state && revision(name) > before;
		indigo_release_property(p);
		if (ready) {
			return true;
		}
		indigo_usleep(1000);
	}
	indigo_property *p = snapshot(AGENT, name);
	fprintf(stderr, "Timeout waiting for %s state %d after revision %u (observed state %d, revision %u)\n", name, state, before, p ? p->state : -1, revision(name));
	indigo_release_property(p);
	return false;
}

static bool wait_defined(const char *name) {
	for (int i = 0; i < 3000; i++) {
		indigo_property *p = snapshot(AGENT, name);
		if (p) {
			indigo_release_property(p);
			return true;
		}
		indigo_usleep(1000);
	}
	fprintf(stderr, "Timeout waiting for %s definition\n", name);
	return false;
}

static void barrier_handler(indigo_device *device, void *data) {
	atomic_store((atomic_bool *)data, true);
}

static bool drain(void) {
	static atomic_bool reached;
	reached = false;
	indigo_execute_handler_with_data(agent, barrier_handler, &reached);
	for (int i = 0; i < 3000 && !reached; i++) {
		indigo_usleep(1000);
	}
	REQUIRE(reached);
	return true;
}

static bool wait_counter(atomic_int *counter, int expected) {
	for (int i = 0; i < 3000; i++) {
		if (atomic_load(counter) >= expected) {
			return true;
		}
		indigo_usleep(1000);
	}
	fprintf(stderr, "Timeout waiting for counter %p to reach %d (observed %d)\n", (void *)counter, expected, atomic_load(counter));
	return false;
}

static indigo_property *request_snapshot(void) {
	pthread_mutex_lock(&cache_mutex);
	indigo_property *result = last_request ? indigo_copy_property(NULL, last_request) : NULL;
	pthread_mutex_unlock(&cache_mutex);
	return result;
}

static bool js_state(const char *script, indigo_property_state state) {
	unsigned before = revision(RUN);
	REQUIRE(indigo_change_text_property_1(&observer, AGENT, RUN, "SCRIPT", script) == INDIGO_OK);
	REQUIRE(wait_property(RUN, before, state));
	REQUIRE(drain());
	return true;
}

static bool js(const char *script) {
	return js_state(script, INDIGO_OK_STATE);
}

static bool check_js(const char *expression) {
	char *script = indigo_safe_malloc(strlen(expression) + 128);
	snprintf(script, strlen(expression) + 128, "if (!(%s)) throw new Error('test assertion: expression was false');", expression);
	bool result = js(script);
	if (!result) {
		fprintf(stderr, "JavaScript assertion: %s\n", expression);
	}
	free(script);
	return result;
}

static bool change_switch(const char *name, const char *item, bool value) {
	unsigned before = revision(name);
	REQUIRE(indigo_change_switch_property_1(&observer, AGENT, name, item, value) == INDIGO_OK);
	REQUIRE(wait_property(name, before, INDIGO_OK_STATE));
	return drain();
}

static bool load_configuration(indigo_property_state expected) {
	unsigned before = revision(ON_LOAD);
	REQUIRE(indigo_change_switch_property_1(&observer, AGENT, "CONFIG", "LOAD", true) == INDIGO_OK);
	if (!wait_property(ON_LOAD, before, expected)) {
		indigo_device_context *context = (indigo_device_context *)agent->device_context;
		indigo_property *script = snapshot(AGENT, "AGENT_SCRIPTING_SCRIPT_0");
		indigo_property *add = snapshot(AGENT, ADD);
		indigo_property *load = snapshot(AGENT, ON_LOAD);
		fprintf(stderr, "CONFIG=%d script=%s ADD=%d ON_LOAD count=%d\n", context->configuration_property->state, script ? "present" : "missing", add ? add->state : -1, load ? load->count : -1);
		fprintf(stderr, "Messages:\n%s", messages);
		indigo_release_property(script);
		indigo_release_property(add);
		indigo_release_property(load);
		return false;
	}
	return drain();
}

static bool add_script(const char *name, const char *script) {
	unsigned before = revision(ADD);
	const char *items[] = { "NAME", "SCRIPT" };
	const char *values[] = { name, script };
	REQUIRE(indigo_change_text_property(&observer, AGENT, ADD, 2, items, values) == INDIGO_OK);
	REQUIRE(wait_property(ADD, before, INDIGO_OK_STATE));
	return drain();
}

static bool has_message(const char *message) {
	pthread_mutex_lock(&cache_mutex);
	bool result = strstr(messages, message) != NULL;
	pthread_mutex_unlock(&cache_mutex);
	return result;
}

static bool wait_message(const char *message) {
	for (int i = 0; i < 3000; i++) {
		if (has_message(message)) {
			return true;
		}
		indigo_usleep(1000);
	}
	fprintf(stderr, "Timeout waiting for message '%s'\n", message);
	return false;
}

static indigo_result peer_enumerate(indigo_device *device, indigo_client *client, indigo_property *selector) {
	peer_enumerations++;
	for (int i = 0; i < 5; i++) {
		if (peer_properties[i] && indigo_property_match(peer_properties[i], selector)) {
			indigo_define_property(device, peer_properties[i], "peer definition");
		}
	}
	return INDIGO_OK;
}

static indigo_result peer_change(indigo_device *device, indigo_client *client, indigo_property *property) {
	pthread_mutex_lock(&cache_mutex);
	indigo_release_property(last_request);
	last_request = indigo_copy_property(NULL, property);
	peer_changes++;
	pthread_mutex_unlock(&cache_mutex);
	return INDIGO_OK;
}

static indigo_result peer_blob(indigo_device *device, indigo_client *client, indigo_property *property, indigo_enable_blob_mode mode) {
	blob_mode = mode;
	blob_enables++;
	return INDIGO_OK;
}

static indigo_device peer = INDIGO_DEVICE_INITIALIZER(PEER, NULL, peer_enumerate, peer_change, peer_blob, NULL);

static void init_peer_properties(void) {
	peer_properties[0] = indigo_init_text_property(NULL, PEER, "PEER_TEXT", "Peer", "Text", INDIGO_OK_STATE, INDIGO_RW_PERM, 2);
	indigo_init_text_item(peer_properties[0]->items, "SHORT", "Short", "hello");
	char long_text[1024];
	memset(long_text, 'x', sizeof(long_text) - 1);
	long_text[sizeof(long_text) - 1] = 0;
	indigo_init_text_item_raw(peer_properties[0]->items + 1, "LONG", "Long", long_text);
	peer_properties[1] = indigo_init_number_property(NULL, PEER, "PEER_NUMBER", "Peer", "Number", INDIGO_BUSY_STATE, INDIGO_RW_PERM, 1);
	indigo_init_number_item(peer_properties[1]->items, "VALUE", "Value", -10, 20, 0.5, 12.5);
	peer_properties[1]->items->number.target = 13.5;
	peer_properties[2] = indigo_init_switch_property(NULL, PEER, "PEER_SWITCH", "Peer", "Switch", INDIGO_ALERT_STATE, INDIGO_WO_PERM, INDIGO_ONE_OF_MANY_RULE, 2);
	indigo_init_switch_item(peer_properties[2]->items, "ON", "On", true);
	indigo_init_switch_item(peer_properties[2]->items + 1, "OFF", "Off", false);
	peer_properties[3] = indigo_init_light_property(NULL, PEER, "PEER_LIGHT", "Peer", "Light", INDIGO_IDLE_STATE, 2);
	indigo_init_light_item(peer_properties[3]->items, "FIRST", "First", INDIGO_OK_STATE);
	indigo_init_light_item(peer_properties[3]->items + 1, "SECOND", "Second", INDIGO_BUSY_STATE);
	peer_properties[4] = indigo_init_blob_property(NULL, PEER, "PEER_BLOB", "Peer", "Blob", INDIGO_OK_STATE, 1);
	indigo_init_blob_item(peer_properties[4]->items, "DATA", "Data");
	strcpy(peer_properties[4]->items->blob.url, "http://test.invalid/blob");
	strcpy(peer_properties[4]->items->blob.format, ".bin");
}

static bool setup(void) {
	indigo_use_strict_locking = false;
	indigo_set_log_level(getenv("INDIGO_TEST_DEBUG") ? INDIGO_LOG_DEBUG : INDIGO_LOG_ERROR);
	init_peer_properties();
	REQUIRE(indigo_start() == INDIGO_OK);
	strcpy(observer.name, "Scripting test observer");
	observer.version = INDIGO_VERSION_CURRENT;
	observer.define_property = defined;
	observer.update_property = updated;
	observer.delete_property = deleted;
	observer.send_message = message_received;
	REQUIRE(indigo_attach_client(&observer) == INDIGO_OK);
	REQUIRE(indigo_attach_device(&peer) == INDIGO_OK);
	REQUIRE(indigo_agent_scripting(INDIGO_DRIVER_INIT, NULL) == INDIGO_OK);
	running = true;
	REQUIRE(agent != NULL);
	REQUIRE(js("var testEvents = []; var testValue = 0;"));
	return true;
}

static void cleanup(void) {
	gate_release = true;
	if (running) {
		indigo_agent_scripting(INDIGO_DRIVER_SHUTDOWN, NULL);
	}
	indigo_detach_device(&peer);
	indigo_detach_client(&observer);
	indigo_stop();
	for (unsigned i = 0; i < ARRAY_SIZE(cache); i++) {
		indigo_release_property(cache[i].property);
	}
	for (int i = 0; i < 5; i++) {
		indigo_release_property(peer_properties[i]);
	}
	indigo_release_property(last_request);
}

static void remove_files(const char *path) {
	DIR *directory = opendir(path);
	if (directory) {
		struct dirent *entry;
		while ((entry = readdir(directory))) {
			if (!strcmp(entry->d_name, ".") || !strcmp(entry->d_name, "..")) {
				continue;
			}
			char child[1024];
			snprintf(child, sizeof(child), "%s/%s", path, entry->d_name);
			struct stat st;
			if (!lstat(child, &st) && S_ISDIR(st.st_mode)) {
				remove_files(child);
			} else {
				unlink(child);
			}
		}
		closedir(directory);
	}
	rmdir(path);
}

static void schema_and_lifecycle(void) {
	const char *names[] = { RUN, ADD, EXEC, DELETE, ON_LOAD, ON_UNLOAD };
	const int counts[] = { 1, 2, 0, 1, 1, 1 };
	for (unsigned i = 0; i < ARRAY_SIZE(names); i++) {
		indigo_property *p = snapshot(AGENT, names[i]);
		ASSERT_TRUE(p != NULL);
		ASSERT_EQ_INT(counts[i], p->count);
		ASSERT_EQ_INT(INDIGO_RW_PERM, p->perm);
		ASSERT_EQ_INT(INDIGO_OK_STATE, p->state);
		ASSERT_FALSE(p->hidden);
		indigo_release_property(p);
	}
	indigo_driver_info info;
	ASSERT_EQ_INT(INDIGO_OK, indigo_agent_scripting(INDIGO_DRIVER_INFO, &info));
	ASSERT_STREQ("indigo_agent_scripting", info.name);
	ASSERT_EQ_INT(INDIGO_DRIVER_API_3, INDIGO_DRIVER_API_GENERATION(info.version));
	ASSERT_FALSE(info.multi_device_support);
	unsigned before = revision(RUN);
	ASSERT_EQ_INT(INDIGO_OK, indigo_agent_scripting(INDIGO_DRIVER_INIT, NULL));
	ASSERT_EQ_INT(before, revision(RUN));
	ASSERT_TRUE(snapshot(AGENT, "CONNECTION") == NULL);
	ASSERT_TRUE(snapshot(AGENT, "PROFILE") == NULL);
}

static void immediate_execution(void) {
	ASSERT_TRUE(js("testValue = 123;"));
	ASSERT_TRUE(check_js("testValue === 123"));
	ASSERT_TRUE(js(""));
	ASSERT_TRUE(js_state("function (", INDIGO_ALERT_STATE));
	ASSERT_TRUE(js_state("throw new Error('intentional runtime failure')", INDIGO_ALERT_STATE));
	ASSERT_TRUE(has_message("Failed to execute script"));
	ASSERT_TRUE(js("testValue++;"));
	ASSERT_TRUE(check_js("testValue === 124"));
}

static void repeated_execution(void) {
	for (int i = 0; i < 2000; i++) {
		ASSERT_TRUE(js("testValue++; ({value:testValue})"));
	}
	ASSERT_TRUE(check_js("testValue === 2000"));
}

static void long_script_execution(void) {
	const size_t lengths[] = { 511, 512, 513, 8192, 65536, 140000 };
	for (unsigned i = 0; i < ARRAY_SIZE(lengths); i++) {
		char *script = indigo_safe_malloc(lengths[i] + 1);
		memset(script, ' ', lengths[i]);
		memcpy(script, "testValue++;", 12);
		ASSERT_TRUE(js(script));
		free(script);
	}
	ASSERT_TRUE(check_js("testValue === 6"));
}

static void script_crud(void) {
	ASSERT_TRUE(add_script("Zulu", "testValue += 10;"));
	ASSERT_TRUE(add_script("Alpha", "testValue += 1;"));
	indigo_property *p = snapshot(AGENT, EXEC);
	ASSERT_TRUE(p != NULL);
	ASSERT_EQ_INT(2, p->count);
	ASSERT_STREQ("Alpha", p->items[0].label);
	ASSERT_STREQ("Zulu", p->items[1].label);
	indigo_release_property(p);
	ASSERT_TRUE(change_switch(EXEC, "AGENT_SCRIPTING_SCRIPT_0", true));
	ASSERT_TRUE(check_js("testValue === 10"));
	const char *items[] = { "NAME", "SCRIPT" };
	const char *values[] = { "Beta", "testValue += 100;" };
	unsigned before = revision("AGENT_SCRIPTING_SCRIPT_0");
	indigo_change_text_property(&observer, AGENT, "AGENT_SCRIPTING_SCRIPT_0", 2, items, values);
	ASSERT_TRUE(wait_property("AGENT_SCRIPTING_SCRIPT_0", before, INDIGO_OK_STATE));
	ASSERT_TRUE(change_switch(EXEC, "AGENT_SCRIPTING_SCRIPT_0", true));
	ASSERT_TRUE(check_js("testValue === 110"));
	indigo_change_text_property_1(&observer, AGENT, "AGENT_SCRIPTING_SCRIPT_0", "SCRIPT", "testValue++; ");
	ASSERT_TRUE(change_switch(EXEC, "AGENT_SCRIPTING_SCRIPT_0", true));
	ASSERT_TRUE(check_js("testValue === 111"));
	indigo_change_text_property_1(&observer, AGENT, DELETE, "NAME", "Alpha");
	ASSERT_TRUE(snapshot(AGENT, "AGENT_SCRIPTING_SCRIPT_1") == NULL);
	ASSERT_TRUE(add_script("Replacement", "testValue = 0;"));
	p = snapshot(AGENT, "AGENT_SCRIPTING_SCRIPT_1");
	ASSERT_TRUE(p != NULL);
	ASSERT_STREQ("Replacement", p->label);
	indigo_release_property(p);
	indigo_change_text_property_1(&observer, AGENT, DELETE, "NAME", "Replacement");
	indigo_change_text_property_1(&observer, AGENT, DELETE, "NAME", "Beta");
	p = snapshot(AGENT, EXEC);
	ASSERT_EQ_INT(0, p->count);
	indigo_release_property(p);
}

static void empty_name_recovery(void) {
	unsigned before = revision(ADD);
	indigo_change_text_property_1(&observer, AGENT, ADD, "SCRIPT", "testValue = 5;");
	ASSERT_TRUE(wait_property(ADD, before, INDIGO_ALERT_STATE));
	ASSERT_TRUE(add_script("Valid", "testValue = 5;"));
	ASSERT_TRUE(change_switch(EXEC, "AGENT_SCRIPTING_SCRIPT_0", true));
	ASSERT_TRUE(check_js("testValue === 5"));
}

static void saved_script_failure_recovery(void) {
	ASSERT_TRUE(add_script("Bad", "throw new Error('saved failure');"));
	unsigned before = revision(EXEC);
	indigo_change_switch_property_1(&observer, AGENT, EXEC, "AGENT_SCRIPTING_SCRIPT_0", true);
	ASSERT_TRUE(wait_property(EXEC, before, INDIGO_ALERT_STATE));
	indigo_change_text_property_1(&observer, AGENT, "AGENT_SCRIPTING_SCRIPT_0", "SCRIPT", "testValue = 8;");
	ASSERT_TRUE(change_switch(EXEC, "AGENT_SCRIPTING_SCRIPT_0", true));
	ASSERT_TRUE(check_js("testValue === 8"));
	before = revision(EXEC);
	indigo_change_switch_property_1(&observer, AGENT, EXEC, "AGENT_SCRIPTING_SCRIPT_0", false);
	ASSERT_TRUE(wait_property(EXEC, before, INDIGO_OK_STATE));
}

static void delete_acknowledgement(void) {
	ASSERT_TRUE(add_script("Delete me", ""));
	unsigned before = revision(DELETE);
	indigo_change_text_property_1(&observer, AGENT, DELETE, "NAME", "Delete me");
	ASSERT_TRUE(wait_property(DELETE, before, INDIGO_OK_STATE));
}

static void delete_unknown(void) {
	unsigned before = revision(DELETE);
	indigo_change_text_property_1(&observer, AGENT, DELETE, "NAME", "Missing");
	ASSERT_TRUE(wait_property(DELETE, before, INDIGO_ALERT_STATE));
}

static void script_capacity(void) {
	for (int i = 0; i < 128; i++) {
		char name[32];
		snprintf(name, sizeof(name), "Script %03d", i);
		ASSERT_TRUE(add_script(name, ""));
	}
	unsigned before = revision(ADD);
	indigo_change_text_property_1(&observer, AGENT, ADD, "NAME", "Overflow");
	ASSERT_TRUE(wait_property(ADD, before, INDIGO_ALERT_STATE));
	indigo_change_text_property_1(&observer, AGENT, DELETE, "NAME", "Script 000");
	ASSERT_TRUE(add_script("Recovered", ""));
}

static void configuration_roundtrip(void) {
	char script[8192];
	memset(script, 'x', sizeof(script) - 1);
	const char *prefix = "testValue = 77; /* <xml> & 'quotes' ";
	memcpy(script, prefix, strlen(prefix));
	script[sizeof(script) - 3] = '*';
	script[sizeof(script) - 2] = '/';
	script[sizeof(script) - 1] = 0;
	ASSERT_TRUE(add_script("Persist <&>", script));
	ASSERT_TRUE(change_switch(ON_UNLOAD, "AGENT_SCRIPTING_SCRIPT_0", true));
	ASSERT_EQ_INT(INDIGO_OK, indigo_agent_scripting(INDIGO_DRIVER_SHUTDOWN, NULL));
	running = false;
	ASSERT_EQ_INT(INDIGO_OK, indigo_agent_scripting(INDIGO_DRIVER_INIT, NULL));
	running = true;
	ASSERT_TRUE(wait_defined("AGENT_SCRIPTING_SCRIPT_0"));
	indigo_property *p = snapshot(AGENT, "AGENT_SCRIPTING_SCRIPT_0");
	ASSERT_TRUE(p != NULL);
	ASSERT_STREQ("Persist <&>", p->label);
	ASSERT_STREQ(script, indigo_get_text_item_value(p->items + 1));
	indigo_release_property(p);
	ASSERT_TRUE(js("testValue = 0;"));
	ASSERT_TRUE(change_switch(EXEC, "AGENT_SCRIPTING_SCRIPT_0", true));
	ASSERT_TRUE(check_js("testValue === 77"));
}

static void on_load_order(void) {
	ASSERT_TRUE(add_script("Load hook", "indigo_send_message('automatic-load-hook');"));
	ASSERT_TRUE(change_switch(ON_LOAD, "AGENT_SCRIPTING_SCRIPT_0", true));
	ASSERT_EQ_INT(INDIGO_OK, indigo_agent_scripting(INDIGO_DRIVER_SHUTDOWN, NULL));
	running = false;
	ASSERT_EQ_INT(INDIGO_OK, indigo_agent_scripting(INDIGO_DRIVER_INIT, NULL));
	running = true;
	ASSERT_TRUE(wait_message("automatic-load-hook"));
}

static void shutdown_during_automatic_load(void) {
	ASSERT_TRUE(add_script("Load hook", "indigo_send_message('load-before-shutdown');"));
	ASSERT_TRUE(change_switch(ON_LOAD, "AGENT_SCRIPTING_SCRIPT_0", true));
	ASSERT_EQ_INT(INDIGO_OK, indigo_agent_scripting(INDIGO_DRIVER_SHUTDOWN, NULL));
	running = false;
	ASSERT_EQ_INT(INDIGO_OK, indigo_agent_scripting(INDIGO_DRIVER_INIT, NULL));
	running = true;
	ASSERT_EQ_INT(INDIGO_OK, indigo_agent_scripting(INDIGO_DRIVER_SHUTDOWN, NULL));
	running = false;
	ASSERT_EQ_INT(INDIGO_OK, indigo_agent_scripting(INDIGO_DRIVER_INIT, NULL));
	running = true;
	ASSERT_TRUE(wait_defined("AGENT_SCRIPTING_SCRIPT_0"));
}

static void on_load_existing(void) {
	ASSERT_TRUE(add_script("Hook", "testValue++;"));
	ASSERT_TRUE(change_switch(ON_LOAD, "AGENT_SCRIPTING_SCRIPT_0", true));
	ASSERT_TRUE(load_configuration(INDIGO_OK_STATE));
	ASSERT_TRUE(check_js("testValue === 1"));
}

static void on_unload_execution(void) {
	ASSERT_TRUE(add_script("Unload", "indigo_send_message('unload-ran');"));
	ASSERT_TRUE(change_switch(ON_UNLOAD, "AGENT_SCRIPTING_SCRIPT_0", true));
	ASSERT_EQ_INT(INDIGO_OK, indigo_agent_scripting(INDIGO_DRIVER_SHUTDOWN, NULL));
	running = false;
	ASSERT_TRUE(has_message("unload-ran"));
}

static void hook_defaults_and_rename(void) {
	ASSERT_TRUE(change_switch(ON_LOAD, ADD, true));
	ASSERT_TRUE(change_switch(ON_UNLOAD, ADD, true));
	ASSERT_TRUE(add_script("Zulu", ""));
	ASSERT_TRUE(add_script("Alpha", ""));
	indigo_change_text_property_1(&observer, AGENT, "AGENT_SCRIPTING_SCRIPT_0", "NAME", "Aardvark");
	for (int i = 0; i < 2; i++) {
		indigo_property *p = snapshot(AGENT, i ? ON_UNLOAD : ON_LOAD);
		ASSERT_TRUE(p != NULL);
		ASSERT_EQ_INT(3, p->count);
		ASSERT_STREQ("Aardvark", p->items[1].label);
		ASSERT_TRUE(p->items[1].sw.value && p->items[2].sw.value);
		indigo_release_property(p);
	}
}

static void invalid_rename_recovery(void) {
	ASSERT_TRUE(add_script("First", "testValue = 1;"));
	ASSERT_TRUE(add_script("Second", "testValue = 2;"));
	unsigned before = revision("AGENT_SCRIPTING_SCRIPT_0");
	ASSERT_EQ_INT(INDIGO_OK, indigo_change_text_property_1(&observer, AGENT, "AGENT_SCRIPTING_SCRIPT_0", "NAME", "Second"));
	ASSERT_TRUE(wait_property("AGENT_SCRIPTING_SCRIPT_0", before, INDIGO_ALERT_STATE));
	indigo_property *p = snapshot(AGENT, "AGENT_SCRIPTING_SCRIPT_0");
	ASSERT_STREQ("First", indigo_get_text_item_value(p->items));
	indigo_release_property(p);
	before = revision("AGENT_SCRIPTING_SCRIPT_0");
	ASSERT_EQ_INT(INDIGO_OK, indigo_change_text_property_1(&observer, AGENT, "AGENT_SCRIPTING_SCRIPT_0", "NAME", ""));
	ASSERT_TRUE(wait_property("AGENT_SCRIPTING_SCRIPT_0", before, INDIGO_ALERT_STATE));
	before = revision("AGENT_SCRIPTING_SCRIPT_0");
	ASSERT_EQ_INT(INDIGO_OK, indigo_change_text_property_1(&observer, AGENT, "AGENT_SCRIPTING_SCRIPT_0", "NAME", "Recovered"));
	ASSERT_TRUE(wait_property("AGENT_SCRIPTING_SCRIPT_0", before, INDIGO_OK_STATE));
}

static void on_load_failure_recovery(void) {
	ASSERT_TRUE(add_script("Bad load", "throw new Error('bad load hook');"));
	ASSERT_TRUE(change_switch(ON_LOAD, "AGENT_SCRIPTING_SCRIPT_0", true));
	ASSERT_TRUE(load_configuration(INDIGO_ALERT_STATE));
	ASSERT_TRUE(change_switch(ON_LOAD, "AGENT_SCRIPTING_SCRIPT_0", false));
	ASSERT_TRUE(load_configuration(INDIGO_OK_STATE));
}

static void on_unload_failure(void) {
	ASSERT_TRUE(add_script("Bad unload", "throw new Error('bad unload hook');"));
	ASSERT_TRUE(change_switch(ON_UNLOAD, "AGENT_SCRIPTING_SCRIPT_0", true));
	ASSERT_EQ_INT(INDIGO_OK, indigo_agent_scripting(INDIGO_DRIVER_SHUTDOWN, NULL));
	running = false;
	indigo_property *p = snapshot(AGENT, ON_UNLOAD);
	ASSERT_TRUE(p != NULL);
	ASSERT_EQ_INT(INDIGO_ALERT_STATE, p->state);
	indigo_release_property(p);
}

static void save_failure_recovery(void) {
	char blocker[300];
	snprintf(blocker, sizeof(blocker), "%s/blocker", test_root);
	FILE *file = fopen(blocker, "w");
	ASSERT_TRUE(file != NULL);
	fputs("not a directory", file);
	fclose(file);
	snprintf(config_folder, sizeof(config_folder), "%s/subfolder", blocker);
	ASSERT_TRUE(add_script("Memory only", "testValue = 1;"));
	indigo_device_context *context = (indigo_device_context *)agent->device_context;
	ASSERT_EQ_INT(INDIGO_ALERT_STATE, context->configuration_property->state);
	snprintf(config_folder, sizeof(config_folder), "%s/.indigo", test_root);
	ASSERT_TRUE(add_script("Saved", "testValue = 2;"));
	DIR *directory = opendir(config_folder);
	ASSERT_TRUE(directory != NULL);
	bool found = false;
	struct dirent *entry;
	while ((entry = readdir(directory))) {
		if (entry->d_name[0] != '.') {
			found = true;
		}
	}
	closedir(directory);
	ASSERT_TRUE(found);
}

static void duplicate_script_recovery(void) {
	ASSERT_TRUE(add_script("Same", "testValue = 1;"));
	unsigned before = revision(ADD);
	const char *items[] = { "NAME", "SCRIPT" };
	const char *values[] = { "Same", "testValue = 2;" };
	ASSERT_EQ_INT(INDIGO_OK, indigo_change_text_property(&observer, AGENT, ADD, 2, items, values));
	ASSERT_TRUE(wait_property(ADD, before, INDIGO_ALERT_STATE));
	ASSERT_TRUE(add_script("Other", "testValue = 3;"));
}

static void low_level_change_bindings(void) {
	ASSERT_TRUE(js("indigo_change_text_property('" PEER "','TARGET_TEXT',{FIRST:'alpha',SECOND:'beta'});"));
	ASSERT_TRUE(wait_counter(&peer_changes, 1));
	indigo_property *p = request_snapshot();
	ASSERT_EQ_INT(INDIGO_TEXT_VECTOR, p->type);
	ASSERT_EQ_INT(2, p->count);
	ASSERT_STREQ("alpha", indigo_get_text_item_value(p->items));
	indigo_release_property(p);
	ASSERT_TRUE(js("indigo_change_number_property('" PEER "','TARGET_NUMBER',{FIRST:12.5,SECOND:-3});"));
	ASSERT_TRUE(wait_counter(&peer_changes, 2));
	p = request_snapshot();
	ASSERT_EQ_INT(INDIGO_NUMBER_VECTOR, p->type);
	ASSERT_NEAR(12.5, p->items->number.value, 1e-12);
	indigo_release_property(p);
	ASSERT_TRUE(js("indigo_change_switch_property('" PEER "','TARGET_SWITCH',{ON:true,OFF:false});"));
	ASSERT_TRUE(wait_counter(&peer_changes, 3));
	p = request_snapshot();
	ASSERT_EQ_INT(INDIGO_SWITCH_VECTOR, p->type);
	ASSERT_TRUE(p->items->sw.value);
	ASSERT_FALSE((p->items + 1)->sw.value);
	indigo_release_property(p);
	ASSERT_TRUE(js("indigo_change_property('" PEER "','HIGH_LEVEL',{FIRST:'through boot.js'});"));
	ASSERT_TRUE(wait_counter(&peer_changes, 4));
	p = request_snapshot();
	ASSERT_EQ_INT(INDIGO_TEXT_VECTOR, p->type);
	ASSERT_STREQ("through boot.js", indigo_get_text_item_value(p->items));
	indigo_release_property(p);
	ASSERT_TRUE(js("indigo_change_text_property('" PEER "','TARGET_LONG',{SCRIPT:Array(8193).join('x')});"));
	ASSERT_TRUE(wait_counter(&peer_changes, 5));
	p = request_snapshot();
	ASSERT_EQ_INT(8192, strlen(indigo_get_text_item_value(p->items)));
	indigo_release_property(p);
}

static void enumeration_and_blob_enable(void) {
	int enumerations = atomic_load(&peer_enumerations);
	ASSERT_TRUE(js("indigo_enumerate_properties('" PEER "','PEER_TEXT');"));
	ASSERT_TRUE(wait_counter(&peer_enumerations, enumerations + 1));
	ASSERT_TRUE(js("indigo_enumerate_properties(null,null);"));
	ASSERT_TRUE(wait_counter(&peer_enumerations, enumerations + 2));
	ASSERT_TRUE(js("indigo_enable_blob('" PEER "','PEER_BLOB',true);"));
	ASSERT_TRUE(wait_counter(&blob_enables, 1));
	ASSERT_EQ_INT(INDIGO_ENABLE_BLOB_URL, blob_mode);
	ASSERT_TRUE(js("indigo_enable_blob('" PEER "','PEER_BLOB',false);"));
	ASSERT_TRUE(wait_counter(&blob_enables, 2));
	ASSERT_EQ_INT(INDIGO_ENABLE_BLOB_NEVER, blob_mode);
	indigo_property selector = { 0 };
	INDIGO_COPY_NAME(selector.device, AGENT);
	INDIGO_COPY_NAME(selector.name, "IGNORED_BLOB");
	ASSERT_EQ_INT(INDIGO_OK, indigo_enable_blob(&observer, &selector, INDIGO_ENABLE_BLOB_ALSO));
	ASSERT_TRUE(drain());
}

static void define_update_redefine_delete(void) {
	ASSERT_TRUE(js("indigo_define_text_property('" AGENT "','JS_TEXT','JS','Text label',{A:'one',B:'two'},{A:{label:'Alpha'},B:{label:'Beta'}},'Busy','RW','text-defined');"));
	indigo_property *p = snapshot(AGENT, "JS_TEXT");
	ASSERT_TRUE(p != NULL);
	ASSERT_EQ_INT(INDIGO_TEXT_VECTOR, p->type);
	ASSERT_EQ_INT(INDIGO_BUSY_STATE, p->state);
	ASSERT_EQ_INT(INDIGO_RW_PERM, p->perm);
	ASSERT_STREQ("Alpha", p->items->label);
	indigo_release_property(p);
	ASSERT_TRUE(has_message("text-defined"));
	p = snapshot(AGENT, "JS_TEXT");
	ASSERT_STREQ("one", indigo_get_text_item_value(p->items));
	indigo_release_property(p);
	ASSERT_TRUE(js("indigo_update_text_property('" AGENT "','JS_TEXT',{A:'changed',MISSING:'ignored'},'Ok','text-updated');"));
	p = snapshot(AGENT, "JS_TEXT");
	ASSERT_STREQ("changed", indigo_get_text_item_value(p->items));
	ASSERT_EQ_INT(INDIGO_OK_STATE, p->state);
	indigo_release_property(p);
	ASSERT_TRUE(js("indigo_redefine_text_property('" AGENT "','JS_TEXT','JS2','Redefined',{C:'three'},{C:{label:'Gamma'}},'Alert','RO','text-redefined');"));
	p = snapshot(AGENT, "JS_TEXT");
	ASSERT_EQ_INT(1, p->count);
	ASSERT_STREQ("JS2", p->group);
	ASSERT_STREQ("three", indigo_get_text_item_value(p->items));
	ASSERT_EQ_INT(INDIGO_ALERT_STATE, p->state);
	indigo_release_property(p);
	ASSERT_TRUE(js("indigo_define_number_property('" AGENT "','JS_NUMBER','JS','Number',{N:2.5},{N:{label:'Number',format:'%g',min:-5,max:5,step:0.25}},'Ok','RW',null);"));
	p = snapshot(AGENT, "JS_NUMBER");
	ASSERT_EQ_INT(INDIGO_NUMBER_VECTOR, p->type);
	ASSERT_NEAR(2.5, p->items->number.value, 1e-12);
	ASSERT_NEAR(-5, p->items->number.min, 1e-12);
	ASSERT_NEAR(5, p->items->number.max, 1e-12);
	ASSERT_NEAR(0.25, p->items->number.step, 1e-12);
	indigo_release_property(p);
	ASSERT_TRUE(js("indigo_update_number_property('" AGENT "','JS_NUMBER',{N:-1.25},'Busy',null);"));
	p = snapshot(AGENT, "JS_NUMBER");
	ASSERT_NEAR(-1.25, p->items->number.value, 1e-12);
	ASSERT_EQ_INT(INDIGO_BUSY_STATE, p->state);
	indigo_release_property(p);
	ASSERT_TRUE(js("indigo_redefine_number_property('" AGENT "','JS_NUMBER','JS','Number 2',{N:4},{N:{label:'N2',format:'%5.2f',min:0,max:10,step:1}},'Idle','RO',null);"));
	ASSERT_TRUE(js("indigo_define_switch_property('" AGENT "','JS_SWITCH','JS','Switch',{A:true,B:false},{A:{label:'A'},B:{label:'B'}},'Ok','RW','AT_MOST_ONE',null);"));
	p = snapshot(AGENT, "JS_SWITCH");
	ASSERT_EQ_INT(INDIGO_SWITCH_VECTOR, p->type);
	ASSERT_EQ_INT(INDIGO_AT_MOST_ONE_RULE, p->rule);
	ASSERT_TRUE(p->items->sw.value);
	indigo_release_property(p);
	ASSERT_TRUE(js("indigo_update_switch_property('" AGENT "','JS_SWITCH',{A:false,B:true},'Alert',null);"));
	ASSERT_TRUE(js("indigo_redefine_switch_property('" AGENT "','JS_SWITCH','JS','Switch 2',{A:false},{A:{label:'Only'}},'Idle','RO','ONE_OF_MANY',null);"));
	p = snapshot(AGENT, "JS_SWITCH");
	ASSERT_EQ_INT(INDIGO_ONE_OF_MANY_RULE, p->rule);
	ASSERT_EQ_INT(1, p->count);
	indigo_release_property(p);
	ASSERT_TRUE(js("indigo_define_light_property('" AGENT "','JS_LIGHT','JS','Light',{A:'Ok',B:'Busy'},{A:{label:'A'},B:{label:'B'}},'Idle','light-defined');"));
	ASSERT_TRUE(js("indigo_update_light_property('" AGENT "','JS_LIGHT',{A:'Alert',B:'Idle'},'Ok',null);"));
	p = snapshot(AGENT, "JS_LIGHT");
	ASSERT_EQ_INT(INDIGO_LIGHT_VECTOR, p->type);
	ASSERT_EQ_INT(INDIGO_ALERT_STATE, p->items->light.value);
	ASSERT_EQ_INT(INDIGO_IDLE_STATE, (p->items + 1)->light.value);
	indigo_release_property(p);
	ASSERT_TRUE(js("indigo_redefine_light_property('" AGENT "','JS_LIGHT','JS','Light 2',{C:'Busy'},{C:{label:'C'}},'Alert',null);"));
	ASSERT_TRUE(js("indigo_delete_property('" AGENT "','JS_TEXT','text-deleted');"));
	ASSERT_TRUE(snapshot(AGENT, "JS_TEXT") == NULL);
	ASSERT_TRUE(has_message("text-deleted"));
}

static void defaults_and_large_property(void) {
	ASSERT_TRUE(js("indigo_define_switch_property('" AGENT "','DEFAULTS','JS','Defaults',{A:true},{A:{label:'A'}},'unknown','WO','unknown',null);"));
	indigo_property *p = snapshot(AGENT, "DEFAULTS");
	ASSERT_EQ_INT(INDIGO_IDLE_STATE, p->state);
	ASSERT_EQ_INT(INDIGO_WO_PERM, p->perm);
	ASSERT_EQ_INT(INDIGO_ANY_OF_MANY_RULE, p->rule);
	indigo_release_property(p);
	ASSERT_TRUE(js("var values={},defs={}; for(var i=0;i<257;i++){values['I'+i]=i;defs['I'+i]={label:'Item '+i,format:'%g',min:0,max:300,step:1};} indigo_define_number_property('" AGENT "','LARGE','JS','Large',values,defs,'Ok','unknown',null);"));
	p = snapshot(AGENT, "LARGE");
	ASSERT_TRUE(p != NULL);
	ASSERT_EQ_INT(257, p->count);
	ASSERT_EQ_INT(INDIGO_RW_PERM, p->perm);
	ASSERT_STREQ("I256", p->items[256].name);
	ASSERT_NEAR(256, p->items[256].number.value, 1e-12);
	indigo_release_property(p);
}

static void cached_property_capacity(void) {
	ASSERT_TRUE(js("for(var i=0;i<126;i++) indigo_define_text_property('" AGENT "','CAP_'+i,'JS','Cap',{A:''},{A:{label:'A'}},'Ok','RW',null);"));
	ASSERT_TRUE(snapshot(AGENT, "CAP_125") != NULL);
	ASSERT_TRUE(js_state("indigo_define_text_property('" AGENT "','OVERFLOW','JS','Overflow',{A:''},{A:{label:'A'}},'Ok','RW',null);", INDIGO_ALERT_STATE));
	ASSERT_TRUE(js("indigo_delete_property('" AGENT "','CAP_0',null); indigo_define_text_property('" AGENT "','RECOVERED','JS','Recovered',{A:'yes'},{A:{label:'A'}},'Ok','RW',null);"));
	ASSERT_TRUE(snapshot(AGENT, "RECOVERED") != NULL);
}

static void boot_cache_and_callbacks(void) {
	ASSERT_TRUE(check_js("indigo_devices['" PEER "'].PEER_TEXT.items.SHORT === 'hello'"));
	ASSERT_TRUE(check_js("indigo_devices['" PEER "'].PEER_TEXT.items.LONG.length === 1023"));
	ASSERT_TRUE(check_js("indigo_devices['" PEER "'].PEER_NUMBER.items.VALUE === 12.5"));
	ASSERT_TRUE(check_js("indigo_devices['" PEER "'].PEER_NUMBER.item_defs.VALUE.min === -10 && indigo_devices['" PEER "'].PEER_NUMBER.item_defs.VALUE.max === 20"));
	ASSERT_TRUE(check_js("indigo_devices['" PEER "'].PEER_SWITCH.perm === 'WO' && indigo_devices['" PEER "'].PEER_SWITCH.state === 'Alert'"));
	ASSERT_TRUE(check_js("indigo_devices['" PEER "'].PEER_LIGHT.items.FIRST === 'Ok' && indigo_devices['" PEER "'].PEER_BLOB.items.DATA.format === '.bin'"));
	ASSERT_TRUE(js("testEvents=[]; indigo_event_handlers.test={devices:['" PEER "'],on_define:function(p){testEvents.push('D:'+p.name)},on_update:function(p){testEvents.push('U:'+p.name+':'+p.state)},on_delete:function(p){testEvents.push('X:'+p.name)},on_message:function(m){testEvents.push('M:'+m)}}; indigo_event_handlers.global={on_enumerate_properties:function(p){testEvents.push('E:'+(p.device||'')+':'+(p.name||''))},on_change_property:function(p){testEvents.push('C:'+p.name+':'+p.state)}};"));
	indigo_property *extra = indigo_init_text_property(NULL, PEER, "EXTRA", "Peer", "Extra", INDIGO_OK_STATE, INDIGO_RO_PERM, 1);
	indigo_init_text_item(extra->items, "VALUE", "Value", "defined");
	indigo_define_property(&peer, extra, "defined-message");
	peer_properties[1]->state = INDIGO_OK_STATE;
	peer_properties[1]->items->number.value = 14;
	indigo_update_property(&peer, peer_properties[1], "updated-message");
	indigo_send_message(&peer, OK_PROPERTY, "peer-message");
	indigo_delete_property(&peer, extra, "deleted-message");
	indigo_property selector = { 0 };
	INDIGO_COPY_NAME(selector.device, AGENT);
	INDIGO_COPY_NAME(selector.name, RUN);
	indigo_enumerate_properties(&observer, &selector);
	indigo_change_number_property_1(&observer, AGENT, "UNKNOWN_CHANGE", "VALUE", 9);
	ASSERT_TRUE(drain());
	ASSERT_TRUE(check_js("testEvents.indexOf('D:EXTRA') >= 0 && testEvents.indexOf('U:PEER_NUMBER:Ok') >= 0 && testEvents.indexOf('X:EXTRA') >= 0"));
	ASSERT_TRUE(check_js("testEvents.some(function(x){return x.indexOf('M:" PEER ": peer-message')===0})"));
	ASSERT_TRUE(check_js("testEvents.indexOf('E:" AGENT ":" RUN "') >= 0"));
	ASSERT_TRUE(check_js("testEvents.indexOf('C:UNKNOWN_CHANGE:Idle') >= 0"));
	ASSERT_TRUE(check_js("indigo_devices['" PEER "'].EXTRA === undefined && indigo_devices['" PEER "'].PEER_NUMBER.items.VALUE === 14"));
	indigo_property *device_selector = indigo_init_text_property(NULL, PEER, "", "", "", INDIGO_OK_STATE, INDIGO_RO_PERM, 0);
	indigo_delete_property(&peer, device_selector, "device-deleted");
	ASSERT_TRUE(drain());
	ASSERT_TRUE(check_js("indigo_devices['" PEER "'] === undefined"));
	indigo_release_property(device_selector);
	indigo_release_property(extra);
}

static void peer_property_change_helper(void) {
	ASSERT_TRUE(js("indigo_devices['" PEER "'].PEER_NUMBER.change({VALUE:7.5});"));
	ASSERT_TRUE(wait_counter(&peer_changes, 1));
	indigo_property *p = request_snapshot();
	ASSERT_EQ_INT(INDIGO_NUMBER_VECTOR, p->type);
	ASSERT_NEAR(7.5, p->items->number.value, 1e-12);
	indigo_release_property(p);
}

static void blob_bindings(void) {
	char path[512];
	snprintf(path, sizeof(path), "%s/blob.bin", test_root);
	char script[1024];
	snprintf(script, sizeof(script), "var blob=indigo_devices['%s'].PEER_BLOB.items.DATA; if(!indigo_populate_blob(blob)||blob.size!==7) throw new Error('populate failed'); indigo_save_blob('%s',blob);", PEER, path);
	ASSERT_TRUE(js(script));
	ASSERT_EQ_INT(1, atomic_load(&blob_downloads));
	FILE *file = fopen(path, "rb");
	ASSERT_TRUE(file != NULL);
	unsigned char data[7];
	ASSERT_EQ_INT(7, fread(data, 1, sizeof(data), file));
	fclose(file);
	ASSERT_EQ_INT(255, data[3]);
	peer_properties[4]->items->blob.value = NULL;
	peer_properties[4]->items->blob.size = 0;
	fail_blob = true;
	ASSERT_TRUE(js("var blob=indigo_devices['" PEER "'].PEER_BLOB.items.DATA; blob.size=0; if(indigo_populate_blob(blob)!==undefined) throw new Error('failure must be undefined');"));
	ASSERT_EQ_INT(2, atomic_load(&blob_downloads));
	fail_blob = false;
	ASSERT_TRUE(js("indigo_save_blob('/no/such/scripting-test/blob.bin',indigo_devices['" PEER "'].PEER_BLOB.items.DATA);"));
	ASSERT_EQ_INT(3, atomic_load(&blob_downloads));
	ASSERT_TRUE(js("if(indigo_populate_blob({})!==undefined) throw new Error('invalid populate result'); if(indigo_save_blob('/tmp/invalid-blob',{})!==undefined) throw new Error('invalid save result');"));
}

static void conversion_bindings(void) {
	ASSERT_TRUE(check_js("Math.abs(indigo_stod('12:30:00') - 12.5) < 1e-9"));
	ASSERT_TRUE(check_js("Math.abs(indigo_stod(indigo_dtos(12.5,null)) - 12.5) < 1e-6"));
	ASSERT_TRUE(check_js("indigo_utc_to_time('2024-01-01 13:00:00') === 1704114000"));
	ASSERT_TRUE(check_js("indigo_utc_to_time('2024-01-01 13:00') === 1704114000"));
	ASSERT_TRUE(check_js("indigo_utc_to_delay('13:00:00') === 1504 && indigo_utc_to_delay('12:00') > 80000"));
	ASSERT_TRUE(check_js("indigo_time_to_delay(1704114000) === 1504 && indigo_time_to_delay(1) === 0"));
	ASSERT_TRUE(check_js("indigo_time_to_utc(1704112496) === '2024-01-01 12:34:56'"));
	ASSERT_TRUE(check_js("indigo_delay_to_utc(64) === '2024-01-01 12:36:00'"));
	ASSERT_TRUE(check_js("indigo_utc_diff('13:00') === 1504 && indigo_local_time_diff(1704114000) === 1504"));
	ASSERT_TRUE(check_js("isFinite(indigo_solar_altitude(48.15,17.11)) && isFinite(indigo_target_altitude(5.5,-20,48.15,17.11))"));
	ASSERT_TRUE(js_state("indigo_utc_to_time('invalid')", INDIGO_ALERT_STATE));
	ASSERT_TRUE(js("testValue = 1;"));
}

static void timer_bindings(void) {
	int messages_before = atomic_load(&message_count);
	ASSERT_TRUE(js("var fired=indigo_set_timer(function(){indigo_send_message('timer-fired')},0.01); if(fired<0) throw new Error('timer failed');"));
	ASSERT_TRUE(wait_counter(&message_count, messages_before + 1));
	ASSERT_TRUE(has_message("timer-fired"));
	ASSERT_TRUE(js("var cancelled=indigo_set_timer(function(){indigo_send_message('cancelled-fired')},0.05); indigo_cancel_timer(cancelled);"));
	indigo_usleep(100000);
	ASSERT_FALSE(has_message("cancelled-fired"));
	fail_timer = true;
	ASSERT_TRUE(check_js("indigo_set_timer(function(){},1) === -1"));
	fail_timer = false;
	ASSERT_TRUE(js("var timerIds=[]; for(var i=0;i<32;i++) timerIds.push(indigo_set_timer(function(){},10));"));
	ASSERT_TRUE(js_state("indigo_set_timer(function(){},10)", INDIGO_ALERT_STATE));
	ASSERT_TRUE(js("for(var i=0;i<timerIds.length;i++) indigo_cancel_timer(timerIds[i]);"));
	ASSERT_TRUE(js_state("indigo_cancel_timer(-1)", INDIGO_ALERT_STATE));
	ASSERT_TRUE(js("var badCallback=indigo_set_timer(function(){throw new Error('timer callback failure')},0.01);"));
	indigo_usleep(50000);
	ASSERT_TRUE(js("testValue = 9;"));
}

static void shutdown_cancels_timers(void) {
	ASSERT_TRUE(js("indigo_set_timer(function(){indigo_send_message('late-timer')},0.05);"));
	ASSERT_EQ_INT(INDIGO_OK, indigo_agent_scripting(INDIGO_DRIVER_SHUTDOWN, NULL));
	running = false;
	indigo_usleep(100000);
	ASSERT_FALSE(has_message("late-timer"));
}

static void logging_and_messages(void) {
	ASSERT_TRUE(js("indigo_error('error-binding'); indigo_log('log-binding'); indigo_debug('debug-binding'); indigo_trace('trace-binding'); indigo_send_message('script-message');"));
	ASSERT_TRUE(wait_counter(&message_count, 1));
	ASSERT_TRUE(has_message("script-message"));
	ASSERT_TRUE(js("indigo_log_with_property('cached',indigo_devices['" PEER "'].PEER_TEXT); indigo_error_with_property('cached',indigo_devices['" PEER "'].PEER_BLOB);"));
}

static void callback_exception_recovery(void) {
	ASSERT_TRUE(js("indigo_on_define_property=function(){throw new Error('define callback')}; indigo_on_update_property=function(){throw new Error('update callback')}; indigo_on_delete_property=function(){throw new Error('delete callback')}; indigo_on_send_message=function(){throw new Error('message callback')}; indigo_on_enumerate_properties=function(){throw new Error('enumerate callback')}; indigo_on_change_property=function(){throw new Error('change callback')};"));
	indigo_property *p = indigo_init_text_property(NULL, PEER, "CALLBACK", "Peer", "Callback", INDIGO_OK_STATE, INDIGO_RO_PERM, 1);
	indigo_init_text_item(p->items, "VALUE", "Value", "one");
	indigo_define_property(&peer, p, NULL);
	indigo_update_property(&peer, p, NULL);
	indigo_delete_property(&peer, p, NULL);
	indigo_send_message(&peer, OK_PROPERTY, "callback message");
	indigo_property selector = { 0 };
	indigo_enumerate_properties(&observer, &selector);
	indigo_change_text_property_1(&observer, AGENT, "CALLBACK_CHANGE", "VALUE", "x");
	indigo_release_property(p);
	ASSERT_TRUE(js("testValue = 10;"));
}

static void invalid_binding_arguments_recover(void) {
	const char *scripts[] = {
		"indigo_change_text_property('x','y',{A:1})",
		"indigo_change_number_property('x','y',{A:'x'})",
		"indigo_change_switch_property('x','y',{A:1})",
		"indigo_enable_blob('x','y','yes')",
		"indigo_utc_to_time(1)",
		"indigo_utc_to_delay('invalid')"
	};
	for (unsigned i = 0; i < ARRAY_SIZE(scripts); i++) {
		ASSERT_TRUE(js_state(scripts[i], INDIGO_ALERT_STATE));
	}
	ASSERT_TRUE(js("testValue = 11;"));
}

static const indigo_test_case tests[] = {
	{ "schema and lifecycle", schema_and_lifecycle },
	{ "immediate execution and recovery", immediate_execution },
	{ "repeated execution", repeated_execution },
	{ "long script execution", long_script_execution },
	{ "script create rename execute delete", script_crud },
	{ "empty name recovery", empty_name_recovery },
	{ "duplicate script recovery", duplicate_script_recovery },
	{ "saved script failure recovery", saved_script_failure_recovery },
	{ "delete acknowledgement", delete_acknowledgement },
	{ "delete unknown script", delete_unknown },
	{ "script capacity and reuse", script_capacity },
	{ "configuration long text roundtrip", configuration_roundtrip },
	{ "on-load order after reinitialize", on_load_order },
	{ "shutdown during automatic load", shutdown_during_automatic_load },
	{ "on-load existing scripts", on_load_existing },
	{ "on-unload execution", on_unload_execution },
	{ "on-load failure recovery", on_load_failure_recovery },
	{ "on-unload failure", on_unload_failure },
	{ "hook defaults and rename", hook_defaults_and_rename },
	{ "invalid rename recovery", invalid_rename_recovery },
	{ "configuration save failure recovery", save_failure_recovery },
	{ "low-level change bindings", low_level_change_bindings },
	{ "enumeration and BLOB enable bindings", enumeration_and_blob_enable },
	{ "define update redefine delete bindings", define_update_redefine_delete },
	{ "binding defaults and large property", defaults_and_large_property },
	{ "cached property capacity and reuse", cached_property_capacity },
	{ "boot.js cache and callbacks", boot_cache_and_callbacks },
	{ "boot.js property change helper", peer_property_change_helper },
	{ "BLOB populate and save bindings", blob_bindings },
	{ "conversion and astronomy bindings", conversion_bindings },
	{ "timer scheduling cancellation capacity", timer_bindings },
	{ "shutdown cancels pending timers", shutdown_cancels_timers },
	{ "logging and message bindings", logging_and_messages },
	{ "callback exception recovery", callback_exception_recovery },
	{ "invalid binding argument recovery", invalid_binding_arguments_recover }
};

int main(int argc, char **argv) {
	setvbuf(stdout, NULL, _IONBF, 0);
	int failed = 0, executed = 0;
	for (unsigned i = 0; i < ARRAY_SIZE(tests); i++) {
		if (argc > 1 && !strstr(tests[i].name, argv[1])) {
			continue;
		}
		executed++;
		strcpy(test_root, "/tmp/indigo_scripting_test_XXXXXX");
		if (!mkdtemp(test_root)) {
			return 1;
		}
		snprintf(config_folder, sizeof(config_folder), "%s/.indigo", test_root);
		mkdir(config_folder, 0700);
		pid_t child = fork();
		if (child == 0) {
			alarm(90);
			int status = setup() ? indigo_run_tests("Scripting Agent integration", tests + i, 1) : 1;
			cleanup();
			exit(status || indigo_test_failures ? 1 : 0);
		}
		int status = -1;
		if (child < 0 || waitpid(child, &status, 0) != child || !WIFEXITED(status) || WEXITSTATUS(status)) {
			fprintf(stderr, "FAILED %s (status %d)\n", tests[i].name, status);
			failed++;
		}
		if (getenv("INDIGO_TEST_KEEP_OUTPUT")) {
			printf("Kept test output in %s\n", test_root);
		} else {
			remove_files(test_root);
		}
	}
	printf("Scripting Agent: %d/%d passed (including cleanup)\n", executed - failed, executed);
	return executed ? (failed ? 1 : 0) : 2;
}
