// Copyright (c) 2026 INDIGO initiative
// All rights reserved.
//
// You may use this software under the terms of 'INDIGO Astronomy
// open-source license' (see LICENSE.md).
//
// THIS SOFTWARE IS PROVIDED BY THE AUTHORS 'AS IS' AND ANY EXPRESS
// OR IMPLIED WARRANTIES, INCLUDING, BUT NOT LIMITED TO, THE IMPLIED
// WARRANTIES OF MERCHANTABILITY AND FITNESS FOR A PARTICULAR PURPOSE
// ARE DISCLAIMED. IN NO EVENT SHALL THE AUTHOR BE LIABLE FOR ANY
// DIRECT, INDIRECT, INCIDENTAL, SPECIAL, EXEMPLARY, OR CONSEQUENTIAL
// DAMAGES (INCLUDING, BUT NOT LIMITED TO, PROCUREMENT OF SUBSTITUTE
// GOODS OR SERVICES; LOSS OF USE, DATA, OR PROFITS; OR BUSINESS
// INTERRUPTION) HOWEVER CAUSED AND ON ANY THEORY OF LIABILITY,
// WHETHER IN CONTRACT, STRICT LIABILITY, OR TORT (INCLUDING
// NEGLIGENCE OR OTHERWISE) ARISING IN ANY WAY OUT OF THE USE OF THIS
// SOFTWARE, EVEN IF ADVISED OF THE POSSIBILITY OF SUCH DAMAGE.

// Code is generated by AI

#include <stdatomic.h>
#include <time.h>
#include <pthread.h>
#include <dirent.h>
#include <unistd.h>
#include <stdio.h>
#include <ASICamera2.h>
#include <indigo/indigo_ccd_driver.h>
#include "ccd_test_noise.h"

#define IMAGER_WIDTH 1600
#include <indigo/indigo_usb_utils.h>
#include <indigo_drivers/ccd_asi/indigo_ccd_asi.h>
#include "simulator_test_common.h"

#define CAMERAS 8
#define PROPERTIES 80
#define PIXEL_PROPERTY "X_PIXEL_FORMAT"
#define ADVANCED_PROPERTY "X_ADVANCED"
#define PRESETS_PROPERTY "X_PRESETS"
#define SUFFIX_PROPERTY "X_CUSTOM_SUFFIX"

typedef struct {
	ASI_CAMERA_INFO info;
	ASI_ID suffix;
	atomic_long config[64];
	atomic_bool visible, opened, exposing, video, snapshot_needs_stop;
	atomic_int opens, closes, frames, starts, stops, width, height, bin, left, top, format;
	atomic_int open_error, init_error, read_error, start_error, stop_error;
	atomic_int read_config_fail, write_config_fail, caps_fail, status_error, roi_error;
	atomic_int relays, config_error, roi_write_error, origin_read_error, origin_write_error, malformed_roi;
	atomic_int snapshot_failures, failed_statuses;
	atomic_int video_delay_ms;
	atomic_int forced_status, video_timeouts, video_starts, video_stops, guide_on_error, guide_off_error, suffix_error, egain_error, gain_offset_error, dark;
	atomic_int missing_control, readonly_control, reverse_controls, malformed_caps, read_value_control;
	atomic_long read_value;
	_Atomic double deadline;
} mock_camera;

typedef struct {
	char name[INDIGO_NAME_SIZE];
	indigo_property *properties[PROPERTIES];
	int updates[PROPERTIES];
} observed_device;

static mock_camera cameras[CAMERAS];
static _Atomic double clock_offset;

double asi_test_monotonic_time(void) {
	return indigo_monotonic_time() + clock_offset;
}

static pthread_t bus_thread;
static atomic_int wrong_single_mode;
static atomic_int wrong_bus_thread, raw_blobs, last_width, last_height;
static atomic_int fail_register, fail_descriptor, wrong_vendor, discovery_fail, count_fail, fail_guider_attach;
static atomic_int discovery_calls, wrong_product, reverse_discovery;
static atomic_int sdk_active[CAMERAS], concurrent_sdk, updates_after_detach;
static _Thread_local int attaching_index = -1, probing_index = -1;
static int request_revisions[CAMERAS * 2][PROPERTIES];
static observed_device observed[CAMERAS * 2];
static pthread_mutex_t observation_mutex = PTHREAD_MUTEX_INITIALIZER;
static libusb_hotplug_callback_fn usb_callback;
static int usb_devices[CAMERAS];
static atomic_int usb_ref_balance[CAMERAS], invalid_usb_unref, usb_refs, attached, lock_count, fail_lock;
static atomic_int sdk_after_close, blobs, bad_blob, pulse_writes, short_waits, fail_attach, fail_configs, unbalanced_unlock;

typedef struct {
	bool active;
	struct timespec started;
	double duration_ms;
	unsigned completed;
} pulse_measurement;

static pulse_measurement pulse_measurements[CAMERAS][4];
static pthread_mutex_t pulse_mutex = PTHREAD_MUTEX_INITIALIZER;
static char config_folder[] = "/tmp/indigo_ccd_asi_XXXXXX";

typedef struct {
	pthread_mutex_t mutex;
	pthread_cond_t condition;
	bool armed;
	atomic_int entered;
} test_gate;

static test_gate initialization_gate = { .mutex = PTHREAD_MUTEX_INITIALIZER, .condition = PTHREAD_COND_INITIALIZER };
static test_gate read_gate = { .mutex = PTHREAD_MUTEX_INITIALIZER, .condition = PTHREAD_COND_INITIALIZER };
static test_gate temperature_gate = { .mutex = PTHREAD_MUTEX_INITIALIZER, .condition = PTHREAD_COND_INITIALIZER };
static test_gate queue_gate = { .mutex = PTHREAD_MUTEX_INITIALIZER, .condition = PTHREAD_COND_INITIALIZER };
static atomic_int gate_timeouts, fail_queue, fast_poll, barriers;
static atomic_bool shutdown_work_pending;
static atomic_int premature_shutdown_detach;
static indigo_device *logical[CAMERAS * 2];
static indigo_queue *driver_queue;
static _Atomic(indigo_timer_callback) temperature_handler;

static void arm_gate(test_gate *gate) {
	pthread_mutex_lock(&gate->mutex);
	gate->armed = true;
	atomic_store(&gate->entered, 0);
	pthread_mutex_unlock(&gate->mutex);
}

static void release_gate(test_gate *gate) {
	pthread_mutex_lock(&gate->mutex);
	gate->armed = false;
	pthread_cond_broadcast(&gate->condition);
	pthread_mutex_unlock(&gate->mutex);
}

static void enter_gate(test_gate *gate) {
	pthread_mutex_lock(&gate->mutex);
	if (gate->armed) {
		struct timespec deadline;
		clock_gettime(CLOCK_REALTIME, &deadline);
		deadline.tv_sec += 5;
		atomic_store(&gate->entered, 1);
		while (gate->armed) {
			if (pthread_cond_timedwait(&gate->condition, &gate->mutex, &deadline) != 0) {
				atomic_fetch_add(&gate_timeouts, 1);
				gate->armed = false;
			}
		}
	}
	pthread_mutex_unlock(&gate->mutex);
}

static test_gate setup_gate = { .mutex = PTHREAD_MUTEX_INITIALIZER, .condition = PTHREAD_COND_INITIALIZER };

static void block_queue(indigo_device *device) {
	enter_gate(&queue_gate);
}

static void queue_barrier(indigo_device *device) {
	atomic_fetch_add(&barriers, 1);
}

indigo_queue *asi_test_queue_create(indigo_device *device) {
	if (atomic_load(&fail_queue)) {
		return NULL;
	}
	driver_queue = indigo_queue_create(device);
	return driver_queue;
}

void asi_test_execute_in(indigo_device *device, double delay, indigo_timer_callback callback) {
	if (delay == 5) {
		temperature_handler = callback;
		if (atomic_load(&fast_poll)) {
			delay = 0.01;
		}
	}
	indigo_execute_handler_in(device, delay, callback);
}

const char *asi_test_config_folder(void) {
	return config_folder;
}

static int device_index(const char *name) {
	if (attaching_index >= 0) {
		return attaching_index;
	}
	for (int i = 0; i < CAMERAS * 2; i++) {
		if (logical[i] && !strcmp(observed[i].name, name)) {
			return i;
		}
	}
	int index = -1;
	sscanf(name, "ASI test %d", &index);
	return index >= 0 && index < CAMERAS ? 2 * index + (strstr(name, "(guider)") != NULL) : -1;
}

static int property_index(int index, const char *name, bool create) {
	int empty = -1;
	for (int i = 0; i < PROPERTIES; i++) {
		if (observed[index].properties[i] && !strcmp(observed[index].properties[i]->name, name)) {
			return i;
		}
		if (!observed[index].properties[i] && empty < 0) {
			empty = i;
		}
	}
	return create ? empty : -1;
}

static indigo_result observe(indigo_client *client, indigo_device *device, indigo_property *property, const char *message) {
	if (getenv("ASI_TEST_TRACE")) {
		fprintf(stderr, "PROPERTY %s %d %s\n", property->name, property->state, message ? message : "");
	}
	if (property->state == INDIGO_ALERT_STATE && message) {
		fprintf(stderr, "%s.%s: %s\n", property->device, property->name, message);
	}
	int index = device_index(property->device);
	if (index < 0) {
		return INDIGO_OK;
	}
	if (!logical[index]) {
		atomic_fetch_add(&updates_after_detach, 1);
	}
	pthread_mutex_lock(&observation_mutex);
	int slot = property_index(index, property->name, true);
	if (slot >= 0) {
		indigo_release_property(observed[index].properties[slot]);
		observed[index].properties[slot] = indigo_copy_property(NULL, property);
		observed[index].updates[slot]++;
	}
	pthread_mutex_unlock(&observation_mutex);
	return INDIGO_OK;
}

static indigo_result observe_delete(indigo_client *client, indigo_device *device, indigo_property *property, const char *message) {
	int index = device_index(property->device);
	if (index < 0) {
		return INDIGO_OK;
	}
	pthread_mutex_lock(&observation_mutex);
	for (int i = 0; i < PROPERTIES; i++) {
		indigo_property *cached = observed[index].properties[i];
		if (cached && (!property->name[0] || !strcmp(cached->name, property->name))) {
			indigo_release_property(cached);
			observed[index].properties[i] = NULL;
		}
	}
	pthread_mutex_unlock(&observation_mutex);
	return INDIGO_OK;
}

static indigo_result observe_image(indigo_client *client, indigo_device *device, indigo_property *property, const char *message) {
	if (!strcmp(property->name, "CCD_IMAGE") && property->state == INDIGO_OK_STATE && property->count && property->items[0].blob.size > 0) {
		indigo_item *item = property->items;
		bool valid = item->blob.value != NULL;
		if (valid && !strcmp(item->blob.format, ".raw")) {
			indigo_raw_header header = { 0 };
			valid = item->blob.size >= sizeof(header);
			if (valid) {
				memcpy(&header, item->blob.value, sizeof(header));
				int index = device_index(property->device) / 2;
				mock_camera *c = cameras + index;
				int format = atomic_load(&c->format);
				int bytes = format == ASI_IMG_RAW16 ? 2 : format == ASI_IMG_RGB24 ? 3
																																					: 1;
				unsigned signature = bytes == 2 ? INDIGO_RAW_MONO16 : bytes == 3 ? INDIGO_RAW_RGB24
																																				 : INDIGO_RAW_MONO8;
				long length = (long)header.width * header.height * bytes;
				valid = header.signature == signature && header.width == atomic_load(&c->width) && header.height == atomic_load(&c->height) && item->blob.size >= sizeof(header) + length;
				if (valid) {
					const unsigned char *pixels = (unsigned char *)item->blob.value + sizeof(header);
					for (long i = 0; i < (long)header.width * header.height; i++) {
						int x = (i % header.width + atomic_load(&c->left)) * atomic_load(&c->bin);
						int y = (i / header.width + atomic_load(&c->top)) * atomic_load(&c->bin);
						int source = y * IMAGER_WIDTH + x;
						unsigned short mono = ccd_test_noise(source, 0);
						bool match = bytes == 3 ? (pixels[3 * i] == (ccd_test_noise(source, 1) >> 8) && pixels[3 * i + 1] == (ccd_test_noise(source, 2) >> 8) && pixels[3 * i + 2] == (ccd_test_noise(source, 3) >> 8)) : bytes == 2 ? !memcmp(pixels + 2 * i, &mono, 2)
																																																																																																												 : pixels[i] == (mono >> 8);
						if (!match) {
							valid = false;
							break;
						}
					}
				}
				const char *patterns[] = { "RGGB", "BGGR", "GRBG", "GBRG" };
				bool known_pattern = c->info.BayerPattern >= ASI_BAYER_RG && c->info.BayerPattern <= ASI_BAYER_GB;
				bool bayer = c->info.IsColorCam && known_pattern && (format == ASI_IMG_RAW8 || format == ASI_IMG_RAW16);
				bool has_bayer = valid && memmem((char *)item->blob.value + sizeof(header) + length, item->blob.size - sizeof(header) - length, "BAYERPAT=", 9) != NULL;
				valid = valid && bayer == has_bayer;
				if (valid && bayer) {
					valid = memmem((char *)item->blob.value + sizeof(header) + length, item->blob.size - sizeof(header) - length, patterns[c->info.BayerPattern], 4) != NULL;
				}
				atomic_store(&last_width, header.width);
				atomic_store(&last_height, header.height);
			}
			atomic_fetch_add(&raw_blobs, 1);
		}
		if (!valid) {
			fprintf(stderr, "Invalid image contract: %s %ld bytes\n", item->blob.format, item->blob.size);
			atomic_fetch_add(&bad_blob, 1);
		}
		atomic_fetch_add(&blobs, 1);
	}
	return observe(client, device, property, message);
}

static indigo_client test_client = { .name = "ASI camera SDK test", .version = INDIGO_VERSION_CURRENT, .define_property = observe, .update_property = observe_image, .delete_property = observe_delete };

indigo_result asi_test_attach(indigo_device *device) {
	if (atomic_exchange(&fail_attach, 0)) {
		return INDIGO_FAILED;
	}
	int index = -1;
	bool slave = device->master_device && device->master_device != device;
	if (slave && atomic_exchange(&fail_guider_attach, 0)) {
		return INDIGO_FAILED;
	}
	if (slave) {
		for (int i = 0; i < CAMERAS; i++) {
			if (logical[2 * i] == device->master_device) {
				index = 2 * i + 1;
			}
		}
	} else {
		index = 2 * probing_index;
	}
	if (index < 0) {
		return INDIGO_FAILED;
	}
	logical[index] = device;
	snprintf(observed[index].name, INDIGO_NAME_SIZE, "%s", device->name);
	attaching_index = index;
	indigo_result result = indigo_attach_device(device);
	attaching_index = -1;
	if (result == INDIGO_OK) {
		atomic_fetch_add(&attached, 1);
	}
	return result;
}

indigo_result asi_test_detach(indigo_device *device) {
	if (atomic_load(&shutdown_work_pending)) {
		atomic_fetch_add(&premature_shutdown_detach, 1);
	}
	indigo_result result = indigo_detach_device(device);
	atomic_fetch_sub(&attached, 1);
	for (int i = 0; i < CAMERAS * 2; i++) {
		if (logical[i] == device) {
			logical[i] = NULL;
		}
	}
	return result;
}

static indigo_property *snapshot(int index, const char *name) {
	pthread_mutex_lock(&observation_mutex);
	int slot = property_index(index, name, false);
	indigo_property *copy = slot < 0 ? NULL : indigo_copy_property(NULL, observed[index].properties[slot]);
	pthread_mutex_unlock(&observation_mutex);
	return copy;
}

static int state(int index, const char *name) {
	indigo_property *property = snapshot(index, name);
	int value = property ? (int)property->state : -1;
	indigo_release_property(property);
	return value;
}

static bool wait_state(int index, const char *name, int expected) {
	for (int i = 0; i < (!strcmp(name, "CONFIG") ? 2000 : 400); i++) {
		pthread_mutex_lock(&observation_mutex);
		int slot = property_index(index, name, false);
		bool ready = slot >= 0 && observed[index].properties[slot]->state == expected && observed[index].updates[slot] > request_revisions[index][slot];
		pthread_mutex_unlock(&observation_mutex);
		if (ready) {
			return true;
		}
		indigo_usleep(10000);
	}
	fprintf(stderr, "device %d property %s: expected state %d, got %d\n", index, name, expected, state(index, name));
	return false;
}

static bool wait_count(atomic_int *value, int expected) {
	for (int i = 0; i < 400; i++) {
		if (atomic_load(value) == expected) {
			return true;
		}
		indigo_usleep(10000);
	}
	fprintf(stderr, "counter expected %d, got %d\n", expected, atomic_load(value));
	return false;
}

void asi_test_usb_start(void) {
}

indigo_result asi_test_lock(indigo_device *device) {
	if (atomic_load(&fail_lock)) {
		return INDIGO_FAILED;
	}
	atomic_fetch_add(&lock_count, 1);
	return INDIGO_OK;
}

indigo_result asi_test_unlock(indigo_device *device) {
	if (atomic_load(&lock_count) == 0) {
		atomic_fetch_add(&unbalanced_unlock, 1);
		return INDIGO_FAILED;
	}
	atomic_fetch_sub(&lock_count, 1);
	return INDIGO_OK;
}

int LIBUSB_CALL asi_test_usb_register(libusb_context *ctx, int events, int flags, int vid, int pid, int cls, libusb_hotplug_callback_fn callback, void *data, libusb_hotplug_callback_handle *handle) {
	if (atomic_load(&fail_register)) {
		return LIBUSB_ERROR_OTHER;
	}
	usb_callback = callback;
	callback(NULL, (libusb_device *)&usb_devices[0], LIBUSB_HOTPLUG_EVENT_DEVICE_ARRIVED, NULL);
	return LIBUSB_SUCCESS;
}

int asi_test_usb_register_sim(libusb_context *ctx, libusb_hotplug_event events, libusb_hotplug_flag flags, int vid, int pid, int cls, libusb_hotplug_callback_fn callback, void *data, libusb_hotplug_callback_handle *handle) {
	return asi_test_usb_register(ctx, events, flags, vid, pid, cls, callback, data, handle);
}

void LIBUSB_CALL asi_test_usb_deregister(libusb_context *ctx, libusb_hotplug_callback_handle handle) {
	usb_callback = NULL;
}

int asi_test_usb_deregister_poll(libusb_context *ctx, libusb_hotplug_callback_handle handle) {
	usb_callback = NULL;
	return LIBUSB_SUCCESS;
}

libusb_device *LIBUSB_CALL asi_test_usb_ref(libusb_device *device) {
	atomic_fetch_add(&usb_refs, 1);
	atomic_fetch_add(&usb_ref_balance[(int *)device - usb_devices], 1);
	return device;
}

void LIBUSB_CALL asi_test_usb_unref(libusb_device *device) {
	atomic_fetch_sub(&usb_refs, 1);
	if (atomic_fetch_sub(&usb_ref_balance[(int *)device - usb_devices], 1) <= 0) {
		atomic_fetch_add(&invalid_usb_unref, 1);
	}
}

int LIBUSB_CALL asi_test_usb_descriptor(libusb_device *device, struct libusb_device_descriptor *descriptor) {
	memset(descriptor, 0, sizeof(*descriptor));
	descriptor->idVendor = atomic_load(&wrong_vendor) ? 0xffff : 0x03c3;
	descriptor->idProduct = wrong_product ? 0x9999 : 0x120a;
	return atomic_load(&fail_descriptor) ? LIBUSB_ERROR_IO : LIBUSB_SUCCESS;
}

static void usb_event(int index, bool arrive) {
	usb_callback(NULL, (libusb_device *)&usb_devices[index], arrive ? LIBUSB_HOTPLUG_EVENT_DEVICE_ARRIVED : LIBUSB_HOTPLUG_EVENT_DEVICE_LEFT, NULL);
}

static void remember_request(const char *device, const char *property) {
	int index = device_index(device);
	pthread_mutex_lock(&observation_mutex);
	int slot = index < 0 ? -1 : property_index(index, property, false);
	if (slot >= 0) {
		request_revisions[index][slot] = observed[index].updates[slot];
	}
	pthread_mutex_unlock(&observation_mutex);
}

static indigo_result request_number(indigo_client *client, const char *device, const char *property, int count, const char **items, double *values) {
	remember_request(device, property);
	return indigo_change_number_property(client, device, property, count, items, values);
}

static indigo_result request_number_1(indigo_client *client, const char *device, const char *property, const char *item, double value) {
	remember_request(device, property);
	return indigo_change_number_property_1(client, device, property, item, value);
}

static indigo_result request_switch(indigo_client *client, const char *device, const char *property, const char *item, bool value) {
	remember_request(device, property);
	return indigo_change_switch_property_1(client, device, property, item, value);
}

static indigo_result request_text(indigo_client *client, const char *device, const char *property, const char *item, const char *value) {
	remember_request(device, property);
	return indigo_change_text_property_1(client, device, property, item, value);
}

#define indigo_change_number_property request_number
#define indigo_change_number_property_1 request_number_1
#define indigo_change_switch_property_1 request_switch
#define indigo_change_text_property_1 request_text

static bool set_switch(int index, const char *property, const char *item, bool value) {
	return indigo_change_switch_property_1(&test_client, observed[index].name, property, item, value) == INDIGO_OK;
}

static bool connect_device(int index, bool connect) {
	if (!set_switch(index, "CONNECTION", connect ? "CONNECTED" : "DISCONNECTED", true) || !wait_state(index, "CONNECTION", INDIGO_OK_STATE)) {
		return false;
	}
	if (connect && index % 2 == 0) {
		return indigo_change_text_property_1(&test_client, observed[index].name, "CCD_LOCAL_MODE", "DIR", config_folder) == INDIGO_OK && wait_state(index, "CCD_LOCAL_MODE", INDIGO_OK_STATE);
	}
	return true;
}

static mock_camera *camera(int id) {
	for (int i = 0; i < CAMERAS; i++) {
		if (cameras[i].info.CameraID == id) {
			return cameras + i;
		}
	}
	return NULL;
}

static ASI_ERROR_CODE check_camera(int id, bool open) {
	mock_camera *c = camera(id);
	if (!c || !atomic_load(&c->visible)) {
		return ASI_ERROR_INVALID_ID;
	}
	if (open && pthread_equal(pthread_self(), bus_thread)) {
		atomic_fetch_add(&wrong_bus_thread, 1);
	}
	if (open && !atomic_load(&c->opened)) {
		atomic_fetch_add(&sdk_after_close, 1);
		return ASI_ERROR_CAMERA_CLOSED;
	}
	return ASI_SUCCESS;
}

typedef struct {
	int index;
} sdk_scope;

static sdk_scope sdk_enter(int id) {
	int index = -1;
	for (int i = 0; i < CAMERAS; i++) {
		if (cameras[i].info.CameraID == id) {
			index = i;
			if (atomic_fetch_add(&sdk_active[i], 1)) {
				atomic_fetch_add(&concurrent_sdk, 1);
			}
			break;
		}
	}
	return (sdk_scope){ index };
}

static void sdk_leave(sdk_scope *scope) {
	if (scope->index >= 0) {
		atomic_fetch_sub(&sdk_active[scope->index], 1);
	}
}

#define SDK_CHECK(id, opened)                                          \
	sdk_scope scope __attribute__((cleanup(sdk_leave))) = sdk_enter(id); \
	do {                                                                 \
		ASI_ERROR_CODE result = check_camera(id, opened);                  \
		if (result) {                                                      \
			return result;                                                   \
		}                                                                  \
	} while (0)

int ASIGetNumOfConnectedCameras(void) {
	atomic_fetch_add(&discovery_calls, 1);
	if (count_fail) {
		return -1;
	}
	int count = 0;
	for (int i = 0; i < CAMERAS; i++) {
		count += atomic_load(&cameras[i].visible);
	}
	return count;
}

ASI_BOOL ASICameraCheck(int vid, int pid) {
	return vid == 0x03c3 && pid == 0x120a ? ASI_TRUE : ASI_FALSE;
}

int ASIGetProductIDs(int *ids) {
	if (ids) {
		ids[0] = 0x120a;
	}
	return 1;
}

ASI_ERROR_CODE ASIGetCameraProperty(ASI_CAMERA_INFO *info, int index) {
	if (discovery_fail) {
		return ASI_ERROR_GENERAL_ERROR;
	}
	for (int step = 0; step < CAMERAS; step++) {
		int i = reverse_discovery ? CAMERAS - 1 - step : step;
		if (atomic_load(&cameras[i].visible) && index-- == 0) {
			*info = cameras[i].info;
			return ASI_SUCCESS;
		}
	}
	return ASI_ERROR_INVALID_INDEX;
}

ASI_ERROR_CODE ASIGetCameraPropertyByID(int id, ASI_CAMERA_INFO *info) {
	SDK_CHECK(id, false);
	if (camera(id)->egain_error) {
		return ASI_ERROR_GENERAL_ERROR;
	}
	*info = camera(id)->info;
	info->ElecPerADU = 2.0 * pow(10.0, -atomic_load(&camera(id)->config[ASI_GAIN]) / 200.0);
	return ASI_SUCCESS;
}

ASI_ERROR_CODE ASIOpenCamera(int id) {
	SDK_CHECK(id, false);
	mock_camera *c = camera(id);
	probing_index = (int)(c - cameras);
	if (c->open_error) {
		return ASI_ERROR_GENERAL_ERROR;
	}
	if (atomic_exchange(&c->opened, true)) {
		atomic_fetch_add(&concurrent_sdk, 1);
	}
	atomic_fetch_add(&c->opens, 1);
	return ASI_SUCCESS;
}

ASI_ERROR_CODE ASIInitCamera(int id) {
	SDK_CHECK(id, true);
	enter_gate(&initialization_gate);
	return camera(id)->init_error ? ASI_ERROR_GENERAL_ERROR : ASI_SUCCESS;
}

ASI_ERROR_CODE ASICloseCamera(int id) {
	sdk_scope scope __attribute__((cleanup(sdk_leave))) = sdk_enter(id);
	mock_camera *c = camera(id);
	if (!c || !atomic_exchange(&c->opened, false)) {
		atomic_fetch_add(&sdk_after_close, 1);
		return ASI_ERROR_CAMERA_CLOSED;
	}
	c->exposing = c->video = false;
	c->relays = 0;
	atomic_fetch_add(&c->closes, 1);
	return ASI_SUCCESS;
}

static const ASI_CONTROL_TYPE controls[] = { ASI_EXPOSURE, ASI_GAIN, ASI_GAMMA, ASI_OFFSET, ASI_BANDWIDTHOVERLOAD, ASI_TEMPERATURE, ASI_TARGET_TEMP, ASI_COOLER_ON, ASI_COOLER_POWER_PERC, ASI_WB_R, ASI_WB_B, ASI_GPS_SUPPORT, ASI_ROLLING_INTERVAL };
static const char *control_names[] = { "Exposure", "Gain", "Gamma", "Offset", "BandWidth", "Temperature", "TargetTemp", "CoolerOn", "CoolerPower", "WB_R", "WB_B", "GPS", "RollingInterval" };

static bool control_available(mock_camera *c, ASI_CONTROL_TYPE control) {
	if (control + 1 == c->missing_control) {
		return false;
	}
	if (!c->info.IsCoolerCam && (control == ASI_TARGET_TEMP || control == ASI_COOLER_ON || control == ASI_COOLER_POWER_PERC)) {
		return false;
	}
	return true;
}

ASI_ERROR_CODE ASIGetNumOfControls(int id, int *count) {
	SDK_CHECK(id, true);
	if (camera(id)->config_error) {
		return ASI_ERROR_GENERAL_ERROR;
	}
	*count = 0;
	for (int i = 0; i < ARRAY_SIZE(controls); i++) {
		*count += control_available(camera(id), controls[i]);
	}
	return ASI_SUCCESS;
}

ASI_ERROR_CODE ASIGetControlCaps(int id, int index, ASI_CONTROL_CAPS *caps) {
	SDK_CHECK(id, true);
	if (index < 0 || index >= ARRAY_SIZE(controls)) {
		return ASI_ERROR_INVALID_INDEX;
	}
	mock_camera *c = camera(id);
	if (c->caps_fail) {
		return ASI_ERROR_GENERAL_ERROR;
	}
	int selected = -1;
	for (int step = 0; step < ARRAY_SIZE(controls); step++) {
		int candidate = c->reverse_controls ? ARRAY_SIZE(controls) - 1 - step : step;
		if (control_available(c, controls[candidate]) && index-- == 0) {
			selected = candidate;
			break;
		}
	}
	index = selected;
	if (index < 0 || index >= ARRAY_SIZE(controls)) {
		return ASI_ERROR_INVALID_INDEX;
	}
	memset(caps, 0, sizeof(*caps));
	caps->ControlType = controls[index];
	strcpy(caps->Name, control_names[index]);
	caps->MaxValue = 100;
	caps->IsWritable = ASI_TRUE;
	if (caps->ControlType == ASI_EXPOSURE) {
		caps->MinValue = 100;
		caps->MaxValue = 120000000;
	} else if (caps->ControlType == ASI_TEMPERATURE || caps->ControlType == ASI_COOLER_POWER_PERC) {
		caps->IsWritable = ASI_FALSE;
	} else if (caps->ControlType == ASI_TARGET_TEMP) {
		caps->MinValue = -40;
		caps->MaxValue = 40;
	}
	if (caps->ControlType == ASI_TEMPERATURE) {
		caps->MinValue = -1000;
		caps->MaxValue = 1000;
	}
	if (caps->ControlType + 1 == c->readonly_control) {
		caps->IsWritable = ASI_FALSE;
	}
	if (c->malformed_caps == 1) {
		caps->MaxValue = caps->MinValue - 1;
	} else if (c->malformed_caps == 2) {
		memset(caps->Name, '%', sizeof(caps->Name));
	}
	return ASI_SUCCESS;
}

ASI_ERROR_CODE ASIGetControlValue(int id, ASI_CONTROL_TYPE control, long *value, ASI_BOOL *automatic) {
	SDK_CHECK(id, true);
	if (control == ASI_TEMPERATURE) {
		enter_gate(&temperature_gate);
	}
	if (atomic_load(&camera(id)->read_config_fail) == control + 1) {
		return ASI_ERROR_GENERAL_ERROR;
	}
	*value = camera(id)->read_value_control == control + 1 ? camera(id)->read_value : atomic_load(&camera(id)->config[control]);
	*automatic = ASI_FALSE;
	return ASI_SUCCESS;
}

ASI_ERROR_CODE ASISetControlValue(int id, ASI_CONTROL_TYPE control, long value, ASI_BOOL automatic) {
	SDK_CHECK(id, true);
	if (atomic_load(&camera(id)->write_config_fail) == control + 1) {
		return ASI_ERROR_GENERAL_ERROR;
	}
	atomic_store(&camera(id)->config[control], value);
	return ASI_SUCCESS;
}

ASI_ERROR_CODE ASIGetROIFormat(int id, int *width, int *height, int *bin, ASI_IMG_TYPE *format) {
	SDK_CHECK(id, true);
	mock_camera *c = camera(id);
	enter_gate(&setup_gate);
	if (c->roi_error) {
		return ASI_ERROR_GENERAL_ERROR;
	}
	*width = c->width;
	*height = c->height;
	*bin = c->malformed_roi ? 0 : c->bin;
	*format = c->format;
	return ASI_SUCCESS;
}

ASI_ERROR_CODE ASISetROIFormat(int id, int width, int height, int bin, ASI_IMG_TYPE format) {
	SDK_CHECK(id, true);
	mock_camera *c = camera(id);
	if (c->roi_write_error) {
		return ASI_ERROR_GENERAL_ERROR;
	}
	if (c->exposing || c->video || width % 8 || height % 2 || width * bin > c->info.MaxWidth || height * bin > c->info.MaxHeight) {
		return ASI_ERROR_INVALID_SIZE;
	}
	c->width = width;
	c->height = height;
	c->bin = bin;
	c->format = format;
	return ASI_SUCCESS;
}

ASI_ERROR_CODE ASIGetStartPos(int id, int *left, int *top) {
	SDK_CHECK(id, true);
	if (camera(id)->origin_read_error) {
		return ASI_ERROR_GENERAL_ERROR;
	}
	*left = camera(id)->left;
	*top = camera(id)->top;
	return ASI_SUCCESS;
}

ASI_ERROR_CODE ASISetStartPos(int id, int left, int top) {
	SDK_CHECK(id, true);
	if (camera(id)->origin_write_error) {
		return ASI_ERROR_GENERAL_ERROR;
	}
	camera(id)->left = left;
	camera(id)->top = top;
	return ASI_SUCCESS;
}

ASI_ERROR_CODE ASIStartExposure(int id, ASI_BOOL dark) {
	SDK_CHECK(id, true);
	mock_camera *c = camera(id);
	if (c->snapshot_needs_stop) {
		return ASI_ERROR_EXPOSURE_IN_PROGRESS;
	}
	if (c->start_error) {
		return ASI_ERROR_GENERAL_ERROR;
	}
	c->dark = dark;
	c->exposing = true;
	c->deadline = indigo_monotonic_time() + atomic_load(&c->config[ASI_EXPOSURE]) / 1000000.0;
	atomic_fetch_add(&c->starts, 1);
	return ASI_SUCCESS;
}

ASI_ERROR_CODE ASIGetExpStatus(int id, ASI_EXPOSURE_STATUS *status) {
	SDK_CHECK(id, true);
	mock_camera *c = camera(id);
	if (c->status_error) {
		return ASI_ERROR_GENERAL_ERROR;
	}
	if (c->snapshot_failures > 0 && indigo_monotonic_time() >= c->deadline) {
		c->snapshot_failures--;
		c->failed_statuses++;
		c->snapshot_needs_stop = true;
		*status = ASI_EXP_FAILED;
		return ASI_SUCCESS;
	}
	if (c->forced_status) {
		*status = c->forced_status - 1;
		return ASI_SUCCESS;
	}
	*status = !c->exposing ? ASI_EXP_IDLE : indigo_monotonic_time() < c->deadline ? ASI_EXP_WORKING
																																								: ASI_EXP_SUCCESS;
	return ASI_SUCCESS;
}

static ASI_ERROR_CODE fill_frame(int id, unsigned char *buffer, long size) {
	mock_camera *c = camera(id);
	if (c->read_error) {
		return ASI_ERROR_GENERAL_ERROR;
	}
	int bytes = c->format == ASI_IMG_RGB24 ? 3 : c->format == ASI_IMG_RAW16 ? 2
																																					: 1;
	long pixels = (long)c->width * c->height;
	if (size < pixels * bytes) {
		return ASI_ERROR_BUFFER_TOO_SMALL;
	}
	for (long i = 0; i < pixels; i++) {
		int source = ((i / c->width + c->top) * c->bin) * IMAGER_WIDTH + (i % c->width + c->left) * c->bin;
		unsigned short mono = ccd_test_noise(source, 0);
		if (bytes == 3) {
			for (int channel = 0; channel < 3; channel++) {
				buffer[3 * i + channel] = ccd_test_noise(source, 3 - channel) >> 8; // SDK BGR order, converted by the driver image handoff.
			}
		} else if (bytes == 2) {
			memcpy(buffer + 2 * i, &mono, 2);
		} else {
			buffer[i] = mono >> 8;
		}
	}
	atomic_fetch_add(&c->frames, 1);
	return ASI_SUCCESS;
}

ASI_ERROR_CODE ASIGetDataAfterExp(int id, unsigned char *buffer, long size) {
	SDK_CHECK(id, true);
	enter_gate(&read_gate);
	ASI_ERROR_CODE result = fill_frame(id, buffer, size);
	camera(id)->exposing = false;
	return result;
}

ASI_ERROR_CODE ASIStopExposure(int id) {
	SDK_CHECK(id, true);
	camera(id)->snapshot_needs_stop = false;
	camera(id)->exposing = false;
	if (camera(id)->stop_error) {
		return ASI_ERROR_GENERAL_ERROR;
	}
	atomic_fetch_add(&camera(id)->stops, 1);
	return ASI_SUCCESS;
}

ASI_ERROR_CODE ASIStartVideoCapture(int id) {
	SDK_CHECK(id, true);
	if (camera(id)->start_error) {
		return ASI_ERROR_GENERAL_ERROR;
	}
	atomic_fetch_add(&camera(id)->video_starts, 1);
	camera(id)->video = true;
	camera(id)->deadline = indigo_monotonic_time() + atomic_load(&camera(id)->config[ASI_EXPOSURE]) / 1000000.0 + camera(id)->video_delay_ms / 1000.0;
	return ASI_SUCCESS;
}

ASI_ERROR_CODE ASIGetVideoData(int id, unsigned char *buffer, long size, int wait_ms) {
	SDK_CHECK(id, true);
	mock_camera *c = camera(id);
	if (wait_ms > 20) {
		atomic_fetch_add(&short_waits, 1);
	}
	if (c->video_timeouts) {
		atomic_fetch_sub(&c->video_timeouts, 1);
		return ASI_ERROR_TIMEOUT;
	}
	double remaining = c->deadline - indigo_monotonic_time();
	if (remaining > 0) {
		indigo_usleep((long)(fmin(remaining, wait_ms / 1000.0) * 1000000));
	}
	if (indigo_monotonic_time() < c->deadline) {
		return ASI_ERROR_TIMEOUT;
	}
	enter_gate(&read_gate);
	ASI_ERROR_CODE result = fill_frame(id, buffer, size);
	c->deadline = indigo_monotonic_time() + atomic_load(&c->config[ASI_EXPOSURE]) / 1000000.0 + c->video_delay_ms / 1000.0;
	return result;
}

ASI_ERROR_CODE ASIStopVideoCapture(int id) {
	SDK_CHECK(id, true);
	camera(id)->video = false;
	atomic_fetch_add(&camera(id)->video_stops, 1);
	return camera(id)->stop_error ? ASI_ERROR_GENERAL_ERROR : ASI_SUCCESS;
}

ASI_ERROR_CODE ASIPulseGuideOn(int id, ASI_GUIDE_DIRECTION direction) {
	SDK_CHECK(id, true);
	if (camera(id)->guide_on_error) {
		return ASI_ERROR_GENERAL_ERROR;
	}
	pthread_mutex_lock(&pulse_mutex);
	pulse_measurement *sample = &pulse_measurements[camera(id) - cameras][direction];
	clock_gettime(CLOCK_MONOTONIC, &sample->started);
	sample->active = true;
	pthread_mutex_unlock(&pulse_mutex);
	atomic_fetch_or(&camera(id)->relays, 1 << direction);
	atomic_fetch_add(&pulse_writes, 1);
	return ASI_SUCCESS;
}

ASI_ERROR_CODE ASIPulseGuideOff(int id, ASI_GUIDE_DIRECTION direction) {
	SDK_CHECK(id, true);
	if (camera(id)->guide_off_error) {
		return ASI_ERROR_GENERAL_ERROR;
	}
	pthread_mutex_lock(&pulse_mutex);
	pulse_measurement *sample = &pulse_measurements[camera(id) - cameras][direction];
	if (sample->active) {
		struct timespec now;
		clock_gettime(CLOCK_MONOTONIC, &now);
		sample->duration_ms = (now.tv_sec - sample->started.tv_sec) * 1000.0 + (now.tv_nsec - sample->started.tv_nsec) / 1000000.0;
		sample->active = false;
		sample->completed++;
	}
	pthread_mutex_unlock(&pulse_mutex);
	atomic_fetch_and(&camera(id)->relays, ~(1 << direction));
	atomic_fetch_add(&pulse_writes, 1);
	return ASI_SUCCESS;
}

ASI_ERROR_CODE ASIGetID(int id, ASI_ID *value) {
	SDK_CHECK(id, true);
	if (camera(id)->suffix_error) {
		return ASI_ERROR_GENERAL_ERROR;
	}
	*value = camera(id)->suffix;
	return ASI_SUCCESS;
}

ASI_ERROR_CODE ASISetID(int id, ASI_ID value) {
	SDK_CHECK(id, true);
	if (camera(id)->suffix_error) {
		return ASI_ERROR_GENERAL_ERROR;
	}
	camera(id)->suffix = value;
	return ASI_SUCCESS;
}

ASI_ERROR_CODE ASIGetSerialNumber(int id, ASI_SN *serial) {
	SDK_CHECK(id, true);
	memset(serial, (unsigned)id + 1, sizeof(*serial));
	return ASI_SUCCESS;
}

ASI_ERROR_CODE ASIGetGainOffset(int id, int *dr, int *unity, int *rn, int *orn) {
	SDK_CHECK(id, true);
	if (camera(id)->gain_offset_error) {
		return ASI_ERROR_GENERAL_ERROR;
	}
	*dr = 5;
	*unity = 10;
	*rn = 75;
	*orn = 20;
	return ASI_SUCCESS;
}

char *ASIGetSDKVersion(void) {
	return "fake ASI 1.41";
}

static void properties_and_exposure(void) {
	ASSERT_TRUE(connect_device(0, true));
	const char *names[] = { PIXEL_PROPERTY, ADVANCED_PROPERTY, PRESETS_PROPERTY, SUFFIX_PROPERTY, "CCD_GAIN", "CCD_OFFSET", "CCD_EGAIN", "CCD_STREAMING", "CCD_STREAMING_SETTINGS" };
	for (int i = 0; i < ARRAY_SIZE(names); i++) {
		ASSERT_EQ_INT(INDIGO_OK_STATE, state(0, names[i]));
	}
	indigo_property *p = snapshot(0, PIXEL_PROPERTY);
	ASSERT_EQ_INT(4, p->count);
	ASSERT_STREQ("RAW 8", p->items[0].name);
	indigo_release_property(p);
	p = snapshot(0, "CCD_MODE");
	ASSERT_EQ_INT(8, p->count);
	indigo_release_property(p);
	ASSERT_TRUE(set_switch(0, "CCD_IMAGE_FORMAT", "RAW", true));
	ASSERT_EQ_INT(INDIGO_OK, indigo_change_number_property_1(&test_client, observed[0].name, "CCD_EXPOSURE", "EXPOSURE", 0.01));
	ASSERT_TRUE(wait_count(&blobs, 1));
	ASSERT_TRUE(wait_state(0, "CCD_EXPOSURE", INDIGO_OK_STATE));
	ASSERT_EQ_INT(0, atomic_load(&bad_blob));
	ASSERT_TRUE(set_switch(0, CONFIG_PROPERTY_NAME, CONFIG_SAVE_ITEM_NAME, true));
	ASSERT_TRUE(wait_state(0, CONFIG_PROPERTY_NAME, INDIGO_OK_STATE));
	ASSERT_TRUE(connect_device(0, false));
	ASSERT_EQ_INT(-1, state(0, PIXEL_PROPERTY));
}

static void finite_stream(void) {
	ASSERT_TRUE(connect_device(0, true));
	ASSERT_TRUE(set_switch(0, "CCD_IMAGE_FORMAT", "RAW", true));
	const char *items[] = { "EXPOSURE", "COUNT" };
	double values[] = { 0.01, 0 };
	ASSERT_EQ_INT(INDIGO_OK, indigo_change_number_property(&test_client, observed[0].name, "CCD_STREAMING", 2, items, values));
	ASSERT_TRUE(wait_state(0, "CCD_STREAMING", INDIGO_OK_STATE));
	ASSERT_EQ_INT(0, cameras[0].video_starts);
	ASSERT_EQ_INT(0, blobs);
	values[1] = 3;
	ASSERT_EQ_INT(INDIGO_OK, indigo_change_number_property(&test_client, observed[0].name, "CCD_STREAMING", 2, items, values));
	ASSERT_TRUE(wait_count(&blobs, 3));
	ASSERT_TRUE(wait_state(0, "CCD_STREAMING", INDIGO_OK_STATE));
	ASSERT_EQ_INT(3, atomic_load(&cameras[0].frames));
}

static void failed_readout_recovers(void) {
	ASSERT_TRUE(connect_device(0, true));
	atomic_store(&cameras[0].read_error, ASI_ERROR_GENERAL_ERROR);
	ASSERT_EQ_INT(INDIGO_OK, indigo_change_number_property_1(&test_client, observed[0].name, "CCD_EXPOSURE", "EXPOSURE", 0.01));
	ASSERT_TRUE(wait_state(0, "CCD_EXPOSURE", INDIGO_ALERT_STATE));
	ASSERT_EQ_INT(0, atomic_load(&blobs));
	atomic_store(&cameras[0].read_error, 0);
	ASSERT_EQ_INT(INDIGO_OK, indigo_change_number_property_1(&test_client, observed[0].name, "CCD_EXPOSURE", "EXPOSURE", 0.01));
	ASSERT_TRUE(wait_count(&blobs, 1));
}

static void guider_shared_session(void) {
	ASSERT_TRUE(connect_device(1, true));
	ASSERT_TRUE(connect_device(0, true));
	int opens = cameras[0].opens;
	ASSERT_EQ_INT(INDIGO_OK, indigo_change_number_property_1(&test_client, observed[1].name, "GUIDER_GUIDE_RA", "EAST", 20));
	ASSERT_TRUE(wait_state(1, "GUIDER_GUIDE_RA", INDIGO_OK_STATE));
	ASSERT_EQ_INT(0, cameras[0].relays);
	ASSERT_TRUE(connect_device(0, false));
	ASSERT_TRUE(cameras[0].opened);
	ASSERT_TRUE(connect_device(1, false));
	ASSERT_FALSE(cameras[0].opened);
	ASSERT_EQ_INT(opens, cameras[0].opens);
}

static void open_init_rollback(void) {
	cameras[0].open_error = 1;
	ASSERT_TRUE(set_switch(0, "CONNECTION", "CONNECTED", true));
	ASSERT_TRUE(wait_state(0, "CONNECTION", INDIGO_ALERT_STATE));
	ASSERT_EQ_INT(0, lock_count);
	cameras[0].open_error = 0;
	cameras[0].init_error = 1;
	ASSERT_TRUE(set_switch(0, "CONNECTION", "CONNECTED", true));
	ASSERT_TRUE(wait_state(0, "CONNECTION", INDIGO_ALERT_STATE));
	ASSERT_FALSE(cameras[0].opened);
	ASSERT_EQ_INT(cameras[0].opens, cameras[0].closes);
	cameras[0].init_error = 0;
	ASSERT_TRUE(connect_device(0, true));
}

static void formats_and_roi(void) {
	ASSERT_TRUE(connect_device(0, true));
	ASSERT_TRUE(set_switch(0, "CCD_IMAGE_FORMAT", "RAW", true));
	const char *formats[] = { "RAW 8", "RAW 16", "RGB 24", "Y 8" };
	for (int i = 0; i < ARRAY_SIZE(formats); i++) {
		ASSERT_TRUE(set_switch(0, PIXEL_PROPERTY, formats[i], true));
		ASSERT_TRUE(wait_state(0, PIXEL_PROPERTY, INDIGO_OK_STATE));
		ASSERT_EQ_INT(INDIGO_OK, indigo_change_number_property_1(&test_client, observed[0].name, "CCD_EXPOSURE", "EXPOSURE", 0.01));
		ASSERT_TRUE(wait_state(0, "CCD_EXPOSURE", INDIGO_OK_STATE));
		ASSERT_TRUE(wait_count(&blobs, i + 1));
	}
	const char *items[] = { "LEFT", "TOP", "WIDTH", "HEIGHT" };
	double values[] = { 16, 24, 256, 256 };
	ASSERT_EQ_INT(INDIGO_OK, indigo_change_number_property(&test_client, observed[0].name, "CCD_FRAME", 4, items, values));
	ASSERT_TRUE(wait_state(0, "CCD_FRAME", INDIGO_OK_STATE));
	ASSERT_EQ_INT(INDIGO_OK, indigo_change_number_property_1(&test_client, observed[0].name, "CCD_BIN", "HORIZONTAL", 2));
	ASSERT_TRUE(wait_state(0, "CCD_BIN", INDIGO_OK_STATE));
	ASSERT_EQ_INT(INDIGO_OK, indigo_change_number_property_1(&test_client, observed[0].name, "CCD_EXPOSURE", "EXPOSURE", 0.01));
	ASSERT_TRUE(wait_state(0, "CCD_EXPOSURE", INDIGO_OK_STATE));
	ASSERT_TRUE(wait_count(&blobs, 5));
	ASSERT_EQ_INT(128, cameras[0].width);
	ASSERT_EQ_INT(8, cameras[0].left);
	ASSERT_EQ_INT(12, cameras[0].top);
}

static void configuration_roundtrip(void) {
	ASSERT_TRUE(connect_device(0, true));
	ASSERT_EQ_INT(INDIGO_OK, indigo_change_number_property_1(&test_client, observed[0].name, ADVANCED_PROPERTY, "WB_R", 52));
	ASSERT_TRUE(wait_state(0, ADVANCED_PROPERTY, INDIGO_OK_STATE));
	ASSERT_TRUE(set_switch(0, "CONFIG", "SAVE", true));
	ASSERT_TRUE(wait_state(0, "CONFIG", INDIGO_OK_STATE));
	ASSERT_EQ_INT(INDIGO_OK, indigo_change_number_property_1(&test_client, observed[0].name, ADVANCED_PROPERTY, "WB_R", 70));
	ASSERT_TRUE(wait_state(0, ADVANCED_PROPERTY, INDIGO_OK_STATE));
	ASSERT_TRUE(set_switch(0, "CONFIG", "LOAD", true));
	ASSERT_TRUE(wait_state(0, "CONFIG", INDIGO_OK_STATE));
	ASSERT_EQ_INT(52, cameras[0].config[ASI_WB_R]);
}

static void start_failure_is_immediate(void) {
	ASSERT_TRUE(connect_device(0, true));
	cameras[0].start_error = 1;
	ASSERT_EQ_INT(INDIGO_OK, indigo_change_number_property_1(&test_client, observed[0].name, "CCD_EXPOSURE", "EXPOSURE", 30));
	ASSERT_TRUE(wait_state(0, "CCD_EXPOSURE", INDIGO_ALERT_STATE));
	ASSERT_EQ_INT(0, blobs);
	cameras[0].start_error = 0;
	ASSERT_EQ_INT(INDIGO_OK, indigo_change_number_property_1(&test_client, observed[0].name, "CCD_EXPOSURE", "EXPOSURE", 0.01));
	ASSERT_TRUE(wait_count(&blobs, 1));
}

static void advanced_failure_is_alert(void) {
	ASSERT_TRUE(connect_device(0, true));
	cameras[0].write_config_fail = ASI_WB_R + 1;
	ASSERT_EQ_INT(INDIGO_OK, indigo_change_number_property_1(&test_client, observed[0].name, ADVANCED_PROPERTY, "WB_R", 52));
	ASSERT_TRUE(wait_state(0, ADVANCED_PROPERTY, INDIGO_ALERT_STATE));
	ASSERT_EQ_INT(0, cameras[0].config[ASI_WB_R]);
	cameras[0].write_config_fail = 0;
	ASSERT_EQ_INT(INDIGO_OK, indigo_change_number_property_1(&test_client, observed[0].name, ADVANCED_PROPERTY, "WB_R", 52));
	ASSERT_TRUE(wait_state(0, ADVANCED_PROPERTY, INDIGO_OK_STATE));
	ASSERT_EQ_INT(52, cameras[0].config[ASI_WB_R]);
}

static void initialization_read_rollback(void) {
	const ASI_CONTROL_TYPE reads[] = { ASI_EXPOSURE, ASI_GAIN, ASI_GAMMA, ASI_OFFSET, ASI_COOLER_POWER_PERC, ASI_BANDWIDTHOVERLOAD };
	for (int i = 0; i < ARRAY_SIZE(reads); i++) {
		cameras[0].read_config_fail = reads[i] + 1;
		ASSERT_TRUE(set_switch(0, "CONNECTION", "CONNECTED", true));
		ASSERT_TRUE(wait_state(0, "CONNECTION", INDIGO_ALERT_STATE));
		ASSERT_FALSE(cameras[0].opened);
		ASSERT_EQ_INT(cameras[0].opens, cameras[0].closes);
	}
	cameras[0].read_config_fail = 0;
	ASSERT_TRUE(connect_device(0, true));
}

static void setup_read_failure_recovers(void) {
	ASSERT_TRUE(connect_device(0, true));
	cameras[0].roi_error = 1;
	ASSERT_EQ_INT(INDIGO_OK, indigo_change_number_property_1(&test_client, observed[0].name, "CCD_EXPOSURE", "EXPOSURE", 30));
	ASSERT_TRUE(wait_state(0, "CCD_EXPOSURE", INDIGO_ALERT_STATE));
	ASSERT_EQ_INT(0, cameras[0].starts);
	cameras[0].roi_error = 0;
	ASSERT_EQ_INT(INDIGO_OK, indigo_change_number_property_1(&test_client, observed[0].name, "CCD_EXPOSURE", "EXPOSURE", 0.01));
	ASSERT_TRUE(wait_count(&blobs, 1));
}

static bool poll_temperature(void);

static void temperature_read_failure(void) {
	ASSERT_TRUE(connect_device(0, true));
	cameras[0].read_config_fail = ASI_TEMPERATURE + 1;
	ASSERT_TRUE(poll_temperature());
	ASSERT_TRUE(wait_state(0, "CCD_TEMPERATURE", INDIGO_ALERT_STATE));
	cameras[0].read_config_fail = 0;
}

static void long_stream_abort_restart(void) {
	ASSERT_TRUE(connect_device(0, true));
	ASSERT_TRUE(set_switch(0, "CCD_IMAGE_FORMAT", "RAW", true));
	const char *items[] = { "EXPOSURE", "COUNT" };
	double values[] = { 2.5, -1 };
	ASSERT_EQ_INT(INDIGO_OK, indigo_change_number_property(&test_client, observed[0].name, "CCD_STREAMING", 2, items, values));
	ASSERT_TRUE(wait_count(&blobs, 1));
	ASSERT_TRUE(wait_count(&blobs, 2));
	ASSERT_TRUE(set_switch(0, "CCD_ABORT_EXPOSURE", "ABORT_EXPOSURE", true));
	ASSERT_TRUE(wait_state(0, "CCD_ABORT_EXPOSURE", INDIGO_OK_STATE));
	ASSERT_EQ_INT(INDIGO_OK_STATE, state(0, "CCD_STREAMING"));
	ASSERT_FALSE(cameras[0].video);
	values[0] = 0.1;
	values[1] = 2;
	ASSERT_EQ_INT(INDIGO_OK, indigo_change_number_property(&test_client, observed[0].name, "CCD_STREAMING", 2, items, values));
	ASSERT_TRUE(wait_state(0, "CCD_STREAMING", INDIGO_OK_STATE));
	ASSERT_TRUE(wait_count(&blobs, 4));
}

static void abort_overtakes_pending_start(void) {
	ASSERT_TRUE(connect_device(0, true));
	arm_gate(&queue_gate);
	indigo_execute_handler(logical[0], block_queue);
	ASSERT_TRUE(wait_count(&queue_gate.entered, 1));
	ASSERT_EQ_INT(INDIGO_OK, indigo_change_number_property_1(&test_client, observed[0].name, "CCD_EXPOSURE", "EXPOSURE", 30));
	ASSERT_TRUE(set_switch(0, "CCD_ABORT_EXPOSURE", "ABORT_EXPOSURE", true));
	release_gate(&queue_gate);
	ASSERT_TRUE(wait_state(0, "CCD_ABORT_EXPOSURE", INDIGO_OK_STATE));
	ASSERT_EQ_INT(0, cameras[0].starts);
	ASSERT_EQ_INT(0, blobs);
	ASSERT_EQ_INT(INDIGO_ALERT_STATE, state(0, "CCD_EXPOSURE"));
}

static void idle_abort_terminal(void) {
	ASSERT_TRUE(connect_device(0, true));
	ASSERT_TRUE(set_switch(0, "CCD_ABORT_EXPOSURE", "ABORT_EXPOSURE", true));
	ASSERT_TRUE(wait_state(0, "CCD_ABORT_EXPOSURE", INDIGO_ALERT_STATE));
}

static void guide_all_axes_and_disconnect(void) {
	ASSERT_TRUE(connect_device(0, true));
	ASSERT_TRUE(connect_device(1, true));
	const char *directions[] = { "NORTH", "SOUTH", "EAST", "WEST" };
	for (int i = 0; i < ARRAY_SIZE(directions); i++) {
		const char *property = i < 2 ? "GUIDER_GUIDE_DEC" : "GUIDER_GUIDE_RA";
		ASSERT_EQ_INT(INDIGO_OK, indigo_change_number_property_1(&test_client, observed[1].name, property, directions[i], 20));
		ASSERT_TRUE(wait_state(1, property, INDIGO_OK_STATE));
		ASSERT_EQ_INT(0, cameras[0].relays);
	}
	ASSERT_EQ_INT(INDIGO_OK, indigo_change_number_property_1(&test_client, observed[1].name, "GUIDER_GUIDE_RA", "EAST", 1000));
	ASSERT_TRUE(wait_state(1, "GUIDER_GUIDE_RA", INDIGO_BUSY_STATE));
	ASSERT_EQ_INT(INDIGO_OK, indigo_change_number_property_1(&test_client, observed[1].name, "GUIDER_GUIDE_DEC", "NORTH", 1000));
	ASSERT_TRUE(wait_state(1, "GUIDER_GUIDE_DEC", INDIGO_BUSY_STATE));
	ASSERT_TRUE(connect_device(1, false));
	ASSERT_EQ_INT(0, cameras[0].relays);
	ASSERT_TRUE(cameras[0].opened);
}

static double number_value(int index, const char *property, const char *item) {
	indigo_property *p = snapshot(index, property);
	double result = NAN;
	if (p) {
		for (int i = 0; i < p->count; i++) {
			if (!strcmp(p->items[i].name, item)) {
				result = p->items[i].number.value;
			}
		}
	}
	indigo_release_property(p);
	return result;
}

static bool take_image(int index, double exposure) {
	int expected = blobs + 1;
	return set_switch(index, "CCD_IMAGE_FORMAT", "RAW", true) && indigo_change_number_property_1(&test_client, observed[index].name, "CCD_EXPOSURE", "EXPOSURE", exposure) == INDIGO_OK && wait_state(index, "CCD_EXPOSURE", INDIGO_OK_STATE) && wait_count(&blobs, expected);
}

static bool drain_discovery(void) {
	int expected = barriers + 1;
	indigo_queue_add(driver_queue, NULL, INDIGO_TASK_PRIORITY_NORMAL, 0, queue_barrier, NULL);
	return wait_count(&barriers, expected);
}

static bool remove_initial(void) {
	cameras[0].visible = false;
	usb_event(0, false);
	return wait_count(&attached, 0);
}

static void discovery_identity_and_reordering(void) {
	ASSERT_TRUE(remove_initial());
	cameras[0].info.CameraID = 4096;
	cameras[1].info.CameraID = INT_MAX;
	strcpy(cameras[0].info.Name, "ASI same 100% (CAM0)");
	strcpy(cameras[1].info.Name, "ASI same 100% (CAM1)");
	memcpy(cameras[0].suffix.id, "12345678", 8);
	memcpy(cameras[1].suffix.id, "12345678", 8);
	cameras[0].visible = cameras[1].visible = true;
	reverse_discovery = true;
	usb_event(0, true);
	usb_event(1, true);
	ASSERT_TRUE(wait_count(&attached, 4));
	ASSERT_TRUE(strcmp(observed[0].name, observed[2].name));
	ASSERT_TRUE(strstr(observed[0].name, "100%") != NULL);
	ASSERT_TRUE(connect_device(0, true));
	ASSERT_TRUE(connect_device(2, true));
	ASSERT_TRUE(take_image(0, 0.01));
	ASSERT_TRUE(take_image(2, 0.01));
	usb_event(0, true);
	ASSERT_TRUE(drain_discovery());
	ASSERT_EQ_INT(4, attached);
	cameras[0].visible = false;
	usb_event(1, false); // USB pointer and SDK discovery identity intentionally differ.
	ASSERT_TRUE(wait_count(&attached, 2));
	ASSERT_TRUE(logical[2] != NULL && logical[0] == NULL);
	ASSERT_TRUE(take_image(2, 0.01));
}

static void discovery_filter_failures_retry(void) {
	ASSERT_TRUE(remove_initial());
	cameras[0].visible = true;
	wrong_vendor = 1;
	usb_event(0, true);
	ASSERT_TRUE(drain_discovery());
	ASSERT_EQ_INT(0, attached);
	wrong_vendor = 0;
	fail_descriptor = 1;
	usb_event(0, true);
	ASSERT_TRUE(drain_discovery());
	ASSERT_EQ_INT(0, attached);
	fail_descriptor = 0;
	wrong_product = 1;
	usb_event(0, true);
	ASSERT_TRUE(drain_discovery());
	ASSERT_EQ_INT(0, attached);
	wrong_product = 0;
	discovery_fail = 1;
	usb_event(0, true);
	ASSERT_TRUE(drain_discovery());
	ASSERT_EQ_INT(0, attached);
	discovery_fail = 0;
	ASSERT_TRUE(wait_count(&attached, 2)); // generated retry, no second event
	count_fail = 1;
	usb_event(0, false);
	ASSERT_TRUE(drain_discovery());
	ASSERT_EQ_INT(2, attached);
	count_fail = 0;
	discovery_fail = 1;
	usb_event(0, false);
	ASSERT_TRUE(drain_discovery());
	ASSERT_EQ_INT(2, attached);
	discovery_fail = 0;
	ASSERT_TRUE(connect_device(0, true));
	ASSERT_TRUE(take_image(0, 0.01));
}

static void discovery_attach_and_init_rollback(void) {
	ASSERT_EQ_INT(INDIGO_OK, indigo_ccd_asi(INDIGO_DRIVER_SHUTDOWN, NULL));
	ASSERT_EQ_INT(0, attached);
	fail_queue = 1;
	ASSERT_EQ_INT(INDIGO_FAILED, indigo_ccd_asi(INDIGO_DRIVER_INIT, NULL));
	fail_queue = 0;
	fail_register = 1;
	ASSERT_EQ_INT(INDIGO_FAILED, indigo_ccd_asi(INDIGO_DRIVER_INIT, NULL));
	fail_register = 0;
	fail_attach = 1;
	ASSERT_EQ_INT(INDIGO_OK, indigo_ccd_asi(INDIGO_DRIVER_INIT, NULL));
	ASSERT_TRUE(wait_count(&attached, 2));
	ASSERT_TRUE(remove_initial());
	fail_guider_attach = 1;
	cameras[0].visible = true;
	usb_event(0, true);
	ASSERT_TRUE(wait_count(&attached, 1));
	ASSERT_TRUE(logical[0] != NULL && logical[1] == NULL);
	ASSERT_TRUE(connect_device(0, true));
	ASSERT_TRUE(take_image(0, 0.01));
	ASSERT_TRUE(connect_device(0, false));
}

static void malformed_identity_recovery(void) {
	ASSERT_TRUE(remove_initial());
	cameras[0].visible = true;
	ASI_CAMERA_INFO valid = cameras[0].info;
	for (int mode = 0; mode < 5; mode++) {
		cameras[0].info = valid;
		if (mode == 0) {
			cameras[0].info.CameraID = -1;
		} else if (mode == 1) {
			cameras[0].info.MaxWidth = 0;
		} else if (mode == 2) {
			cameras[0].info.PixelSize = NAN;
		} else if (mode == 3) {
			cameras[0].info.SupportedBins[0] = -1;
		} else {
			cameras[0].info.SupportedVideoFormat[0] = 99;
		}
		usb_event(0, true);
		ASSERT_TRUE(drain_discovery());
		ASSERT_EQ_INT(0, attached);
		usb_event(0, false); // cancel retry before changing the fixture metadata
		ASSERT_TRUE(drain_discovery());
	}
	cameras[0].info = valid;
	memset(cameras[0].info.Name, '%', sizeof(cameras[0].info.Name));
	usb_event(0, true);
	ASSERT_TRUE(wait_count(&attached, 2));
	ASSERT_TRUE(connect_device(0, true));
	ASSERT_TRUE(take_image(0, 0.01));
}

static void limited_formats_and_bins(void) {
	ASSERT_TRUE(remove_initial());
	cameras[0].info.ST4Port = false;
	cameras[0].info.IsColorCam = false;
	cameras[0].info.IsCoolerCam = false;
	cameras[0].info.SupportedVideoFormat[0] = ASI_IMG_RAW16;
	cameras[0].info.SupportedVideoFormat[1] = ASI_IMG_END;
	cameras[0].info.SupportedBins[1] = 4;
	cameras[0].visible = true;
	usb_event(0, true);
	ASSERT_TRUE(wait_count(&attached, 1));
	ASSERT_TRUE(connect_device(0, true));
	indigo_property *p = snapshot(0, PIXEL_PROPERTY);
	ASSERT_EQ_INT(1, p->count);
	ASSERT_TRUE(p->items[0].sw.value);
	indigo_release_property(p);
	ASSERT_TRUE(take_image(0, 0.01));
	ASSERT_EQ_INT(ASI_IMG_RAW16, cameras[0].format);
	ASSERT_EQ_INT(INDIGO_OK, indigo_change_number_property_1(&test_client, observed[0].name, "CCD_BIN", "HORIZONTAL", 3));
	ASSERT_TRUE(wait_state(0, "CCD_BIN", INDIGO_ALERT_STATE));
	ASSERT_EQ_INT(1, number_value(0, "CCD_BIN", "HORIZONTAL"));
	ASSERT_EQ_INT(INDIGO_OK, indigo_change_number_property_1(&test_client, observed[0].name, "CCD_BIN", "VERTICAL", 4));
	ASSERT_TRUE(wait_state(0, "CCD_BIN", INDIGO_OK_STATE));
	ASSERT_TRUE(take_image(0, 0.01));
	ASSERT_EQ_INT(4, cameras[0].bin);
}

static void malformed_geometry_and_recovery(void) {
	ASSERT_TRUE(connect_device(0, true));
	cameras[0].malformed_roi = 1;
	ASSERT_EQ_INT(INDIGO_OK, indigo_change_number_property_1(&test_client, observed[0].name, "CCD_EXPOSURE", "EXPOSURE", 0.01));
	ASSERT_TRUE(wait_state(0, "CCD_EXPOSURE", INDIGO_ALERT_STATE));
	ASSERT_EQ_INT(0, cameras[0].starts);
	cameras[0].malformed_roi = 0;
	ASSERT_TRUE(take_image(0, 0.01));
}

static void control_failures_and_presets(void) {
	ASSERT_TRUE(connect_device(0, true));
	const char *properties[] = { "CCD_GAIN", "CCD_GAMMA", "CCD_OFFSET" };
	const char *items[] = { "GAIN", "GAMMA", "OFFSET" };
	const int controls[] = { ASI_GAIN, ASI_GAMMA, ASI_OFFSET };
	for (int i = 0; i < 3; i++) {
		ASSERT_EQ_INT(INDIGO_OK, indigo_change_number_property_1(&test_client, observed[0].name, properties[i], items[i], 20));
		ASSERT_TRUE(wait_state(0, properties[i], INDIGO_OK_STATE));
		ASSERT_EQ_INT(20, cameras[0].config[controls[i]]);
		cameras[0].write_config_fail = controls[i] + 1;
		ASSERT_EQ_INT(INDIGO_OK, indigo_change_number_property_1(&test_client, observed[0].name, properties[i], items[i], 30));
		ASSERT_TRUE(wait_state(0, properties[i], INDIGO_ALERT_STATE));
		ASSERT_EQ_INT(20, number_value(0, properties[i], items[i]));
		cameras[0].write_config_fail = 0;
		cameras[0].read_config_fail = controls[i] + 1;
		ASSERT_EQ_INT(INDIGO_OK, indigo_change_number_property_1(&test_client, observed[0].name, properties[i], items[i], 30));
		ASSERT_TRUE(wait_state(0, properties[i], INDIGO_ALERT_STATE));
		ASSERT_EQ_INT(20, number_value(0, properties[i], items[i]));
		cameras[0].read_config_fail = 0;
	}
	const char *presets[] = { "ASI_HIGHEST_DR", "ASI_UNITY_GAIN", "ASI_LOWEST_RN" };
	const int gains[] = { 0, 60, 75 }, offsets[] = { 5, 10, 20 };
	for (int i = 0; i < 3; i++) {
		ASSERT_TRUE(set_switch(0, PRESETS_PROPERTY, presets[i], true));
		ASSERT_TRUE(wait_state(0, PRESETS_PROPERTY, INDIGO_OK_STATE));
		ASSERT_EQ_INT(gains[i], cameras[0].config[ASI_GAIN]);
		ASSERT_EQ_INT(offsets[i], cameras[0].config[ASI_OFFSET]);
	}
	cameras[0].write_config_fail = ASI_OFFSET + 1;
	ASSERT_TRUE(set_switch(0, PRESETS_PROPERTY, presets[0], true));
	ASSERT_TRUE(wait_state(0, PRESETS_PROPERTY, INDIGO_ALERT_STATE));
	ASSERT_EQ_INT(0, cameras[0].config[ASI_GAIN]);
	ASSERT_EQ_INT(20, cameras[0].config[ASI_OFFSET]);
	cameras[0].write_config_fail = 0;
	cameras[0].egain_error = 1;
	ASSERT_EQ_INT(INDIGO_OK, indigo_change_number_property_1(&test_client, observed[0].name, "CCD_GAIN", "GAIN", 40));
	ASSERT_TRUE(wait_state(0, "CCD_EGAIN", INDIGO_ALERT_STATE));
	cameras[0].egain_error = 0;
	ASSERT_TRUE(take_image(0, 0.01));
}

static void suffix_boundaries_and_failure(void) {
	ASSERT_TRUE(connect_device(0, true));
	const char *values[] = { "a", "12345678", "" };
	for (int i = 0; i < 3; i++) {
		ASSERT_EQ_INT(INDIGO_OK, indigo_change_text_property_1(&test_client, observed[0].name, SUFFIX_PROPERTY, "SUFFIX", values[i]));
		ASSERT_TRUE(wait_state(0, SUFFIX_PROPERTY, INDIGO_OK_STATE));
		ASSERT_EQ_INT(0, memcmp(cameras[0].suffix.id, values[i], strlen(values[i])));
	}
	ASSERT_EQ_INT(INDIGO_OK, indigo_change_text_property_1(&test_client, observed[0].name, SUFFIX_PROPERTY, "SUFFIX", "123456789"));
	ASSERT_TRUE(wait_state(0, SUFFIX_PROPERTY, INDIGO_ALERT_STATE));
	ASSERT_EQ_INT(0, cameras[0].suffix.id[0]);
	cameras[0].suffix_error = 1;
	ASSERT_EQ_INT(INDIGO_OK, indigo_change_text_property_1(&test_client, observed[0].name, SUFFIX_PROPERTY, "SUFFIX", "failure"));
	ASSERT_TRUE(wait_state(0, SUFFIX_PROPERTY, INDIGO_ALERT_STATE));
	indigo_property *p = snapshot(0, SUFFIX_PROPERTY);
	ASSERT_STREQ("", p->items->text.value);
	indigo_release_property(p);
	cameras[0].suffix_error = 0;
}

static void exposure_status_failures(void) {
	ASSERT_TRUE(connect_device(0, true));
	const int modes[] = { -1, ASI_EXP_IDLE + 1, ASI_EXP_FAILED + 1, 99 };
	for (int i = 0; i < ARRAY_SIZE(modes); i++) {
		cameras[0].status_error = modes[i] < 0;
		cameras[0].forced_status = modes[i] > 0 ? modes[i] : 0;
		ASSERT_EQ_INT(INDIGO_OK, indigo_change_number_property_1(&test_client, observed[0].name, "CCD_EXPOSURE", "EXPOSURE", 0.01));
		ASSERT_TRUE(wait_state(0, "CCD_EXPOSURE", INDIGO_ALERT_STATE));
		ASSERT_EQ_INT(0, blobs);
	}
	cameras[0].status_error = cameras[0].forced_status = 0;
	ASSERT_TRUE(take_image(0, 0.01));
}

static void video_error_paths(void) {
	ASSERT_TRUE(connect_device(0, true));
	const char *items[] = { "EXPOSURE", "COUNT" };
	double values[] = { 0.01, 1 };
	for (int mode = 0; mode < 3; mode++) {
		cameras[0].start_error = mode == 0;
		cameras[0].read_error = mode == 1;
		cameras[0].stop_error = mode == 2;
		ASSERT_EQ_INT(INDIGO_OK, indigo_change_number_property(&test_client, observed[0].name, "CCD_STREAMING", 2, items, values));
		ASSERT_TRUE(wait_state(0, "CCD_STREAMING", INDIGO_ALERT_STATE));
		ASSERT_FALSE(cameras[0].video);
	}
	cameras[0].start_error = cameras[0].read_error = cameras[0].stop_error = 0;
	cameras[0].video_timeouts = 3;
	ASSERT_EQ_INT(INDIGO_OK, indigo_change_number_property(&test_client, observed[0].name, "CCD_STREAMING", 2, items, values));
	ASSERT_TRUE(wait_state(0, "CCD_STREAMING", INDIGO_OK_STATE));
	ASSERT_EQ_INT(cameras[0].video_starts, cameras[0].video_stops);
	ASSERT_EQ_INT(2, blobs);
}

static void finite_video_abort_and_timeout(void) {
	ASSERT_TRUE(connect_device(0, true));
	const char *items[] = { "EXPOSURE", "COUNT" };
	double values[] = { 2.5, 2 };
	ASSERT_EQ_INT(INDIGO_OK, indigo_change_number_property(&test_client, observed[0].name, "CCD_STREAMING", 2, items, values));
	ASSERT_TRUE(wait_count(&cameras[0].video_starts, 1));
	ASSERT_TRUE(set_switch(0, "CCD_ABORT_EXPOSURE", "ABORT_EXPOSURE", true));
	ASSERT_TRUE(wait_state(0, "CCD_ABORT_EXPOSURE", INDIGO_OK_STATE));
	ASSERT_EQ_INT(INDIGO_ALERT_STATE, state(0, "CCD_STREAMING"));
	ASSERT_EQ_INT(0, blobs);
	values[0] = 0.01;
	cameras[0].video_timeouts = 100000;
	ASSERT_EQ_INT(INDIGO_OK, indigo_change_number_property(&test_client, observed[0].name, "CCD_STREAMING", 2, items, values));
	ASSERT_TRUE(wait_state(0, "CCD_STREAMING", INDIGO_ALERT_STATE));
	cameras[0].video_timeouts = 0;
	ASSERT_TRUE(take_image(0, 0.01));
}

static void guide_failures_and_overlap(void) {
	ASSERT_TRUE(connect_device(1, true));
	cameras[0].guide_on_error = 1;
	ASSERT_EQ_INT(INDIGO_OK, indigo_change_number_property_1(&test_client, observed[1].name, "GUIDER_GUIDE_RA", "EAST", 20));
	ASSERT_TRUE(wait_state(1, "GUIDER_GUIDE_RA", INDIGO_ALERT_STATE));
	ASSERT_EQ_INT(0, cameras[0].relays);
	cameras[0].guide_on_error = 0;
	cameras[0].guide_off_error = 1;
	ASSERT_EQ_INT(INDIGO_OK, indigo_change_number_property_1(&test_client, observed[1].name, "GUIDER_GUIDE_RA", "EAST", 20));
	ASSERT_TRUE(wait_state(1, "GUIDER_GUIDE_RA", INDIGO_ALERT_STATE));
	cameras[0].guide_off_error = 0;
	ASSERT_TRUE(connect_device(1, false));
	ASSERT_EQ_INT(0, cameras[0].relays);
	ASSERT_TRUE(connect_device(1, true));
	ASSERT_EQ_INT(INDIGO_OK, indigo_change_number_property_1(&test_client, observed[1].name, "GUIDER_GUIDE_RA", "EAST", 100));
	ASSERT_TRUE(wait_state(1, "GUIDER_GUIDE_RA", INDIGO_BUSY_STATE));
	ASSERT_EQ_INT(INDIGO_OK, indigo_change_number_property_1(&test_client, observed[1].name, "GUIDER_GUIDE_RA", "WEST", 200));
	ASSERT_TRUE(wait_state(1, "GUIDER_GUIDE_RA", INDIGO_OK_STATE));
	ASSERT_EQ_INT(0, cameras[0].relays);
	ASSERT_EQ_INT(INDIGO_OK, indigo_change_number_property_1(&test_client, observed[1].name, "GUIDER_GUIDE_DEC", "NORTH", 0));
	ASSERT_TRUE(wait_state(1, "GUIDER_GUIDE_DEC", INDIGO_OK_STATE));
}

static void readout_abort_and_restart(void) {
	ASSERT_TRUE(connect_device(0, true));
	arm_gate(&read_gate);
	ASSERT_EQ_INT(INDIGO_OK, indigo_change_number_property_1(&test_client, observed[0].name, "CCD_EXPOSURE", "EXPOSURE", 0.01));
	ASSERT_TRUE(wait_count(&read_gate.entered, 1));
	ASSERT_TRUE(set_switch(0, "CCD_ABORT_EXPOSURE", "ABORT_EXPOSURE", true));
	release_gate(&read_gate);
	ASSERT_TRUE(wait_state(0, "CCD_ABORT_EXPOSURE", INDIGO_OK_STATE));
	ASSERT_EQ_INT(0, blobs);
	ASSERT_TRUE(take_image(0, 0.01));
	ASSERT_TRUE(set_switch(0, "CCD_ABORT_EXPOSURE", "ABORT_EXPOSURE", true));
	ASSERT_TRUE(wait_state(0, "CCD_ABORT_EXPOSURE", INDIGO_ALERT_STATE));
	ASSERT_EQ_INT(1, blobs);
}

static void disconnect_readout_with_sibling(void) {
	ASSERT_TRUE(connect_device(0, true));
	ASSERT_TRUE(connect_device(1, true));
	arm_gate(&read_gate);
	ASSERT_EQ_INT(INDIGO_OK, indigo_change_number_property_1(&test_client, observed[0].name, "CCD_EXPOSURE", "EXPOSURE", 0.01));
	ASSERT_TRUE(wait_count(&read_gate.entered, 1));
	ASSERT_TRUE(set_switch(0, "CONNECTION", "DISCONNECTED", true));
	release_gate(&read_gate);
	ASSERT_TRUE(wait_state(0, "CONNECTION", INDIGO_OK_STATE));
	ASSERT_TRUE(cameras[0].opened);
	ASSERT_EQ_INT(0, blobs);
	ASSERT_EQ_INT(INDIGO_OK, indigo_change_number_property_1(&test_client, observed[1].name, "GUIDER_GUIDE_DEC", "SOUTH", 20));
	ASSERT_TRUE(wait_state(1, "GUIDER_GUIDE_DEC", INDIGO_OK_STATE));
	ASSERT_TRUE(connect_device(0, true));
	ASSERT_TRUE(take_image(0, 0.01));
}

static void unplug_active_and_replug(void) {
	ASSERT_TRUE(connect_device(0, true));
	ASSERT_TRUE(connect_device(1, true));
	ASSERT_EQ_INT(INDIGO_OK, indigo_change_number_property_1(&test_client, observed[0].name, "CCD_EXPOSURE", "EXPOSURE", 30));
	ASSERT_TRUE(wait_count(&cameras[0].starts, 1));
	ASSERT_EQ_INT(INDIGO_OK, indigo_change_number_property_1(&test_client, observed[1].name, "GUIDER_GUIDE_RA", "EAST", 3000));
	ASSERT_TRUE(wait_state(1, "GUIDER_GUIDE_RA", INDIGO_BUSY_STATE));
	ASSERT_EQ_INT(INDIGO_BUSY, indigo_ccd_asi(INDIGO_DRIVER_SHUTDOWN, NULL));
	cameras[0].visible = false;
	usb_event(0, false);
	ASSERT_TRUE(wait_count(&attached, 0));
	ASSERT_EQ_INT(0, lock_count);
	ASSERT_FALSE(cameras[0].opened);
	cameras[0].visible = true;
	usb_event(0, true);
	ASSERT_TRUE(wait_count(&attached, 2));
	ASSERT_TRUE(connect_device(0, true));
	ASSERT_TRUE(take_image(0, 0.01));
}

static void frame_types_and_fractional_countdown(void) {
	ASSERT_TRUE(connect_device(0, true));
	const char *types[] = { "LIGHT", "DARK", "FLAT", "DARKFLAT", "BIAS" };
	for (int i = 0; i < ARRAY_SIZE(types); i++) {
		ASSERT_TRUE(set_switch(0, "CCD_FRAME_TYPE", types[i], true));
		ASSERT_TRUE(take_image(0, 0.1));
		ASSERT_EQ_INT(i == 1 || i == 3 || i == 4, cameras[0].dark);
		ASSERT_EQ_INT(i == 4 ? 100 : 100000, cameras[0].config[ASI_EXPOSURE]);
	}
	ASSERT_TRUE(set_switch(0, "CCD_FRAME_TYPE", "LIGHT", true));
	ASSERT_TRUE(take_image(0, 1.5));
	ASSERT_EQ_INT(1500000, cameras[0].config[ASI_EXPOSURE]);
	ASSERT_EQ_INT(INDIGO_OK, indigo_change_number_property_1(&test_client, observed[0].name, "CCD_EXPOSURE", "EXPOSURE", 2.5));
	ASSERT_TRUE(wait_count(&cameras[0].starts, 7));
	arm_gate(&queue_gate);
	indigo_execute_handler(logical[0], block_queue);
	ASSERT_TRUE(wait_count(&queue_gate.entered, 1));
	double deadline = indigo_monotonic_time() + 2;
	while (number_value(0, "CCD_EXPOSURE", "EXPOSURE") >= 2.5 && indigo_monotonic_time() < deadline) {
		indigo_usleep(10000);
	}
	ASSERT_TRUE(number_value(0, "CCD_EXPOSURE", "EXPOSURE") < 2.5);
	release_gate(&queue_gate);
	ASSERT_TRUE(wait_state(0, "CCD_EXPOSURE", INDIGO_OK_STATE));
	ASSERT_EQ_INT(2500000, cameras[0].config[ASI_EXPOSURE]);
}

static void capability_rebuild_and_cooling(void) {
	cameras[0].reverse_controls = 1;
	cameras[0].readonly_control = ASI_GAMMA + 1;
	cameras[0].config[ASI_TARGET_TEMP] = -5;
	cameras[0].config[ASI_COOLER_ON] = 1;
	ASSERT_TRUE(connect_device(0, true));
	indigo_property *p = snapshot(0, "CCD_GAMMA");
	ASSERT_EQ_INT(INDIGO_RO_PERM, p->perm);
	indigo_release_property(p);
	p = snapshot(0, "CCD_TEMPERATURE");
	ASSERT_EQ_INT(INDIGO_RW_PERM, p->perm);
	ASSERT_EQ_INT(-5, p->items->number.target);
	indigo_release_property(p);
	ASSERT_EQ_INT(45, cameras[0].config[ASI_BANDWIDTHOVERLOAD]);
	ASSERT_EQ_INT(0, cameras[0].config[ASI_GPS_SUPPORT]);
	ASSERT_EQ_INT(0, cameras[0].config[ASI_ROLLING_INTERVAL]);
	ASSERT_TRUE(connect_device(0, false));
	cameras[0].reverse_controls = cameras[0].readonly_control = 0;
	cameras[0].missing_control = ASI_GAMMA + 1;
	ASSERT_TRUE(connect_device(0, true));
	ASSERT_EQ_INT(-1, state(0, "CCD_GAMMA"));
	ASSERT_TRUE(connect_device(0, false));
	cameras[0].missing_control = ASI_TARGET_TEMP + 1;
	ASSERT_TRUE(connect_device(0, true));
	p = snapshot(0, "CCD_TEMPERATURE");
	ASSERT_EQ_INT(INDIGO_RO_PERM, p->perm);
	indigo_release_property(p);
}

static void sensor_only_and_sensor_absent(void) {
	ASSERT_TRUE(remove_initial());
	cameras[0].info.IsCoolerCam = false;
	cameras[0].info.ST4Port = false;
	cameras[0].visible = true;
	usb_event(0, true);
	ASSERT_TRUE(wait_count(&attached, 1));
	ASSERT_TRUE(connect_device(0, true));
	ASSERT_EQ_INT(-1, state(0, "CCD_COOLER"));
	ASSERT_EQ_INT(-1, state(0, "CCD_COOLER_POWER"));
	indigo_property *p = snapshot(0, "CCD_TEMPERATURE");
	ASSERT_TRUE(p != NULL);
	ASSERT_EQ_INT(INDIGO_RO_PERM, p->perm);
	indigo_release_property(p);
	ASSERT_TRUE(poll_temperature());
	ASSERT_EQ_INT(INDIGO_OK_STATE, state(0, "CCD_TEMPERATURE"));
	ASSERT_TRUE(take_image(0, 0.01));
	ASSERT_TRUE(connect_device(0, false));
	cameras[0].missing_control = ASI_TEMPERATURE + 1;
	cameras[0].reverse_controls = 1;
	ASSERT_TRUE(connect_device(0, true));
	ASSERT_EQ_INT(-1, state(0, "CCD_TEMPERATURE"));
	ASSERT_EQ_INT(-1, state(0, "CCD_COOLER"));
	ASSERT_EQ_INT(-1, state(0, "CCD_COOLER_POWER"));
	ASSERT_TRUE(take_image(0, 0.01));
}

static void control_metadata_rollback(void) {
	atomic_int *failures[] = { &cameras[0].config_error, &cameras[0].caps_fail, &cameras[0].malformed_caps, &cameras[0].gain_offset_error };
	for (int i = 0; i < ARRAY_SIZE(failures); i++) {
		atomic_store(failures[i], 1);
		ASSERT_TRUE(set_switch(0, "CONNECTION", "CONNECTED", true));
		ASSERT_TRUE(wait_state(0, "CONNECTION", INDIGO_ALERT_STATE));
		ASSERT_FALSE(cameras[0].opened);
		ASSERT_EQ_INT(0, lock_count);
		atomic_store(failures[i], 0);
	}
	fail_lock = 1;
	ASSERT_TRUE(set_switch(0, "CONNECTION", "CONNECTED", true));
	ASSERT_TRUE(wait_state(0, "CONNECTION", INDIGO_ALERT_STATE));
	ASSERT_FALSE(cameras[0].opened);
	fail_lock = 0;
	ASSERT_TRUE(connect_device(0, true));
	ASSERT_TRUE(take_image(0, 0.01));
}

static void malformed_numeric_readback(void) {
	ASSERT_TRUE(connect_device(0, true));
	cameras[0].read_value_control = ASI_GAIN + 1;
	cameras[0].read_value = LONG_MAX;
	ASSERT_EQ_INT(INDIGO_OK, indigo_change_number_property_1(&test_client, observed[0].name, "CCD_GAIN", "GAIN", 20));
	ASSERT_TRUE(wait_state(0, "CCD_GAIN", INDIGO_ALERT_STATE));
	ASSERT_EQ_INT(0, number_value(0, "CCD_GAIN", "GAIN"));
	cameras[0].read_value_control = ASI_WB_R + 1;
	ASSERT_EQ_INT(INDIGO_OK, indigo_change_number_property_1(&test_client, observed[0].name, ADVANCED_PROPERTY, "WB_R", 20));
	ASSERT_TRUE(wait_state(0, ADVANCED_PROPERTY, INDIGO_ALERT_STATE));
	ASSERT_EQ_INT(0, number_value(0, ADVANCED_PROPERTY, "WB_R"));
	cameras[0].read_value_control = 0;
	ASSERT_TRUE(take_image(0, 0.01));
}

static bool poll_temperature(void) {
	indigo_timer_callback callback = temperature_handler;
	if (!callback) {
		return false;
	}
	indigo_cancel_pending_handler(logical[0], callback);
	remember_request(observed[0].name, "CCD_TEMPERATURE");
	remember_request(observed[0].name, "CCD_COOLER");
	indigo_execute_handler(logical[0], callback);
	int expected = barriers + 1;
	indigo_execute_handler(logical[0], queue_barrier);
	return wait_count(&barriers, expected);
}

static void cooling_reads_writes_and_settling(void) {
	ASSERT_TRUE(connect_device(0, true));
	ASSERT_EQ_INT(INDIGO_OK_STATE, state(0, "CCD_TEMPERATURE"));
	ASSERT_TRUE(set_switch(0, "CCD_COOLER", "ON", true));
	ASSERT_TRUE(poll_temperature());
	ASSERT_EQ_INT(INDIGO_OK_STATE, state(0, "CCD_COOLER"));
	ASSERT_EQ_INT(1, cameras[0].config[ASI_COOLER_ON]);
	cameras[0].config[ASI_TEMPERATURE] = 0;
	ASSERT_TRUE(poll_temperature());
	ASSERT_EQ_INT(INDIGO_OK_STATE, state(0, "CCD_TEMPERATURE"));
	ASSERT_EQ_INT(INDIGO_OK, indigo_change_number_property_1(&test_client, observed[0].name, "CCD_TEMPERATURE", "TEMPERATURE", -5));
	ASSERT_TRUE(poll_temperature());
	ASSERT_EQ_INT(INDIGO_OK_STATE, state(0, "CCD_COOLER"));
	ASSERT_EQ_INT(-5, cameras[0].config[ASI_TARGET_TEMP]);
	ASSERT_EQ_INT(INDIGO_BUSY_STATE, state(0, "CCD_TEMPERATURE"));
	cameras[0].config[ASI_TEMPERATURE] = -50;
	cameras[0].config[ASI_COOLER_POWER_PERC] = 37;
	ASSERT_TRUE(poll_temperature());
	ASSERT_EQ_INT(INDIGO_OK_STATE, state(0, "CCD_TEMPERATURE"));
	ASSERT_EQ_INT(-5, number_value(0, "CCD_TEMPERATURE", "TEMPERATURE"));
	ASSERT_EQ_INT(37, number_value(0, "CCD_COOLER_POWER", "POWER"));
	const int controls[] = { ASI_TEMPERATURE, ASI_COOLER_ON, ASI_TARGET_TEMP, ASI_COOLER_POWER_PERC };
	for (int i = 0; i < ARRAY_SIZE(controls); i++) {
		cameras[0].read_config_fail = controls[i] + 1;
		ASSERT_TRUE(poll_temperature());
		ASSERT_EQ_INT(INDIGO_ALERT_STATE, state(0, "CCD_TEMPERATURE"));
		ASSERT_EQ_INT(-5, number_value(0, "CCD_TEMPERATURE", "TEMPERATURE"));
		cameras[0].read_config_fail = 0;
		ASSERT_TRUE(poll_temperature());
		ASSERT_EQ_INT(INDIGO_OK_STATE, state(0, "CCD_TEMPERATURE"));
	}
	cameras[0].write_config_fail = ASI_TARGET_TEMP + 1;
	ASSERT_EQ_INT(INDIGO_OK, indigo_change_number_property_1(&test_client, observed[0].name, "CCD_TEMPERATURE", "TEMPERATURE", -10));
	ASSERT_TRUE(poll_temperature());
	ASSERT_EQ_INT(INDIGO_ALERT_STATE, state(0, "CCD_TEMPERATURE"));
	cameras[0].write_config_fail = ASI_COOLER_ON + 1;
	ASSERT_TRUE(set_switch(0, "CCD_COOLER", "OFF", true));
	ASSERT_TRUE(poll_temperature());
	ASSERT_EQ_INT(INDIGO_ALERT_STATE, state(0, "CCD_COOLER"));
	cameras[0].write_config_fail = 0;
	ASSERT_TRUE(poll_temperature());
	ASSERT_EQ_INT(INDIGO_OK_STATE, state(0, "CCD_COOLER"));
	ASSERT_EQ_INT(0, cameras[0].config[ASI_COOLER_ON]);
}

static void setup_write_origin_and_control_failures(void) {
	ASSERT_TRUE(connect_device(0, true));
	ASSERT_TRUE(set_switch(0, "CCD_MODE", "RAW 8 2x2", true));
	ASSERT_TRUE(wait_state(0, "CCD_MODE", INDIGO_OK_STATE));
	atomic_int *failures[] = { &cameras[0].roi_write_error, &cameras[0].origin_read_error, &cameras[0].origin_write_error, &cameras[0].write_config_fail };
	const char *items[] = { "LEFT", "TOP", "WIDTH", "HEIGHT" };
	double values[] = { 16, 8, 320, 240 };
	ASSERT_EQ_INT(INDIGO_OK, indigo_change_number_property(&test_client, observed[0].name, "CCD_FRAME", 4, items, values));
	ASSERT_TRUE(wait_state(0, "CCD_FRAME", INDIGO_OK_STATE));
	for (int i = 0; i < ARRAY_SIZE(failures); i++) {
		atomic_store(failures[i], i == 3 ? ASI_EXPOSURE + 1 : 1);
		ASSERT_EQ_INT(INDIGO_OK, indigo_change_number_property_1(&test_client, observed[0].name, "CCD_EXPOSURE", "EXPOSURE", 0.1));
		ASSERT_TRUE(wait_state(0, "CCD_EXPOSURE", INDIGO_ALERT_STATE));
		ASSERT_EQ_INT(0, cameras[0].starts);
		atomic_store(failures[i], 0);
	}
	ASSERT_TRUE(take_image(0, 0.1));
	ASSERT_EQ_INT(8, cameras[0].left);
	ASSERT_EQ_INT(4, cameras[0].top);
	ASSERT_EQ_INT(160, cameras[0].width);
	ASSERT_EQ_INT(120, cameras[0].height);
}

static void acquisition_conflicts_preserve_configuration(void) {
	ASSERT_TRUE(connect_device(0, true));
	ASSERT_EQ_INT(INDIGO_OK, indigo_change_number_property_1(&test_client, observed[0].name, "CCD_EXPOSURE", "EXPOSURE", 2.5));
	ASSERT_TRUE(wait_count(&cameras[0].starts, 1));
	ASSERT_EQ_INT(INDIGO_OK, indigo_change_number_property_1(&test_client, observed[0].name, "CCD_FRAME", "WIDTH", 320));
	ASSERT_EQ_INT(INDIGO_OK, indigo_change_number_property_1(&test_client, observed[0].name, "CCD_BIN", "HORIZONTAL", 2));
	ASSERT_TRUE(set_switch(0, "CCD_MODE", "RAW 16 2x2", true));
	ASSERT_TRUE(set_switch(0, PIXEL_PROPERTY, "RGB 24", true));
	ASSERT_EQ_INT(INDIGO_OK, indigo_change_number_property_1(&test_client, observed[0].name, "CCD_GAIN", "GAIN", 20));
	ASSERT_EQ_INT(INDIGO_OK, indigo_change_number_property_1(&test_client, observed[0].name, ADVANCED_PROPERTY, "WB_R", 20));
	ASSERT_TRUE(set_switch(0, PRESETS_PROPERTY, "ASI_LOWEST_RN", true));
	ASSERT_EQ_INT(INDIGO_OK, indigo_change_text_property_1(&test_client, observed[0].name, SUFFIX_PROPERTY, "SUFFIX", "busy"));
	ASSERT_TRUE(wait_state(0, "CCD_EXPOSURE", INDIGO_OK_STATE));
	ASSERT_EQ_INT(640, number_value(0, "CCD_FRAME", "WIDTH"));
	ASSERT_EQ_INT(1, number_value(0, "CCD_BIN", "HORIZONTAL"));
	ASSERT_EQ_INT(0, cameras[0].config[ASI_GAIN]);
	ASSERT_EQ_INT(0, cameras[0].config[ASI_WB_R]);
	ASSERT_EQ_INT(0, cameras[0].suffix.id[0]);
	ASSERT_EQ_INT(1, blobs);
	ASSERT_TRUE(take_image(0, 0.01));
}

static void asi120_family_cooldown_and_unity(void) {
	ASSERT_TRUE(remove_initial());
	strcpy(cameras[0].info.Name, "ZWO ASI120MC-S");
	cameras[0].visible = true;
	usb_event(0, true);
	ASSERT_TRUE(wait_count(&attached, 2));
	ASSERT_TRUE(connect_device(0, true));
	ASSERT_TRUE(connect_device(1, true));
	ASSERT_TRUE(set_switch(0, PRESETS_PROPERTY, "ASI_UNITY_GAIN", true));
	ASSERT_TRUE(wait_state(0, PRESETS_PROPERTY, INDIGO_OK_STATE));
	ASSERT_EQ_INT(29, cameras[0].config[ASI_GAIN]);
	ASSERT_EQ_INT(INDIGO_OK, indigo_change_number_property_1(&test_client, observed[0].name, "CCD_EXPOSURE", "EXPOSURE", 0.01));
	ASSERT_TRUE(wait_count(&cameras[0].frames, 1));
	ASSERT_EQ_INT(0, blobs);
	ASSERT_EQ_INT(INDIGO_OK, indigo_change_number_property_1(&test_client, observed[1].name, "GUIDER_GUIDE_RA", "EAST", 20));
	ASSERT_TRUE(wait_state(1, "GUIDER_GUIDE_RA", INDIGO_OK_STATE));
	ASSERT_TRUE(wait_count(&blobs, 1));
}

static void video_final_frame_abort_orders(void) {
	ASSERT_TRUE(connect_device(0, true));
	const char *items[] = { "EXPOSURE", "COUNT" };
	double values[] = { 0.01, 1 };
	arm_gate(&read_gate);
	ASSERT_EQ_INT(INDIGO_OK, indigo_change_number_property(&test_client, observed[0].name, "CCD_STREAMING", 2, items, values));
	ASSERT_TRUE(wait_count(&read_gate.entered, 1));
	ASSERT_TRUE(set_switch(0, "CCD_ABORT_EXPOSURE", "ABORT_EXPOSURE", true));
	release_gate(&read_gate);
	ASSERT_TRUE(wait_state(0, "CCD_ABORT_EXPOSURE", INDIGO_OK_STATE));
	ASSERT_EQ_INT(0, blobs);
	ASSERT_EQ_INT(1, cameras[0].video_stops);
	ASSERT_EQ_INT(INDIGO_OK, indigo_change_number_property(&test_client, observed[0].name, "CCD_STREAMING", 2, items, values));
	ASSERT_TRUE(wait_state(0, "CCD_STREAMING", INDIGO_OK_STATE));
	ASSERT_EQ_INT(1, blobs);
	ASSERT_TRUE(set_switch(0, "CCD_ABORT_EXPOSURE", "ABORT_EXPOSURE", true));
	ASSERT_TRUE(wait_state(0, "CCD_ABORT_EXPOSURE", INDIGO_ALERT_STATE));
	ASSERT_EQ_INT(2, cameras[0].video_stops);
}

static void shutdown_pending_discovery_and_capacity(void) {
	for (int i = 1; i < CAMERAS; i++) {
		cameras[i].visible = true;
		usb_event(i, true);
	}
	ASSERT_TRUE(drain_discovery());
	ASSERT_EQ_INT(4, attached); // generator default is five logical slots; pairs require two.
	ASSERT_TRUE(logical[4] == NULL);
	cameras[0].visible = false;
	usb_event(0, false);
	ASSERT_TRUE(wait_count(&attached, 2));
	usb_event(2, true);
	ASSERT_TRUE(wait_count(&attached, 4));
	ASSERT_TRUE(logical[4] != NULL);
	cameras[0].visible = true;
	ASSERT_EQ_INT(INDIGO_OK, indigo_ccd_asi(INDIGO_DRIVER_SHUTDOWN, NULL));
	ASSERT_EQ_INT(0, attached);
	ASSERT_EQ_INT(0, usb_refs);
	ASSERT_EQ_INT(INDIGO_OK, indigo_ccd_asi(INDIGO_DRIVER_INIT, NULL));
	ASSERT_TRUE(wait_count(&attached, 2));
	for (int i = 1; i < CAMERAS; i++) {
		usb_event(i, true);
	}
	ASSERT_EQ_INT(INDIGO_OK, indigo_ccd_asi(INDIGO_DRIVER_SHUTDOWN, NULL));
	ASSERT_EQ_INT(0, attached);
	ASSERT_EQ_INT(0, usb_refs);
}

static void unchanged_advanced_controls_are_not_written(void) {
	ASSERT_TRUE(connect_device(0, true));
	cameras[0].write_config_fail = ASI_WB_B + 1;
	ASSERT_EQ_INT(INDIGO_OK, indigo_change_number_property_1(&test_client, observed[0].name, ADVANCED_PROPERTY, "WB_R", 20));
	ASSERT_TRUE(wait_state(0, ADVANCED_PROPERTY, INDIGO_OK_STATE));
	ASSERT_EQ_INT(20, cameras[0].config[ASI_WB_R]);
	ASSERT_EQ_INT(0, cameras[0].config[ASI_WB_B]);
	cameras[0].write_config_fail = 0;
}

static void snapshot_watchdog_recovery(void) {
	ASSERT_TRUE(connect_device(0, true));
	cameras[0].forced_status = ASI_EXP_WORKING + 1;
	ASSERT_EQ_INT(INDIGO_OK, indigo_change_number_property_1(&test_client, observed[0].name, "CCD_EXPOSURE", "EXPOSURE", 0.01));
	ASSERT_TRUE(wait_count(&cameras[0].starts, 1));
	clock_offset = 61;
	ASSERT_TRUE(wait_state(0, "CCD_EXPOSURE", INDIGO_ALERT_STATE));
	ASSERT_EQ_INT(0, blobs);
	clock_offset = 0;
	cameras[0].forced_status = 0;
	ASSERT_TRUE(take_image(0, 0.01));
}

static int compare_double(const void *a, const void *b) {
	double first = *(const double *)a, second = *(const double *)b;
	return (first > second) - (first < second);
}

static void discovery_retry_exhaustion(void) {
	ASSERT_TRUE(remove_initial());
	int before = discovery_calls;
	usb_event(0, true);
	ASSERT_TRUE(indigo_queue_drain(driver_queue));
	ASSERT_EQ_INT(0, attached);
	ASSERT_TRUE(discovery_calls >= before + 6);
	cameras[0].visible = true;
	ASSERT_TRUE(drain_discovery());
	ASSERT_EQ_INT(0, attached);
	usb_event(0, true);
	ASSERT_TRUE(wait_count(&attached, 2));
	ASSERT_TRUE(connect_device(0, true));
	ASSERT_TRUE(take_image(0, 0.01));
}

static void opposed_guide_requests(void) {
	ASSERT_TRUE(connect_device(1, true));
	const char *ra[] = { "EAST", "WEST" };
	const char *dec[] = { "NORTH", "SOUTH" };
	double values[] = { 500, 500 };
	ASSERT_EQ_INT(INDIGO_OK, indigo_change_number_property(&test_client, observed[1].name, "GUIDER_GUIDE_RA", 2, ra, values));
	ASSERT_TRUE(wait_state(1, "GUIDER_GUIDE_RA", INDIGO_BUSY_STATE));
	ASSERT_TRUE(wait_count(&cameras[0].relays, 1 << ASI_GUIDE_EAST));
	ASSERT_EQ_INT(INDIGO_OK, indigo_change_number_property(&test_client, observed[1].name, "GUIDER_GUIDE_DEC", 2, dec, values));
	ASSERT_TRUE(wait_state(1, "GUIDER_GUIDE_DEC", INDIGO_BUSY_STATE));
	ASSERT_TRUE(wait_count(&cameras[0].relays, (1 << ASI_GUIDE_EAST) | (1 << ASI_GUIDE_NORTH)));
	ASSERT_TRUE(wait_state(1, "GUIDER_GUIDE_RA", INDIGO_OK_STATE));
	ASSERT_TRUE(wait_state(1, "GUIDER_GUIDE_DEC", INDIGO_OK_STATE));
	ASSERT_EQ_INT(0, cameras[0].relays);
	ASSERT_EQ_INT(0, number_value(1, "GUIDER_GUIDE_RA", "WEST"));
	ASSERT_EQ_INT(0, number_value(1, "GUIDER_GUIDE_DEC", "SOUTH"));
}

static void unplug_during_sdk_read(void) {
	for (int streaming = 0; streaming < 3; streaming++) {
		ASSERT_TRUE(connect_device(0, true));
		test_gate *gate = streaming == 2 ? &temperature_gate : &read_gate;
		arm_gate(gate);
		if (streaming == 2) {
			ASSERT_TRUE(temperature_handler != NULL);
			indigo_cancel_pending_handler(logical[0], temperature_handler);
			indigo_execute_handler(logical[0], temperature_handler);
		} else if (streaming) {
			ASSERT_EQ_INT(INDIGO_OK, indigo_change_number_property(&test_client, observed[0].name, "CCD_STREAMING", 2, (const char *[]){ "EXPOSURE", "COUNT" }, (double[]){ 0.01, -1 }));
		} else {
			ASSERT_EQ_INT(INDIGO_OK, indigo_change_number_property_1(&test_client, observed[0].name, "CCD_EXPOSURE", "EXPOSURE", 0.01));
		}
		ASSERT_TRUE(wait_count(&gate->entered, 1));
		cameras[0].visible = false;
		usb_event(0, false);
		release_gate(gate);
		ASSERT_TRUE(wait_count(&attached, 0));
		ASSERT_FALSE(cameras[0].opened);
		ASSERT_EQ_INT(0, sdk_after_close);
		ASSERT_EQ_INT(0, updates_after_detach);
		cameras[0].visible = true;
		usb_event(0, true);
		ASSERT_TRUE(wait_count(&attached, 2));
		ASSERT_TRUE(connect_device(0, true));
		ASSERT_TRUE(take_image(0, 0.01));
		ASSERT_TRUE(connect_device(0, false));
	}
}

static void asi120_failed_snapshot_retry(void) {
	ASSERT_TRUE(remove_initial());
	strcpy(cameras[0].info.Name, "ASI120MC-S");
	cameras[0].visible = true;
	usb_event(0, true);
	ASSERT_TRUE(wait_count(&attached, 2));
	ASSERT_TRUE(connect_device(0, true));
	ASSERT_TRUE(set_switch(0, "CCD_FRAME_TYPE", "DARK", true));
	cameras[0].snapshot_failures = 3;
	ASSERT_TRUE(set_switch(0, "CCD_IMAGE_FORMAT", "RAW", true));
	ASSERT_EQ_INT(INDIGO_OK, indigo_change_number_property_1(&test_client, observed[0].name, "CCD_EXPOSURE", "EXPOSURE", 1.5));
	double deadline = indigo_monotonic_time() + 10;
	while (state(0, "CCD_EXPOSURE") == INDIGO_BUSY_STATE && indigo_monotonic_time() < deadline) {
		indigo_usleep(10000);
	}
	ASSERT_TRUE(wait_state(0, "CCD_EXPOSURE", INDIGO_OK_STATE));
	ASSERT_EQ_INT(4, cameras[0].starts);
	ASSERT_EQ_INT(1, blobs);
	ASSERT_EQ_INT(1500000, cameras[0].config[ASI_EXPOSURE]);
	ASSERT_EQ_INT(1, cameras[0].dark);
	ASSERT_TRUE(set_switch(0, "CCD_FRAME_TYPE", "LIGHT", true));
	cameras[0].snapshot_failures = 4;
	ASSERT_EQ_INT(INDIGO_OK, indigo_change_number_property_1(&test_client, observed[0].name, "CCD_EXPOSURE", "EXPOSURE", 0.01));
	ASSERT_TRUE(wait_state(0, "CCD_EXPOSURE", INDIGO_ALERT_STATE));
	ASSERT_EQ_INT(8, cameras[0].starts);
	ASSERT_EQ_INT(1, blobs);
	ASSERT_TRUE(take_image(0, 0.01));
	cameras[0].snapshot_failures = 1;
	ASSERT_EQ_INT(INDIGO_OK, indigo_change_number_property_1(&test_client, observed[0].name, "CCD_EXPOSURE", "EXPOSURE", 0.01));
	ASSERT_TRUE(wait_count(&cameras[0].failed_statuses, 8));
	ASSERT_TRUE(set_switch(0, "CCD_ABORT_EXPOSURE", "ABORT_EXPOSURE", true));
	ASSERT_TRUE(wait_state(0, "CCD_ABORT_EXPOSURE", INDIGO_OK_STATE));
	ASSERT_TRUE(take_image(0, 0.01));
	ASSERT_EQ_INT(11, cameras[0].starts);
	ASSERT_EQ_INT(3, blobs);
	cameras[0].snapshot_failures = 1;
	ASSERT_EQ_INT(INDIGO_OK, indigo_change_number_property_1(&test_client, observed[0].name, "CCD_EXPOSURE", "EXPOSURE", 0.01));
	ASSERT_TRUE(wait_count(&cameras[0].failed_statuses, 9));
	cameras[0].start_error = 1;
	ASSERT_TRUE(wait_state(0, "CCD_EXPOSURE", INDIGO_ALERT_STATE));
	cameras[0].start_error = 0;
	ASSERT_TRUE(take_image(0, 0.01));
	ASSERT_EQ_INT(4, blobs);
	int failed = cameras[0].failed_statuses + 1;
	cameras[0].snapshot_failures = 1;
	ASSERT_EQ_INT(INDIGO_OK, indigo_change_number_property_1(&test_client, observed[0].name, "CCD_EXPOSURE", "EXPOSURE", 0.01));
	ASSERT_TRUE(wait_count(&cameras[0].failed_statuses, failed));
	cameras[0].write_config_fail = ASI_EXPOSURE + 1;
	ASSERT_TRUE(wait_state(0, "CCD_EXPOSURE", INDIGO_ALERT_STATE));
	cameras[0].write_config_fail = 0;
	ASSERT_TRUE(take_image(0, 0.01));
	ASSERT_TRUE(connect_device(1, true));
	failed = cameras[0].failed_statuses + 1;
	int starts = cameras[0].starts;
	cameras[0].snapshot_failures = 1;
	ASSERT_EQ_INT(INDIGO_OK, indigo_change_number_property_1(&test_client, observed[0].name, "CCD_EXPOSURE", "EXPOSURE", 0.01));
	ASSERT_TRUE(wait_count(&cameras[0].failed_statuses, failed));
	ASSERT_TRUE(connect_device(0, false));
	ASSERT_TRUE(cameras[0].opened);
	ASSERT_EQ_INT(starts + 1, cameras[0].starts);
	ASSERT_EQ_INT(INDIGO_OK, indigo_change_number_property_1(&test_client, observed[1].name, "GUIDER_GUIDE_RA", "EAST", 20));
	ASSERT_TRUE(wait_state(1, "GUIDER_GUIDE_RA", INDIGO_OK_STATE));
	ASSERT_TRUE(connect_device(0, true));
	ASSERT_TRUE(take_image(0, 0.01));
	ASSERT_EQ_INT(6, blobs);
	starts = cameras[0].starts;
	cameras[0].snapshot_failures = 1;
	cameras[0].stop_error = 1;
	ASSERT_EQ_INT(INDIGO_OK, indigo_change_number_property_1(&test_client, observed[0].name, "CCD_EXPOSURE", "EXPOSURE", 0.01));
	ASSERT_TRUE(wait_state(0, "CCD_EXPOSURE", INDIGO_ALERT_STATE));
	ASSERT_EQ_INT(starts + 1, cameras[0].starts);
	cameras[0].stop_error = 0;
	ASSERT_TRUE(take_image(0, 0.01));
	ASSERT_EQ_INT(7, blobs);
}

static void asi120_video_settling(void) {
	ASSERT_TRUE(remove_initial());
	strcpy(cameras[0].info.Name, "ASI120MC-S");
	cameras[0].visible = true;
	usb_event(0, true);
	ASSERT_TRUE(wait_count(&attached, 2));
	ASSERT_TRUE(connect_device(0, true));
	ASSERT_TRUE(set_switch(0, "CCD_IMAGE_FORMAT", "RAW", true));
	cameras[0].video_delay_ms = 900;
	ASSERT_EQ_INT(INDIGO_OK, indigo_change_number_property(&test_client, observed[0].name, "CCD_STREAMING", 2, (const char *[]){ "EXPOSURE", "COUNT" }, (double[]){ 0.01, 2 }));
	ASSERT_TRUE(wait_state(0, "CCD_STREAMING", INDIGO_OK_STATE));
	ASSERT_EQ_INT(2, blobs);
	cameras[0].video_timeouts = 100000;
	ASSERT_EQ_INT(INDIGO_OK, indigo_change_number_property(&test_client, observed[0].name, "CCD_STREAMING", 2, (const char *[]){ "EXPOSURE", "COUNT" }, (double[]){ 0.01, -1 }));
	ASSERT_TRUE(wait_count(&cameras[0].video_starts, 2));
	clock_offset = 6;
	ASSERT_TRUE(wait_state(0, "CCD_STREAMING", INDIGO_ALERT_STATE));
	clock_offset = 0;
	cameras[0].video_timeouts = cameras[0].video_delay_ms = 0;
	ASSERT_EQ_INT(INDIGO_OK, indigo_change_number_property(&test_client, observed[0].name, "CCD_STREAMING", 2, (const char *[]){ "EXPOSURE", "COUNT" }, (double[]){ 0.01, 1 }));
	ASSERT_TRUE(wait_state(0, "CCD_STREAMING", INDIGO_OK_STATE));
	ASSERT_EQ_INT(3, blobs);
	ASSERT_EQ_INT(cameras[0].video_starts, cameras[0].video_stops);
}

static void property_inventory(void) {
	const char *common[] = { "INFO", "CONFIG", "PROFILE_NAME", "PROFILE", "CONNECTION" };
	const char *common_hidden[] = { "SIMULATION", "DEVICE_PORT", "DEVICE_PORTS", "AUTHENTICATION", "ADDITIONAL_INSTANCES" };
	for (int d = 0; d < 2; d++) {
		for (int i = 0; i < ARRAY_SIZE(common); i++) {
			ASSERT_TRUE(state(d, common[i]) >= 0);
		}
		for (int i = 0; i < ARRAY_SIZE(common_hidden); i++) {
			ASSERT_EQ_INT(-1, state(d, common_hidden[i]));
		}
		indigo_property *info = snapshot(d, "INFO");
		bool interface_found = false;
		for (int i = 0; i < info->count; i++) {
			if (!strcmp(info->items[i].name, "DEVICE_INTERFACE")) {
				interface_found = (atoi(info->items[i].text.value) & (d ? INDIGO_INTERFACE_GUIDER : INDIGO_INTERFACE_CCD)) != 0;
			}
		}
		indigo_release_property(info);
		ASSERT_TRUE(interface_found);
	}
	ASSERT_EQ_INT(-1, state(0, "CCD_EXPOSURE"));
	ASSERT_EQ_INT(-1, state(1, "GUIDER_GUIDE_RA"));
	ASSERT_TRUE(connect_device(0, true));
	ASSERT_TRUE(connect_device(1, true));
	const char *ccd[] = { "CCD_INFO", "CCD_LENS", "CCD_LOCAL_MODE", "CCD_IMAGE_FILE", "CCD_MODE", "CCD_EXPOSURE", "CCD_FPS", "CCD_ABORT_EXPOSURE", "CCD_FRAME", "CCD_BIN", "CCD_FRAME_TYPE", "CCD_IMAGE_FORMAT", "CCD_UPLOAD_MODE", "CCD_PREVIEW", "CCD_IMAGE", "CCD_FITS_HEADERS", "CCD_SET_FITS_HEADER", "CCD_REMOVE_FITS_HEADER", "CCD_JPEG_SETTINGS", "CCD_JPEG_STRETCH_PRESETS", "CCD_STREAMING", "CCD_STREAMING_SETTINGS", "CCD_OFFSET", "CCD_GAIN", "CCD_EGAIN", "CCD_GAMMA", "CCD_COOLER", "CCD_COOLER_POWER", "CCD_TEMPERATURE", PIXEL_PROPERTY, ADVANCED_PROPERTY, PRESETS_PROPERTY, SUFFIX_PROPERTY };
	for (int i = 0; i < ARRAY_SIZE(ccd); i++) {
		if (state(0, ccd[i]) < 0) {
			fprintf(stderr, "Missing CCD inventory property: %s\n", ccd[i]);
		}
		ASSERT_TRUE(state(0, ccd[i]) >= 0);
	}
	const char *hidden[] = { "CCD_READ_MODE", "CCD_RBI_FLUSH_ENABLE", "CCD_RBI_FLUSH", "ASI_ADVANCED", "ASI_PRESETS", "ASI_CUSTOM_SUFFIX", "PIXEL_FORMAT" };
	for (int i = 0; i < ARRAY_SIZE(hidden); i++) {
		ASSERT_EQ_INT(-1, state(0, hidden[i]));
	}
	ASSERT_EQ_INT(640, number_value(0, "CCD_INFO", "WIDTH"));
	ASSERT_EQ_INT(480, number_value(0, "CCD_INFO", "HEIGHT"));
	ASSERT_TRUE(state(1, "GUIDER_GUIDE_RA") >= 0);
	ASSERT_TRUE(state(1, "GUIDER_GUIDE_DEC") >= 0);
	ASSERT_EQ_INT(-1, state(1, "GUIDER_RATE"));
	ASSERT_TRUE(connect_device(0, false));
	ASSERT_TRUE(set_switch(0, "CONNECTION", "DISCONNECTED", true));
	ASSERT_TRUE(drain_discovery());
	ASSERT_EQ_INT(INDIGO_OK_STATE, state(0, "CONNECTION"));
	ASSERT_TRUE(connect_device(1, false));
	ASSERT_TRUE(set_switch(1, "CONNECTION", "DISCONNECTED", true));
	ASSERT_TRUE(drain_discovery());
	ASSERT_EQ_INT(INDIGO_OK_STATE, state(1, "CONNECTION"));
}

static void guide_timing_measurements(void) {
	ASSERT_TRUE(connect_device(0, true));
	ASSERT_TRUE(connect_device(1, true));
	const int directions[] = { ASI_GUIDE_EAST, ASI_GUIDE_WEST, ASI_GUIDE_NORTH, ASI_GUIDE_SOUTH };
	const char *names[] = { "EAST", "WEST", "NORTH", "SOUTH" };
	const double durations[] = { 20, 100, 500 };
	for (int workload = 0; workload < 2; workload++) {
		if (workload) {
			ASSERT_EQ_INT(INDIGO_OK, indigo_change_number_property(&test_client, observed[0].name, "CCD_STREAMING", 2, (const char *[]){ "EXPOSURE", "COUNT" }, (double[]){ 0.05, -1 }));
			ASSERT_TRUE(wait_count(&cameras[0].video_starts, 1));
		}
		for (int direction = 0; direction < 4; direction++) {
			const char *property = direction < 2 ? "GUIDER_GUIDE_RA" : "GUIDER_GUIDE_DEC";
			for (int duration = 0; duration < 3; duration++) {
				double errors[4], sum = 0, squares = 0, maximum_absolute = 0;
				for (int trial = 0; trial < 5; trial++) {
					ASSERT_EQ_INT(INDIGO_OK, indigo_change_number_property_1(&test_client, observed[1].name, property, names[direction], durations[duration]));
					ASSERT_TRUE(wait_state(1, property, INDIGO_OK_STATE));
					pthread_mutex_lock(&pulse_mutex);
					double actual = pulse_measurements[0][directions[direction]].duration_ms;
					pthread_mutex_unlock(&pulse_mutex);
					ASSERT_TRUE(isfinite(actual) && actual >= 0 && actual < 4000);
					if (trial) {
						double error = actual - durations[duration];
						errors[trial - 1] = error;
						sum += error;
						squares += error * error;
						maximum_absolute = fmax(maximum_absolute, fabs(error));
					}
				}
				qsort(errors, 4, sizeof(double), compare_double);
				double mean = sum / 4;
				printf("TIMING %s %s requested_ms=%.0f n=4 warmup=1 actual_mean_ms=%.3f error_ms min=%.3f mean=%.3f median=%.3f p95=%.3f p99=%.3f max=%.3f sd=%.3f max_abs=%.3f error_mean_pct=%.3f\n", workload ? "streaming" : "idle", names[direction], durations[duration], durations[duration] + mean, errors[0], mean, (errors[1] + errors[2]) / 2, errors[3], errors[3], errors[3], sqrt(fmax(0, squares / 4 - mean * mean)), maximum_absolute, 100 * mean / durations[duration]);
			}
		}
		if (workload) {
			ASSERT_TRUE(set_switch(0, "CCD_ABORT_EXPOSURE", "ABORT_EXPOSURE", true));
			ASSERT_TRUE(wait_state(0, "CCD_ABORT_EXPOSURE", INDIGO_OK_STATE));
		}
	}
}

static bool begin_fixture(void) {
	clock_offset = 0;
	memset(cameras, 0, sizeof(cameras));
	memset(logical, 0, sizeof(logical));
	atomic_store(&concurrent_sdk, 0);
	atomic_store(&unbalanced_unlock, 0);
	atomic_store(&discovery_fail, 0);
	atomic_store(&count_fail, 0);
	memset(request_revisions, 0, sizeof(request_revisions));
	atomic_store(&wrong_bus_thread, 0);
	atomic_store(&raw_blobs, 0);
	memset(pulse_measurements, 0, sizeof(pulse_measurements));
	atomic_store(&blobs, 0);
	atomic_store(&pulse_writes, 0);
	atomic_store(&short_waits, 0);
	atomic_store(&bad_blob, 0);
	atomic_store(&sdk_after_close, 0);
	for (int i = 0; i < CAMERAS; i++) {
		mock_camera *c = cameras + i;
		c->info.CameraID = i;
		snprintf(c->info.Name, sizeof(c->info.Name), "ASI test %d", i);
		c->info.MaxWidth = 640;
		c->info.MaxHeight = 480;
		c->info.PixelSize = 3.75;
		c->info.BitDepth = 12;
		c->info.ST4Port = true;
		c->info.IsColorCam = true;
		c->info.BayerPattern = ASI_BAYER_RG;
		c->info.SupportedBins[0] = 1;
		c->info.SupportedBins[1] = 2;
		c->info.SupportedVideoFormat[0] = ASI_IMG_RAW8;
		c->info.SupportedVideoFormat[1] = ASI_IMG_RGB24;
		c->info.SupportedVideoFormat[2] = ASI_IMG_RAW16;
		c->info.SupportedVideoFormat[3] = ASI_IMG_Y8;
		c->info.SupportedVideoFormat[4] = ASI_IMG_END;
		atomic_store(&c->config[ASI_EXPOSURE], 10000);
		c->info.ElecPerADU = 2;
		c->info.IsCoolerCam = true;
		atomic_store(&c->config[ASI_TEMPERATURE], 200);
		atomic_store(&c->bin, 1);
		atomic_store(&c->width, 640);
		atomic_store(&c->height, 480);
	}
	atomic_store(&cameras[0].visible, true);
	return indigo_ccd_asi(INDIGO_DRIVER_INIT, NULL) == INDIGO_OK && wait_count(&attached, 2);
}

static void end_fixture(void) {
	release_gate(&temperature_gate);
	release_gate(&initialization_gate);
	release_gate(&read_gate);
	release_gate(&queue_gate);
	release_gate(&setup_gate);
	atomic_store(&fast_poll, 0);
	atomic_store(&fail_queue, 0);
	atomic_store(&fail_lock, 0);
	atomic_store(&fail_register, 0);
	atomic_store(&fail_descriptor, 0);
	atomic_store(&wrong_vendor, 0);
	wrong_product = reverse_discovery = discovery_fail = count_fail = 0;
	for (int i = 0; i < CAMERAS; i++) {
		cameras[i].guide_off_error = cameras[i].guide_on_error = cameras[i].status_error = cameras[i].forced_status = 0;
		atomic_store(&cameras[i].config_error, 0);
		atomic_store(&cameras[i].stop_error, 0);
		atomic_store(&cameras[i].read_config_fail, 0);
		atomic_store(&cameras[i].write_config_fail, 0);
	}
	for (int i = 0; i < CAMERAS * 2; i++) {
		indigo_property *p = snapshot(i, "CONNECTION");
		if (p && p->items[0].sw.value) {
			connect_device(i, false);
		}
		indigo_release_property(p);
	}
	ASSERT_EQ_INT(INDIGO_OK, indigo_ccd_asi(INDIGO_DRIVER_SHUTDOWN, NULL));
	ASSERT_EQ_INT(0, atomic_load(&attached));
	ASSERT_EQ_INT(0, atomic_load(&lock_count));
	ASSERT_EQ_INT(0, atomic_load(&sdk_after_close));
	ASSERT_EQ_INT(0, atomic_load(&wrong_single_mode));
	ASSERT_EQ_INT(0, atomic_load(&wrong_bus_thread));
	ASSERT_EQ_INT(0, atomic_load(&concurrent_sdk));
	ASSERT_EQ_INT(0, atomic_load(&updates_after_detach));
	ASSERT_EQ_INT(0, atomic_load(&gate_timeouts));
	ASSERT_EQ_INT(0, atomic_load(&bad_blob));
	ASSERT_EQ_INT(0, atomic_load(&unbalanced_unlock));
	ASSERT_EQ_INT(0, atomic_load(&short_waits));
	for (int i = 0; i < CAMERAS; i++) {
		ASSERT_EQ_INT(cameras[i].opens, cameras[i].closes);
		ASSERT_EQ_INT(0, sdk_active[i]);
	}
	ASSERT_EQ_INT(0, atomic_load(&usb_refs));
	ASSERT_EQ_INT(0, atomic_load(&invalid_usb_unref));
	for (int i = 0; i < CAMERAS * 2; i++) {
		for (int j = 0; j < PROPERTIES; j++) {
			indigo_release_property(observed[i].properties[j]);
			observed[i].properties[j] = NULL;
		}
	}
}

int main(int argc, char **argv) {
	bus_thread = pthread_self();
	setvbuf(stdout, NULL, _IONBF, 0);
	if (!mkdtemp(config_folder)) {
		return 1;
	}
	indigo_start();
	indigo_attach_client(&test_client);
	const indigo_test_case tests[] = {
		{ "Timing guide ON-OFF", guide_timing_measurements },
		{ "Snapshot watchdog recovery", snapshot_watchdog_recovery },
		{ "Sensor only and absent", sensor_only_and_sensor_absent },
		{ "Complete property inventory", property_inventory },
		{ "ASI120 failed snapshot retry", asi120_failed_snapshot_retry },
		{ "ASI120 video settling", asi120_video_settling },
		{ "Remaining discovery retries", discovery_retry_exhaustion },
		{ "Remaining opposed guides", opposed_guide_requests },
		{ "Remaining unplug SDK read", unplug_during_sdk_read },
		{ "Unchanged advanced controls", unchanged_advanced_controls_are_not_written },
		{ "Edges capability_rebuild_and_cooling", capability_rebuild_and_cooling },
		{ "Edges control_metadata_rollback", control_metadata_rollback },
		{ "Edges malformed_numeric_readback", malformed_numeric_readback },
		{ "Edges cooling_reads_writes_and_settling", cooling_reads_writes_and_settling },
		{ "Edges setup_write_origin_and_control_failures", setup_write_origin_and_control_failures },
		{ "Edges acquisition_conflicts_preserve_configuration", acquisition_conflicts_preserve_configuration },
		{ "Edges asi120_family_cooldown_and_unity", asi120_family_cooldown_and_unity },
		{ "Edges video_final_frame_abort_orders", video_final_frame_abort_orders },
		{ "Edges shutdown_pending_discovery_and_capacity", shutdown_pending_discovery_and_capacity },
		{ "Matrix discovery_identity_and_reordering", discovery_identity_and_reordering },
		{ "Matrix discovery_filter_failures_retry", discovery_filter_failures_retry },
		{ "Matrix discovery_attach_and_init_rollback", discovery_attach_and_init_rollback },
		{ "Matrix malformed_identity_recovery", malformed_identity_recovery },
		{ "Matrix limited_formats_and_bins", limited_formats_and_bins },
		{ "Matrix malformed_geometry_and_recovery", malformed_geometry_and_recovery },
		{ "Matrix control_failures_and_presets", control_failures_and_presets },
		{ "Matrix suffix_boundaries_and_failure", suffix_boundaries_and_failure },
		{ "Matrix exposure_status_failures", exposure_status_failures },
		{ "Matrix video_error_paths", video_error_paths },
		{ "Matrix finite_video_abort_and_timeout", finite_video_abort_and_timeout },
		{ "Matrix guide_failures_and_overlap", guide_failures_and_overlap },
		{ "Matrix readout_abort_and_restart", readout_abort_and_restart },
		{ "Matrix disconnect_readout_with_sibling", disconnect_readout_with_sibling },
		{ "Matrix unplug_active_and_replug", unplug_active_and_replug },
		{ "Matrix frame_types_and_fractional_countdown", frame_types_and_fractional_countdown },
		{ "CCD properties image and configuration baseline", properties_and_exposure },
		{ "Finite streaming baseline", finite_stream },
		{ "Long indefinite stream abort restart", long_stream_abort_restart },
		{ "Urgent abort overtakes pending start", abort_overtakes_pending_start },
		{ "Idle abort terminal", idle_abort_terminal },
		{ "Guide axes and disconnect", guide_all_axes_and_disconnect },
		{ "Initialization read rollback", initialization_read_rollback },
		{ "Setup read failure recovery", setup_read_failure_recovers },
		{ "Temperature read failure", temperature_read_failure },
		{ "Start failure immediate recovery", start_failure_is_immediate },
		{ "Advanced failure ALERT recovery", advanced_failure_is_alert },
		{ "Guider shared session", guider_shared_session },
		{ "Open Init rollback", open_init_rollback },
		{ "Formats and ROI", formats_and_roi },
		{ "Configuration roundtrip", configuration_roundtrip },
		{ "Readout error and subsequent acquisition", failed_readout_recovers }
	};
	int result = 0, selected = 0;
	for (int i = 0; i < ARRAY_SIZE(tests); i++) {
		if ((!strncmp(tests[i].name, "Timing", 6) && (argc < 2 || strcmp(argv[1], "--timing"))) || (argc > 1 && !strcmp(argv[1], "--timing") && strncmp(tests[i].name, "Timing", 6)) || (argc > 1 && strcmp(argv[1], "--timing") && !strstr(tests[i].name, argv[1]))) {
			continue;
		}
		selected++;
		alarm(90);
		if (!begin_fixture()) {
			result = 1;
			break;
		}
		result |= indigo_run_tests("ASI camera fake SDK", tests + i, 1);
		int before_cleanup = indigo_test_failures;
		end_fixture();
		if (indigo_test_failures != before_cleanup) {
			fprintf(stderr, "Cleanup failed for %s\n", tests[i].name);
			result = 1;
			break;
		}
		alarm(0);
	}
	if (!selected) {
		fprintf(stderr, "No test matches the requested filter\n");
		result = 1;
	}
	alarm(30);
	indigo_detach_client(&test_client);
	indigo_stop();
	alarm(0);
	DIR *dir = opendir(config_folder);
	if (dir) {
		struct dirent *entry;
		while ((entry = readdir(dir))) {
			if (entry->d_name[0] != '.') {
				char path[1024];
				snprintf(path, sizeof(path), "%s/%s", config_folder, entry->d_name);
				unlink(path);
			}
		}
		closedir(dir);
	}
	rmdir(config_folder);
	return result || indigo_test_failures;
}
