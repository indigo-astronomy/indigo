// Copyright (c) 2026 INDIGO initiative
// All rights reserved.
//
// You may use this software under the terms of 'INDIGO Astronomy
// open-source license' (see LICENSE.md).
//
// THIS SOFTWARE IS PROVIDED BY THE AUTHORS 'AS IS' AND ANY EXPRESS
// OR IMPLIED WARRANTIES, INCLUDING, BUT NOT LIMITED TO, THE IMPLIED
// WARRANTIES OF MERCHANTABILITY AND FITNESS FOR A PARTICULAR PURPOSE
// ARE DISCLAIMED. IN NO EVENT SHALL THE AUTHOR BE LIABLE FOR ANY
// DIRECT, INDIRECT, INCIDENTAL, SPECIAL, EXEMPLARY, OR CONSEQUENTIAL
// DAMAGES (INCLUDING, BUT NOT LIMITED TO, PROCUREMENT OF SUBSTITUTE
// GOODS OR SERVICES; LOSS OF USE, DATA, OR PROFITS; OR BUSINESS
// INTERRUPTION) HOWEVER CAUSED AND ON ANY THEORY OF LIABILITY,
// WHETHER IN CONTRACT, STRICT LIABILITY, OR TORT (INCLUDING
// NEGLIGENCE OR OTHERWISE) ARISING IN ANY WAY OUT OF THE USE OF THIS
// SOFTWARE, EVEN IF ADVISED OF THE POSSIBILITY OF SUCH DAMAGE.

// Code is generated by AI

// Compliance suite for the Shoestring FCUSB focuser. The device has no position
// encoder: a move is a direction driven for the requested number of
// milliseconds, so every scenario asserts the power, the frequency and the
// direction the driver sent, and how long the motor was actually driven.

#include <stdatomic.h>
#include <stdint.h>

#include <indigo/indigo_driver.h>
#include <indigo/indigo_usb_utils.h>
#include <libfcusb.h>
#include <indigo_drivers/focuser_fcusb/indigo_focuser_fcusb.h>

#include "serial_simulator_test_common.h"

#define FCUSB_DEVICE_NAME                  "FCUSB test"
#define X_FOCUSER_FREQUENCY_PROPERTY_NAME  "X_FOCUSER_FREQUENCY"
#define X_FOCUSER_FREQUENCY_1_ITEM_NAME    "FREQUENCY_1"
#define X_FOCUSER_FREQUENCY_4_ITEM_NAME    "FREQUENCY_4"
#define X_FOCUSER_FREQUENCY_16_ITEM_NAME   "FREQUENCY_16"

static char config_folder[] = "/tmp/indigo-fcusb-config-XXXXXX";

// X_FOCUSER_FREQUENCY is persisted by the driver, so the CONFIG roundtrip is
// redirected into a scratch directory.
const char *fcusb_test_config_folder(void) {
	return config_folder;
}

static const simulator_driver_case focuser = { "Shoestring FCUSB focuser", "indigo_focuser_fcusb", FCUSB_DEVICE_NAME, indigo_focuser_fcusb, false, NULL, 0, NULL, 0, NULL, 0, NULL, 0 };

// ----------------------------------------------------------------- fake focuser

static atomic_int opened, closed, calls, calls_after_close, references, attached;
static atomic_int fail_open, fail_power, fail_frequency, fail_move, fail_stop;
static atomic_int power, frequency, direction, stops, moves;
static atomic_int fail_queue, fail_register, fail_attach;
static double motion_started, motion_stopped;
static libusb_hotplug_callback_fn hotplug;
static indigo_queue *driver_queue;
static libfcusb_device_context context_handle;
void (*libfcusb_debug)(const char *);

static double now_seconds(void) {
	struct timeval tv;
	gettimeofday(&tv, NULL);
	return tv.tv_sec + tv.tv_usec / 1e6;
}

static void reset_fake(void) {
	atomic_store(&opened, 0);
	atomic_store(&closed, 0);
	atomic_store(&calls, 0);
	atomic_store(&calls_after_close, 0);
	atomic_store(&references, 0);
	atomic_store(&attached, 0);
	atomic_store(&fail_open, 0);
	atomic_store(&fail_power, 0);
	atomic_store(&fail_frequency, 0);
	atomic_store(&fail_move, 0);
	atomic_store(&fail_stop, 0);
	atomic_store(&power, -1);
	atomic_store(&frequency, -1);
	atomic_store(&direction, 0);
	atomic_store(&stops, 0);
	atomic_store(&moves, 0);
	atomic_store(&fail_queue, 0);
	atomic_store(&fail_register, 0);
	atomic_store(&fail_attach, 0);
	motion_started = motion_stopped = 0;
	hotplug = NULL;
}

static bool transfer(void) {
	atomic_fetch_add(&calls, 1);
	if (atomic_load(&opened) == atomic_load(&closed)) {
		atomic_fetch_add(&calls_after_close, 1);
		return false;
	}
	return true;
}

bool libfcusb_focuser(libusb_device *device, const char **name) {
	*name = FCUSB_DEVICE_NAME;
	return true;
}

bool libfcusb_open(libusb_device *device, libfcusb_device_context **context) {
	*context = &context_handle;
	if (atomic_exchange(&fail_open, 0)) {
		return false;
	}
	atomic_fetch_add(&opened, 1);
	return true;
}

void libfcusb_close(libfcusb_device_context *context) {
	atomic_fetch_add(&closed, 1);
}

bool libfcusb_set_power(libfcusb_device_context *context, unsigned value) {
	if (!transfer() || atomic_exchange(&fail_power, 0)) {
		return false;
	}
	atomic_store(&power, (int)value);
	return true;
}

bool libfcusb_set_frequency(libfcusb_device_context *context, unsigned value) {
	if (!transfer() || atomic_exchange(&fail_frequency, 0)) {
		return false;
	}
	atomic_store(&frequency, (int)value);
	return true;
}

static bool start_motion(int requested) {
	if (!transfer() || atomic_exchange(&fail_move, 0)) {
		return false;
	}
	atomic_store(&direction, requested);
	atomic_fetch_add(&moves, 1);
	motion_started = now_seconds();
	return true;
}

bool libfcusb_move_in(libfcusb_device_context *context) {
	return start_motion(-1);
}

bool libfcusb_move_out(libfcusb_device_context *context) {
	return start_motion(1);
}

bool libfcusb_stop(libfcusb_device_context *context) {
	if (!transfer() || atomic_exchange(&fail_stop, 0)) {
		return false;
	}
	if (atomic_exchange(&direction, 0) != 0) {
		motion_stopped = now_seconds();
	}
	atomic_fetch_add(&stops, 1);
	return true;
}

bool libfcusb_led_green(libfcusb_device_context *context) { return true; }
bool libfcusb_led_red(libfcusb_device_context *context) { return true; }
bool libfcusb_led_off(libfcusb_device_context *context) { return true; }

// ----------------------------------------------------------------- fake boundary

indigo_queue *fcusb_queue_create(indigo_device *device) {
	if (atomic_exchange(&fail_queue, 0)) {
		return NULL;
	}
	return driver_queue = indigo_queue_create(device);
}

void fcusb_usb_start(void) { }

int LIBUSB_CALL fcusb_usb_register(libusb_context *ctx, int events, int flags, int vid, int pid, int cls, libusb_hotplug_callback_fn fn, void *data, libusb_hotplug_callback_handle *registration) {
	if (atomic_exchange(&fail_register, 0)) {
		return LIBUSB_ERROR_OTHER;
	}
	hotplug = fn;
	*registration = 1;
	fn(NULL, (libusb_device *)(uintptr_t)1, LIBUSB_HOTPLUG_EVENT_DEVICE_ARRIVED, NULL);
	return 0;
}

void LIBUSB_CALL fcusb_usb_deregister(libusb_context *ctx, libusb_hotplug_callback_handle registration) {
	hotplug = NULL;
}

int fcusb_usb_register_sim(libusb_context *ctx, libusb_hotplug_event events, libusb_hotplug_flag flags, int vid, int pid, int cls, libusb_hotplug_callback_fn fn, void *data, libusb_hotplug_callback_handle *registration) {
	return fcusb_usb_register(ctx, events, flags, vid, pid, cls, fn, data, registration);
}

int fcusb_usb_deregister_poll(libusb_context *ctx, libusb_hotplug_callback_handle registration) {
	fcusb_usb_deregister(ctx, registration);
	return 0;
}

libusb_device * LIBUSB_CALL fcusb_usb_ref(libusb_device *device) {
	atomic_fetch_add(&references, 1);
	return device;
}

void LIBUSB_CALL fcusb_usb_unref(libusb_device *device) {
	atomic_fetch_sub(&references, 1);
}

indigo_result fcusb_usb_path(libusb_device *device, char *path) {
	strcpy(path, "1");
	return INDIGO_OK;
}

indigo_result fcusb_attach_device(indigo_device *device) {
	if (atomic_exchange(&fail_attach, 0)) {
		return INDIGO_FAILED;
	}
	indigo_result result = indigo_attach_device(device);
	if (result == INDIGO_OK) {
		atomic_fetch_add(&attached, 1);
	}
	return result;
}

indigo_result fcusb_detach_device(indigo_device *device) {
	indigo_result result = indigo_detach_device(device);
	atomic_fetch_sub(&attached, 1);
	return result;
}

// ----------------------------------------------------------------- helpers

static bool state_seen(const char *property, indigo_property_state state, unsigned int revision) {
	if (wait_for_property_state_seen_after(property, state, revision)) {
		return true;
	}
	indigo_property *cached = find_cached_property(property);
	fprintf(stderr, "%s never published state %d (current %d)\n", property, state, cached == NULL ? -1 : cached->state);
	return false;
}

static bool number_change(const char *property, const char *item, double value, indigo_property_state state) {
	unsigned int revision = property_state_revision(property, state);
	return indigo_change_number_property_1(&simulator_test_client, focuser.device_name, property, item, value) == INDIGO_OK && state_seen(property, state, revision);
}

static bool switch_change(const char *property, const char *item, indigo_property_state state) {
	unsigned int revision = property_state_revision(property, state);
	return indigo_change_switch_property_1(&simulator_test_client, focuser.device_name, property, item, true) == INDIGO_OK && state_seen(property, state, revision);
}

static bool switch_is(const char *property_name, const char *item_name, bool expected) {
	indigo_item *item = find_cached_item(property_name, item_name);
	if (item == NULL || item->sw.value != expected) {
		fprintf(stderr, "%s.%s: expected %s\n", property_name, item_name, expected ? "on" : "off");
		return false;
	}
	return true;
}

static bool wait_for_direction(int expected) {
	for (int i = 0; i < 400; i++) {
		if (atomic_load(&direction) == expected) {
			return true;
		}
		indigo_usleep(10000);
	}
	fprintf(stderr, "Motor direction never became %d, it is %d\n", expected, atomic_load(&direction));
	return false;
}

// A complete move: it starts in the requested direction and the finalizer stops
// the motor again. The driver moves inward by default, which is what most
// scenarios use, so -1 is the expected direction unless a scenario selects the
// other one.
static bool move_completes(double milliseconds, int expected_direction) {
	unsigned int done = property_state_revision(FOCUSER_STEPS_PROPERTY_NAME, INDIGO_OK_STATE);
	if (!number_change(FOCUSER_STEPS_PROPERTY_NAME, FOCUSER_STEPS_ITEM_NAME, milliseconds, INDIGO_BUSY_STATE) || !wait_for_direction(expected_direction)) {
		return false;
	}
	if (!state_seen(FOCUSER_STEPS_PROPERTY_NAME, INDIGO_OK_STATE, done)) {
		return false;
	}
	if (atomic_load(&direction) != 0) {
		fprintf(stderr, "Motor still running after the move\n");
		return false;
	}
	return true;
}

static bool driver_up(void) {
	reset_fake();
	if (!bring_up_serial_driver(&focuser)) {
		return false;
	}
	indigo_queue_drain(driver_queue);
	return true;
}

static bool connect_focuser(void) {
	return connect_serial_device(&focuser, NULL);
}

static bool driver_start(void) {
	return driver_up() && connect_focuser();
}

static void driver_stop(void) {
	if (context.connected) {
		disconnect_serial_device(&focuser);
	}
	tear_down_serial_driver(&focuser);
	ASSERT_EQ_INT(0, attached);
	ASSERT_EQ_INT(0, references);
	ASSERT_EQ_INT(opened, closed);
	ASSERT_EQ_INT(0, calls_after_close);
}

static void plug(void) {
	hotplug(NULL, (libusb_device *)(uintptr_t)1, LIBUSB_HOTPLUG_EVENT_DEVICE_ARRIVED, NULL);
	indigo_queue_drain(driver_queue);
}

static void unplug(void) {
	hotplug(NULL, (libusb_device *)(uintptr_t)1, LIBUSB_HOTPLUG_EVENT_DEVICE_LEFT, NULL);
	indigo_queue_drain(driver_queue);
}

// ----------------------------------------------------------------- identity and lifecycle

static void metadata(void) {
	assert_simulator_driver_info(&focuser);
	SERIAL_CHECK_TRUE(driver_start());
	SERIAL_CHECK_TRUE(context.connected && context.last_connection_state == INDIGO_OK_STATE);
	assert_device_interface(INDIGO_INTERFACE_FOCUSER);
	SERIAL_CHECK_EQ_INT(1, attached);
	SERIAL_CHECK_EQ_INT(1, opened);
cleanup:
	driver_stop();
}

static void property_contract(void) {
	SERIAL_CHECK_TRUE(driver_up());
	reset_simulator_context(&focuser);
	enumerate_simulator_device();
	SERIAL_CHECK_TRUE(!has_defined_property(FOCUSER_STEPS_PROPERTY_NAME));
	SERIAL_CHECK_TRUE(connect_focuser());
	assert_property_has_item(FOCUSER_STEPS_PROPERTY_NAME, FOCUSER_STEPS_ITEM_NAME);
	assert_property_has_item(FOCUSER_DIRECTION_PROPERTY_NAME, FOCUSER_DIRECTION_MOVE_INWARD_ITEM_NAME);
	assert_property_has_item(FOCUSER_DIRECTION_PROPERTY_NAME, FOCUSER_DIRECTION_MOVE_OUTWARD_ITEM_NAME);
	assert_property_has_item(FOCUSER_ABORT_MOTION_PROPERTY_NAME, FOCUSER_ABORT_MOTION_ITEM_NAME);
	assert_property_has_item(FOCUSER_SPEED_PROPERTY_NAME, FOCUSER_SPEED_ITEM_NAME);
	assert_property_has_item(X_FOCUSER_FREQUENCY_PROPERTY_NAME, X_FOCUSER_FREQUENCY_1_ITEM_NAME);
	assert_property_has_item(X_FOCUSER_FREQUENCY_PROPERTY_NAME, X_FOCUSER_FREQUENCY_4_ITEM_NAME);
	assert_property_has_item(X_FOCUSER_FREQUENCY_PROPERTY_NAME, X_FOCUSER_FREQUENCY_16_ITEM_NAME);
	// The focuser has no encoder, so there is no position, no sync and no
	// temperature of any kind.
	SERIAL_CHECK_TRUE(!has_defined_property(FOCUSER_POSITION_PROPERTY_NAME));
	SERIAL_CHECK_TRUE(!has_defined_property(FOCUSER_ON_POSITION_SET_PROPERTY_NAME));
	SERIAL_CHECK_TRUE(!has_defined_property(FOCUSER_TEMPERATURE_PROPERTY_NAME));
	SERIAL_CHECK_TRUE(!has_defined_property(FOCUSER_BACKLASH_PROPERTY_NAME));
	// The speed item drives the motor power instead of a step rate.
	indigo_item *speed = find_cached_item(FOCUSER_SPEED_PROPERTY_NAME, FOCUSER_SPEED_ITEM_NAME);
	SERIAL_CHECK_TRUE(speed != NULL && speed->number.max == 255 && speed->number.value == 255);
	SERIAL_CHECK_TRUE(!strcmp(speed->label, "Power (0-255)"));
	SERIAL_CHECK_TRUE(switch_is(X_FOCUSER_FREQUENCY_PROPERTY_NAME, X_FOCUSER_FREQUENCY_1_ITEM_NAME, true));
	disconnect_serial_device(&focuser);
	for (int i = 0; i < 50 && find_cached_property(X_FOCUSER_FREQUENCY_PROPERTY_NAME) != NULL; i++) {
		indigo_usleep(100000);
	}
	SERIAL_CHECK_TRUE(find_cached_property(X_FOCUSER_FREQUENCY_PROPERTY_NAME) == NULL);
cleanup:
	driver_stop();
}

static void open_failure(void) {
	SERIAL_CHECK_TRUE(driver_up());
	atomic_store(&fail_open, 1);
	SERIAL_CHECK_TRUE(!connect_focuser());
	SERIAL_CHECK_TRUE(!context.connected);
	SERIAL_CHECK_EQ_INT(0, opened);
	SERIAL_CHECK_TRUE(connect_focuser());
	SERIAL_CHECK_EQ_INT(1, opened);
	SERIAL_CHECK_TRUE(move_completes(200, -1));
cleanup:
	driver_stop();
}

static void repeated_init_shutdown(void) {
	for (int i = 0; i < 3; i++) {
		SERIAL_CHECK_TRUE(driver_start());
		disconnect_serial_device(&focuser);
		SERIAL_CHECK_TRUE(!context.connected);
		tear_down_serial_driver(&focuser);
		SERIAL_CHECK_EQ_INT(0, attached);
		SERIAL_CHECK_EQ_INT(0, references);
		SERIAL_CHECK_EQ_INT(opened, closed);
	}
	return;
cleanup:
	driver_stop();
}

static void shutdown_rejected_while_connected(void) {
	SERIAL_CHECK_TRUE(driver_start());
	SERIAL_CHECK_EQ_INT(INDIGO_BUSY, focuser.entry(INDIGO_DRIVER_SHUTDOWN, NULL));
	SERIAL_CHECK_TRUE(move_completes(200, -1));
cleanup:
	driver_stop();
}

static void hotplug_events(void) {
	SERIAL_CHECK_TRUE(driver_start());
	SERIAL_CHECK_EQ_INT(1, attached);
	plug();
	SERIAL_CHECK_EQ_INT(1, attached);
	disconnect_serial_device(&focuser);
	unplug();
	SERIAL_CHECK_EQ_INT(0, attached);
	SERIAL_CHECK_EQ_INT(opened, closed);
	unplug();
	SERIAL_CHECK_EQ_INT(0, attached);
	plug();
	SERIAL_CHECK_EQ_INT(1, attached);
	SERIAL_CHECK_TRUE(connect_focuser());
	SERIAL_CHECK_TRUE(move_completes(200, -1));
cleanup:
	driver_stop();
}

// Unplugging a focuser that is moving has to release it without driving the
// motor any further.
static void removal_during_motion(void) {
	SERIAL_CHECK_TRUE(driver_start());
	SERIAL_CHECK_TRUE(number_change(FOCUSER_STEPS_PROPERTY_NAME, FOCUSER_STEPS_ITEM_NAME, 4000, INDIGO_BUSY_STATE));
	SERIAL_CHECK_TRUE(wait_for_direction(-1));
	unplug();
	SERIAL_CHECK_EQ_INT(0, attached);
	SERIAL_CHECK_EQ_INT(opened, closed);
	// Closing the focuser stops the motor.
	SERIAL_CHECK_EQ_INT(0, atomic_load(&direction));
	int writes = atomic_load(&calls);
	indigo_usleep(4500000);
	SERIAL_CHECK_EQ_INT(writes, atomic_load(&calls));
	SERIAL_CHECK_EQ_INT(0, calls_after_close);
	plug();
	SERIAL_CHECK_TRUE(connect_focuser());
	SERIAL_CHECK_TRUE(move_completes(200, -1));
cleanup:
	driver_stop();
}

static void init_rollback(void) {
	reset_fake();
	atomic_store(&fail_queue, 1);
	SERIAL_CHECK_TRUE(!bring_up_serial_driver(&focuser));
	SERIAL_CHECK_EQ_INT(0, attached);
	SERIAL_CHECK_TRUE(hotplug == NULL);
	atomic_store(&fail_register, 1);
	SERIAL_CHECK_TRUE(!bring_up_serial_driver(&focuser));
	SERIAL_CHECK_EQ_INT(0, attached);
	SERIAL_CHECK_EQ_INT(0, references);
	atomic_store(&fail_attach, 1);
	SERIAL_CHECK_TRUE(bring_up_serial_driver(&focuser));
	indigo_queue_drain(driver_queue);
	SERIAL_CHECK_EQ_INT(0, attached);
	SERIAL_CHECK_EQ_INT(0, references);
	plug();
	SERIAL_CHECK_EQ_INT(1, attached);
	SERIAL_CHECK_TRUE(connect_focuser());
cleanup:
	driver_stop();
}

// ----------------------------------------------------------------- motion

// A move drives the requested direction for the requested number of
// milliseconds, at the configured power and frequency.
static void timed_move(void) {
	SERIAL_CHECK_TRUE(driver_start());
	SERIAL_CHECK_TRUE(switch_change(FOCUSER_DIRECTION_PROPERTY_NAME, FOCUSER_DIRECTION_MOVE_OUTWARD_ITEM_NAME, INDIGO_OK_STATE));
	SERIAL_CHECK_TRUE(move_completes(400, 1));
	SERIAL_CHECK_EQ_INT(255, atomic_load(&power));
	SERIAL_CHECK_EQ_INT(1, atomic_load(&frequency));
	double driven = motion_stopped - motion_started;
	printf("Outward move driven for %.3f s\n", driven);
	SERIAL_CHECK_TRUE(driven > .35 && driven < .7);
	SERIAL_CHECK_TRUE(switch_change(FOCUSER_DIRECTION_PROPERTY_NAME, FOCUSER_DIRECTION_MOVE_INWARD_ITEM_NAME, INDIGO_OK_STATE));
	SERIAL_CHECK_TRUE(move_completes(300, -1));
	driven = motion_stopped - motion_started;
	printf("Inward move driven for %.3f s\n", driven);
	SERIAL_CHECK_TRUE(driven > .25 && driven < .6);
	// The step count is cleared when the move finishes.
	SERIAL_CHECK_TRUE(wait_for_number_item_value(FOCUSER_STEPS_PROPERTY_NAME, FOCUSER_STEPS_ITEM_NAME, 0, 0));
cleanup:
	driver_stop();
}

// The power and the frequency are written before the motor is started.
static void power_and_frequency(void) {
	SERIAL_CHECK_TRUE(driver_start());
	SERIAL_CHECK_TRUE(number_change(FOCUSER_SPEED_PROPERTY_NAME, FOCUSER_SPEED_ITEM_NAME, 120, INDIGO_OK_STATE));
	SERIAL_CHECK_TRUE(switch_change(X_FOCUSER_FREQUENCY_PROPERTY_NAME, X_FOCUSER_FREQUENCY_4_ITEM_NAME, INDIGO_OK_STATE));
	SERIAL_CHECK_TRUE(move_completes(200, -1));
	SERIAL_CHECK_EQ_INT(120, atomic_load(&power));
	SERIAL_CHECK_EQ_INT(4, atomic_load(&frequency));
	SERIAL_CHECK_TRUE(switch_change(X_FOCUSER_FREQUENCY_PROPERTY_NAME, X_FOCUSER_FREQUENCY_16_ITEM_NAME, INDIGO_OK_STATE));
	SERIAL_CHECK_TRUE(move_completes(200, -1));
	SERIAL_CHECK_EQ_INT(16, atomic_load(&frequency));
	SERIAL_CHECK_TRUE(switch_change(X_FOCUSER_FREQUENCY_PROPERTY_NAME, X_FOCUSER_FREQUENCY_1_ITEM_NAME, INDIGO_OK_STATE));
	SERIAL_CHECK_TRUE(move_completes(200, -1));
	SERIAL_CHECK_EQ_INT(1, atomic_load(&frequency));
cleanup:
	driver_stop();
}

// Each of the three writes a move needs can fail, and none of them may be
// published as a started motion.
static void move_command_failures(void) {
	SERIAL_CHECK_TRUE(driver_start());
	atomic_store(&fail_power, 1);
	SERIAL_CHECK_TRUE(number_change(FOCUSER_STEPS_PROPERTY_NAME, FOCUSER_STEPS_ITEM_NAME, 200, INDIGO_ALERT_STATE));
	SERIAL_CHECK_EQ_INT(0, atomic_load(&direction));
	atomic_store(&fail_frequency, 1);
	SERIAL_CHECK_TRUE(number_change(FOCUSER_STEPS_PROPERTY_NAME, FOCUSER_STEPS_ITEM_NAME, 200, INDIGO_ALERT_STATE));
	SERIAL_CHECK_EQ_INT(0, atomic_load(&direction));
	atomic_store(&fail_move, 1);
	SERIAL_CHECK_TRUE(number_change(FOCUSER_STEPS_PROPERTY_NAME, FOCUSER_STEPS_ITEM_NAME, 200, INDIGO_ALERT_STATE));
	SERIAL_CHECK_EQ_INT(0, atomic_load(&direction));
	// A zero move has nothing to drive and is refused as well.
	SERIAL_CHECK_TRUE(number_change(FOCUSER_STEPS_PROPERTY_NAME, FOCUSER_STEPS_ITEM_NAME, 0, INDIGO_ALERT_STATE));
	SERIAL_CHECK_EQ_INT(0, atomic_load(&moves));
	SERIAL_CHECK_TRUE(move_completes(200, -1));
cleanup:
	driver_stop();
}

// A stop the device refuses at the end of a move must be reported rather than
// published as a completed move.
static void stop_failure(void) {
	SERIAL_CHECK_TRUE(driver_start());
	unsigned int alerts = property_state_revision(FOCUSER_STEPS_PROPERTY_NAME, INDIGO_ALERT_STATE);
	SERIAL_CHECK_TRUE(number_change(FOCUSER_STEPS_PROPERTY_NAME, FOCUSER_STEPS_ITEM_NAME, 300, INDIGO_BUSY_STATE));
	SERIAL_CHECK_TRUE(wait_for_direction(-1));
	atomic_store(&fail_stop, 1);
	SERIAL_CHECK_TRUE(state_seen(FOCUSER_STEPS_PROPERTY_NAME, INDIGO_ALERT_STATE, alerts));
	SERIAL_CHECK_TRUE(move_completes(200, -1));
cleanup:
	driver_stop();
}

// An aborted move stops the motor and is reported as interrupted.
static void abort_motion(void) {
	SERIAL_CHECK_TRUE(driver_start());
	unsigned int alerts = property_state_revision(FOCUSER_STEPS_PROPERTY_NAME, INDIGO_ALERT_STATE);
	SERIAL_CHECK_TRUE(number_change(FOCUSER_STEPS_PROPERTY_NAME, FOCUSER_STEPS_ITEM_NAME, 4000, INDIGO_BUSY_STATE));
	SERIAL_CHECK_TRUE(wait_for_direction(-1));
	SERIAL_CHECK_TRUE(switch_change(FOCUSER_ABORT_MOTION_PROPERTY_NAME, FOCUSER_ABORT_MOTION_ITEM_NAME, INDIGO_OK_STATE));
	SERIAL_CHECK_EQ_INT(0, atomic_load(&direction));
	SERIAL_CHECK_TRUE(state_seen(FOCUSER_STEPS_PROPERTY_NAME, INDIGO_ALERT_STATE, alerts));
	// The cancelled move must not stop the motor a second time later on.
	int writes = atomic_load(&calls);
	indigo_usleep(4500000);
	SERIAL_CHECK_EQ_INT(writes, atomic_load(&calls));
	SERIAL_CHECK_TRUE(move_completes(200, -1));
cleanup:
	driver_stop();
}

static void abort_while_idle(void) {
	SERIAL_CHECK_TRUE(driver_start());
	SERIAL_CHECK_TRUE(switch_change(FOCUSER_ABORT_MOTION_PROPERTY_NAME, FOCUSER_ABORT_MOTION_ITEM_NAME, INDIGO_OK_STATE));
	SERIAL_CHECK_TRUE(move_completes(200, -1));
cleanup:
	driver_stop();
}

// A stop the device refuses during an abort must be reported.
static void abort_command_failure(void) {
	SERIAL_CHECK_TRUE(driver_start());
	SERIAL_CHECK_TRUE(number_change(FOCUSER_STEPS_PROPERTY_NAME, FOCUSER_STEPS_ITEM_NAME, 4000, INDIGO_BUSY_STATE));
	SERIAL_CHECK_TRUE(wait_for_direction(-1));
	atomic_store(&fail_stop, 1);
	SERIAL_CHECK_TRUE(switch_change(FOCUSER_ABORT_MOTION_PROPERTY_NAME, FOCUSER_ABORT_MOTION_ITEM_NAME, INDIGO_ALERT_STATE));
	SERIAL_CHECK_TRUE(switch_change(FOCUSER_ABORT_MOTION_PROPERTY_NAME, FOCUSER_ABORT_MOTION_ITEM_NAME, INDIGO_OK_STATE));
	SERIAL_CHECK_EQ_INT(0, atomic_load(&direction));
	SERIAL_CHECK_TRUE(move_completes(200, -1));
cleanup:
	driver_stop();
}

// Disconnecting while the motor runs stops it and cancels the pending
// completion.
static void disconnect_during_motion(void) {
	SERIAL_CHECK_TRUE(driver_start());
	SERIAL_CHECK_TRUE(number_change(FOCUSER_STEPS_PROPERTY_NAME, FOCUSER_STEPS_ITEM_NAME, 4000, INDIGO_BUSY_STATE));
	SERIAL_CHECK_TRUE(wait_for_direction(-1));
	disconnect_serial_device(&focuser);
	SERIAL_CHECK_TRUE(!context.connected);
	SERIAL_CHECK_EQ_INT(0, atomic_load(&direction));
	SERIAL_CHECK_EQ_INT(opened, closed);
	int writes = atomic_load(&calls);
	indigo_usleep(4500000);
	SERIAL_CHECK_EQ_INT(writes, atomic_load(&calls));
	SERIAL_CHECK_EQ_INT(0, calls_after_close);
	SERIAL_CHECK_TRUE(connect_focuser());
	SERIAL_CHECK_TRUE(move_completes(200, -1));
cleanup:
	driver_stop();
}

// X_FOCUSER_FREQUENCY is the one setting the driver persists.
static void configuration_roundtrip(void) {
	SERIAL_CHECK_TRUE(driver_start());
	SERIAL_CHECK_TRUE(switch_change(X_FOCUSER_FREQUENCY_PROPERTY_NAME, X_FOCUSER_FREQUENCY_16_ITEM_NAME, INDIGO_OK_STATE));
	SERIAL_CHECK_TRUE(switch_change(CONFIG_PROPERTY_NAME, CONFIG_SAVE_ITEM_NAME, INDIGO_OK_STATE));
	disconnect_serial_device(&focuser);
	tear_down_serial_driver(&focuser);
	SERIAL_CHECK_TRUE(driver_start());
	SERIAL_CHECK_TRUE(switch_is(X_FOCUSER_FREQUENCY_PROPERTY_NAME, X_FOCUSER_FREQUENCY_1_ITEM_NAME, true));
	SERIAL_CHECK_TRUE(switch_change(CONFIG_PROPERTY_NAME, CONFIG_LOAD_ITEM_NAME, INDIGO_OK_STATE));
	for (int i = 0; i < 50 && !switch_is(X_FOCUSER_FREQUENCY_PROPERTY_NAME, X_FOCUSER_FREQUENCY_16_ITEM_NAME, true); i++) {
		indigo_usleep(100000);
	}
	SERIAL_CHECK_TRUE(switch_is(X_FOCUSER_FREQUENCY_PROPERTY_NAME, X_FOCUSER_FREQUENCY_16_ITEM_NAME, true));
	// The restored setting has to govern the next move.
	SERIAL_CHECK_TRUE(move_completes(200, -1));
	SERIAL_CHECK_EQ_INT(16, atomic_load(&frequency));
cleanup:
	driver_stop();
}

// ----------------------------------------------------------------- runner

int main(void) {
	setvbuf(stdout, NULL, _IONBF, 0);
	alarm(300);
	if (mkdtemp(config_folder) == NULL) {
		fprintf(stderr, "Cannot create configuration directory\n");
		return 1;
	}
	const indigo_test_case tests[] = {
		{ "metadata", metadata },
		{ "property_contract", property_contract },
		{ "open_failure", open_failure },
		{ "repeated_init_shutdown", repeated_init_shutdown },
		{ "shutdown_rejected_while_connected", shutdown_rejected_while_connected },
		{ "hotplug_events", hotplug_events },
		{ "removal_during_motion", removal_during_motion },
		{ "init_rollback", init_rollback },
		{ "timed_move", timed_move },
		{ "power_and_frequency", power_and_frequency },
		{ "move_command_failures", move_command_failures },
		{ "stop_failure", stop_failure },
		{ "abort_motion", abort_motion },
		{ "abort_while_idle", abort_while_idle },
		{ "abort_command_failure", abort_command_failure },
		{ "disconnect_during_motion", disconnect_during_motion },
		{ "configuration_roundtrip", configuration_roundtrip }
	};
	return indigo_run_tests("Shoestring FCUSB focuser", tests, ARRAY_SIZE(tests));
}
