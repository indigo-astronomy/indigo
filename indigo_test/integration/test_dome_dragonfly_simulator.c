// Copyright (c) 2026 INDIGO initiative
// All rights reserved.
//
// You may use this software under the terms of 'INDIGO Astronomy
// open-source license' (see LICENSE.md).
//
// THIS SOFTWARE IS PROVIDED BY THE AUTHORS 'AS IS' AND ANY EXPRESS
// OR IMPLIED WARRANTIES, INCLUDING, BUT NOT LIMITED TO, THE IMPLIED
// WARRANTIES OF MERCHANTABILITY AND FITNESS FOR A PARTICULAR PURPOSE
// ARE DISCLAIMED. IN NO EVENT SHALL THE AUTHOR BE LIABLE FOR ANY
// DIRECT, INDIRECT, INCIDENTAL, SPECIAL, EXEMPLARY, OR CONSEQUENTIAL
// DAMAGES (INCLUDING, BUT NOT LIMITED TO, PROCUREMENT OF SUBSTITUTE
// GOODS OR SERVICES; LOSS OF USE, DATA, OR PROFITS; OR BUSINESS
// INTERRUPTION) HOWEVER CAUSED AND ON ANY THEORY OF LIABILITY,
// WHETHER IN CONTRACT, STRICT LIABILITY, OR TORT (INCLUDING
// NEGLIGENCE OR OTHERWISE) ARISING IN ANY WAY OUT OF THE USE OF THIS
// SOFTWARE, EVEN IF ADVISED OF THE POSSIBILITY OF SUCH DAMAGE.

// Code is generated by AI

// indigo_dome_dragonfly acceptance suite against the loopback UDP Dragonfly
// simulator. The driver exposes two logical devices over one controller: the
// roll-off roof master "Dome Dragonfly" and the general purpose relay device
// "Dragonfly Controller", which owns relays 4...8 and sensors 3...7.
// Relays 1...3 and sensors 1, 2 and 8 are reserved for the roof and the mount
// park input, see indigo_drivers/dome_dragonfly/README.md.

#include <indigo_drivers/dome_dragonfly/indigo_dome_dragonfly.h>
#include "serial_simulator_test_common.h"
#include "aux_test_isolation.h"

#ifndef DOME_DRAGONFLY_SIMULATOR_EXECUTABLE
#define DOME_DRAGONFLY_SIMULATOR_EXECUTABLE "build/integration/dome_dragonfly_simulator"
#endif

// The two driver specific properties were named LA_DOME_SETTINGS and
// LA_DOME_BUTTON_FUNCTION before the generator migration; the X_ prefix is
// mandatory for driver specific properties. Item names are unchanged. See
// indigo_drivers/dome_dragonfly/REFACTOR.md.
#define X_DOME_SETTINGS_NAME "X_DOME_SETTINGS"
#define X_DOME_BUTTON_FUNCTION_NAME "X_DOME_BUTTON_FUNCTION"

#define BUTTON_PULSE_LENGTH_ITEM_NAME "BUTTON_PULSE_LENGTH"
#define READ_SENSORS_DELAY_ITEM_NAME "READ_SENSORS_DELAY"
#define OPEN_CLOSE_TIMEOUT_ITEM_NAME "OPEN_CLOSE_TIMEOUT"
#define PARK_SENSOR_THRESHOLD_ITEM_NAME "PARK_SENSOR_THRESHOLD"
#define ONE_BUTTON_ITEM_NAME "1_BUTTON_PUSH"
#define TWO_BUTTONS_ITEM_NAME "2_BUTTONS_PUSH_HOLD"
#define THREE_BUTTONS_ITEM_NAME "3_BUTTONS_PUSH"

#define DOME_DEVICE_NAME "Dome Dragonfly"
#define AUX_DEVICE_NAME "Dragonfly Controller"

static const char *const dome_base_properties[] = {
	INFO_PROPERTY_NAME,
	CONFIG_PROPERTY_NAME,
	PROFILE_NAME_PROPERTY_NAME,
	PROFILE_PROPERTY_NAME,
	CONNECTION_PROPERTY_NAME,
	DEVICE_PORT_PROPERTY_NAME,
	AUTHENTICATION_PROPERTY_NAME,
	X_DOME_SETTINGS_NAME,
	X_DOME_BUTTON_FUNCTION_NAME
};

static const char *const dome_hidden_properties[] = {
	SIMULATION_PROPERTY_NAME,
	DEVICE_PORTS_PROPERTY_NAME,
	DEVICE_BAUDRATE_PROPERTY_NAME,
	DOME_SPEED_PROPERTY_NAME,
	DOME_DIRECTION_PROPERTY_NAME,
	DOME_HORIZONTAL_COORDINATES_PROPERTY_NAME,
	DOME_STEPS_PROPERTY_NAME,
	DOME_PARK_PROPERTY_NAME,
	DOME_DIMENSION_PROPERTY_NAME,
	DOME_SLAVING_PARAMETERS_PROPERTY_NAME,
	DOME_STATE_PROPERTY_NAME,
	DOME_FLAP_PROPERTY_NAME,
	DOME_PARK_POSITION_PROPERTY_NAME,
	DOME_HOME_PROPERTY_NAME,
	UTC_TIME_PROPERTY_NAME,
	DOME_SET_HOST_TIME_PROPERTY_NAME
};

static const char *const dome_connected_properties[] = {
	DOME_ON_COORDINATES_SET_PROPERTY_NAME,
	DOME_ABORT_MOTION_PROPERTY_NAME,
	DOME_SHUTTER_PROPERTY_NAME,
	GEOGRAPHIC_COORDINATES_PROPERTY_NAME
};

static const char *const aux_base_properties[] = {
	INFO_PROPERTY_NAME,
	CONFIG_PROPERTY_NAME,
	PROFILE_NAME_PROPERTY_NAME,
	PROFILE_PROPERTY_NAME,
	CONNECTION_PROPERTY_NAME,
	AUTHENTICATION_PROPERTY_NAME,
	AUX_OUTLET_NAMES_PROPERTY_NAME,
	AUX_SENSOR_NAMES_PROPERTY_NAME
};

static const char *const aux_connected_properties[] = {
	AUX_GPIO_OUTLETS_PROPERTY_NAME,
	AUX_OUTLET_PULSE_LENGTHS_PROPERTY_NAME,
	AUX_GPIO_SENSORS_PROPERTY_NAME
};

static const simulator_driver_case dome_case = {
	"Lunatico Dragonfly Dome",
	"indigo_dome_dragonfly",
	DOME_DEVICE_NAME,
	indigo_dome_dragonfly,
	false,
	dome_base_properties, ARRAY_SIZE(dome_base_properties),
	dome_hidden_properties, ARRAY_SIZE(dome_hidden_properties),
	dome_connected_properties, ARRAY_SIZE(dome_connected_properties),
	NULL, 0
};

static const simulator_driver_case aux_case = {
	"Lunatico Dragonfly Dome",
	"indigo_dome_dragonfly",
	AUX_DEVICE_NAME,
	indigo_dome_dragonfly,
	false,
	aux_base_properties, ARRAY_SIZE(aux_base_properties),
	dome_hidden_properties, ARRAY_SIZE(dome_hidden_properties),
	aux_connected_properties, ARRAY_SIZE(aux_connected_properties),
	NULL, 0
};

// The AUX device shares the controller with the dome, so the dome device is
// pointed at the simulator first; connect_serial_device() then also sets the
// AUX device's own DEVICE_PORT while that property is still published.
static bool connect_aux_device(void) {
	if (!bring_up_serial_driver(&aux_case)) {
		return false;
	}
	if (indigo_change_text_property_1_raw(&simulator_test_client, DOME_DEVICE_NAME, DEVICE_PORT_PROPERTY_NAME, DEVICE_PORT_ITEM_NAME, aux_simulator.port) != INDIGO_OK) {
		tear_down_serial_driver(&aux_case);
		return false;
	}
	indigo_usleep(100000);
	if (!connect_serial_device(&aux_case, aux_simulator.port)) {
		tear_down_serial_driver(&aux_case);
		return false;
	}
	return true;
}

static bool set_shutter(const char *item) {
	return indigo_change_switch_property_1(&simulator_test_client, DOME_DEVICE_NAME, DOME_SHUTTER_PROPERTY_NAME, item, true) == INDIGO_OK;
}

static bool set_setting(const char *item, double value) {
	if (indigo_change_number_property_1(&simulator_test_client, DOME_DEVICE_NAME, X_DOME_SETTINGS_NAME, item, value) != INDIGO_OK) {
		return false;
	}
	return wait_for_number_item_value(X_DOME_SETTINGS_NAME, item, value, .001);
}

static bool set_button_function(const char *item) {
	if (indigo_change_switch_property_1(&simulator_test_client, DOME_DEVICE_NAME, X_DOME_BUTTON_FUNCTION_NAME, item, true) != INDIGO_OK) {
		return false;
	}
	return aux_wait_switch(X_DOME_BUTTON_FUNCTION_NAME, item, true);
}

// Shorten the sensor poll delay so a roof reaching its end position within one
// second is picked up inside the suite's time budget.
static bool set_fast_roof_polling(void) {
	return set_setting(READ_SENSORS_DELAY_ITEM_NAME, 1);
}

static bool wait_for_shutter(const char *item, indigo_property_state state) {
	for (int i = 0; i < 300; i++) {
		indigo_property *property = find_cached_property(DOME_SHUTTER_PROPERTY_NAME);
		indigo_item *cached = find_cached_item(DOME_SHUTTER_PROPERTY_NAME, item);
		if (property != NULL && cached != NULL && property->state == state && cached->sw.value) {
			return true;
		}
		indigo_usleep(100000);
	}
	return false;
}

static bool shutter_switches_are_off(void) {
	indigo_item *opened = find_cached_item(DOME_SHUTTER_PROPERTY_NAME, DOME_SHUTTER_OPENED_ITEM_NAME);
	indigo_item *closed = find_cached_item(DOME_SHUTTER_PROPERTY_NAME, DOME_SHUTTER_CLOSED_ITEM_NAME);
	return opened != NULL && closed != NULL && !opened->sw.value && !closed->sw.value;
}

// Bounded negative check: the property must not leave the given state.
static bool state_stays(const char *property_name, indigo_property_state state, int deciseconds) {
	for (int i = 0; i < deciseconds; i++) {
		indigo_property *property = find_cached_property(property_name);
		if (property == NULL || property->state != state) {
			return false;
		}
		indigo_usleep(100000);
	}
	return true;
}

// Point the single device compliance context at another logical device of the
// same driver and re-read its published properties.
static bool switch_to_device(const simulator_driver_case *device_case) {
	reset_simulator_context(device_case);
	enumerate_simulator_device();
	indigo_usleep(200000);
	return has_defined_property(CONNECTION_PROPERTY_NAME);
}

static bool device_reports_connected(void) {
	indigo_property *connection = find_cached_property(CONNECTION_PROPERTY_NAME);
	indigo_item *connected = find_cached_item(CONNECTION_PROPERTY_NAME, CONNECTION_CONNECTED_ITEM_NAME);
	return connection != NULL && connected != NULL && connected->sw.value && connection->state == INDIGO_OK_STATE;
}

// Teardown for scenarios that connect both logical devices: every device is
// disconnected in turn before the single driver SHUTDOWN.
static void stop_all_devices(void) {
	static const simulator_driver_case *const cases[] = { &aux_case, &dome_case };
	for (int i = 0; i < ARRAY_SIZE(cases); i++) {
		switch_to_device(cases[i]);
		if (device_reports_connected()) {
			disconnect_serial_device(cases[i]);
		}
	}
	indigo_result shutdown = dome_case.entry(INDIGO_DRIVER_SHUTDOWN, NULL);
	indigo_detach_client(&simulator_test_client);
	indigo_result stopped = indigo_stop();
	release_cached_properties();
	ASSERT_EQ_INT(INDIGO_OK, shutdown);
	ASSERT_EQ_INT(INDIGO_OK, stopped);
}

static void outlet_item_name(char *buffer, size_t size, int channel) {
	snprintf(buffer, size, "OUTLET_%d", channel);
}

static void sensor_item_name(char *buffer, size_t size, int channel) {
	snprintf(buffer, size, "GPIO_SENSOR_NAME_%d", channel);
}

// Driver metadata, the dome device inventory, the relabelled shutter and the
// settings and wiring properties this driver adds.
static void dome_identity_and_inventory(void) {
	indigo_property *shutter = NULL;
	indigo_item *model = NULL;

	assert_simulator_driver_info(&dome_case);
	SERIAL_CHECK_TRUE(bring_up_serial_driver(&dome_case));
	enumerate_simulator_device();
	assert_device_interface(INDIGO_INTERFACE_DOME);
	assert_defined_properties(dome_base_properties, ARRAY_SIZE(dome_base_properties));
	assert_not_defined_properties(dome_hidden_properties, ARRAY_SIZE(dome_hidden_properties));
	assert_not_defined_properties(dome_connected_properties, ARRAY_SIZE(dome_connected_properties));
	assert_defined_property_count(ARRAY_SIZE(dome_base_properties));
	assert_property_has_item(X_DOME_SETTINGS_NAME, BUTTON_PULSE_LENGTH_ITEM_NAME);
	assert_property_has_item(X_DOME_SETTINGS_NAME, READ_SENSORS_DELAY_ITEM_NAME);
	assert_property_has_item(X_DOME_SETTINGS_NAME, OPEN_CLOSE_TIMEOUT_ITEM_NAME);
	assert_property_has_item(X_DOME_SETTINGS_NAME, PARK_SENSOR_THRESHOLD_ITEM_NAME);
	assert_property_has_item(X_DOME_BUTTON_FUNCTION_NAME, ONE_BUTTON_ITEM_NAME);
	assert_property_has_item(X_DOME_BUTTON_FUNCTION_NAME, TWO_BUTTONS_ITEM_NAME);
	assert_property_has_item(X_DOME_BUTTON_FUNCTION_NAME, THREE_BUTTONS_ITEM_NAME);
	assert_switch_item_value(X_DOME_BUTTON_FUNCTION_NAME, ONE_BUTTON_ITEM_NAME, true);
	SERIAL_CHECK_TRUE(connect_serial_device(&dome_case, aux_simulator.port));
	assert_defined_properties(dome_connected_properties, ARRAY_SIZE(dome_connected_properties));
	assert_not_defined_properties(dome_hidden_properties, ARRAY_SIZE(dome_hidden_properties));
	assert_defined_property_count(ARRAY_SIZE(dome_base_properties) + ARRAY_SIZE(dome_connected_properties));
	shutter = find_cached_property(DOME_SHUTTER_PROPERTY_NAME);
	SERIAL_CHECK_TRUE(shutter != NULL && !strcmp(shutter->label, "Shutter / Roof"));
	assert_property_has_item(DOME_SHUTTER_PROPERTY_NAME, DOME_SHUTTER_OPENED_ITEM_NAME);
	assert_property_has_item(DOME_SHUTTER_PROPERTY_NAME, DOME_SHUTTER_CLOSED_ITEM_NAME);
	model = find_cached_item(INFO_PROPERTY_NAME, INFO_DEVICE_MODEL_ITEM_NAME);
	SERIAL_CHECK_TRUE(model != NULL && !strcmp(model->text.value, "Dragonfly"));
cleanup:
	aux_stop(&dome_case);
}

// The relay device exposes only the five general purpose channels; relays
// 1...3 and sensors 1, 2 and 8 belong to the roof.
static void aux_identity_and_inventory(void) {
	char item[32];

	SERIAL_CHECK_TRUE(bring_up_serial_driver(&aux_case));
	enumerate_simulator_device();
	assert_device_interface(INDIGO_INTERFACE_AUX_GPIO);
	assert_defined_properties(aux_base_properties, ARRAY_SIZE(aux_base_properties));
	assert_not_defined_properties(aux_connected_properties, ARRAY_SIZE(aux_connected_properties));
	tear_down_serial_driver(&aux_case);
	SERIAL_CHECK_TRUE(connect_aux_device());
	assert_defined_properties(aux_connected_properties, ARRAY_SIZE(aux_connected_properties));
	for (int i = 4; i <= 8; i++) {
		outlet_item_name(item, sizeof(item), i);
		assert_property_has_item(AUX_GPIO_OUTLETS_PROPERTY_NAME, item);
		assert_property_has_item(AUX_OUTLET_PULSE_LENGTHS_PROPERTY_NAME, item);
	}
	for (int i = 3; i <= 7; i++) {
		sensor_item_name(item, sizeof(item), i);
		assert_property_has_item(AUX_GPIO_SENSORS_PROPERTY_NAME, item);
	}
	SERIAL_CHECK_EQ_INT(5, find_cached_property(AUX_GPIO_OUTLETS_PROPERTY_NAME)->count);
	SERIAL_CHECK_EQ_INT(5, find_cached_property(AUX_GPIO_SENSORS_PROPERTY_NAME)->count);
	assert_not_defined_property(DEVICE_PORTS_PROPERTY_NAME);
cleanup:
	aux_stop(&aux_case);
}

// Default wiring: one relay is pulsed and the controller toggles the roof.
static void one_button_open_and_close(void) {
	SERIAL_CHECK_TRUE(start_serial_driver(&dome_case, aux_simulator.port));
	SERIAL_CHECK_TRUE(wait_for_shutter(DOME_SHUTTER_CLOSED_ITEM_NAME, INDIGO_OK_STATE));
	SERIAL_CHECK_TRUE(set_fast_roof_polling());
	SERIAL_CHECK_TRUE(set_shutter(DOME_SHUTTER_OPENED_ITEM_NAME));
	SERIAL_CHECK_TRUE(wait_for_shutter(DOME_SHUTTER_OPENED_ITEM_NAME, INDIGO_OK_STATE));
	SERIAL_CHECK_TRUE(set_shutter(DOME_SHUTTER_CLOSED_ITEM_NAME));
	SERIAL_CHECK_TRUE(wait_for_shutter(DOME_SHUTTER_CLOSED_ITEM_NAME, INDIGO_OK_STATE));
cleanup:
	aux_stop(&dome_case);
}

// Two buttons, push and hold: the open relay stays closed while the roof moves
// and is released when the end sensor is reached.
static void two_button_open(void) {
	SERIAL_CHECK_TRUE(start_serial_driver(&dome_case, aux_simulator.port));
	SERIAL_CHECK_TRUE(set_button_function(TWO_BUTTONS_ITEM_NAME));
	SERIAL_CHECK_TRUE(set_fast_roof_polling());
	SERIAL_CHECK_TRUE(wait_for_shutter(DOME_SHUTTER_CLOSED_ITEM_NAME, INDIGO_OK_STATE));
	SERIAL_CHECK_TRUE(set_shutter(DOME_SHUTTER_OPENED_ITEM_NAME));
	SERIAL_CHECK_TRUE(wait_for_shutter(DOME_SHUTTER_OPENED_ITEM_NAME, INDIGO_OK_STATE));
cleanup:
	aux_stop(&dome_case);
}

// Three buttons, push: separate open, close and stop relays are pulsed.
static void three_button_open(void) {
	SERIAL_CHECK_TRUE(start_serial_driver(&dome_case, aux_simulator.port));
	SERIAL_CHECK_TRUE(set_button_function(THREE_BUTTONS_ITEM_NAME));
	SERIAL_CHECK_TRUE(set_fast_roof_polling());
	SERIAL_CHECK_TRUE(wait_for_shutter(DOME_SHUTTER_CLOSED_ITEM_NAME, INDIGO_OK_STATE));
	SERIAL_CHECK_TRUE(set_shutter(DOME_SHUTTER_OPENED_ITEM_NAME));
	SERIAL_CHECK_TRUE(wait_for_shutter(DOME_SHUTTER_OPENED_ITEM_NAME, INDIGO_OK_STATE));
cleanup:
	aux_stop(&dome_case);
}

static bool abort_motion(void) {
	return indigo_change_switch_property_1(&simulator_test_client, DOME_DEVICE_NAME, DOME_ABORT_MOTION_PROPERTY_NAME, DOME_ABORT_MOTION_ITEM_NAME, true) == INDIGO_OK;
}

static bool abort_settled(void) {
	if (!wait_for_property_state(DOME_SHUTTER_PROPERTY_NAME, INDIGO_ALERT_STATE)) {
		return false;
	}
	if (!wait_for_property_state(DOME_ABORT_MOTION_PROPERTY_NAME, INDIGO_OK_STATE)) {
		return false;
	}
	assert_switch_item_value(DOME_ABORT_MOTION_PROPERTY_NAME, DOME_ABORT_MOTION_ITEM_NAME, false);
	return state_stays(DOME_SHUTTER_PROPERTY_NAME, INDIGO_ALERT_STATE, 20);
}

// Abort stops a roof that is still travelling and leaves the shutter in ALERT,
// because the roof is neither open nor closed. Accepting the request already
// publishes BUSY, so the abort waits for the second BUSY update, which the
// handler sends once the button has actually been pushed.
static void abort_while_opening(void) {
	unsigned int revision;

	SERIAL_CHECK_TRUE(start_serial_driver(&dome_case, aux_simulator.port));
	SERIAL_CHECK_TRUE(wait_for_shutter(DOME_SHUTTER_CLOSED_ITEM_NAME, INDIGO_OK_STATE));
	SERIAL_CHECK_TRUE(set_fast_roof_polling());
	revision = property_revision(DOME_SHUTTER_PROPERTY_NAME);
	SERIAL_CHECK_TRUE(set_shutter(DOME_SHUTTER_OPENED_ITEM_NAME));
	SERIAL_CHECK_TRUE(wait_for_property_state_after(DOME_SHUTTER_PROPERTY_NAME, INDIGO_BUSY_STATE, revision + 1));
	SERIAL_CHECK_TRUE(abort_motion());
	SERIAL_CHECK_TRUE(abort_settled());
cleanup:
	aux_stop(&dome_case);
}

// An abort that overtakes a queued shutter start cancels it, so the roof is
// never pushed and the operation still settles.
static void abort_before_start(void) {
	SERIAL_CHECK_TRUE(start_serial_driver(&dome_case, aux_simulator.port));
	SERIAL_CHECK_TRUE(wait_for_shutter(DOME_SHUTTER_CLOSED_ITEM_NAME, INDIGO_OK_STATE));
	SERIAL_CHECK_TRUE(set_fast_roof_polling());
	SERIAL_CHECK_TRUE(set_shutter(DOME_SHUTTER_OPENED_ITEM_NAME));
	SERIAL_CHECK_TRUE(abort_motion());
	SERIAL_CHECK_TRUE(abort_settled());
cleanup:
	aux_stop(&dome_case);
}

// A roof that never reaches its end sensor fails the operation after the
// configured timeout and both shutter switches are cleared.
static void open_timeout(void) {
	SERIAL_CHECK_TRUE(start_serial_driver(&dome_case, aux_simulator.port));
	SERIAL_CHECK_TRUE(wait_for_shutter(DOME_SHUTTER_CLOSED_ITEM_NAME, INDIGO_OK_STATE));
	SERIAL_CHECK_TRUE(set_fast_roof_polling());
	SERIAL_CHECK_TRUE(set_setting(OPEN_CLOSE_TIMEOUT_ITEM_NAME, 3));
	SERIAL_CHECK_TRUE(set_shutter(DOME_SHUTTER_OPENED_ITEM_NAME));
	SERIAL_CHECK_TRUE(wait_for_property_state(DOME_SHUTTER_PROPERTY_NAME, INDIGO_BUSY_STATE));
	SERIAL_CHECK_TRUE(wait_for_property_state(DOME_SHUTTER_PROPERTY_NAME, INDIGO_ALERT_STATE));
	SERIAL_CHECK_TRUE(shutter_switches_are_off());
cleanup:
	aux_stop(&dome_case);
}

// The roof must not move while the mount is not parked; the shutter switch is
// restored to the state the roof is actually in.
static void refuses_to_move_when_not_parked(void) {
	SERIAL_CHECK_TRUE(start_serial_driver(&dome_case, aux_simulator.port));
	SERIAL_CHECK_TRUE(wait_for_shutter(DOME_SHUTTER_CLOSED_ITEM_NAME, INDIGO_OK_STATE));
	SERIAL_CHECK_TRUE(set_shutter(DOME_SHUTTER_OPENED_ITEM_NAME));
	SERIAL_CHECK_TRUE(wait_for_shutter(DOME_SHUTTER_CLOSED_ITEM_NAME, INDIGO_ALERT_STATE));
	SERIAL_CHECK_TRUE(state_stays(DOME_SHUTTER_PROPERTY_NAME, INDIGO_ALERT_STATE, 20));
cleanup:
	aux_stop(&dome_case);
}

// Connecting to an already open roof seeds the shutter from the end sensors.
static void initial_state_open(void) {
	SERIAL_CHECK_TRUE(start_serial_driver(&dome_case, aux_simulator.port));
	SERIAL_CHECK_TRUE(wait_for_shutter(DOME_SHUTTER_OPENED_ITEM_NAME, INDIGO_OK_STATE));
cleanup:
	aux_stop(&dome_case);
}

// A roof that is neither open nor closed, and a roof whose end sensors are
// both active, are both reported as an unknown state.
static void initial_state_unknown(void) {
	SERIAL_CHECK_TRUE(start_serial_driver(&dome_case, aux_simulator.port));
	SERIAL_CHECK_TRUE(wait_for_property_state(DOME_SHUTTER_PROPERTY_NAME, INDIGO_ALERT_STATE));
	SERIAL_CHECK_TRUE(shutter_switches_are_off());
cleanup:
	aux_stop(&dome_case);
}

// Requesting the state the roof is already in is acknowledged without moving
// it. A real move reports BUSY until the sensor read delay elapses, so the
// shutter settling at OK and staying there proves nothing was started.
static void already_open(void) {
	unsigned int revision;

	SERIAL_CHECK_TRUE(start_serial_driver(&dome_case, aux_simulator.port));
	SERIAL_CHECK_TRUE(wait_for_shutter(DOME_SHUTTER_OPENED_ITEM_NAME, INDIGO_OK_STATE));
	revision = property_revision(DOME_SHUTTER_PROPERTY_NAME);
	SERIAL_CHECK_TRUE(set_shutter(DOME_SHUTTER_OPENED_ITEM_NAME));
	SERIAL_CHECK_TRUE(wait_for_property_state_seen_after(DOME_SHUTTER_PROPERTY_NAME, INDIGO_OK_STATE, revision));
	SERIAL_CHECK_TRUE(state_stays(DOME_SHUTTER_PROPERTY_NAME, INDIGO_OK_STATE, 40));
	assert_switch_item_value(DOME_SHUTTER_PROPERTY_NAME, DOME_SHUTTER_OPENED_ITEM_NAME, true);
	assert_switch_item_value(DOME_SHUTTER_PROPERTY_NAME, DOME_SHUTTER_CLOSED_ITEM_NAME, false);
cleanup:
	aux_stop(&dome_case);
}

// A rejected relay command fails the shutter operation instead of reporting a
// move that never started.
static void shutter_relay_error(void) {
	SERIAL_CHECK_TRUE(start_serial_driver(&dome_case, aux_simulator.port));
	SERIAL_CHECK_TRUE(wait_for_shutter(DOME_SHUTTER_CLOSED_ITEM_NAME, INDIGO_OK_STATE));
	SERIAL_CHECK_TRUE(set_shutter(DOME_SHUTTER_OPENED_ITEM_NAME));
	SERIAL_CHECK_TRUE(wait_for_property_state(DOME_SHUTTER_PROPERTY_NAME, INDIGO_ALERT_STATE));
	SERIAL_CHECK_TRUE(state_stays(DOME_SHUTTER_PROPERTY_NAME, INDIGO_ALERT_STATE, 20));
cleanup:
	aux_stop(&dome_case);
}

// The five general purpose relays of the AUX device address controller
// channels 4...8.
static void aux_relays(void) {
	char item[32];

	SERIAL_CHECK_TRUE(connect_aux_device());
	for (int i = 4; i <= 8; i++) {
		outlet_item_name(item, sizeof(item), i);
		SERIAL_CHECK_EQ_INT(indigo_change_switch_property_1(&simulator_test_client, AUX_DEVICE_NAME, AUX_GPIO_OUTLETS_PROPERTY_NAME, item, true), INDIGO_OK);
		SERIAL_CHECK_TRUE(aux_wait_switch(AUX_GPIO_OUTLETS_PROPERTY_NAME, item, true));
	}
	for (int i = 4; i <= 8; i++) {
		outlet_item_name(item, sizeof(item), i);
		SERIAL_CHECK_EQ_INT(indigo_change_switch_property_1(&simulator_test_client, AUX_DEVICE_NAME, AUX_GPIO_OUTLETS_PROPERTY_NAME, item, false), INDIGO_OK);
		SERIAL_CHECK_TRUE(aux_wait_switch(AUX_GPIO_OUTLETS_PROPERTY_NAME, item, false));
	}
cleanup:
	aux_stop(&aux_case);
}

// The five general purpose sensors of the AUX device read controller channels
// 3...7, so the roof and park inputs are not exposed there.
static void aux_sensors(void) {
	char item[32];

	SERIAL_CHECK_TRUE(connect_aux_device());
	for (int i = 3; i <= 7; i++) {
		sensor_item_name(item, sizeof(item), i);
		SERIAL_CHECK_TRUE(wait_for_number_item_value(AUX_GPIO_SENSORS_PROPERTY_NAME, item, 10 + i, .01));
	}
	SERIAL_CHECK_TRUE(wait_for_property_state(AUX_GPIO_SENSORS_PROPERTY_NAME, INDIGO_OK_STATE));
cleanup:
	aux_stop(&aux_case);
}

// A timed pulse on a general purpose relay clears itself.
static void aux_pulse(void) {
	SERIAL_CHECK_TRUE(connect_aux_device());
	SERIAL_CHECK_EQ_INT(indigo_change_number_property_1(&simulator_test_client, AUX_DEVICE_NAME, AUX_OUTLET_PULSE_LENGTHS_PROPERTY_NAME, "OUTLET_4", 500), INDIGO_OK);
	SERIAL_CHECK_TRUE(wait_for_number_item_value(AUX_OUTLET_PULSE_LENGTHS_PROPERTY_NAME, "OUTLET_4", 500, .01));
	SERIAL_CHECK_EQ_INT(indigo_change_switch_property_1(&simulator_test_client, AUX_DEVICE_NAME, AUX_GPIO_OUTLETS_PROPERTY_NAME, "OUTLET_4", true), INDIGO_OK);
	SERIAL_CHECK_TRUE(aux_wait_switch(AUX_GPIO_OUTLETS_PROPERTY_NAME, "OUTLET_4", true));
	SERIAL_CHECK_TRUE(aux_wait_switch(AUX_GPIO_OUTLETS_PROPERTY_NAME, "OUTLET_4", false));
cleanup:
	aux_stop(&aux_case);
}

// Both logical devices share one controller session. Dome first: the AUX
// device joins the open session, and closing the AUX device leaves the dome
// working on the same socket.
static void shared_connection_dome_first(void) {
	SERIAL_CHECK_TRUE(start_serial_driver(&dome_case, aux_simulator.port));
	SERIAL_CHECK_TRUE(wait_for_shutter(DOME_SHUTTER_CLOSED_ITEM_NAME, INDIGO_OK_STATE));
	SERIAL_CHECK_TRUE(connect_serial_device(&aux_case, aux_simulator.port));
	SERIAL_CHECK_TRUE(wait_for_number_item_value(AUX_GPIO_SENSORS_PROPERTY_NAME, "GPIO_SENSOR_NAME_3", 13, .01));
	disconnect_serial_device(&aux_case);
	SERIAL_CHECK_TRUE(!context.connected);
	SERIAL_CHECK_TRUE(switch_to_device(&dome_case));
	SERIAL_CHECK_TRUE(device_reports_connected());
	SERIAL_CHECK_TRUE(set_fast_roof_polling());
	SERIAL_CHECK_TRUE(set_shutter(DOME_SHUTTER_OPENED_ITEM_NAME));
	SERIAL_CHECK_TRUE(wait_for_shutter(DOME_SHUTTER_OPENED_ITEM_NAME, INDIGO_OK_STATE));
cleanup:
	stop_all_devices();
}

// The reverse order: the AUX device opens the session, the dome joins it, and
// closing the dome leaves the relay device working.
static void shared_connection_aux_first(void) {
	SERIAL_CHECK_TRUE(connect_aux_device());
	SERIAL_CHECK_TRUE(wait_for_number_item_value(AUX_GPIO_SENSORS_PROPERTY_NAME, "GPIO_SENSOR_NAME_3", 13, .01));
	SERIAL_CHECK_TRUE(connect_serial_device(&dome_case, NULL));
	SERIAL_CHECK_TRUE(wait_for_shutter(DOME_SHUTTER_CLOSED_ITEM_NAME, INDIGO_OK_STATE));
	disconnect_serial_device(&dome_case);
	SERIAL_CHECK_TRUE(!context.connected);
	SERIAL_CHECK_TRUE(switch_to_device(&aux_case));
	SERIAL_CHECK_TRUE(device_reports_connected());
	SERIAL_CHECK_EQ_INT(indigo_change_switch_property_1(&simulator_test_client, AUX_DEVICE_NAME, AUX_GPIO_OUTLETS_PROPERTY_NAME, "OUTLET_4", true), INDIGO_OK);
	SERIAL_CHECK_TRUE(aux_wait_switch(AUX_GPIO_OUTLETS_PROPERTY_NAME, "OUTLET_4", true));
cleanup:
	stop_all_devices();
}

// SHUTDOWN is refused while a device is still connected and a redundant
// disconnect is tolerated.
static void lifecycle(void) {
	SERIAL_CHECK_TRUE(start_serial_driver(&dome_case, aux_simulator.port));
	SERIAL_CHECK_EQ_INT(INDIGO_BUSY, dome_case.entry(INDIGO_DRIVER_SHUTDOWN, NULL));
	SERIAL_CHECK_TRUE(context.connected);
	disconnect_serial_device(&dome_case);
	disconnect_serial_device(&dome_case);
	SERIAL_CHECK_TRUE(!context.connected);
cleanup:
	aux_stop(&dome_case);
}

// Connection is refused for a controller that is not a Dragonfly and for one
// that does not answer at all.
static void rejected_connection(void) {
	SERIAL_CHECK_TRUE(bring_up_serial_driver(&dome_case));
	SERIAL_CHECK_TRUE(aux_reject(&dome_case, aux_simulator.port));
	SERIAL_CHECK_TRUE(wait_for_property_state(CONNECTION_PROPERTY_NAME, INDIGO_ALERT_STATE));
	SERIAL_CHECK_TRUE(!context.connected);
cleanup:
	aux_stop(&dome_case);
}

int main(void) {
	const aux_simulated_case tests[] = {
		{ "dome_identity_and_inventory", dome_identity_and_inventory, "normal" },
		{ "aux_identity_and_inventory", aux_identity_and_inventory, "normal" },
		{ "one_button_open_and_close", one_button_open_and_close, "normal" },
		{ "two_button_open", two_button_open, "two-button" },
		{ "three_button_open", three_button_open, "three-button" },
		{ "abort_while_opening", abort_while_opening, "slow-roof" },
		{ "abort_before_start", abort_before_start, "slow-roof" },
		{ "open_timeout", open_timeout, "slow-roof" },
		{ "refuses_to_move_when_not_parked", refuses_to_move_when_not_parked, "not-parked" },
		{ "initial_state_open", initial_state_open, "open" },
		{ "initial_state_unknown", initial_state_unknown, "half-open" },
		{ "initial_state_both_sensors", initial_state_unknown, "open+both-sensors" },
		{ "already_open", already_open, "open" },
		{ "shutter_relay_error", shutter_relay_error, "relay-error" },
		{ "aux_relays", aux_relays, "normal" },
		{ "aux_sensors", aux_sensors, "normal" },
		{ "aux_pulse", aux_pulse, "normal" },
		{ "shared_connection_dome_first", shared_connection_dome_first, "normal" },
		{ "shared_connection_aux_first", shared_connection_aux_first, "normal" },
		{ "lifecycle", lifecycle, "normal" },
		{ "wrong_identity", rejected_connection, "wrong-model" },
		{ "silent_device", rejected_connection, "no-reply" }
	};
	return run_aux_simulated("dome_dragonfly", DOME_DRAGONFLY_SIMULATOR_EXECUTABLE, tests, ARRAY_SIZE(tests));
}
