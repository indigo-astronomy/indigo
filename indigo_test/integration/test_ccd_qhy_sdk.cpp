// Copyright (c) 2026 INDIGO initiative
// All rights reserved.
//
// You may use this software under the terms of 'INDIGO Astronomy
// open-source license' (see LICENSE.md).
//
// THIS SOFTWARE IS PROVIDED BY THE AUTHORS 'AS IS' AND ANY EXPRESS
// OR IMPLIED WARRANTIES, INCLUDING, BUT NOT LIMITED TO, THE IMPLIED
// WARRANTIES OF MERCHANTABILITY AND FITNESS FOR A PARTICULAR PURPOSE
// ARE DISCLAIMED. IN NO EVENT SHALL THE AUTHOR BE LIABLE FOR ANY
// DIRECT, INDIRECT, INCIDENTAL, SPECIAL, EXEMPLARY, OR CONSEQUENTIAL
// DAMAGES (INCLUDING, BUT NOT LIMITED TO, PROCUREMENT OF SUBSTITUTE
// GOODS OR SERVICES; LOSS OF USE, DATA, OR PROFITS; OR BUSINESS
// INTERRUPTION) HOWEVER CAUSED AND ON ANY THEORY OF LIABILITY,
// WHETHER IN CONTRACT, STRICT LIABILITY, OR TORT (INCLUDING
// NEGLIGENCE OR OTHERWISE) ARISING IN ANY WAY OUT OF THE USE OF THIS
// SOFTWARE, EVEN IF ADVISED OF THE POSSIBILITY OF SUCH DAMAGE.

// Code is generated by AI

#include <atomic>
#include <initializer_list>
#include <pthread.h>
#include <unistd.h>
#include <dirent.h>
#include <qhyccd.h>
#include <indigo/indigo_usb_utils.h>
#include <indigo/indigo_ccd_driver.h>
#include "../test_runner.h"

#ifdef QHY2
#define ENTRY indigo_ccd_qhy2
#else
#define ENTRY indigo_ccd_qhy
#endif
extern "C" indigo_result ENTRY(indigo_driver_action, indigo_driver_info *);

static std::atomic<int> opens, closes, active, attached, blobs, after_close, bus_calls, locks, resources;
static std::atomic<bool> fail_mode, fail_bits;
static std::atomic<int> fail_open, fail_init, fail_chip, fail_start, fail_read, fail_stop, fail_control;
static std::atomic<int> malformed, guide_calls, guide_direction, guide_duration, fw_slot, read_mode;
static std::atomic<int> width(320), height(240), bits(16), bin(1), left, top, formats(3), bin_mask(3), mode_count(2);
static std::atomic<bool> visible(true), live, exposing, cooled, st4(true), cfw(true), temperature_only, shutter;
static std::atomic<double> exposure(0.01), deadline, clock_shift;
static std::atomic<double> params[128];
static std::atomic<bool> color, verify_raw, fail_cooling;
static std::atomic<int> bad_raw, shutter_mode, camera_mask(1), sensor_depth(16);
static pthread_t bus_thread;
static int usb_token;
static int usb_tokens[3];
static std::atomic<int> enumeration_calls, fail_enumeration;
static libusb_hotplug_callback_fn usb_callback;
static indigo_device *devices[6];
static indigo_property *cache[6][80];
static unsigned revisions[6][80], requested[6][80];
static pthread_mutex_t mutex = PTHREAD_MUTEX_INITIALIZER;
static bool migrated;
static std::atomic<int> fail_registration, fail_resource, fail_attachment, fail_descriptor, scan_error, fail_id, refs, fail_range, invalid_value, wheel_status(-1), remaining_error, memory_length;
static std::atomic<bool> guide_blocks, reset_controls;
static char config_folder[] = "/tmp/indigo_qhy_config_XXXXXX";
extern "C" const char *qhy_test_config_folder(void) { return config_folder; }

static pthread_mutex_t gate_mutex = PTHREAD_MUTEX_INITIALIZER;
static pthread_cond_t gate_cond = PTHREAD_COND_INITIALIZER;
static std::atomic<bool> gate_entered, gate_release;
static void queue_gate(indigo_device *d) {
	pthread_mutex_lock(&gate_mutex);
	gate_entered = true;
	struct timespec until;
	clock_gettime(CLOCK_REALTIME, &until);
	until.tv_sec += 5;
	while (!gate_release) {
		if (pthread_cond_timedwait(&gate_cond, &gate_mutex, &until)) { break; }
	}
	pthread_mutex_unlock(&gate_mutex);
}

static void release_gate(void) {
	pthread_mutex_lock(&gate_mutex);
	gate_release = true;
	pthread_cond_broadcast(&gate_cond);
	pthread_mutex_unlock(&gate_mutex);
}

static void call(void) {
	if (pthread_equal(bus_thread, pthread_self())) {
		bus_calls++;
	}
}

static bool valid(qhyccd_handle *h) {
	call();
	if (!h || active <= 0) {
		after_close++;
		return false;
	}
	return true;
}

extern "C" double qhy_test_clock(void) {
	return indigo_monotonic_time() + clock_shift;
}

uint32_t InitQHYCCDResource(void) { if (fail_resource) { return QHYCCD_ERROR; } resources++; return QHYCCD_SUCCESS; }

uint32_t ReleaseQHYCCDResource(void) { resources--; return QHYCCD_SUCCESS; }

void SetQHYCCDLogLevel(uint8_t level) { }

uint32_t OSXInitQHYCCDFirmware(char *path) { return QHYCCD_SUCCESS; }

uint32_t ScanQHYCCD(void) { call(); return scan_error ? QHYCCD_ERROR : visible ? __builtin_popcount((unsigned)camera_mask.load()) : 0; }
#ifdef QHY2
uint32_t GetQHYCCDId(uint32_t index, char *id)
#else
uint32_t GetQHYCCDId(int index, char *id)
#endif
 { int actual = 0;
	for (; actual < 3; actual++) { if (camera_mask & (1 << actual)) { if (index-- == 0) { break; } } }
	snprintf(id, 256, "QHYTEST-%03d", actual + 1); return fail_id ? QHYCCD_ERROR : QHYCCD_SUCCESS; }

uint32_t GetQHYCCDModel(char *id, char *model) { strcpy(model, "QHY test"); return QHYCCD_SUCCESS; }

qhyccd_handle *OpenQHYCCD(char *id) {
	call();
	if (fail_open) { return NULL; }
	opens++; active++;
	return (qhyccd_handle *)&usb_token;
}

uint32_t CloseQHYCCD(qhyccd_handle *h) { valid(h); closes++; active--; return QHYCCD_SUCCESS; }

uint32_t InitQHYCCD(qhyccd_handle *h) { valid(h); bits = formats == 1 ? 8 : formats == 2 ? 16 : sensor_depth.load(); if (reset_controls) { params[CONTROL_GAIN] = params[CONTROL_OFFSET] = params[CONTROL_GAMMA] = params[CONTROL_USBTRAFFIC] = params[CONTROL_SPEED] = 0; } return fail_init ? QHYCCD_ERROR : QHYCCD_SUCCESS; }

uint32_t SetQHYCCDStreamMode(qhyccd_handle *h, uint8_t mode) { valid(h); live = mode; return fail_mode ? QHYCCD_ERROR : QHYCCD_SUCCESS; }

uint32_t GetQHYCCDChipInfo(qhyccd_handle *h, double *cw, double *ch, uint32_t *w, uint32_t *v, double *pw, double *ph, uint32_t *b) {
	valid(h); *cw = 3.2; *ch = 2.4; *pw = *ph = 3.75; *w = read_mode ? 640 : 320; *v = 240; *b = sensor_depth;
	return fail_chip ? QHYCCD_ERROR : QHYCCD_SUCCESS;
}

uint32_t GetQHYCCDEffectiveArea(qhyccd_handle *h, uint32_t *x, uint32_t *y, uint32_t *w, uint32_t *v) { valid(h); *x = *y = 0; *w = read_mode ? 640 : 320; *v = 240; return QHYCCD_SUCCESS; }

uint32_t IsQHYCCDControlAvailable(qhyccd_handle *h, CONTROL_ID c) {
	valid(h);
	if (c == CAM_COLOR) { return color ? BAYER_RG : QHYCCD_ERROR; }
	bool yes = c == CONTROL_EXPOSURE || c == CONTROL_GAIN || c == CONTROL_OFFSET || c == CONTROL_GAMMA || c == CONTROL_USBTRAFFIC || c == CONTROL_SPEED;
	yes |= c == CONTROL_ST4PORT && st4; yes |= c == CONTROL_CFWPORT && cfw;
	yes |= c == CONTROL_COOLER && cooled; yes |= c == CAM_CHIPTEMPERATURESENSOR_INTERFACE && temperature_only; yes |= c == CAM_MECHANICALSHUTTER && shutter;
	yes |= c == CAM_8BITS && (formats & 1); yes |= c == CAM_16BITS && (formats & 2);
	if (c >= CAM_BIN1X1MODE && c <= CAM_BIN4X4MODE) { yes = bin_mask & (1 << (c - CAM_BIN1X1MODE)); }
	return yes ? QHYCCD_SUCCESS : QHYCCD_ERROR;
}

uint32_t GetQHYCCDParamMinMaxStep(qhyccd_handle *h, CONTROL_ID c, double *min, double *max, double *step) { valid(h); *min = fail_range ? 1000 : 0; *max = c == CONTROL_EXPOSURE ? 900000000 : 100; *step = 1; return QHYCCD_SUCCESS; }

double GetQHYCCDParam(qhyccd_handle *h, CONTROL_ID c) { valid(h); return invalid_value == (int)c + 1 ? NAN : params[c].load(); }

uint32_t SetQHYCCDParam(qhyccd_handle *h, CONTROL_ID c, double value) {
	valid(h);
	if (fail_control == (int)c + 1) { return QHYCCD_ERROR; }
	params[c] = value;
	if (c == CONTROL_EXPOSURE) { exposure = value / 1e6; }
	return QHYCCD_SUCCESS;
}

uint32_t SetQHYCCDBinMode(qhyccd_handle *h, uint32_t x, uint32_t y) { valid(h); bin = x; return x == y && (bin_mask & (1 << (x - 1))) ? QHYCCD_SUCCESS : QHYCCD_ERROR; }

uint32_t SetQHYCCDResolution(qhyccd_handle *h, uint32_t x, uint32_t y, uint32_t w, uint32_t v) { valid(h); left = x; top = y; width = w; height = v; return QHYCCD_SUCCESS; }

uint32_t SetQHYCCDBitsMode(qhyccd_handle *h, uint32_t b) { valid(h); if (formats != 3 || fail_bits) { return QHYCCD_ERROR; } bits = b; return QHYCCD_SUCCESS; }

uint32_t GetQHYCCDMemLength(qhyccd_handle *h) { valid(h); return memory_length ? memory_length.load() : 640 * 480 * 2; }

uint32_t ExpQHYCCDSingleFrame(qhyccd_handle *h) { valid(h); exposing = !fail_start; deadline = indigo_monotonic_time() + exposure; return fail_start ? QHYCCD_ERROR : QHYCCD_SUCCESS; }

uint32_t BeginQHYCCDLive(qhyccd_handle *h) { live = true; return ExpQHYCCDSingleFrame(h); }

uint32_t GetQHYCCDExposureRemaining(qhyccd_handle *h) { valid(h); return remaining_error ? QHYCCD_ERROR : indigo_monotonic_time() < deadline ? 200 : 0; }

static uint32_t frame(qhyccd_handle *h, uint32_t *w, uint32_t *v, uint32_t *b, uint32_t *channels, uint8_t *data) {
	valid(h);
	if (fail_read) { return QHYCCD_ERROR; }
	*w = malformed ? 0 : width.load(); *v = height; *b = bits; *channels = 1;
	for (unsigned i = 0; i < width * height * (bits / 8); i++) { data[i] = (uint8_t)((i * 73 + i / 251 + 19) & 255); }
	deadline = indigo_monotonic_time() + exposure;
	return QHYCCD_SUCCESS;
}

uint32_t GetQHYCCDSingleFrame(qhyccd_handle *h, uint32_t *w, uint32_t *v, uint32_t *b, uint32_t *channels, uint8_t *data) { exposing = false; return frame(h, w, v, b, channels, data); }

uint32_t GetQHYCCDLiveFrame(qhyccd_handle *h, uint32_t *w, uint32_t *v, uint32_t *b, uint32_t *channels, uint8_t *data) { return frame(h, w, v, b, channels, data); }

uint32_t CancelQHYCCDExposingAndReadout(qhyccd_handle *h) { valid(h); exposing = false; return fail_stop ? QHYCCD_ERROR : QHYCCD_SUCCESS; }

uint32_t StopQHYCCDLive(qhyccd_handle *h) { live = false; return CancelQHYCCDExposingAndReadout(h); }

uint32_t ControlQHYCCDTemp(qhyccd_handle *h, double t) { valid(h); if (fail_cooling) { return QHYCCD_ERROR; } params[CONTROL_CURTEMP] = t; params[CONTROL_CURPWM] = 127.5; return QHYCCD_SUCCESS; }

uint32_t ControlQHYCCDShutter(qhyccd_handle *h, uint8_t s) { valid(h); shutter_mode = s; return QHYCCD_SUCCESS; }

uint32_t ControlQHYCCDGuide(qhyccd_handle *h, uint32_t direction, uint16_t duration) { valid(h); guide_calls++; guide_direction = direction; guide_duration = duration; if (guide_blocks) { indigo_usleep(duration * 1000); } return fail_control ? QHYCCD_ERROR : QHYCCD_SUCCESS; }

uint32_t SendOrder2QHYCCDCFW(qhyccd_handle *h, char *order, uint32_t length) { valid(h); fw_slot = order[0] - '0'; return fail_control ? QHYCCD_ERROR : QHYCCD_SUCCESS; }

uint32_t GetQHYCCDCFWStatus(qhyccd_handle *h, char *status) { valid(h); status[0] = wheel_status >= 0 ? wheel_status.load() : '0' + fw_slot; status[1] = 0; return fail_read ? QHYCCD_ERROR : QHYCCD_SUCCESS; }
#ifdef QHY2
void SetQHYCCDAutoDetectCamera(bool enabled) { }

uint32_t SetQHYCCDSingleFrameTimeOut(qhyccd_handle *h, uint32_t ms) { valid(h); return QHYCCD_SUCCESS; }

uint32_t GetQHYCCDNumberOfReadModes(qhyccd_handle *h, uint32_t *n) { valid(h); *n = mode_count; return QHYCCD_SUCCESS; }

uint32_t GetQHYCCDReadMode(qhyccd_handle *h, uint32_t *n) { valid(h); *n = read_mode; return QHYCCD_SUCCESS; }

uint32_t GetQHYCCDReadModeName(qhyccd_handle *h, uint32_t n, char *name) { valid(h); snprintf(name, 32, "Mode %u", n); return QHYCCD_SUCCESS; }

uint32_t SetQHYCCDReadMode(qhyccd_handle *h, uint32_t n) { valid(h); read_mode = n; return fail_control ? QHYCCD_ERROR : QHYCCD_SUCCESS; }
#endif

extern "C" void qhy_test_usb_start(void) { }

extern "C" indigo_result qhy_test_lock(indigo_device *d) { locks++; return INDIGO_OK; }

extern "C" indigo_result qhy_test_unlock(indigo_device *d) { locks--; return INDIGO_OK; }

extern "C" libusb_device *qhy_test_usb_device(libusb_device_handle *h) { return (libusb_device *)&usb_token; }

extern "C" indigo_result qhy_test_usb_path(libusb_device *d, char *path) { strcpy(path, "test"); return INDIGO_OK; }

extern "C" int qhy_test_usb_register_sim(libusb_context *, libusb_hotplug_event, libusb_hotplug_flag, int, int, int, libusb_hotplug_callback_fn cb, void *, libusb_hotplug_callback_handle *) {
	if (fail_registration) { return LIBUSB_ERROR_OTHER; }
	usb_callback = cb;
	// Deliberately reverse USB order relative to SDK IDs.
	for (int i = 2; i >= 0; i--) {
		if (visible && (camera_mask & (1 << i))) {
			cb(NULL, (libusb_device *)&usb_tokens[i], LIBUSB_HOTPLUG_EVENT_DEVICE_ARRIVED, NULL);
		}
	}
	return 0;
}

extern "C" libusb_device *qhy_test_usb_ref(libusb_device *d);
extern "C" void qhy_test_usb_unref(libusb_device *d);

extern "C" ssize_t qhy_test_usb_list(libusb_context *, libusb_device ***list) {
	enumeration_calls++;
	if (fail_enumeration) { *list = NULL; return LIBUSB_ERROR_OTHER; }
	*list = (libusb_device **)calloc(4, sizeof(libusb_device *));
	int count = 0;
	for (int i = 0; i < 3; i++) {
		if (visible && (camera_mask & (1 << i))) { (*list)[count++] = qhy_test_usb_ref((libusb_device *)&usb_tokens[i]); }
	}
	return count;
}

extern "C" void qhy_test_usb_free_list(libusb_device **list, int unref) {
	for (int i = 0; list[i]; i++) {
		if (unref) { qhy_test_usb_unref(list[i]); }
	}
	free(list);
}

extern "C" int qhy_test_usb_deregister_poll(libusb_context *, libusb_hotplug_callback_handle) { usb_callback = NULL; return 0; }

extern "C" libusb_device *qhy_test_usb_ref(libusb_device *d) { refs++; return d; }

extern "C" void qhy_test_usb_unref(libusb_device *d) { refs--; }

extern "C" int qhy_test_usb_descriptor(libusb_device *, struct libusb_device_descriptor *d) { memset(d, 0, sizeof(*d)); d->idVendor = 0x1618; return fail_descriptor ? LIBUSB_ERROR_OTHER : 0; }

extern "C" indigo_result qhy_test_attach(indigo_device *d) {
	int i = strstr(d->name, "guider") ? 1 : strstr(d->name, "wheel") ? 2 : 0;
	if (fail_attachment == i + 1) { return INDIGO_FAILED; }
	if (devices[i]) { i += 3; }
	if (devices[i]) { return INDIGO_FAILED; }
	devices[i] = d;
	indigo_result r = indigo_attach_device(d);
	if (r == INDIGO_OK) { attached++; }
	return r;
}

extern "C" indigo_result qhy_test_detach(indigo_device *d) {
	indigo_result r = indigo_detach_device(d);
	for (int i = 0; i < 6; i++) { if (devices[i] == d) { devices[i] = NULL; } }
	attached--; return r;
}

static int slot(int dev, const char *name) {
	for (int i = 0; i < 80; i++) { if (cache[dev][i] && !strcmp(cache[dev][i]->name, name)) { return i; } }
	return -1;
}

static indigo_result observe(indigo_client *, indigo_device *d, indigo_property *p, const char *message) {
	if (getenv("QHY_TEST_TRACE")) { fprintf(stderr, "%s %d %s\n", p->name, p->state, message ? message : ""); }
	pthread_mutex_lock(&mutex);
	int dev = -1;
	for (int i = 0; i < 6; i++) { if (devices[i] == d) { dev = i; } }
	if (dev >= 0) {
		int s = slot(dev, p->name);
		if (s < 0) { for (int i = 0; i < 80; i++) { if (!cache[dev][i]) { s = i; break; } } }
		if (s >= 0) { indigo_release_property(cache[dev][s]); cache[dev][s] = indigo_copy_property(NULL, p); revisions[dev][s]++; }
		if (!strcmp(p->name, "CCD_IMAGE") && p->state == INDIGO_OK_STATE && p->items[0].blob.size > 0) {
			blobs++;
			if (verify_raw) {
				indigo_raw_header header;
				indigo_item *item = p->items;
				size_t length = width * height * (bits / 8);
				bool ok = item->blob.size >= sizeof(header) + length;
				if (ok) {
					memcpy(&header, item->blob.value, sizeof(header));
					ok = header.width == width && header.height == height && header.signature == (bits == 8 ? INDIGO_RAW_MONO8 : INDIGO_RAW_MONO16);
					uint8_t *data = (uint8_t *)item->blob.value + sizeof(header);
					for (size_t i = 0; i < length && ok; i++) { ok = data[i] == (uint8_t)((i * 73 + i / 251 + 19) & 255); }
					bool bayer = memmem(data + length, item->blob.size - sizeof(header) - length, "RGGB", 4) != NULL;
					ok = ok && bayer == color;
				}
				if (!ok) { bad_raw++; }
			}
		}
	}
	pthread_mutex_unlock(&mutex);
	return INDIGO_OK;
}

static indigo_result deleted(indigo_client *, indigo_device *d, indigo_property *p, const char *) {
	pthread_mutex_lock(&mutex);
	for (int dev = 0; dev < 6; dev++) {
		if (devices[dev] != d) { continue; }
		for (int i = 0; i < 80; i++) { if (cache[dev][i] && (!p->name[0] || !strcmp(cache[dev][i]->name, p->name))) { indigo_release_property(cache[dev][i]); cache[dev][i] = NULL; } }
	}
	pthread_mutex_unlock(&mutex);
	return INDIGO_OK;
}

static indigo_client client = { .name = "QHY SDK test", .version = INDIGO_VERSION_CURRENT, .define_property = observe, .update_property = observe, .delete_property = deleted };
static indigo_property *snapshot(int d, const char *name) {
	pthread_mutex_lock(&mutex);
	int s = slot(d, name);
	indigo_property *p = s < 0 ? NULL : indigo_copy_property(NULL, cache[d][s]);
	pthread_mutex_unlock(&mutex);
	return p;
}

static void mark(int d, const char *name) {
	pthread_mutex_lock(&mutex);
	int s = slot(d, name);
	if (s >= 0) { requested[d][s] = revisions[d][s]; }
	pthread_mutex_unlock(&mutex);
}

static bool wait_state(int d, const char *name, indigo_property_state expected) {
	for (int n = 0; n < 600; n++) {
		pthread_mutex_lock(&mutex);
		int s = slot(d, name);
		bool ok = s >= 0 && cache[d][s]->state == expected && revisions[d][s] > requested[d][s];
		pthread_mutex_unlock(&mutex);
		if (ok) { return true; }
		indigo_usleep(10000);
	}
	fprintf(stderr, "Timed out: device %d %s expected %d\n", d, name, expected);
	return false;
}

static void number(int d, const char *p, const char *item, double v) { mark(d, p); indigo_change_number_property_1(&client, devices[d]->name, p, item, v); }

static void sw(int d, const char *p, const char *item) { mark(d, p); indigo_change_switch_property_1(&client, devices[d]->name, p, item, true); }

static bool connect(int d, bool on) { sw(d, "CONNECTION", on ? "CONNECTED" : "DISCONNECTED"); return wait_state(d, "CONNECTION", INDIGO_OK_STATE); }

static bool begin(int expected = 3) {
	bus_calls = 0; after_close = 0; blobs = 0;
	if (ENTRY(INDIGO_DRIVER_INIT, NULL) != INDIGO_OK) { return false; }
	for (int i = 0; i < 600 && attached < expected; i++) { indigo_usleep(10000); }
	return attached == expected;
}

static void end(void) {
	fail_open = fail_init = fail_chip = fail_start = fail_read = fail_stop = fail_control = malformed = 0;
	clock_shift = 0;
	fail_mode = fail_bits = false;
	release_gate();
	fail_registration = fail_resource = fail_attachment = fail_descriptor = scan_error = fail_id = fail_range = invalid_value = remaining_error = memory_length = 0;
	wheel_status = -1;
	guide_blocks = reset_controls = false;
	for (int d = 5; d >= 0; d--) {
		indigo_property *p = snapshot(d, "CONNECTION");
		if (p && p->items[0].sw.value) { connect(d, false); }
		indigo_release_property(p);
	}
	ENTRY(INDIGO_DRIVER_SHUTDOWN, NULL);
}

static void basic_lifecycle(void) {
	ASSERT_TRUE(begin());
	ASSERT_TRUE(connect(1, true)); ASSERT_TRUE(connect(0, true)); ASSERT_TRUE(connect(2, true));
	ASSERT_EQ_INT(1, active.load());
	ASSERT_TRUE(connect(0, false)); ASSERT_EQ_INT(1, active.load());
	ASSERT_TRUE(connect(1, false)); ASSERT_EQ_INT(1, active.load());
	ASSERT_TRUE(connect(2, false)); ASSERT_EQ_INT(0, active.load());
	end(); ASSERT_EQ_INT(opens.load(), closes.load()); ASSERT_EQ_INT(0, locks.load()); ASSERT_EQ_INT(0, resources.load());
}

static void open_rollback(void) {
	ASSERT_TRUE(begin());
	fail_chip = 1; sw(0, "CONNECTION", "CONNECTED"); ASSERT_TRUE(wait_state(0, "CONNECTION", INDIGO_ALERT_STATE));
	int leaked = active; end(); ASSERT_EQ_INT(0, leaked);
}

static void acquisition(void) {
	ASSERT_TRUE(begin()); ASSERT_TRUE(connect(0, true));
	sw(0, "CCD_IMAGE_FORMAT", "RAW");
	number(0, "CCD_EXPOSURE", "EXPOSURE", 0.1); ASSERT_TRUE(wait_state(0, "CCD_EXPOSURE", INDIGO_OK_STATE)); ASSERT_EQ_INT(1, blobs.load());
	end();
}

static void failed_advanced(void) {
	ASSERT_TRUE(begin()); ASSERT_TRUE(connect(0, true));
	fail_control = CONTROL_USBTRAFFIC + 1;
	number(0, migrated ? "X_ADVANCED" : "QHY_ADVANCED", "USBTRAFFIC", 60);
	ASSERT_TRUE(wait_state(0, migrated ? "X_ADVANCED" : "QHY_ADVANCED", INDIGO_ALERT_STATE));
	end();
}

static void initialization_failures(void) {
	for (int stage = 0; stage < 3; stage++) {
		ASSERT_TRUE(begin());
		if (stage == 0) { fail_open = 1; }
		if (stage == 1) { fail_init = 1; }
		if (stage == 2) { fail_chip = 1; }
		sw(0, "CONNECTION", "CONNECTED"); ASSERT_TRUE(wait_state(0, "CONNECTION", INDIGO_ALERT_STATE));
		ASSERT_EQ_INT(0, active.load()); ASSERT_EQ_INT(0, locks.load());
		fail_open = fail_init = fail_chip = 0;
		ASSERT_TRUE(connect(0, true)); end();
	}
}

static void start_and_read_failures(void) {
	ASSERT_TRUE(begin()); ASSERT_TRUE(connect(0, true));
	for (int stage = 0; stage < 3; stage++) {
		fail_start = stage == 0; fail_read = stage == 1; malformed = stage == 2;
		int previous = blobs;
		number(0, "CCD_EXPOSURE", "EXPOSURE", 0.01); ASSERT_TRUE(wait_state(0, "CCD_EXPOSURE", INDIGO_ALERT_STATE));
		ASSERT_EQ_INT(previous, blobs.load());
		fail_start = fail_read = malformed = 0;
		number(0, "CCD_EXPOSURE", "EXPOSURE", 0.01); ASSERT_TRUE(wait_state(0, "CCD_EXPOSURE", INDIGO_OK_STATE));
		ASSERT_EQ_INT(previous + 1, blobs.load());
	}
	end(); ASSERT_EQ_INT(0, after_close.load());
}

static void fractional_exposures(void) {
	ASSERT_TRUE(begin()); ASSERT_TRUE(connect(0, true));
	for (double seconds : { 0.1, 1.5, 2.5 }) {
		double start = indigo_monotonic_time();
		number(0, "CCD_EXPOSURE", "EXPOSURE", seconds); ASSERT_TRUE(wait_state(0, "CCD_EXPOSURE", INDIGO_OK_STATE));
		ASSERT_TRUE(indigo_monotonic_time() - start >= seconds - 0.01);
		ASSERT_TRUE(fabs(exposure - seconds) < 1e-6);
	}
	end();
}

static void abort_and_restart(void) {
	ASSERT_TRUE(begin()); ASSERT_TRUE(connect(0, true));
	number(0, "CCD_EXPOSURE", "EXPOSURE", 20); ASSERT_TRUE(wait_state(0, "CCD_EXPOSURE", INDIGO_BUSY_STATE));
	sw(0, "CCD_ABORT_EXPOSURE", "ABORT_EXPOSURE"); ASSERT_TRUE(wait_state(0, "CCD_ABORT_EXPOSURE", INDIGO_OK_STATE));
	ASSERT_TRUE(wait_state(0, "CCD_EXPOSURE", INDIGO_OK_STATE)); ASSERT_EQ_INT(0, blobs.load());
	number(0, "CCD_EXPOSURE", "EXPOSURE", 0.01); ASSERT_TRUE(wait_state(0, "CCD_EXPOSURE", INDIGO_OK_STATE));
	ASSERT_EQ_INT(1, blobs.load()); end();
}

static void stream_start(int count) {
	mark(0, "CCD_STREAMING");
	const char *names[] = { "EXPOSURE", "COUNT" };
	const double values[] = { 0.01, (double)count };
	indigo_change_number_property(&client, devices[0]->name, "CCD_STREAMING", 2, names, values);
}

static void streams_and_abort(void) {
	ASSERT_TRUE(begin()); ASSERT_TRUE(connect(0, true));
	stream_start(3); ASSERT_TRUE(wait_state(0, "CCD_STREAMING", INDIGO_OK_STATE)); ASSERT_EQ_INT(3, blobs.load());
	stream_start(-1); ASSERT_TRUE(wait_state(0, "CCD_STREAMING", INDIGO_BUSY_STATE));
	for (int i = 0; i < 400 && blobs < 6; i++) { indigo_usleep(10000); }
	ASSERT_TRUE(blobs >= 6);
	sw(0, "CCD_ABORT_EXPOSURE", "ABORT_EXPOSURE"); ASSERT_TRUE(wait_state(0, "CCD_ABORT_EXPOSURE", INDIGO_OK_STATE));
	ASSERT_TRUE(wait_state(0, "CCD_STREAMING", INDIGO_OK_STATE));
	int final_blobs = blobs; indigo_usleep(100000); ASSERT_EQ_INT(final_blobs, blobs.load());
	number(0, "CCD_EXPOSURE", "EXPOSURE", 0.01); ASSERT_TRUE(wait_state(0, "CCD_EXPOSURE", INDIGO_OK_STATE)); end();
}

static void stream_errors(void) {
	ASSERT_TRUE(begin()); ASSERT_TRUE(connect(0, true));
	fail_start = 1; stream_start(2); ASSERT_TRUE(wait_state(0, "CCD_STREAMING", INDIGO_ALERT_STATE)); ASSERT_EQ_INT(0, blobs.load());
	fail_start = 0; fail_stop = 1; stream_start(1); ASSERT_TRUE(wait_state(0, "CCD_STREAMING", INDIGO_ALERT_STATE));
	fail_stop = 0; fail_read = 1; stream_start(1); ASSERT_TRUE(wait_state(0, "CCD_STREAMING", INDIGO_BUSY_STATE));
	indigo_usleep(100000); clock_shift = 30;
	ASSERT_TRUE(wait_state(0, "CCD_STREAMING", INDIGO_ALERT_STATE)); clock_shift = 0; fail_read = 0;
	stream_start(1); ASSERT_TRUE(wait_state(0, "CCD_STREAMING", INDIGO_OK_STATE)); end();
}

static void guider_directions_and_failures(void) {
	ASSERT_TRUE(begin()); ASSERT_TRUE(connect(1, true));
	const char *properties[] = { "GUIDER_GUIDE_RA", "GUIDER_GUIDE_DEC", "GUIDER_GUIDE_DEC", "GUIDER_GUIDE_RA" };
	const char *items[] = { "EAST", "NORTH", "SOUTH", "WEST" };
	for (int i = 0; i < 4; i++) {
		number(1, properties[i], items[i], 30); ASSERT_TRUE(wait_state(1, properties[i], INDIGO_OK_STATE));
		ASSERT_EQ_INT(i, guide_direction.load()); ASSERT_EQ_INT(30, guide_duration.load());
	}
	fail_control = 1; number(1, "GUIDER_GUIDE_RA", "EAST", 10); ASSERT_TRUE(wait_state(1, "GUIDER_GUIDE_RA", INDIGO_ALERT_STATE));
	fail_control = 0; number(1, "GUIDER_GUIDE_RA", "WEST", 10); ASSERT_TRUE(wait_state(1, "GUIDER_GUIDE_RA", INDIGO_OK_STATE));
	end(); ASSERT_EQ_INT(0, after_close.load());
}

static void wheel_position_and_errors(void) {
	ASSERT_TRUE(begin()); ASSERT_TRUE(connect(2, true)); ASSERT_TRUE(wait_state(2, "WHEEL_SLOT", INDIGO_OK_STATE));
	number(2, "WHEEL_SLOT", "SLOT", 5); ASSERT_TRUE(wait_state(2, "WHEEL_SLOT", INDIGO_OK_STATE)); ASSERT_EQ_INT(4, fw_slot.load());
	indigo_property *p = snapshot(2, "WHEEL_SLOT"); ASSERT_TRUE(p); ASSERT_EQ_INT(5, p->items[0].number.value); indigo_release_property(p);
	fail_control = 1; number(2, "WHEEL_SLOT", "SLOT", 3); ASSERT_TRUE(wait_state(2, "WHEEL_SLOT", INDIGO_ALERT_STATE));
	fail_control = 0; fail_read = 1; number(2, "WHEEL_SLOT", "SLOT", 2); ASSERT_TRUE(wait_state(2, "WHEEL_SLOT", INDIGO_ALERT_STATE));
	fail_read = 0; number(2, "WHEEL_SLOT", "SLOT", 1); ASSERT_TRUE(wait_state(2, "WHEEL_SLOT", INDIGO_OK_STATE)); end();
}

static void controls_and_no_bus_io(void) {
	ASSERT_TRUE(begin()); ASSERT_TRUE(connect(0, true));
	const char *names[] = { "CCD_GAIN", "CCD_OFFSET", "CCD_GAMMA", "X_ADVANCED" };
	const char *items[] = { "GAIN", "OFFSET", "GAMMA", "USBTRAFFIC" };
	const CONTROL_ID controls[] = { CONTROL_GAIN, CONTROL_OFFSET, CONTROL_GAMMA, CONTROL_USBTRAFFIC };
	for (int i = 0; i < 4; i++) {
		number(0, names[i], items[i], 55); ASSERT_TRUE(wait_state(0, names[i], INDIGO_OK_STATE)); ASSERT_EQ_INT(55, params[controls[i]]);
		fail_control = controls[i] + 1; number(0, names[i], items[i], 60); ASSERT_TRUE(wait_state(0, names[i], INDIGO_ALERT_STATE));
		indigo_property *p = snapshot(0, names[i]); ASSERT_TRUE(p); ASSERT_EQ_INT(55, p->items[0].number.value); indigo_release_property(p); fail_control = 0;
	}
	ASSERT_EQ_INT(0, bus_calls.load()); end();
}

static void read_modes(void) {
	ASSERT_TRUE(begin()); ASSERT_TRUE(connect(0, true));
#ifdef QHY2
	indigo_property *p = snapshot(0, "X_READ_MODE"); ASSERT_TRUE(p); ASSERT_EQ_INT(2, p->count); indigo_release_property(p);
	sw(0, "X_READ_MODE", "1"); ASSERT_TRUE(wait_state(0, "X_READ_MODE", INDIGO_OK_STATE));
	p = snapshot(0, "CCD_INFO"); ASSERT_TRUE(p); ASSERT_EQ_INT(640, p->items[0].number.value); indigo_release_property(p);
	fail_control = 1; sw(0, "X_READ_MODE", "0"); ASSERT_TRUE(wait_state(0, "X_READ_MODE", INDIGO_ALERT_STATE)); fail_control = 0;
	sw(0, "X_READ_MODE", "0"); ASSERT_TRUE(wait_state(0, "X_READ_MODE", INDIGO_OK_STATE));
#else
	indigo_property *p = snapshot(0, "X_READ_MODE"); ASSERT_TRUE(p == NULL);
#endif
	end();
}

static void roi_formats_and_bins(void) {
	ASSERT_TRUE(begin()); ASSERT_TRUE(connect(0, true));
	sw(0, "CCD_IMAGE_FORMAT", "RAW");
	for (const char *format : { "RAW 8", "RAW 16" }) {
		sw(0, "X_PIXEL_FORMAT", format); ASSERT_TRUE(wait_state(0, "X_PIXEL_FORMAT", INDIGO_OK_STATE));
		const char *names[] = { "LEFT", "TOP", "WIDTH", "HEIGHT" }; const double values[] = { 16, 8, 256, 128 };
		mark(0, "CCD_FRAME"); indigo_change_number_property(&client, devices[0]->name, "CCD_FRAME", 4, names, values); ASSERT_TRUE(wait_state(0, "CCD_FRAME", INDIGO_OK_STATE));
		number(0, "CCD_BIN", "HORIZONTAL", 2); ASSERT_TRUE(wait_state(0, "CCD_BIN", INDIGO_OK_STATE));
		number(0, "CCD_EXPOSURE", "EXPOSURE", 0.01); ASSERT_TRUE(wait_state(0, "CCD_EXPOSURE", INDIGO_OK_STATE));
		ASSERT_EQ_INT(128, width.load()); ASSERT_EQ_INT(64, height.load()); ASSERT_EQ_INT(8, left.load()); ASSERT_EQ_INT(4, top.load()); ASSERT_EQ_INT(!strcmp(format, "RAW 8") ? 8 : 16, bits.load());
		number(0, "CCD_BIN", "HORIZONTAL", 1); ASSERT_TRUE(wait_state(0, "CCD_BIN", INDIGO_OK_STATE));
	}
	end();
}

static void acquisition_conflicts(void) {
	ASSERT_TRUE(begin()); ASSERT_TRUE(connect(0, true));
	number(0, "CCD_EXPOSURE", "EXPOSURE", 20); ASSERT_TRUE(wait_state(0, "CCD_EXPOSURE", INDIGO_BUSY_STATE));
	sw(0, "X_PIXEL_FORMAT", "RAW 8"); ASSERT_TRUE(wait_state(0, "X_PIXEL_FORMAT", INDIGO_ALERT_STATE));
	number(0, "CCD_BIN", "HORIZONTAL", 2); ASSERT_TRUE(wait_state(0, "CCD_BIN", INDIGO_ALERT_STATE));
	indigo_property *p = snapshot(0, "CCD_BIN"); ASSERT_TRUE(p); ASSERT_EQ_INT(1, p->items[0].number.value); indigo_release_property(p);
	sw(0, "CCD_ABORT_EXPOSURE", "ABORT_EXPOSURE"); ASSERT_TRUE(wait_state(0, "CCD_ABORT_EXPOSURE", INDIGO_OK_STATE)); end();
}

static void disconnect_and_sibling_survival(void) {
	ASSERT_TRUE(begin()); ASSERT_TRUE(connect(1, true)); ASSERT_TRUE(connect(0, true));
	stream_start(-1); ASSERT_TRUE(wait_state(0, "CCD_STREAMING", INDIGO_BUSY_STATE));
	ASSERT_TRUE(connect(0, false)); ASSERT_EQ_INT(1, active.load()); ASSERT_TRUE(!live);
	number(1, "GUIDER_GUIDE_DEC", "NORTH", 10); ASSERT_TRUE(wait_state(1, "GUIDER_GUIDE_DEC", INDIGO_OK_STATE));
	ASSERT_TRUE(connect(0, true)); number(0, "CCD_EXPOSURE", "EXPOSURE", 0.01); ASSERT_TRUE(wait_state(0, "CCD_EXPOSURE", INDIGO_OK_STATE)); end();
}

#ifdef QHY2
static void startup_only_discovery(void) {
	ASSERT_TRUE(begin()); ASSERT_TRUE(usb_callback != NULL);
	for (int phase = 0; phase < 4; phase++) {
		if (phase) { ASSERT_TRUE(connect(0, true)); }
		if (phase == 2) { number(0, "CCD_EXPOSURE", "EXPOSURE", 20); ASSERT_TRUE(wait_state(0, "CCD_EXPOSURE", INDIGO_BUSY_STATE)); }
		if (phase == 3) { stream_start(-1); ASSERT_TRUE(wait_state(0, "CCD_STREAMING", INDIGO_BUSY_STATE)); }
		visible = false; usb_callback(NULL, (libusb_device *)&usb_tokens[0], LIBUSB_HOTPLUG_EVENT_DEVICE_LEFT, NULL);
		for (int i = 0; i < 600 && attached; i++) { indigo_usleep(10000); }
		ASSERT_EQ_INT(0, attached.load()); ASSERT_EQ_INT(0, active.load());
		visible = true; usb_callback(NULL, (libusb_device *)&usb_tokens[0], LIBUSB_HOTPLUG_EVENT_DEVICE_ARRIVED, NULL);
		for (int i = 0; i < 600 && attached != 3; i++) { indigo_usleep(10000); }
		ASSERT_EQ_INT(3, attached.load()); ASSERT_TRUE(connect(0, true));
		number(0, "CCD_EXPOSURE", "EXPOSURE", 0.01); ASSERT_TRUE(wait_state(0, "CCD_EXPOSURE", INDIGO_OK_STATE));
		ASSERT_TRUE(connect(0, false));
	}
	end(); ASSERT_EQ_INT(0, refs.load()); ASSERT_EQ_INT(0, after_close.load());
}
#else
static void startup_only_discovery(void) {
	int before = enumeration_calls;
	ASSERT_TRUE(begin()); ASSERT_TRUE(usb_callback == NULL);
	ASSERT_EQ_INT(before + 1, enumeration_calls.load());
	visible = false; indigo_usleep(100000); ASSERT_EQ_INT(3, attached.load());
	visible = true; camera_mask = 3; indigo_usleep(100000);
	ASSERT_EQ_INT(3, attached.load()); ASSERT_EQ_INT(before + 1, enumeration_calls.load());
	camera_mask = 1; end(); ASSERT_EQ_INT(0, refs.load());
}
#endif

static void init_enumeration_and_attachment_rollback(void) {
	fail_resource = 1; ASSERT_EQ_INT(INDIGO_FAILED, ENTRY(INDIGO_DRIVER_INIT, NULL)); ASSERT_EQ_INT(0, resources.load());
	fail_resource = 0;
#ifdef QHY2
	fail_registration = 1;
	ASSERT_EQ_INT(INDIGO_FAILED, ENTRY(INDIGO_DRIVER_INIT, NULL));
	ASSERT_EQ_INT(0, resources.load()); ASSERT_TRUE(usb_callback == NULL);
	fail_registration = 0;
	visible = false;
#else
	fail_enumeration = 1;
#endif
	ASSERT_EQ_INT(INDIGO_OK, ENTRY(INDIGO_DRIVER_INIT, NULL)); indigo_usleep(100000); ASSERT_EQ_INT(0, attached.load());
	end(); fail_enumeration = 0; visible = true; ASSERT_EQ_INT(0, resources.load()); ASSERT_EQ_INT(0, refs.load());
	fail_attachment = 1; ASSERT_EQ_INT(INDIGO_OK, ENTRY(INDIGO_DRIVER_INIT, NULL)); indigo_usleep(100000); ASSERT_EQ_INT(0, attached.load());
	end(); ASSERT_EQ_INT(0, refs.load()); ASSERT_EQ_INT(0, active.load());
	ASSERT_TRUE(begin()); end(); ASSERT_EQ_INT(0, refs.load());
}

static void discovery_failure_and_reload(void) {
	fail_id = 1; ASSERT_EQ_INT(INDIGO_OK, ENTRY(INDIGO_DRIVER_INIT, NULL)); indigo_usleep(100000); ASSERT_EQ_INT(0, attached.load());
	int before = enumeration_calls; fail_id = 0;
	indigo_usleep(200000); ASSERT_EQ_INT(0, attached.load()); ASSERT_EQ_INT(before, enumeration_calls.load());
	end(); ASSERT_EQ_INT(0, refs.load());
	ASSERT_TRUE(begin()); end(); ASSERT_EQ_INT(0, refs.load());
}

static void metadata_and_readback_errors(void) {
	ASSERT_TRUE(begin()); fail_range = 1; sw(0, "CONNECTION", "CONNECTED"); ASSERT_TRUE(wait_state(0, "CONNECTION", INDIGO_ALERT_STATE)); ASSERT_EQ_INT(0, active.load());
	fail_range = 0; invalid_value = CONTROL_GAIN + 1; sw(0, "CONNECTION", "CONNECTED"); ASSERT_TRUE(wait_state(0, "CONNECTION", INDIGO_ALERT_STATE)); ASSERT_EQ_INT(0, active.load());
	invalid_value = 0; ASSERT_TRUE(connect(0, true));
	invalid_value = CONTROL_GAIN + 1; number(0, "CCD_GAIN", "GAIN", 33); ASSERT_TRUE(wait_state(0, "CCD_GAIN", INDIGO_ALERT_STATE));
	invalid_value = 0; number(0, "CCD_GAIN", "GAIN", 34); ASSERT_TRUE(wait_state(0, "CCD_GAIN", INDIGO_OK_STATE)); end();
}

static void queued_abort_before_start(void) {
	ASSERT_TRUE(begin()); ASSERT_TRUE(connect(0, true));
	gate_entered = gate_release = false; indigo_execute_handler(devices[0], queue_gate);
	for (int i = 0; i < 400 && !gate_entered; i++) { indigo_usleep(10000); }
	ASSERT_TRUE(gate_entered);
	number(0, "CCD_EXPOSURE", "EXPOSURE", 20); sw(0, "CCD_ABORT_EXPOSURE", "ABORT_EXPOSURE"); release_gate();
	ASSERT_TRUE(wait_state(0, "CCD_ABORT_EXPOSURE", INDIGO_OK_STATE)); ASSERT_TRUE(wait_state(0, "CCD_EXPOSURE", INDIGO_OK_STATE));
	ASSERT_TRUE(!exposing); ASSERT_EQ_INT(0, blobs.load());
	number(0, "CCD_EXPOSURE", "EXPOSURE", 0.01); ASSERT_TRUE(wait_state(0, "CCD_EXPOSURE", INDIGO_OK_STATE)); end();
}

static void wheel_timeout_and_malformed_status(void) {
	ASSERT_TRUE(begin()); ASSERT_TRUE(connect(2, true)); ASSERT_TRUE(wait_state(2, "WHEEL_SLOT", INDIGO_OK_STATE));
	wheel_status = '0'; number(2, "WHEEL_SLOT", "SLOT", 4); ASSERT_TRUE(wait_state(2, "WHEEL_SLOT", INDIGO_BUSY_STATE));
	indigo_usleep(100000); clock_shift = 100; ASSERT_TRUE(wait_state(2, "WHEEL_SLOT", INDIGO_ALERT_STATE)); clock_shift = 0;
	wheel_status = '?'; number(2, "WHEEL_SLOT", "SLOT", 2); ASSERT_TRUE(wait_state(2, "WHEEL_SLOT", INDIGO_ALERT_STATE));
	wheel_status = -1; number(2, "WHEEL_SLOT", "SLOT", 1); ASSERT_TRUE(wait_state(2, "WHEEL_SLOT", INDIGO_OK_STATE)); end();
}

static void setup_reinitialize_recovery(void) {
	ASSERT_TRUE(begin()); ASSERT_TRUE(connect(0, true));
	int before = opens, closed = closes;
	fail_open = 1; fail_init = 1; number(0, "CCD_EXPOSURE", "EXPOSURE", 0.01); ASSERT_TRUE(wait_state(0, "CCD_EXPOSURE", INDIGO_ALERT_STATE));
	fail_init = 0; number(0, "CCD_EXPOSURE", "EXPOSURE", 0.01); ASSERT_TRUE(wait_state(0, "CCD_EXPOSURE", INDIGO_OK_STATE));
	for (const char *format : { "RAW 8", "RAW 16", "RAW 8" }) {
		sw(0, "X_PIXEL_FORMAT", format); ASSERT_TRUE(wait_state(0, "X_PIXEL_FORMAT", INDIGO_OK_STATE));
		number(0, "CCD_EXPOSURE", "EXPOSURE", 0.01); ASSERT_TRUE(wait_state(0, "CCD_EXPOSURE", INDIGO_OK_STATE));
		ASSERT_EQ_INT(!strcmp(format, "RAW 8") ? 8 : 16, bits.load());
		stream_start(1); ASSERT_TRUE(wait_state(0, "CCD_STREAMING", INDIGO_OK_STATE));
		number(0, "CCD_EXPOSURE", "EXPOSURE", 0.01); ASSERT_TRUE(wait_state(0, "CCD_EXPOSURE", INDIGO_OK_STATE));
		ASSERT_EQ_INT(!strcmp(format, "RAW 8") ? 8 : 16, bits.load());
	}
	ASSERT_EQ_INT(before, opens.load()); ASSERT_EQ_INT(closed, closes.load());
	ASSERT_EQ_INT(0, after_close.load()); end();
	ASSERT_EQ_INT(closed + 1, closes.load()); ASSERT_EQ_INT(0, active.load());
	ASSERT_EQ_INT(0, resources.load());
}

static void mode_and_depth_errors(void) {
	ASSERT_TRUE(begin()); ASSERT_TRUE(connect(0, true));
	int before = opens, closed = closes;
	for (int stage = 0; stage < 2; stage++) {
		sw(0, "X_PIXEL_FORMAT", stage ? "RAW 16" : "RAW 8"); ASSERT_TRUE(wait_state(0, "X_PIXEL_FORMAT", INDIGO_OK_STATE));
		fail_mode = stage == 0; fail_bits = stage == 1;
		number(0, "CCD_EXPOSURE", "EXPOSURE", 0.01); ASSERT_TRUE(wait_state(0, "CCD_EXPOSURE", INDIGO_ALERT_STATE));
		fail_mode = fail_bits = false;
		number(0, "CCD_EXPOSURE", "EXPOSURE", 0.01); ASSERT_TRUE(wait_state(0, "CCD_EXPOSURE", INDIGO_OK_STATE));
		ASSERT_EQ_INT(stage ? 16 : 8, bits.load());
	}
	ASSERT_EQ_INT(before, opens.load()); ASSERT_EQ_INT(closed, closes.load()); end();
}

static void stream_reset_error(void) {
	ASSERT_TRUE(begin()); ASSERT_TRUE(connect(0, true));
	int before = opens, closed = closes;
	stream_start(-1); ASSERT_TRUE(wait_state(0, "CCD_STREAMING", INDIGO_BUSY_STATE));
	for (int i = 0; i < 400 && blobs == 0; i++) { indigo_usleep(10000); }
	ASSERT_TRUE(blobs > 0);
	fail_init = 1;
	sw(0, "CCD_ABORT_EXPOSURE", "ABORT_EXPOSURE"); ASSERT_TRUE(wait_state(0, "CCD_ABORT_EXPOSURE", INDIGO_ALERT_STATE));
	fail_init = 0;
	number(0, "CCD_EXPOSURE", "EXPOSURE", 0.01); ASSERT_TRUE(wait_state(0, "CCD_EXPOSURE", INDIGO_OK_STATE));
	ASSERT_EQ_INT(before, opens.load()); ASSERT_EQ_INT(closed, closes.load()); end();
}

static void bounded_readout_and_buffer_contract(void) {
	ASSERT_TRUE(begin()); ASSERT_TRUE(connect(0, true));
	memory_length = 200 * 1024 * 1024; number(0, "CCD_EXPOSURE", "EXPOSURE", 0.01); ASSERT_TRUE(wait_state(0, "CCD_EXPOSURE", INDIGO_ALERT_STATE)); ASSERT_EQ_INT(0, blobs.load());
	memory_length = 0; remaining_error = 1; number(0, "CCD_EXPOSURE", "EXPOSURE", 0.01); ASSERT_TRUE(wait_state(0, "CCD_EXPOSURE", INDIGO_ALERT_STATE)); ASSERT_EQ_INT(0, blobs.load());
	remaining_error = 0; number(0, "CCD_EXPOSURE", "EXPOSURE", 0.01); ASSERT_TRUE(wait_state(0, "CCD_EXPOSURE", INDIGO_OK_STATE)); end();
}

static void cooling_and_sensor_profiles(void) {
	cooled = true; ASSERT_TRUE(begin()); ASSERT_TRUE(connect(0, true));
	indigo_property *p = snapshot(0, "CCD_COOLER"); ASSERT_TRUE(p); indigo_release_property(p);
	number(0, "CCD_TEMPERATURE", "TEMPERATURE", -10); sw(0, "CCD_COOLER", "ON");
	ASSERT_TRUE(wait_state(0, "CCD_COOLER", INDIGO_OK_STATE)); ASSERT_TRUE(wait_state(0, "CCD_TEMPERATURE", INDIGO_OK_STATE));
	p = snapshot(0, "CCD_COOLER_POWER"); ASSERT_TRUE(p); ASSERT_TRUE(fabs(p->items[0].number.value - 50) < 0.001); indigo_release_property(p);
	invalid_value = CONTROL_CURTEMP + 1; mark(0, "CCD_TEMPERATURE"); ASSERT_TRUE(wait_state(0, "CCD_TEMPERATURE", INDIGO_ALERT_STATE));
	invalid_value = 0; mark(0, "CCD_TEMPERATURE"); ASSERT_TRUE(wait_state(0, "CCD_TEMPERATURE", INDIGO_OK_STATE));
	sw(0, "CCD_COOLER", "OFF"); ASSERT_TRUE(wait_state(0, "CCD_COOLER", INDIGO_OK_STATE)); end();
	cooled = false; temperature_only = true; ASSERT_TRUE(begin()); ASSERT_TRUE(connect(0, true));
	p = snapshot(0, "CCD_TEMPERATURE"); ASSERT_TRUE(p); ASSERT_EQ_INT(INDIGO_RO_PERM, p->perm); indigo_release_property(p);
	p = snapshot(0, "CCD_COOLER"); ASSERT_TRUE(!p); end(); temperature_only = false;
}

static void optional_interfaces_and_sparse_formats(void) {
	st4 = cfw = false; formats = 2; bin_mask = 5; ASSERT_TRUE(begin(1)); ASSERT_TRUE(connect(0, true));
	ASSERT_TRUE(devices[1] == NULL && devices[2] == NULL);
	indigo_property *p = snapshot(0, "X_PIXEL_FORMAT"); ASSERT_TRUE(!p);
	p = snapshot(0, "CCD_MODE"); ASSERT_TRUE(p); ASSERT_EQ_INT(2, p->count); indigo_release_property(p);
	number(0, "CCD_BIN", "HORIZONTAL", 2); ASSERT_TRUE(wait_state(0, "CCD_BIN", INDIGO_ALERT_STATE)); end();
	formats = 1; sensor_depth = 8; bin_mask = 1;
	ASSERT_TRUE(begin(1)); ASSERT_TRUE(connect(0, true));
	number(0, "CCD_EXPOSURE", "EXPOSURE", 0.01); ASSERT_TRUE(wait_state(0, "CCD_EXPOSURE", INDIGO_OK_STATE));
	ASSERT_EQ_INT(8, bits.load()); end();
	st4 = cfw = true; formats = 3; bin_mask = 3; sensor_depth = 16;
}

static void config_and_reopen_settings(void) {
	ASSERT_TRUE(begin()); ASSERT_TRUE(connect(0, true));
	mark(0, "CCD_LOCAL_MODE");
	indigo_change_text_property_1(&client, devices[0]->name, "CCD_LOCAL_MODE", "DIR", config_folder);
	ASSERT_TRUE(wait_state(0, "CCD_LOCAL_MODE", INDIGO_OK_STATE));
	number(0, "CCD_GAIN", "GAIN", 42); ASSERT_TRUE(wait_state(0, "CCD_GAIN", INDIGO_OK_STATE));
	number(0, "X_ADVANCED", "USBTRAFFIC", 64); ASSERT_TRUE(wait_state(0, "X_ADVANCED", INDIGO_OK_STATE));
	sw(0, "CONFIG", "SAVE"); ASSERT_TRUE(wait_state(0, "CONFIG", INDIGO_OK_STATE));
	number(0, "X_ADVANCED", "USBTRAFFIC", 70); ASSERT_TRUE(wait_state(0, "X_ADVANCED", INDIGO_OK_STATE));
	sw(0, "CONFIG", "LOAD"); ASSERT_TRUE(wait_state(0, "CONFIG", INDIGO_OK_STATE));
	for (int i = 0; i < 400 && params[CONTROL_USBTRAFFIC] != 64; i++) { indigo_usleep(10000); }
	ASSERT_EQ_INT(64, params[CONTROL_USBTRAFFIC]);
	reset_controls = true; number(0, "CCD_EXPOSURE", "EXPOSURE", 0.01); ASSERT_TRUE(wait_state(0, "CCD_EXPOSURE", INDIGO_OK_STATE));
	ASSERT_EQ_INT(64, params[CONTROL_USBTRAFFIC]); ASSERT_EQ_INT(42, params[CONTROL_GAIN]);
	stream_start(1); ASSERT_TRUE(wait_state(0, "CCD_STREAMING", INDIGO_OK_STATE));
	number(0, "CCD_EXPOSURE", "EXPOSURE", 0.01); ASSERT_TRUE(wait_state(0, "CCD_EXPOSURE", INDIGO_OK_STATE));
	ASSERT_EQ_INT(64, params[CONTROL_USBTRAFFIC]); ASSERT_EQ_INT(42, params[CONTROL_GAIN]); end();
}

static void guide_blocking_and_zero(void) {
	ASSERT_TRUE(begin()); ASSERT_TRUE(connect(1, true)); guide_blocks = true;
	double started = indigo_monotonic_time(); number(1, "GUIDER_GUIDE_RA", "EAST", 50); ASSERT_TRUE(wait_state(1, "GUIDER_GUIDE_RA", INDIGO_OK_STATE));
	ASSERT_TRUE(indigo_monotonic_time() - started >= 0.05);
	int calls = guide_calls; number(1, "GUIDER_GUIDE_RA", "EAST", 0); ASSERT_TRUE(wait_state(1, "GUIDER_GUIDE_RA", INDIGO_OK_STATE)); ASSERT_EQ_INT(calls, guide_calls.load()); end();
}

static void raw_color_payload(void) {
	color = true;
	ASSERT_TRUE(begin()); ASSERT_TRUE(connect(0, true));
	sw(0, "CCD_IMAGE_FORMAT", "RAW"); ASSERT_TRUE(wait_state(0, "CCD_IMAGE_FORMAT", INDIGO_OK_STATE));
	verify_raw = true;
	for (const char *format : { "RAW 8", "RAW 16" }) {
		sw(0, "X_PIXEL_FORMAT", format); ASSERT_TRUE(wait_state(0, "X_PIXEL_FORMAT", INDIGO_OK_STATE));
		number(0, "CCD_EXPOSURE", "EXPOSURE", 0.01); ASSERT_TRUE(wait_state(0, "CCD_EXPOSURE", INDIGO_OK_STATE));
	}
	ASSERT_EQ_INT(2, blobs.load()); ASSERT_EQ_INT(0, bad_raw.load());
	verify_raw = false; end(); color = false;
}

static void zero_stream_and_failed_setting(void) {
	ASSERT_TRUE(begin()); ASSERT_TRUE(connect(0, true));
	number(0, "CCD_STREAMING", "COUNT", 0); ASSERT_TRUE(wait_state(0, "CCD_STREAMING", INDIGO_OK_STATE));
	ASSERT_EQ_INT(0, blobs.load()); ASSERT_TRUE(!exposing);
	number(0, "CCD_GAIN", "GAIN", 21); ASSERT_TRUE(wait_state(0, "CCD_GAIN", INDIGO_OK_STATE));
	fail_control = CONTROL_GAIN + 1; number(0, "CCD_GAIN", "GAIN", 63); ASSERT_TRUE(wait_state(0, "CCD_GAIN", INDIGO_ALERT_STATE));
	fail_control = 0; reset_controls = true;
	number(0, "CCD_EXPOSURE", "EXPOSURE", 0.01); ASSERT_TRUE(wait_state(0, "CCD_EXPOSURE", INDIGO_OK_STATE));
	ASSERT_EQ_INT(21, params[CONTROL_GAIN]); end();
}

static void cooler_failure_recovery(void) {
	cooled = true; ASSERT_TRUE(begin()); ASSERT_TRUE(connect(0, true));
	fail_cooling = true; sw(0, "CCD_COOLER", "ON"); ASSERT_TRUE(wait_state(0, "CCD_COOLER", INDIGO_ALERT_STATE));
	fail_cooling = false; mark(0, "CCD_COOLER"); ASSERT_TRUE(wait_state(0, "CCD_COOLER", INDIGO_OK_STATE));
	invalid_value = CONTROL_CURPWM + 1; mark(0, "CCD_COOLER_POWER"); ASSERT_TRUE(wait_state(0, "CCD_COOLER_POWER", INDIGO_ALERT_STATE));
	invalid_value = 0; mark(0, "CCD_COOLER_POWER"); ASSERT_TRUE(wait_state(0, "CCD_COOLER_POWER", INDIGO_OK_STATE));
	fail_control = CONTROL_MANULPWM + 1; sw(0, "CCD_COOLER", "OFF"); ASSERT_TRUE(wait_state(0, "CCD_COOLER", INDIGO_ALERT_STATE));
	fail_control = 0; mark(0, "CCD_COOLER"); ASSERT_TRUE(wait_state(0, "CCD_COOLER", INDIGO_OK_STATE));
	end(); cooled = false; ASSERT_EQ_INT(0, after_close.load());
}

static void property_contract_and_frame_types(void) {
	shutter = true;
	ASSERT_TRUE(begin());
	const char *common[] = { "INFO", "CONFIG", "PROFILE", "PROFILE_NAME", "CONNECTION" };
	for (int d = 0; d < 3; d++) {
		for (const char *name : common) {
			indigo_property *p = snapshot(d, name); ASSERT_TRUE(p); indigo_release_property(p);
		}
		ASSERT_TRUE(connect(d, true));
	}
	const char *ccd[] = { "CCD_INFO", "CCD_LENS", "CCD_LOCAL_MODE", "CCD_IMAGE_FILE", "CCD_MODE", "CCD_EXPOSURE", "CCD_FPS", "CCD_ABORT_EXPOSURE", "CCD_FRAME", "CCD_BIN", "CCD_FRAME_TYPE", "CCD_IMAGE_FORMAT", "CCD_UPLOAD_MODE", "CCD_PREVIEW", "CCD_IMAGE", "CCD_FITS_HEADERS", "CCD_SET_FITS_HEADER", "CCD_REMOVE_FITS_HEADER", "CCD_JPEG_SETTINGS", "CCD_JPEG_STRETCH_PRESETS", "CCD_STREAMING", "CCD_STREAMING_SETTINGS", "CCD_OFFSET", "CCD_GAIN", "CCD_GAMMA", "X_PIXEL_FORMAT", "X_ADVANCED" };
	for (const char *name : ccd) {
		indigo_property *p = snapshot(0, name); ASSERT_TRUE(p); indigo_release_property(p);
	}
	for (const char *name : { "GUIDER_GUIDE_RA", "GUIDER_GUIDE_DEC" }) {
		indigo_property *p = snapshot(1, name); ASSERT_TRUE(p); ASSERT_EQ_INT(2, p->count); indigo_release_property(p);
	}
	for (const char *name : { "WHEEL_SLOT", "WHEEL_SLOT_NAME", "WHEEL_SLOT_OFFSET" }) {
		indigo_property *p = snapshot(2, name); ASSERT_TRUE(p); ASSERT_EQ_INT(!strcmp(name, "WHEEL_SLOT") ? 1 : 8, p->count); indigo_release_property(p);
	}
	for (const char *type : { "LIGHT", "DARK", "BIAS", "FLAT", "DARKFLAT" }) {
		sw(0, "CCD_FRAME_TYPE", type); ASSERT_TRUE(wait_state(0, "CCD_FRAME_TYPE", INDIGO_OK_STATE));
		number(0, "CCD_EXPOSURE", "EXPOSURE", 0.02); ASSERT_TRUE(wait_state(0, "CCD_EXPOSURE", INDIGO_OK_STATE));
		ASSERT_EQ_INT(!strcmp(type, "LIGHT") || !strcmp(type, "FLAT") ? MACHANICALSHUTTER_FREE : MACHANICALSHUTTER_CLOSE, shutter_mode.load());
		if (!strcmp(type, "BIAS")) { ASSERT_TRUE(exposure < 0.02); }
	}
	end(); shutter = false;
}

static void sibling_orders_and_guide_overlap(void) {
	for (int first : { 0, 1, 2 }) {
		ASSERT_TRUE(begin()); ASSERT_TRUE(connect(first, true)); ASSERT_EQ_INT(1, active.load());
		ASSERT_TRUE(connect(first, false)); ASSERT_EQ_INT(0, active.load()); end();
	}
	ASSERT_TRUE(begin()); ASSERT_TRUE(connect(0, true)); ASSERT_TRUE(connect(1, true));
	number(0, "CCD_EXPOSURE", "EXPOSURE", 0.2);
	number(1, "GUIDER_GUIDE_RA", "EAST", 70); number(1, "GUIDER_GUIDE_DEC", "NORTH", 90);
	ASSERT_TRUE(wait_state(1, "GUIDER_GUIDE_RA", INDIGO_OK_STATE)); ASSERT_TRUE(wait_state(1, "GUIDER_GUIDE_DEC", INDIGO_OK_STATE));
	ASSERT_TRUE(wait_state(0, "CCD_EXPOSURE", INDIGO_OK_STATE));
	ASSERT_TRUE(connect(1, false)); ASSERT_EQ_INT(1, active.load());
	ASSERT_TRUE(connect(0, false)); ASSERT_EQ_INT(0, active.load()); end();
}

static void discovery_capacity_and_identity(void) {
	cfw = false; camera_mask = 7;
	ASSERT_TRUE(begin(4));
	ASSERT_TRUE(devices[0] && devices[3]); ASSERT_TRUE(strcmp(devices[0]->name, devices[3]->name));
	#ifdef QHY2
	ASSERT_TRUE(usb_callback != NULL);
	// A malformed SDK inventory must not remove any logical devices.
	scan_error = 1;
	usb_callback(NULL, (libusb_device *)&usb_tokens[2], LIBUSB_HOTPLUG_EVENT_DEVICE_LEFT, NULL);
	indigo_usleep(100000); ASSERT_EQ_INT(4, attached.load()); scan_error = 0;
	fail_id = 1;
	usb_callback(NULL, (libusb_device *)&usb_tokens[2], LIBUSB_HOTPLUG_EVENT_DEVICE_LEFT, NULL);
	indigo_usleep(100000); ASSERT_EQ_INT(4, attached.load()); fail_id = 0;
	// Camera 1 was attached to USB token 3; identity selects camera 1 anyway.
	camera_mask = 6;
	usb_callback(NULL, (libusb_device *)&usb_tokens[0], LIBUSB_HOTPLUG_EVENT_DEVICE_LEFT, NULL);
	for (int i = 0; i < 600 && attached != 2; i++) { indigo_usleep(10000); }
	ASSERT_EQ_INT(2, attached.load()); ASSERT_TRUE(!devices[0] && devices[3]);
	ASSERT_TRUE(strstr(devices[3]->name, "QHYTEST-002"));
	usb_callback(NULL, (libusb_device *)&usb_tokens[1], LIBUSB_HOTPLUG_EVENT_DEVICE_ARRIVED, NULL);
	for (int i = 0; i < 600 && attached != 4; i++) { indigo_usleep(10000); }
	ASSERT_EQ_INT(4, attached.load()); ASSERT_TRUE(devices[0] && devices[3]); ASSERT_TRUE(strcmp(devices[0]->name, devices[3]->name));
	usb_callback(NULL, (libusb_device *)&usb_tokens[1], LIBUSB_HOTPLUG_EVENT_DEVICE_ARRIVED, NULL);
	indigo_usleep(100000); ASSERT_EQ_INT(4, attached.load());
#else
	ASSERT_TRUE(usb_callback == NULL);
	camera_mask = 6; indigo_usleep(100000);
	ASSERT_TRUE(devices[0] && devices[3]); ASSERT_EQ_INT(4, attached.load());
#endif
	end(); ASSERT_EQ_INT(0, refs.load()); ASSERT_EQ_INT(0, active.load()); camera_mask = 1; cfw = true;
}

int main(int argc, char **argv) {
	if (!mkdtemp(config_folder)) { return 1; }
	bus_thread = pthread_self(); indigo_start(); indigo_attach_client(&client);
	indigo_driver_info info; ENTRY(INDIGO_DRIVER_INFO, &info); migrated = info.version > 0x0300001A;
	const indigo_test_case cases[] = { { "discovery capacity identity", discovery_capacity_and_identity }, { "property contract frame types", property_contract_and_frame_types }, { "sibling orders guide overlap", sibling_orders_and_guide_overlap }, { "RAW color payload", raw_color_payload }, { "zero stream failed setting", zero_stream_and_failed_setting }, { "cooler failure recovery", cooler_failure_recovery }, { "lifecycle", basic_lifecycle }, { "acquisition", acquisition }, { "open rollback", open_rollback }, { "advanced failure", failed_advanced }, { "initialization failures", initialization_failures }, { "start and read failures", start_and_read_failures }, { "fractional exposures", fractional_exposures }, { "abort restart", abort_and_restart }, { "streams abort", streams_and_abort }, { "stream errors", stream_errors }, { "guide directions errors", guider_directions_and_failures }, { "wheel position errors", wheel_position_and_errors }, { "controls no bus IO", controls_and_no_bus_io }, { "read modes", read_modes }, { "ROI formats bins", roi_formats_and_bins }, { "acquisition conflicts", acquisition_conflicts }, { "disconnect sibling", disconnect_and_sibling_survival }, { "discovery lifecycle", startup_only_discovery }, { "init enumeration attachment", init_enumeration_and_attachment_rollback }, { "discovery failure reload", discovery_failure_and_reload }, { "metadata readback", metadata_and_readback_errors }, { "queued abort", queued_abort_before_start }, { "wheel timeout status", wheel_timeout_and_malformed_status }, { "setup reinitialize", setup_reinitialize_recovery }, { "mode depth errors", mode_and_depth_errors }, { "stream reset error", stream_reset_error }, { "readout buffer contract", bounded_readout_and_buffer_contract }, { "cooling sensor", cooling_and_sensor_profiles }, { "optional sparse profiles", optional_interfaces_and_sparse_formats }, { "configuration restore", config_and_reopen_settings }, { "guide blocking zero", guide_blocking_and_zero } };
	int result = 0, matched = 0;
	for (unsigned i = 0; i < sizeof(cases) / sizeof(cases[0]); i++) {
		if (argc > 1 && !strstr(cases[i].name, argv[1])) { continue; }
		matched++;
		result |= indigo_run_tests("QHY SDK", cases + i, 1);
		end();
	}
	indigo_detach_client(&client); indigo_stop();
	DIR *dir = opendir(config_folder);
	if (dir) {
		struct dirent *entry;
		while ((entry = readdir(dir))) {
			if (strcmp(entry->d_name, ".") && strcmp(entry->d_name, "..")) {
				char path[1024]; snprintf(path, sizeof(path), "%s/%s", config_folder, entry->d_name); unlink(path);
			}
		}
		closedir(dir);
	}
	rmdir(config_folder);
	return matched ? result : 2;
}
