// Copyright (c) 2026 INDIGO initiative
// All rights reserved.
//
// You may use this software under the terms of 'INDIGO Astronomy
// open-source license' (see LICENSE.md).
//
// THIS SOFTWARE IS PROVIDED BY THE AUTHORS 'AS IS' AND ANY EXPRESS
// OR IMPLIED WARRANTIES, INCLUDING, BUT NOT LIMITED TO, THE IMPLIED
// WARRANTIES OF MERCHANTABILITY AND FITNESS FOR A PARTICULAR PURPOSE
// ARE DISCLAIMED. IN NO EVENT SHALL THE AUTHOR BE LIABLE FOR ANY
// DIRECT, INDIRECT, INCIDENTAL, SPECIAL, EXEMPLARY, OR CONSEQUENTIAL
// DAMAGES (INCLUDING, BUT NOT LIMITED TO, PROCUREMENT OF SUBSTITUTE
// GOODS OR SERVICES; LOSS OF USE, DATA, OR PROFITS; OR BUSINESS
// INTERRUPTION) HOWEVER CAUSED AND ON ANY THEORY OF LIABILITY,
// WHETHER IN CONTRACT, STRICT LIABILITY, OR TORT (INCLUDING
// NEGLIGENCE OR OTHERWISE) ARISING IN ANY WAY OUT OF THE USE OF THIS
// SOFTWARE, EVEN IF ADVISED OF THE POSSIBILITY OF SUCH DAMAGE.

// Code is generated by AI

// indigo_aux_alto against alto_simulator, which models an ALTO1 with application firmware 1.03.11
// (indigo_drivers/aux_alto/REFACTOR.md); a full stroke takes 5 s there.

#include <indigo_drivers/aux_alto/indigo_aux_alto.h>

#include "serial_simulator_test_common.h"
#include <indigo/indigo_usbserial_utils.h>
#include <errno.h>
#include <sys/wait.h>
#include <pthread.h>

#ifndef AUX_ALTO_SIMULATOR_EXECUTABLE
#define AUX_ALTO_SIMULATOR_EXECUTABLE "build/integration/alto_simulator"
#endif

#define ALTO_NAME                          "PrimaluceLab ALTO"
#define ALTO_TRAVEL                        239608
#define X_COVER_POSITION_PROPERTY_NAME     "X_COVER_POSITION"
#define X_COVER_POSITION_ITEM_NAME         "POSITION"
#define X_COVER_ABORT_PROPERTY_NAME        "X_COVER_ABORT"
#define X_COVER_ABORT_ITEM_NAME            "ABORT"
#define X_STATE_PROPERTY_NAME              "X_STATE"
#define X_STATE_TEMPERATURE_ITEM_NAME      "TEMPERATURE"
#define X_STATE_VIN_12V_ITEM_NAME          "VIN_12V"
#define X_PRESETS_PROPERTY_NAME            "X_PRESETS"
#define X_PRESET_NAMES_PROPERTY_NAME       "X_PRESET_NAMES"
#define X_PRESET_RECALL_PROPERTY_NAME      "X_PRESET_RECALL"
#define X_CALIBRATION_PROPERTY_NAME        "X_CALIBRATION"
#define X_CALIBRATION_MOTION_PROPERTY_NAME "X_CALIBRATION_MOTION"
#define X_LEDS_PROPERTY_NAME               "X_LEDS"
#define X_WIFI_PROPERTY_NAME               "X_WIFI"
#define X_WIFI_AP_PROPERTY_NAME            "X_WIFI_AP"
#define X_WIFI_STA_PROPERTY_NAME           "X_WIFI_STA"
#define X_WIFI_STATUS_PROPERTY_NAME        "X_WIFI_STATUS"
#define X_WIFI_AP_ITEM_NAME                "AP"
#define X_WIFI_STA_ITEM_NAME               "STA"
#define ON_ITEM_NAME                       "ON"
#define OFF_ITEM_NAME                      "OFF"
#define X_LEDS_DIM_ITEM_NAME               "DIM"
#define MOTION_POLL_REQUEST                "{\"req\":{\"get\":{\"MOT1\":{\"POSITION\":\"\",\"STATUS\":\"\"}}}}"

static const simulator_driver_case alto = {
	"PrimaluceLab ALTO Cover",
	"indigo_aux_alto",
	ALTO_NAME,
	indigo_aux_alto,
	false,
	NULL, 0, NULL, 0, NULL, 0, NULL, 0
};

static external_serial_simulator fixture;
static char fixture_directory[] = "/tmp/indigo-alto.XXXXXX";
static char event_path[PATH_MAX], fault_path[PATH_MAX];

// ----------------------------------------------------------------- fixtures

// Arm a one-shot cover fault. The simulator applies it to the next request containing key and then removes
// the control file; 'external <position>' moves the cover at the next request.
static bool fault(const char *key, const char *action) {
	char temporary[PATH_MAX + 8];
	snprintf(temporary, sizeof(temporary), "%s.tmp", fault_path);
	FILE *file = fopen(temporary, "w");
	if (file == NULL) {
		return false;
	}
	fprintf(file, "%s %s\n", key, action);
	fclose(file);
	return rename(temporary, fault_path) == 0;
}

static int requests(const char *fragment) {
	FILE *file = fopen(event_path, "r");
	if (file == NULL) {
		return -1;
	}
	char line[4096];
	int count = 0;
	while (fgets(line, sizeof(line), file) != NULL) {
		if (strstr(line, fragment) != NULL) {
			count++;
		}
	}
	fclose(file);
	return count;
}

static void print_journal(const char *reason) {
	fprintf(stderr, "%s, journal holds:\n", reason);
	FILE *file = fopen(event_path, "r");
	if (file == NULL) {
		fprintf(stderr, "  (no journal at %s)\n", event_path);
		return;
	}
	char line[4096];
	while (fgets(line, sizeof(line), file) != NULL) {
		fprintf(stderr, "  %s", line);
	}
	fclose(file);
}

static bool wait_for_requests_within(const char *fragment, int expected, int seconds) {
	for (int i = 0; i < seconds * 40; i++) {
		if (requests(fragment) >= expected) {
			return true;
		}
		indigo_usleep(25000);
	}
	char reason[128];
	snprintf(reason, sizeof(reason), "Fewer than %d requests containing '%s'", expected, fragment);
	print_journal(reason);
	return false;
}

static bool wait_for_requests(const char *fragment, int expected) {
	return wait_for_requests_within(fragment, expected, 5);
}

// The n-th request of the journal (0 based) contains fragment.
static bool journal_line_has(int index, const char *fragment) {
	FILE *file = fopen(event_path, "r");
	if (file == NULL) {
		return false;
	}
	char line[4096];
	bool found = false;
	for (int i = 0; fgets(line, sizeof(line), file) != NULL; i++) {
		if (i == index) {
			found = strstr(line, fragment) != NULL;
			break;
		}
	}
	fclose(file);
	if (!found) {
		print_journal("Unexpected request order");
	}
	return found;
}

// ----------------------------------------------------------------- helpers

// The bus delivers the message of an update through send_message, which the common test client does not
// set, so the messages of this driver are recorded here.
static pthread_mutex_t message_mutex = PTHREAD_MUTEX_INITIALIZER;
static char messages[4096];

// The device as the driver attached it, for the USB match pattern it registers.
static indigo_device *attached_alto;

static indigo_result observe_define(indigo_client *client, indigo_device *device, indigo_property *property, const char *message) {
	if (!strcmp(property->device, ALTO_NAME)) {
		attached_alto = device;
	}
	return simulator_client_define_property(client, device, property, message);
}

static indigo_result record_message(indigo_client *client, indigo_device *device, indigo_property *property, const char *message) {
	simulator_client_send_message(client, device, property, message);
	if (message != NULL && *message) {
		pthread_mutex_lock(&message_mutex);
		if (strlen(messages) + strlen(message) + 2 < sizeof(messages)) {
			strcat(messages, message);
			strcat(messages, "\n");
		}
		pthread_mutex_unlock(&message_mutex);
	}
	return INDIGO_OK;
}

static void clear_messages(void) {
	pthread_mutex_lock(&message_mutex);
	messages[0] = 0;
	pthread_mutex_unlock(&message_mutex);
}

static bool message_seen(const char *fragment) {
	for (int i = 0; i < 200; i++) {
		pthread_mutex_lock(&message_mutex);
		bool found = strstr(messages, fragment) != NULL;
		pthread_mutex_unlock(&message_mutex);
		if (found) {
			return true;
		}
		indigo_usleep(25000);
	}
	fprintf(stderr, "No message containing '%s'\n", fragment);
	return false;
}

// Each wait of the shared harness lasts up to 10 s.
static bool state_seen_within(const char *property, indigo_property_state state, unsigned int revision, int seconds) {
	for (int i = 0; i < (seconds + 9) / 10; i++) {
		if (wait_for_property_state_seen_after(property, state, revision)) {
			return true;
		}
	}
	indigo_property *cached = find_cached_property(property);
	fprintf(stderr, "%s never published state %d (current %d)\n", property, state, cached == NULL ? -1 : cached->state);
	return false;
}

static bool state_seen(const char *property, indigo_property_state state, unsigned int revision) {
	return state_seen_within(property, state, revision, 1);
}

static bool number_change(const char *property, const char *item, double value, indigo_property_state state) {
	unsigned int revision = property_state_revision(property, state);
	return indigo_change_number_property_1(&simulator_test_client, ALTO_NAME, property, item, value) == INDIGO_OK && state_seen(property, state, revision);
}

static bool switch_change(const char *property, const char *item, indigo_property_state state) {
	unsigned int revision = property_state_revision(property, state);
	return indigo_change_switch_property_1(&simulator_test_client, ALTO_NAME, property, item, true) == INDIGO_OK && state_seen(property, state, revision);
}

static bool text_change(const char *property, const char *item, const char *value, indigo_property_state state) {
	unsigned int revision = property_state_revision(property, state);
	return indigo_change_text_property_1_raw(&simulator_test_client, ALTO_NAME, property, item, value) == INDIGO_OK && state_seen(property, state, revision);
}

static bool number_is(const char *property_name, const char *item_name, double expected, double tolerance) {
	indigo_item *item = find_cached_item(property_name, item_name);
	if (item == NULL || fabs(item->number.value - expected) > tolerance) {
		fprintf(stderr, "%s.%s: expected %g, received %g\n", property_name, item_name, expected, item == NULL ? NAN : item->number.value);
		return false;
	}
	return true;
}

static bool switch_is(const char *property_name, const char *item_name, bool expected) {
	indigo_item *item = find_cached_item(property_name, item_name);
	if (item == NULL || item->sw.value != expected) {
		fprintf(stderr, "%s.%s: expected %s\n", property_name, item_name, expected ? "on" : "off");
		return false;
	}
	return true;
}

static bool text_is(const char *property_name, const char *item_name, const char *expected) {
	indigo_item *item = find_cached_item(property_name, item_name);
	if (item == NULL || strcmp(item->text.value, expected)) {
		fprintf(stderr, "%s.%s: expected \"%s\", received \"%s\"\n", property_name, item_name, expected, item == NULL ? "(none)" : item->text.value);
		return false;
	}
	return true;
}

static indigo_property_state property_state(const char *property_name) {
	indigo_property *property = find_cached_property(property_name);
	return property == NULL ? -1 : property->state;
}

static double number_target(const char *property_name, const char *item_name) {
	indigo_item *item = find_cached_item(property_name, item_name);
	return item == NULL ? NAN : item->number.target;
}

// The cover settled OK at expected % with AUX_COVER showing the end it is at.
static bool cover_is(double expected) {
	for (int i = 0; i < 400; i++) {
		indigo_item *item = find_cached_item(X_COVER_POSITION_PROPERTY_NAME, X_COVER_POSITION_ITEM_NAME);
		indigo_item *open = find_cached_item(AUX_COVER_PROPERTY_NAME, AUX_COVER_OPEN_ITEM_NAME);
		indigo_item *closed = find_cached_item(AUX_COVER_PROPERTY_NAME, AUX_COVER_CLOSE_ITEM_NAME);
		if (item != NULL && open != NULL && closed != NULL && item->number.value == expected && property_state(X_COVER_POSITION_PROPERTY_NAME) == INDIGO_OK_STATE && property_state(AUX_COVER_PROPERTY_NAME) == INDIGO_OK_STATE && open->sw.value == (expected == 100) && closed->sw.value == (expected == 0)) {
			return true;
		}
		indigo_usleep(25000);
	}
	indigo_item *item = find_cached_item(X_COVER_POSITION_PROPERTY_NAME, X_COVER_POSITION_ITEM_NAME);
	fprintf(stderr, "Cover did not settle at %g (value %g, state %d)\n", expected, item == NULL ? NAN : item->number.value, property_state(X_COVER_POSITION_PROPERTY_NAME));
	return false;
}

// The cover publishes a position strictly between origin and target while BUSY.
static bool cover_in_motion(double origin, double target) {
	for (int i = 0; i < 400; i++) {
		indigo_item *item = find_cached_item(X_COVER_POSITION_PROPERTY_NAME, X_COVER_POSITION_ITEM_NAME);
		if (item != NULL && property_state(X_COVER_POSITION_PROPERTY_NAME) == INDIGO_BUSY_STATE && ((item->number.value > origin && item->number.value < target) || (item->number.value < origin && item->number.value > target))) {
			return true;
		}
		indigo_usleep(25000);
	}
	fprintf(stderr, "Cover never moved between %g and %g\n", origin, target);
	return false;
}

static bool cover_ended(indigo_property_state state) {
	for (int i = 0; i < 600; i++) {
		if (property_state(X_COVER_POSITION_PROPERTY_NAME) == state && property_state(AUX_COVER_PROPERTY_NAME) == state) {
			return true;
		}
		indigo_usleep(25000);
	}
	fprintf(stderr, "Cover motion did not end in state %d (position %d, cover %d)\n", state, property_state(X_COVER_POSITION_PROPERTY_NAME), property_state(AUX_COVER_PROPERTY_NAME));
	return false;
}

static bool driver_up(void) {
	return bring_up_serial_driver(&alto);
}

static bool connect_alto(void) {
	return connect_serial_device(&alto, fixture.port);
}

static bool driver_start(void) {
	return driver_up() && connect_alto();
}

static void driver_stop(void) {
	disconnect_serial_device(&alto);
	tear_down_serial_driver(&alto);
}

// ----------------------------------------------------------------- identity and lifecycle

static void metadata(void) {
	assert_simulator_driver_info(&alto);
	SERIAL_CHECK_TRUE(driver_start());
	SERIAL_CHECK_TRUE(context.connected && context.last_connection_state == INDIGO_OK_STATE);
	assert_device_interface(INDIGO_INTERFACE_AUX_DUSTCAP);
	// Identity, quiet log level, then the full state; nothing is written to the cover.
	SERIAL_CHECK_TRUE(wait_for_requests("{\"req\":{\"get\": \"\"}}", 1));
	SERIAL_CHECK_TRUE(journal_line_has(0, "\"MODNAME\""));
	SERIAL_CHECK_TRUE(journal_line_has(1, "\"LOGLEVEL\""));
	SERIAL_CHECK_TRUE(journal_line_has(2, "{\"req\":{\"get\": \"\"}}"));
	SERIAL_CHECK_EQ_INT(0, requests("\"set\""));
	SERIAL_CHECK_TRUE(text_is(INFO_PROPERTY_NAME, INFO_DEVICE_MODEL_ITEM_NAME, "ALTO1"));
	SERIAL_CHECK_TRUE(text_is(INFO_PROPERTY_NAME, INFO_DEVICE_FW_REVISION_ITEM_NAME, "1.03.11 / 1.01"));
	SERIAL_CHECK_TRUE(text_is(INFO_PROPERTY_NAME, INFO_DEVICE_SERIAL_NUM_ITEM_NAME, "ALTO100001"));
cleanup:
	driver_stop();
}

// The cover prefers a port of a CP2102N bridge with the Silicon Labs VID/PID (10c4:ea60), as the ALTO1 reports.
static void usb_match_pattern(void) {
	SERIAL_CHECK_TRUE(driver_up());
	SERIAL_CHECK_TRUE(attached_alto != NULL);
	SERIAL_CHECK_EQ_INT(1, attached_alto->match_patterns_count);
	indigo_serial_info ports[3] = { { 0 } };
	ports[0].vendor_id = 0x0403;
	ports[0].product_id = 0x6001;
	strcpy(ports[0].product_string, "CP2102N USB to UART Bridge Controller");
	ports[1].vendor_id = 0x10c4;
	ports[1].product_id = 0xea60;
	strcpy(ports[1].product_string, "CP2104 USB to UART Bridge Controller");
	ports[2].vendor_id = 0x10c4;
	ports[2].product_id = 0xea60;
	strcpy(ports[2].product_string, "CP2102N USB to UART Bridge Controller");
	SERIAL_CHECK_TRUE(indigo_usbserial_match(ports, 2, attached_alto->match_patterns, attached_alto->match_patterns_count) == NULL);
	SERIAL_CHECK_TRUE(indigo_usbserial_match(ports, 3, attached_alto->match_patterns, attached_alto->match_patterns_count) == &ports[2]);
cleanup:
	driver_stop();
}

static void property_contract(void) {
	SERIAL_CHECK_TRUE(driver_up());
	reset_simulator_context(&alto);
	enumerate_simulator_device();
	SERIAL_CHECK_TRUE(!has_defined_property(AUX_COVER_PROPERTY_NAME));
	SERIAL_CHECK_TRUE(connect_alto());
	assert_serial_aux_class_property_completeness();
	assert_property_has_item(AUX_COVER_PROPERTY_NAME, AUX_COVER_OPEN_ITEM_NAME);
	assert_property_has_item(AUX_COVER_PROPERTY_NAME, AUX_COVER_CLOSE_ITEM_NAME);
	assert_property_has_item(X_COVER_POSITION_PROPERTY_NAME, X_COVER_POSITION_ITEM_NAME);
	assert_property_has_item(X_COVER_ABORT_PROPERTY_NAME, X_COVER_ABORT_ITEM_NAME);
	assert_property_has_item(X_STATE_PROPERTY_NAME, X_STATE_TEMPERATURE_ITEM_NAME);
	assert_property_has_item(X_CALIBRATION_PROPERTY_NAME, "START");
	assert_property_has_item(X_CALIBRATION_MOTION_PROPERTY_NAME, "CLOSE_SLOW");
	assert_property_has_item(X_LEDS_PROPERTY_NAME, X_LEDS_DIM_ITEM_NAME);
	assert_property_has_item(X_WIFI_PROPERTY_NAME, OFF_ITEM_NAME);
	assert_property_has_item(X_WIFI_PROPERTY_NAME, X_WIFI_AP_ITEM_NAME);
	assert_property_has_item(X_WIFI_PROPERTY_NAME, X_WIFI_STA_ITEM_NAME);
	assert_property_has_item(X_WIFI_AP_PROPERTY_NAME, "AP_SSID");
	assert_property_has_item(X_WIFI_AP_PROPERTY_NAME, "AP_PASSWORD");
	assert_property_has_item(X_WIFI_STA_PROPERTY_NAME, "STA_SSID");
	assert_property_has_item(X_WIFI_STA_PROPERTY_NAME, "STA_PASSWORD");
	SERIAL_CHECK_EQ_INT(3, find_cached_property(X_PRESETS_PROPERTY_NAME)->count);
	SERIAL_CHECK_EQ_INT(3, find_cached_property(X_PRESET_NAMES_PROPERTY_NAME)->count);
	SERIAL_CHECK_EQ_INT(3, find_cached_property(X_PRESET_RECALL_PROPERTY_NAME)->count);
	SERIAL_CHECK_TRUE(find_cached_property(X_STATE_PROPERTY_NAME)->perm == INDIGO_RO_PERM);
	SERIAL_CHECK_TRUE(find_cached_item(X_COVER_POSITION_PROPERTY_NAME, X_COVER_POSITION_ITEM_NAME)->number.max == 100);
	// The connect values come from the full state: open, OPEN on.
	SERIAL_CHECK_TRUE(cover_is(100));
	SERIAL_CHECK_TRUE(switch_is(X_LEDS_PROPERTY_NAME, ON_ITEM_NAME, true));
	SERIAL_CHECK_TRUE(switch_is(X_WIFI_PROPERTY_NAME, X_WIFI_AP_ITEM_NAME, true));
	SERIAL_CHECK_TRUE(text_is(X_WIFI_AP_PROPERTY_NAME, "AP_SSID", "ALTO100001"));
	SERIAL_CHECK_TRUE(text_is(X_WIFI_AP_PROPERTY_NAME, "AP_PASSWORD", "primalucelab"));
	SERIAL_CHECK_TRUE(text_is(X_WIFI_STA_PROPERTY_NAME, "STA_SSID", "MySSID"));
	SERIAL_CHECK_TRUE(text_is(X_WIFI_STA_PROPERTY_NAME, "STA_PASSWORD", "MyPassword"));
	SERIAL_CHECK_TRUE(text_is(X_WIFI_STATUS_PROPERTY_NAME, "IP_ADDRESS", "192.168.4.1"));
	SERIAL_CHECK_TRUE(text_is(X_WIFI_STATUS_PROPERTY_NAME, "PORT", "80"));
	SERIAL_CHECK_TRUE(text_is(X_WIFI_STATUS_PROPERTY_NAME, "CONNECTION", "access point"));
	SERIAL_CHECK_TRUE(find_cached_property(X_WIFI_STATUS_PROPERTY_NAME)->perm == INDIGO_RO_PERM);
	SERIAL_CHECK_TRUE(number_is(X_STATE_PROPERTY_NAME, X_STATE_TEMPERATURE_ITEM_NAME, 30.8, .005));
	SERIAL_CHECK_TRUE(number_is(X_STATE_PROPERTY_NAME, X_STATE_VIN_12V_ITEM_NAME, 13.37, .005));
	disconnect_serial_device(&alto);
	for (int i = 0; i < 50 && find_cached_property(X_STATE_PROPERTY_NAME) != NULL; i++) {
		indigo_usleep(100000);
	}
	SERIAL_CHECK_TRUE(find_cached_property(AUX_COVER_PROPERTY_NAME) == NULL);
	SERIAL_CHECK_TRUE(text_is(INFO_PROPERTY_NAME, INFO_DEVICE_MODEL_ITEM_NAME, "Unknown"));
cleanup:
	driver_stop();
}

// Firmware versions longer than an INDIGO text item are cut off in INFO instead of overflowing it.
static void long_firmware(void) {
	SERIAL_CHECK_TRUE(driver_start());
	char app[301], web[301], combined[700], expected[INDIGO_VALUE_SIZE];
	memset(app, 'x', 300);
	memcpy(app, "1.03.11", 7);
	app[300] = 0;
	memset(web, 'x', 300);
	memcpy(web, "1.01", 4);
	web[300] = 0;
	snprintf(combined, sizeof(combined), "%s / %s", app, web);
	memcpy(expected, combined, sizeof(expected) - 1);
	expected[sizeof(expected) - 1] = 0;
	SERIAL_CHECK_TRUE(text_is(INFO_PROPERTY_NAME, INFO_DEVICE_FW_REVISION_ITEM_NAME, expected));
	SERIAL_CHECK_TRUE(text_is(INFO_PROPERTY_NAME, INFO_DEVICE_SERIAL_NUM_ITEM_NAME, "ALTO100001"));
cleanup:
	driver_stop();
}

// A closed cover shows CLOSE.
static void connect_closed(void) {
	SERIAL_CHECK_TRUE(driver_start());
	SERIAL_CHECK_TRUE(cover_is(0));
cleanup:
	driver_stop();
}

static void unsupported_device(void) {
	SERIAL_CHECK_TRUE(driver_up());
	clear_messages();
	SERIAL_CHECK_TRUE(!connect_alto());
	SERIAL_CHECK_TRUE(!context.connected);
	SERIAL_CHECK_EQ_INT(INDIGO_ALERT_STATE, context.last_connection_state);
	SERIAL_CHECK_TRUE(message_seen("The device is not an ALTO"));
	SERIAL_CHECK_TRUE(!has_defined_property(AUX_COVER_PROPERTY_NAME));
	SERIAL_CHECK_EQ_INT(0, requests("\"LOGLEVEL\""));
cleanup:
	driver_stop();
}

static void handshake_timeout(void) {
	SERIAL_CHECK_TRUE(driver_up());
	SERIAL_CHECK_TRUE(fault("\"MODNAME\"", "silent"));
	SERIAL_CHECK_TRUE(!connect_alto());
	SERIAL_CHECK_TRUE(wait_for_property_state(CONNECTION_PROPERTY_NAME, INDIGO_ALERT_STATE));
	SERIAL_CHECK_TRUE(!context.connected);
	SERIAL_CHECK_TRUE(connect_alto());
	SERIAL_CHECK_TRUE(cover_is(100));
cleanup:
	driver_stop();
}

static void needs_calibration(void) {
	SERIAL_CHECK_TRUE(driver_up());
	clear_messages();
	SERIAL_CHECK_TRUE(connect_alto());
	SERIAL_CHECK_TRUE(message_seen("CalRestart"));
	SERIAL_CHECK_TRUE(message_seen("ALTO1 needs calibration"));
	// With a travel the cover still moves.
	SERIAL_CHECK_TRUE(number_change(X_COVER_POSITION_PROPERTY_NAME, X_COVER_POSITION_ITEM_NAME, 80, INDIGO_BUSY_STATE));
	SERIAL_CHECK_TRUE(cover_is(80));
cleanup:
	driver_stop();
}

// Without a travel no move is sent.
static void uncalibrated(void) {
	SERIAL_CHECK_TRUE(driver_up());
	clear_messages();
	SERIAL_CHECK_TRUE(connect_alto());
	SERIAL_CHECK_TRUE(message_seen("ALTO1 needs calibration"));
	clear_messages();
	SERIAL_CHECK_TRUE(switch_change(AUX_COVER_PROPERTY_NAME, AUX_COVER_OPEN_ITEM_NAME, INDIGO_ALERT_STATE));
	SERIAL_CHECK_TRUE(message_seen("The cover needs calibration"));
	SERIAL_CHECK_EQ_INT(0, requests("\"POSITION\":100"));
	SERIAL_CHECK_TRUE(switch_is(AUX_COVER_PROPERTY_NAME, AUX_COVER_CLOSE_ITEM_NAME, true));
cleanup:
	driver_stop();
}

static void repeated_init_shutdown(void) {
	for (int i = 0; i < 3; i++) {
		SERIAL_CHECK_TRUE(driver_start());
		disconnect_serial_device(&alto);
		SERIAL_CHECK_TRUE(!context.connected);
		tear_down_serial_driver(&alto);
	}
	return;
cleanup:
	driver_stop();
}

static void shutdown_rejected_while_connected(void) {
	SERIAL_CHECK_TRUE(driver_start());
	SERIAL_CHECK_EQ_INT(INDIGO_BUSY, alto.entry(INDIGO_DRIVER_SHUTDOWN, NULL));
	SERIAL_CHECK_TRUE(switch_change(X_LEDS_PROPERTY_NAME, X_LEDS_DIM_ITEM_NAME, INDIGO_OK_STATE));
cleanup:
	driver_stop();
}

// A reconnect reads the cover again: a move made while disconnected is shown.
static void reconnect(void) {
	SERIAL_CHECK_TRUE(driver_start());
	disconnect_serial_device(&alto);
	SERIAL_CHECK_TRUE(!context.connected);
	disconnect_serial_device(&alto);
	SERIAL_CHECK_TRUE(fault("external", "40"));
	indigo_usleep(100000);
	SERIAL_CHECK_TRUE(connect_alto());
	SERIAL_CHECK_TRUE(cover_is(40));
cleanup:
	driver_stop();
}

// ----------------------------------------------------------------- motion

static void close_and_open(void) {
	SERIAL_CHECK_TRUE(driver_start());
	SERIAL_CHECK_TRUE(switch_change(AUX_COVER_PROPERTY_NAME, AUX_COVER_CLOSE_ITEM_NAME, INDIGO_BUSY_STATE));
	SERIAL_CHECK_TRUE(wait_for_requests("{\"req\":{\"set\":{\"MOT1\":{\"POSITION\":0}}}}", 1));
	// The progress is published while the cover moves.
	SERIAL_CHECK_TRUE(cover_in_motion(100, 0));
	SERIAL_CHECK_TRUE(cover_is(0));
	SERIAL_CHECK_TRUE(switch_change(AUX_COVER_PROPERTY_NAME, AUX_COVER_OPEN_ITEM_NAME, INDIGO_BUSY_STATE));
	SERIAL_CHECK_TRUE(wait_for_requests("{\"req\":{\"set\":{\"MOT1\":{\"POSITION\":100}}}}", 1));
	SERIAL_CHECK_TRUE(cover_in_motion(0, 100));
	SERIAL_CHECK_TRUE(cover_is(100));
	// Opening an open cover ends at once.
	SERIAL_CHECK_TRUE(switch_change(AUX_COVER_PROPERTY_NAME, AUX_COVER_OPEN_ITEM_NAME, INDIGO_BUSY_STATE));
	SERIAL_CHECK_TRUE(cover_is(100));
cleanup:
	driver_stop();
}

// A partial position leaves neither end on.
static void partial_position(void) {
	SERIAL_CHECK_TRUE(driver_start());
	SERIAL_CHECK_TRUE(number_change(X_COVER_POSITION_PROPERTY_NAME, X_COVER_POSITION_ITEM_NAME, 50, INDIGO_BUSY_STATE));
	SERIAL_CHECK_TRUE(wait_for_requests("{\"req\":{\"set\":{\"MOT1\":{\"POSITION\":50}}}}", 1));
	SERIAL_CHECK_TRUE(cover_is(50));
	SERIAL_CHECK_TRUE(switch_is(AUX_COVER_PROPERTY_NAME, AUX_COVER_OPEN_ITEM_NAME, false));
	SERIAL_CHECK_TRUE(switch_is(AUX_COVER_PROPERTY_NAME, AUX_COVER_CLOSE_ITEM_NAME, false));
	// Idle polls agree.
	int polls = requests(MOTION_POLL_REQUEST);
	SERIAL_CHECK_TRUE(wait_for_requests_within(MOTION_POLL_REQUEST, polls + 2, 6));
	SERIAL_CHECK_TRUE(cover_is(50));
cleanup:
	driver_stop();
}

// An abort stops the cover mid-move (decelerated); both cover properties end ALERT at the position reached, the
// target keeps the request, and a fresh move works.
static void abort_motion(void) {
	SERIAL_CHECK_TRUE(driver_start());
	SERIAL_CHECK_TRUE(switch_change(AUX_COVER_PROPERTY_NAME, AUX_COVER_CLOSE_ITEM_NAME, INDIGO_BUSY_STATE));
	SERIAL_CHECK_TRUE(cover_in_motion(90, 40));
	SERIAL_CHECK_TRUE(switch_change(X_COVER_ABORT_PROPERTY_NAME, X_COVER_ABORT_ITEM_NAME, INDIGO_OK_STATE));
	SERIAL_CHECK_TRUE(wait_for_requests("\"MOT_STOP\"", 1));
	SERIAL_CHECK_EQ_INT(0, requests("\"MOT_ABORT\""));
	SERIAL_CHECK_TRUE(cover_ended(INDIGO_ALERT_STATE));
	double stopped = find_cached_item(X_COVER_POSITION_PROPERTY_NAME, X_COVER_POSITION_ITEM_NAME)->number.value;
	printf("Aborted at %g of 0\n", stopped);
	SERIAL_CHECK_TRUE(stopped > 0 && stopped < 100);
	SERIAL_CHECK_TRUE(number_target(X_COVER_POSITION_PROPERTY_NAME, X_COVER_POSITION_ITEM_NAME) == 0);
	SERIAL_CHECK_TRUE(switch_is(AUX_COVER_PROPERTY_NAME, AUX_COVER_CLOSE_ITEM_NAME, false));
	// The stop holds.
	indigo_usleep(1500000);
	SERIAL_CHECK_TRUE(number_is(X_COVER_POSITION_PROPERTY_NAME, X_COVER_POSITION_ITEM_NAME, stopped, 0));
	SERIAL_CHECK_TRUE(switch_change(AUX_COVER_PROPERTY_NAME, AUX_COVER_OPEN_ITEM_NAME, INDIGO_BUSY_STATE));
	SERIAL_CHECK_TRUE(cover_is(100));
cleanup:
	driver_stop();
}

static void abort_while_idle(void) {
	SERIAL_CHECK_TRUE(driver_start());
	SERIAL_CHECK_TRUE(switch_change(X_COVER_ABORT_PROPERTY_NAME, X_COVER_ABORT_ITEM_NAME, INDIGO_OK_STATE));
	SERIAL_CHECK_EQ_INT(0, requests("\"MOT_STOP\""));
	SERIAL_CHECK_TRUE(cover_is(100));
cleanup:
	driver_stop();
}

// A refused stop ends ALERT with the reason; the move goes on and ends normally.
static void abort_refused(void) {
	SERIAL_CHECK_TRUE(driver_start());
	SERIAL_CHECK_TRUE(number_change(X_COVER_POSITION_PROPERTY_NAME, X_COVER_POSITION_ITEM_NAME, 30, INDIGO_BUSY_STATE));
	SERIAL_CHECK_TRUE(cover_in_motion(100, 30));
	clear_messages();
	SERIAL_CHECK_TRUE(fault("\"MOT_STOP\"", "reject"));
	SERIAL_CHECK_TRUE(switch_change(X_COVER_ABORT_PROPERTY_NAME, X_COVER_ABORT_ITEM_NAME, INDIGO_ALERT_STATE));
	SERIAL_CHECK_TRUE(message_seen("Error: invalid command"));
	SERIAL_CHECK_TRUE(cover_is(30));
cleanup:
	driver_stop();
}

// A refused move ends ALERT with the reason, never BUSY, and the position stays.
static void move_refused(void) {
	SERIAL_CHECK_TRUE(driver_start());
	clear_messages();
	SERIAL_CHECK_TRUE(fault("\"POSITION\":0}", "reject"));
	SERIAL_CHECK_TRUE(switch_change(AUX_COVER_PROPERTY_NAME, AUX_COVER_CLOSE_ITEM_NAME, INDIGO_ALERT_STATE));
	SERIAL_CHECK_TRUE(message_seen("Error: invalid command"));
	SERIAL_CHECK_TRUE(switch_is(AUX_COVER_PROPERTY_NAME, AUX_COVER_OPEN_ITEM_NAME, true));
	SERIAL_CHECK_TRUE(number_is(X_COVER_POSITION_PROPERTY_NAME, X_COVER_POSITION_ITEM_NAME, 100, 0));
	SERIAL_CHECK_TRUE(switch_change(AUX_COVER_PROPERTY_NAME, AUX_COVER_CLOSE_ITEM_NAME, INDIGO_BUSY_STATE));
	SERIAL_CHECK_TRUE(cover_is(0));
cleanup:
	driver_stop();
}

// A cover that reports motion without progress is stopped and ends ALERT.
static void stalled_move(void) {
	SERIAL_CHECK_TRUE(driver_start());
	clear_messages();
	SERIAL_CHECK_TRUE(fault("\"POSITION\":20}", "stall"));
	SERIAL_CHECK_TRUE(number_change(X_COVER_POSITION_PROPERTY_NAME, X_COVER_POSITION_ITEM_NAME, 20, INDIGO_BUSY_STATE));
	SERIAL_CHECK_TRUE(cover_ended(INDIGO_ALERT_STATE));
	SERIAL_CHECK_TRUE(message_seen("The cover stalled"));
	SERIAL_CHECK_TRUE(wait_for_requests("\"MOT_STOP\"", 1));
	SERIAL_CHECK_TRUE(number_change(X_COVER_POSITION_PROPERTY_NAME, X_COVER_POSITION_ITEM_NAME, 20, INDIGO_BUSY_STATE));
	SERIAL_CHECK_TRUE(cover_is(20));
cleanup:
	driver_stop();
}

// A single lost readback is retried; persistent ones stop the cover and end ALERT.
static void motion_readback_failures(void) {
	SERIAL_CHECK_TRUE(driver_start());
	SERIAL_CHECK_TRUE(number_change(X_COVER_POSITION_PROPERTY_NAME, X_COVER_POSITION_ITEM_NAME, 40, INDIGO_BUSY_STATE));
	SERIAL_CHECK_TRUE(fault("{\"POSITION\":\"\",\"STATUS\":\"\"}", "garbage"));
	SERIAL_CHECK_TRUE(cover_is(40));
	clear_messages();
	SERIAL_CHECK_TRUE(number_change(X_COVER_POSITION_PROPERTY_NAME, X_COVER_POSITION_ITEM_NAME, 90, INDIGO_BUSY_STATE));
	SERIAL_CHECK_TRUE(fault("{\"POSITION\":\"\",\"STATUS\":\"\"}", "always_garbage"));
	SERIAL_CHECK_TRUE(cover_ended(INDIGO_ALERT_STATE));
	SERIAL_CHECK_TRUE(message_seen("The cover position could not be read"));
	SERIAL_CHECK_TRUE(wait_for_requests("\"MOT_STOP\"", 1));
	unlink(fault_path);
	SERIAL_CHECK_TRUE(number_change(X_COVER_POSITION_PROPERTY_NAME, X_COVER_POSITION_ITEM_NAME, 60, INDIGO_BUSY_STATE));
	SERIAL_CHECK_TRUE(cover_is(60));
cleanup:
	driver_stop();
}

// Motion started elsewhere is published BUSY, then OK where the cover stopped; nothing is sent.
static void external_motion_observed(void) {
	SERIAL_CHECK_TRUE(driver_start());
	unsigned int revision = property_state_revision(X_COVER_POSITION_PROPERTY_NAME, INDIGO_BUSY_STATE);
	SERIAL_CHECK_TRUE(fault("external", "30"));
	SERIAL_CHECK_TRUE(state_seen_within(X_COVER_POSITION_PROPERTY_NAME, INDIGO_BUSY_STATE, revision, 5));
	SERIAL_CHECK_TRUE(cover_is(30));
	SERIAL_CHECK_TRUE(number_target(X_COVER_POSITION_PROPERTY_NAME, X_COVER_POSITION_ITEM_NAME) == 30);
	SERIAL_CHECK_EQ_INT(0, requests("\"set\""));
cleanup:
	driver_stop();
}

// A position request accepted while an idle poll is in flight is executed, even when that poll sees motion started
// elsewhere: the poll neither follows that motion nor publishes over the request, the requested position is sent once
// and the cover ends OK there.
static void request_versus_poll(void) {
	SERIAL_CHECK_TRUE(driver_start());
	SERIAL_CHECK_TRUE(cover_is(100));
	int polls = requests(MOTION_POLL_REQUEST);
	SERIAL_CHECK_TRUE(fault("external", "70 slow"));
	SERIAL_CHECK_TRUE(wait_for_requests(MOTION_POLL_REQUEST, polls + 1));
	SERIAL_CHECK_EQ_INT(INDIGO_OK, indigo_change_number_property_1(&simulator_test_client, ALTO_NAME, X_COVER_POSITION_PROPERTY_NAME, X_COVER_POSITION_ITEM_NAME, 40));
	SERIAL_CHECK_TRUE(wait_for_requests("{\"req\":{\"set\":{\"MOT1\":{\"POSITION\":40}}}}", 1));
	SERIAL_CHECK_TRUE(cover_is(40));
	SERIAL_CHECK_EQ_INT(1, requests("\"POSITION\":40"));
	SERIAL_CHECK_TRUE(number_target(X_COVER_POSITION_PROPERTY_NAME, X_COVER_POSITION_ITEM_NAME) == 40);
cleanup:
	driver_stop();
}

// A request while the cover moves is refused; the move goes on.
static void overlap_refused(void) {
	SERIAL_CHECK_TRUE(driver_start());
	SERIAL_CHECK_TRUE(text_change(X_PRESET_NAMES_PROPERTY_NAME, "PRESET_1", "Half", INDIGO_OK_STATE));
	SERIAL_CHECK_TRUE(number_change(X_COVER_POSITION_PROPERTY_NAME, X_COVER_POSITION_ITEM_NAME, 10, INDIGO_BUSY_STATE));
	SERIAL_CHECK_TRUE(cover_in_motion(100, 10));
	clear_messages();
	SERIAL_CHECK_TRUE(switch_change(X_PRESET_RECALL_PROPERTY_NAME, "PRESET_1", INDIGO_ALERT_STATE));
	SERIAL_CHECK_TRUE(message_seen("The cover is moving"));
	SERIAL_CHECK_EQ_INT(0, requests("\"PRESET\":1"));
	SERIAL_CHECK_TRUE(cover_is(10));
cleanup:
	driver_stop();
}

// A disconnect during a move stops the cover first; a reconnect shows it OK where it stopped.
static void disconnect_during_motion(void) {
	SERIAL_CHECK_TRUE(driver_start());
	SERIAL_CHECK_TRUE(switch_change(AUX_COVER_PROPERTY_NAME, AUX_COVER_CLOSE_ITEM_NAME, INDIGO_BUSY_STATE));
	SERIAL_CHECK_TRUE(cover_in_motion(95, 50));
	disconnect_serial_device(&alto);
	SERIAL_CHECK_TRUE(!context.connected);
	SERIAL_CHECK_EQ_INT(1, requests("\"MOT_STOP\""));
	indigo_usleep(500000);
	SERIAL_CHECK_TRUE(connect_alto());
	indigo_item *item = find_cached_item(X_COVER_POSITION_PROPERTY_NAME, X_COVER_POSITION_ITEM_NAME);
	SERIAL_CHECK_TRUE(item != NULL && item->number.value > 0 && item->number.value < 100);
	SERIAL_CHECK_TRUE(property_state(X_COVER_POSITION_PROPERTY_NAME) == INDIGO_OK_STATE);
cleanup:
	driver_stop();
}

// ----------------------------------------------------------------- polling

// A failed idle poll publishes ALERT with the last values; the next good poll restores OK.
static void poll_failure(void) {
	SERIAL_CHECK_TRUE(driver_start());
	unsigned int alerts = property_state_revision(X_COVER_POSITION_PROPERTY_NAME, INDIGO_ALERT_STATE);
	SERIAL_CHECK_TRUE(fault("{\"POSITION\":\"\",\"STATUS\":\"\"}", "garbage"));
	SERIAL_CHECK_TRUE(state_seen_within(X_COVER_POSITION_PROPERTY_NAME, INDIGO_ALERT_STATE, alerts, 5));
	SERIAL_CHECK_TRUE(number_is(X_COVER_POSITION_PROPERTY_NAME, X_COVER_POSITION_ITEM_NAME, 100, 0));
	SERIAL_CHECK_TRUE(cover_is(100));
cleanup:
	driver_stop();
}

// The motor temperature and the supplies are read every fifth idle poll.
static void environment_polled(void) {
	SERIAL_CHECK_TRUE(driver_start());
	SERIAL_CHECK_TRUE(wait_for_requests_within("\"NTC_T\":\"\"", 1, 15));
	SERIAL_CHECK_TRUE(wait_for_number_item_value(X_STATE_PROPERTY_NAME, X_STATE_TEMPERATURE_ITEM_NAME, 46.88, .005));
	SERIAL_CHECK_TRUE(number_is(X_STATE_PROPERTY_NAME, X_STATE_VIN_12V_ITEM_NAME, 13.39, .005));
	unsigned int alerts = property_state_revision(X_STATE_PROPERTY_NAME, INDIGO_ALERT_STATE);
	SERIAL_CHECK_TRUE(fault("\"NTC_T\"", "garbage"));
	SERIAL_CHECK_TRUE(state_seen_within(X_STATE_PROPERTY_NAME, INDIGO_ALERT_STATE, alerts, 15));
	unsigned int recoveries = property_state_revision(X_STATE_PROPERTY_NAME, INDIGO_OK_STATE);
	SERIAL_CHECK_TRUE(state_seen_within(X_STATE_PROPERTY_NAME, INDIGO_OK_STATE, recoveries, 15));
cleanup:
	driver_stop();
}

// ----------------------------------------------------------------- presets, settings, calibration

static void presets(void) {
	SERIAL_CHECK_TRUE(driver_start());
	clear_messages();
	// A preset without a name refuses a position.
	SERIAL_CHECK_TRUE(number_change(X_PRESETS_PROPERTY_NAME, "PRESET_2", 50, INDIGO_ALERT_STATE));
	SERIAL_CHECK_TRUE(message_seen("Preset #2 needs a name before its position can be set"));
	SERIAL_CHECK_TRUE(number_is(X_PRESETS_PROPERTY_NAME, "PRESET_2", 0, 0));
	SERIAL_CHECK_TRUE(text_change(X_PRESET_NAMES_PROPERTY_NAME, "PRESET_2", "Half", INDIGO_OK_STATE));
	SERIAL_CHECK_TRUE(number_change(X_PRESETS_PROPERTY_NAME, "PRESET_2", 50, INDIGO_OK_STATE));
	// The position is stored in steps.
	SERIAL_CHECK_TRUE(wait_for_requests("{\"req\":{\"set\":{\"PRESET_2\":{\"M1POS\":119804}}}}", 1));
	SERIAL_CHECK_EQ_INT(0, requests("\"PRESET_1\""));
	// A recall moves the cover there.
	SERIAL_CHECK_TRUE(switch_change(X_PRESET_RECALL_PROPERTY_NAME, "PRESET_2", INDIGO_OK_STATE));
	SERIAL_CHECK_TRUE(wait_for_requests("{\"req\":{\"cmd\":{\"PRESET\":2}}}", 1));
	SERIAL_CHECK_TRUE(property_state(X_COVER_POSITION_PROPERTY_NAME) == INDIGO_BUSY_STATE);
	SERIAL_CHECK_TRUE(cover_is(50));
	// An empty preset cannot be recalled.
	clear_messages();
	SERIAL_CHECK_TRUE(switch_change(X_PRESET_RECALL_PROPERTY_NAME, "PRESET_3", INDIGO_ALERT_STATE));
	SERIAL_CHECK_TRUE(message_seen("Error: empty preset"));
	SERIAL_CHECK_TRUE(cover_is(50));
	// The presets are read back after a reconnect.
	disconnect_serial_device(&alto);
	SERIAL_CHECK_TRUE(connect_alto());
	SERIAL_CHECK_TRUE(number_is(X_PRESETS_PROPERTY_NAME, "PRESET_2", 50, 0));
	SERIAL_CHECK_TRUE(text_is(X_PRESET_NAMES_PROPERTY_NAME, "PRESET_2", "Half"));
cleanup:
	driver_stop();
}

static void leds(void) {
	SERIAL_CHECK_TRUE(driver_start());
	SERIAL_CHECK_TRUE(switch_change(X_LEDS_PROPERTY_NAME, X_LEDS_DIM_ITEM_NAME, INDIGO_OK_STATE));
	SERIAL_CHECK_TRUE(wait_for_requests("{\"req\":{\"cmd\":{\"DIMLEDS\":\"low\"}}}", 1));
	SERIAL_CHECK_TRUE(fault("\"DIMLEDS\"", "silent"));
	SERIAL_CHECK_TRUE(switch_change(X_LEDS_PROPERTY_NAME, OFF_ITEM_NAME, INDIGO_ALERT_STATE));
	SERIAL_CHECK_TRUE(switch_is(X_LEDS_PROPERTY_NAME, X_LEDS_DIM_ITEM_NAME, true));
	disconnect_serial_device(&alto);
	SERIAL_CHECK_TRUE(connect_alto());
	SERIAL_CHECK_TRUE(switch_is(X_LEDS_PROPERTY_NAME, X_LEDS_DIM_ITEM_NAME, true));
cleanup:
	driver_stop();
}

// The INDI calibration sequence against the simulator's model (not verified on hardware).
static void calibration(void) {
	SERIAL_CHECK_TRUE(driver_start());
	clear_messages();
	SERIAL_CHECK_TRUE(switch_change(X_CALIBRATION_MOTION_PROPERTY_NAME, "CLOSE_FAST", INDIGO_ALERT_STATE));
	SERIAL_CHECK_TRUE(message_seen("Start a calibration first"));
	SERIAL_CHECK_TRUE(switch_change(X_CALIBRATION_PROPERTY_NAME, "STORE", INDIGO_ALERT_STATE));
	SERIAL_CHECK_EQ_INT(0, requests("\"CAL_ALTO\""));
	clear_messages();
	// Between the steps the property stays OK, so that STORE and CANCEL are accepted.
	SERIAL_CHECK_TRUE(switch_change(X_CALIBRATION_PROPERTY_NAME, "START", INDIGO_OK_STATE));
	SERIAL_CHECK_TRUE(wait_for_requests("{\"req\":{\"cmd\":{\"MOT1\":{\"CAL_ALTO\":\"Init\"}}}}", 1));
	SERIAL_CHECK_TRUE(message_seen("Close the cover fully"));
	// Moves wait for the calibration.
	clear_messages();
	SERIAL_CHECK_TRUE(switch_change(AUX_COVER_PROPERTY_NAME, AUX_COVER_CLOSE_ITEM_NAME, INDIGO_ALERT_STATE));
	SERIAL_CHECK_TRUE(message_seen("A calibration is running"));
	SERIAL_CHECK_TRUE(switch_change(X_CALIBRATION_MOTION_PROPERTY_NAME, "CLOSE_FAST", INDIGO_OK_STATE));
	SERIAL_CHECK_TRUE(wait_for_requests("\"CAL_ALTO\":\"Close_Fast\"", 1));
	indigo_usleep(1000000);
	SERIAL_CHECK_TRUE(switch_change(X_CALIBRATION_MOTION_PROPERTY_NAME, "STOP", INDIGO_OK_STATE));
	SERIAL_CHECK_TRUE(switch_change(X_CALIBRATION_PROPERTY_NAME, "STORE", INDIGO_OK_STATE));
	SERIAL_CHECK_TRUE(wait_for_requests("\"CAL_ALTO\":\"StoreAsClosedPos\"", 1));
	SERIAL_CHECK_TRUE(switch_change(X_CALIBRATION_MOTION_PROPERTY_NAME, "OPEN_FAST", INDIGO_OK_STATE));
	indigo_usleep(2000000);
	clear_messages();
	SERIAL_CHECK_TRUE(switch_change(X_CALIBRATION_PROPERTY_NAME, "STORE", INDIGO_OK_STATE));
	SERIAL_CHECK_TRUE(wait_for_requests("\"CAL_ALTO\":\"StoreAsMaxOpenPos\"", 1));
	SERIAL_CHECK_TRUE(message_seen("Calibration complete, travel"));
	SERIAL_CHECK_TRUE(cover_is(100));
	// The new travel is used.
	SERIAL_CHECK_TRUE(number_change(X_COVER_POSITION_PROPERTY_NAME, X_COVER_POSITION_ITEM_NAME, 50, INDIGO_BUSY_STATE));
	SERIAL_CHECK_TRUE(cover_is(50));
	// A cancelled calibration stops the motor.
	SERIAL_CHECK_TRUE(switch_change(X_CALIBRATION_PROPERTY_NAME, "START", INDIGO_OK_STATE));
	int stops = requests("\"MOT_STOP\"");
	clear_messages();
	SERIAL_CHECK_TRUE(switch_change(X_CALIBRATION_PROPERTY_NAME, "CANCEL", INDIGO_ALERT_STATE));
	SERIAL_CHECK_TRUE(message_seen("Calibration cancelled"));
	SERIAL_CHECK_EQ_INT(stops + 1, requests("\"MOT_STOP\""));
cleanup:
	driver_stop();
}

// ----------------------------------------------------------------- WiFi

// The credentials are written as given and read back on the next connect; what WiFi cannot use is refused with a reason
// before anything is sent, because the cover would store it (ALTO1 firmware 1.03.11 took a 3 character password).
static void wifi_credentials(void) {
	SERIAL_CHECK_TRUE(driver_start());
	SERIAL_CHECK_TRUE(text_change(X_WIFI_STA_PROPERTY_NAME, "STA_SSID", "Observatory", INDIGO_OK_STATE));
	SERIAL_CHECK_TRUE(wait_for_requests("{\"req\":{\"set\":{\"WIFISTA\":{\"SSID\":\"Observatory\", \"PWD\":\"MyPassword\"}}}}", 1));
	SERIAL_CHECK_TRUE(text_change(X_WIFI_AP_PROPERTY_NAME, "AP_PASSWORD", "darkskies", INDIGO_OK_STATE));
	SERIAL_CHECK_TRUE(wait_for_requests("{\"req\":{\"set\":{\"WIFIAP\":{\"SSID\":\"ALTO100001\", \"PWD\":\"darkskies\"}}}}", 1));
	clear_messages();
	SERIAL_CHECK_TRUE(text_change(X_WIFI_AP_PROPERTY_NAME, "AP_PASSWORD", "abc", INDIGO_ALERT_STATE));
	SERIAL_CHECK_TRUE(message_seen("at least 8 characters"));
	SERIAL_CHECK_TRUE(text_change(X_WIFI_AP_PROPERTY_NAME, "AP_SSID", "", INDIGO_ALERT_STATE));
	SERIAL_CHECK_TRUE(message_seen("needs an SSID"));
	SERIAL_CHECK_EQ_INT(1, requests("{\"req\":{\"set\":{\"WIFIAP\""));
	disconnect_serial_device(&alto);
	SERIAL_CHECK_TRUE(connect_alto());
	SERIAL_CHECK_TRUE(text_is(X_WIFI_STA_PROPERTY_NAME, "STA_SSID", "Observatory"));
	SERIAL_CHECK_TRUE(text_is(X_WIFI_AP_PROPERTY_NAME, "AP_SSID", "ALTO100001"));
	SERIAL_CHECK_TRUE(text_is(X_WIFI_AP_PROPERTY_NAME, "AP_PASSWORD", "darkskies"));
cleanup:
	driver_stop();
}

// Station mode and back write LANCFG and restart the cover once each, as the hardware does; Off and the access point
// only switch the access point. The restarted cover keeps being served.
static void wifi_modes(void) {
	SERIAL_CHECK_TRUE(driver_start());
	SERIAL_CHECK_TRUE(switch_change(X_WIFI_PROPERTY_NAME, X_WIFI_STA_ITEM_NAME, INDIGO_OK_STATE));
	SERIAL_CHECK_TRUE(wait_for_requests("{\"req\":{\"set\":{\"LANCFG\":\"sta\"}}}", 1));
	SERIAL_CHECK_EQ_INT(1, requests("\"REBOOT\""));
	// The address the controller got on the joined network is shown; the access point is off.
	SERIAL_CHECK_TRUE(text_is(X_WIFI_STATUS_PROPERTY_NAME, "IP_ADDRESS", "192.0.2.23"));
	SERIAL_CHECK_TRUE(text_is(X_WIFI_STATUS_PROPERTY_NAME, "PORT", "80"));
	SERIAL_CHECK_TRUE(text_is(X_WIFI_STATUS_PROPERTY_NAME, "CONNECTION", "gotip"));
	disconnect_serial_device(&alto);
	SERIAL_CHECK_TRUE(connect_alto());
	SERIAL_CHECK_TRUE(switch_is(X_WIFI_PROPERTY_NAME, X_WIFI_STA_ITEM_NAME, true));
	SERIAL_CHECK_TRUE(switch_change(X_WIFI_PROPERTY_NAME, X_WIFI_AP_ITEM_NAME, INDIGO_OK_STATE));
	SERIAL_CHECK_TRUE(wait_for_requests("{\"req\":{\"set\":{\"LANCFG\":\"ap\"}}}", 1));
	SERIAL_CHECK_EQ_INT(2, requests("\"REBOOT\""));
	SERIAL_CHECK_TRUE(wait_for_requests("{\"req\":{\"cmd\":{\"AP_SET_STATUS\":\"on\"}}}", 1));
	SERIAL_CHECK_TRUE(switch_change(X_WIFI_PROPERTY_NAME, OFF_ITEM_NAME, INDIGO_OK_STATE));
	SERIAL_CHECK_TRUE(wait_for_requests("{\"req\":{\"cmd\":{\"AP_SET_STATUS\":\"off\"}}}", 1));
	SERIAL_CHECK_EQ_INT(2, requests("\"REBOOT\""));
	SERIAL_CHECK_TRUE(number_change(X_COVER_POSITION_PROPERTY_NAME, X_COVER_POSITION_ITEM_NAME, 60, INDIGO_BUSY_STATE));
	SERIAL_CHECK_TRUE(cover_is(60));
	disconnect_serial_device(&alto);
	SERIAL_CHECK_TRUE(connect_alto());
	SERIAL_CHECK_TRUE(switch_is(X_WIFI_PROPERTY_NAME, OFF_ITEM_NAME, true));
	// A refused mode ends ALERT with the cover's reason, keeps the mode and restarts nothing.
	clear_messages();
	SERIAL_CHECK_TRUE(fault("\"LANCFG\":\"sta\"", "reject"));
	SERIAL_CHECK_TRUE(switch_change(X_WIFI_PROPERTY_NAME, X_WIFI_STA_ITEM_NAME, INDIGO_ALERT_STATE));
	SERIAL_CHECK_TRUE(message_seen("Error: invalid command"));
	SERIAL_CHECK_TRUE(switch_is(X_WIFI_PROPERTY_NAME, OFF_ITEM_NAME, true));
	SERIAL_CHECK_EQ_INT(2, requests("\"REBOOT\""));
cleanup:
	driver_stop();
}

// A restart would stop a moving cover or a calibration, so the mode change waits for them; switching the access point
// alone restarts nothing and is served during a move.
static void wifi_restart_waits_for_the_cover(void) {
	SERIAL_CHECK_TRUE(driver_start());
	SERIAL_CHECK_TRUE(number_change(X_COVER_POSITION_PROPERTY_NAME, X_COVER_POSITION_ITEM_NAME, 10, INDIGO_BUSY_STATE));
	SERIAL_CHECK_TRUE(cover_in_motion(100, 10));
	clear_messages();
	SERIAL_CHECK_TRUE(switch_change(X_WIFI_PROPERTY_NAME, X_WIFI_STA_ITEM_NAME, INDIGO_ALERT_STATE));
	SERIAL_CHECK_TRUE(message_seen("wait until it stops"));
	SERIAL_CHECK_TRUE(switch_is(X_WIFI_PROPERTY_NAME, X_WIFI_AP_ITEM_NAME, true));
	SERIAL_CHECK_TRUE(switch_change(X_WIFI_PROPERTY_NAME, OFF_ITEM_NAME, INDIGO_OK_STATE));
	SERIAL_CHECK_TRUE(cover_is(10));
	SERIAL_CHECK_TRUE(switch_change(X_CALIBRATION_PROPERTY_NAME, "START", INDIGO_OK_STATE));
	clear_messages();
	SERIAL_CHECK_TRUE(switch_change(X_WIFI_PROPERTY_NAME, X_WIFI_STA_ITEM_NAME, INDIGO_ALERT_STATE));
	SERIAL_CHECK_TRUE(message_seen("finish the calibration first"));
	SERIAL_CHECK_EQ_INT(0, requests("\"LANCFG\":\"sta\""));
	SERIAL_CHECK_EQ_INT(0, requests("\"REBOOT\""));
	SERIAL_CHECK_TRUE(switch_change(X_CALIBRATION_PROPERTY_NAME, "CANCEL", INDIGO_ALERT_STATE));
cleanup:
	driver_stop();
}

// After the port disappears every request ends ALERT, the handshake is not repeated and disconnect completes.
static void transport_loss(void) {
	SERIAL_CHECK_TRUE(driver_start());
	int handshakes = requests("\"MODNAME\"");
	SERIAL_CHECK_TRUE(fault("\"POSITION\":33}", "close"));
	SERIAL_CHECK_TRUE(number_change(X_COVER_POSITION_PROPERTY_NAME, X_COVER_POSITION_ITEM_NAME, 33, INDIGO_ALERT_STATE));
	SERIAL_CHECK_TRUE(switch_change(AUX_COVER_PROPERTY_NAME, AUX_COVER_CLOSE_ITEM_NAME, INDIGO_ALERT_STATE));
	SERIAL_CHECK_TRUE(switch_change(X_LEDS_PROPERTY_NAME, OFF_ITEM_NAME, INDIGO_ALERT_STATE));
	SERIAL_CHECK_EQ_INT(handshakes, requests("\"MODNAME\""));
	disconnect_serial_device(&alto);
	SERIAL_CHECK_TRUE(!context.connected);
cleanup:
	driver_stop();
}

// ----------------------------------------------------------------- runner

typedef struct { const char *name; void (*run)(void); const char *profile; } simulated_case;

static void copy_case_trace(const char *name) {
	const char *directory = getenv("INDIGO_SIMULATOR_TRACE_DIR");
	if (directory == NULL || *directory == 0) {
		return;
	}
	char target_path[PATH_MAX];
	if (snprintf(target_path, sizeof(target_path), "%s/%s.events", directory, name) >= (int)sizeof(target_path)) {
		return;
	}
	FILE *source = fopen(event_path, "r");
	if (source == NULL) {
		return;
	}
	FILE *target = fopen(target_path, "w");
	if (target != NULL) {
		char line[4096];
		while (fgets(line, sizeof(line), source) != NULL) {
			fputs(line, target);
		}
		fclose(target);
	}
	fclose(source);
}

int main(void) {
	const simulated_case cases[] = {
		{ "metadata", metadata, "normal" },
		{ "usb_match_pattern", usb_match_pattern, "normal" },
		{ "property_contract", property_contract, "normal" },
		{ "connect_closed", connect_closed, "closed" },
		{ "long_firmware", long_firmware, "long-firmware" },
		{ "unsupported_device", unsupported_device, "unsupported" },
		{ "handshake_timeout", handshake_timeout, "normal" },
		{ "needs_calibration", needs_calibration, "needs-calibration" },
		{ "uncalibrated", uncalibrated, "uncalibrated" },
		{ "repeated_init_shutdown", repeated_init_shutdown, "normal" },
		{ "shutdown_rejected_while_connected", shutdown_rejected_while_connected, "normal" },
		{ "reconnect", reconnect, "normal" },
		{ "close_and_open", close_and_open, "normal" },
		{ "partial_position", partial_position, "normal" },
		{ "abort_motion", abort_motion, "normal" },
		{ "abort_while_idle", abort_while_idle, "normal" },
		{ "abort_refused", abort_refused, "normal" },
		{ "move_refused", move_refused, "normal" },
		{ "stalled_move", stalled_move, "normal" },
		{ "motion_readback_failures", motion_readback_failures, "normal" },
		{ "external_motion_observed", external_motion_observed, "normal" },
		{ "request_versus_poll", request_versus_poll, "normal" },
		{ "overlap_refused", overlap_refused, "normal" },
		{ "disconnect_during_motion", disconnect_during_motion, "normal" },
		{ "poll_failure", poll_failure, "normal" },
		{ "environment_polled", environment_polled, "normal" },
		{ "presets", presets, "normal" },
		{ "leds", leds, "normal" },
		{ "calibration", calibration, "normal" },
		{ "wifi_credentials", wifi_credentials, "normal" },
		{ "wifi_modes", wifi_modes, "normal" },
		{ "wifi_restart_waits_for_the_cover", wifi_restart_waits_for_the_cover, "normal" },
		{ "transport_loss", transport_loss, "normal" }
	};
	setvbuf(stdout, NULL, _IOLBF, 0);
	simulator_test_client.send_message = record_message;
	simulator_test_client.define_property = observe_define;
	if (mkdtemp(fixture_directory) == NULL) {
		fprintf(stderr, "Cannot create fixture directory\n");
		return 1;
	}
	snprintf(event_path, sizeof(event_path), "%s/events.log", fixture_directory);
	snprintf(fault_path, sizeof(fault_path), "%s/fault", fixture_directory);
	setenv("INDIGO_ALTO_EVENTS", event_path, 1);
	setenv("INDIGO_ALTO_FAULT", fault_path, 1);
	const char *filter = getenv("ALTO_TEST_FILTER");
	int failures = 0;
	for (int i = 0; i < ARRAY_SIZE(cases); i++) {
		if (filter != NULL && strstr(cases[i].name, filter) == NULL) {
			continue;
		}
		unlink(fault_path);
		const char *arguments[] = { "--profile", cases[i].profile, NULL, NULL };
		if (getenv("ALTO_TEST_TRACE") != NULL) {
			arguments[2] = "--trace";
		}
		if (!start_external_serial_simulator_with_args(&fixture, AUX_ALTO_SIMULATOR_EXECUTABLE, arguments)) {
			fprintf(stderr, "Simulator startup failed\n");
			failures++;
			break;
		}
		fflush(NULL);
		pid_t child = fork();
		if (child == 0) {
			alarm(120);
			indigo_test_case test = { cases[i].name, cases[i].run };
			_exit(indigo_run_tests("PrimaluceLab ALTO", &test, 1));
		}
		int status = 0;
		if (child > 0) {
			while (waitpid(child, &status, 0) < 0) {
				if (errno != EINTR) {
					status = -1;
					break;
				}
			}
		}
		stop_external_serial_simulator(&fixture);
		copy_case_trace(cases[i].name);
		if (child < 0 || status == -1 || !WIFEXITED(status) || WEXITSTATUS(status)) {
			failures++;
			printf("FAIL: %s (exit=%d, signal=%d)\n", cases[i].name, WIFEXITED(status) ? WEXITSTATUS(status) : -1, WIFSIGNALED(status) ? WTERMSIG(status) : 0);
		}
	}
	unlink(fault_path);
	unlink(event_path);
	rmdir(fixture_directory);
	unsetenv("INDIGO_ALTO_EVENTS");
	unsetenv("INDIGO_ALTO_FAULT");
	printf("PrimaluceLab ALTO: %d failing scenarios\n", failures);
	return failures ? 1 : 0;
}
