// Copyright (c) 2026 INDIGO initiative
// All rights reserved.
//
// You may use this software under the terms of 'INDIGO Astronomy
// open-source license' (see LICENSE.md).
//
// THIS SOFTWARE IS PROVIDED BY THE AUTHORS 'AS IS' AND ANY EXPRESS
// OR IMPLIED WARRANTIES, INCLUDING, BUT NOT LIMITED TO, THE IMPLIED
// WARRANTIES OF MERCHANTABILITY AND FITNESS FOR A PARTICULAR PURPOSE
// ARE DISCLAIMED. IN NO EVENT SHALL THE AUTHOR BE LIABLE FOR ANY
// DIRECT, INDIRECT, INCIDENTAL, SPECIAL, EXEMPLARY, OR CONSEQUENTIAL
// DAMAGES (INCLUDING, BUT NOT LIMITED TO, PROCUREMENT OF SUBSTITUTE
// GOODS OR SERVICES; LOSS OF USE, DATA, OR PROFITS; OR BUSINESS
// INTERRUPTION) HOWEVER CAUSED AND ON ANY THEORY OF LIABILITY,
// WHETHER IN CONTRACT, STRICT LIABILITY, OR TORT (INCLUDING
// NEGLIGENCE OR OTHERWISE) ARISING IN ANY WAY OUT OF THE USE OF THIS
// SOFTWARE, EVEN IF ADVISED OF THE POSSIBILITY OF SUCH DAMAGE.

// Code is generated by AI

/** Integration test of indigo_agent_solver on the in-process bus: index management against a synthetic
 Tycho-2 style index placed in INDIGO_CACHE_BASE and a native solve of a synthetic RAW image. No network
 access, the download path is not exercised.
 \file test_agent_solver.c
 */

#include <stdio.h>
#include <stdlib.h>
#include <string.h>
#include <math.h>
#include <pthread.h>
#include <unistd.h>
#include <sys/stat.h>
#include <sys/wait.h>

#include <jpeglib.h>

#include <indigo/indigo_bus.h>
#include <indigo/indigo_fits.h>
#include <indigo/indigo_names.h>
#include <indigo/indigo_platesolver.h>
#include <indigo_drivers/agent_solver/indigo_agent_solver.h>
#include <indigo_drivers/agent_solver/indigo_solver.h>

#include "../test_runner.h"

#define SOLVER									SOLVER_AGENT_NAME
#define INDEX_PROPERTY					"X_AGENT_SOLVER_INDEX"
#define INDEX_ITEM							"INDEX_05DEG_TYC2"
#define SUITE										"Solver agent"
#define ARRAY_SIZE(a)						(sizeof(a) / sizeof((a)[0]))
#define REQUIRE(c) do { if (!(c)) { fprintf(stderr, "%s:%d: %s\n", __FILE__, __LINE__, #c); indigo_test_failures++; return false; } } while (0)
#define WAIT_UNTIL(condition, timeout) ({ double deadline_ = indigo_monotonic_time() + (timeout); bool ready_ = (condition); while (!ready_ && indigo_monotonic_time() < deadline_) { indigo_usleep(10000); ready_ = (condition); } ready_; })

#define CATALOG_STAR_COUNT			28
#define IMAGE_WIDTH							1600
#define IMAGE_HEIGHT						1200
#define IMAGE_SCALE							(8 * ARCSEC_TO_RAD)
#define IMAGE_ANGLE							(20 * DEG_TO_RAD)
#define CATALOG_SCALE						(16 * ARCSEC_TO_RAD)

typedef struct {
	char device[INDIGO_NAME_SIZE];
	char name[INDIGO_NAME_SIZE];
	indigo_property *property;
	unsigned revision;
	unsigned states[4];
} observation;

static observation cache[256];
static pthread_mutex_t cache_mutex = PTHREAD_MUTEX_INITIALIZER;
static indigo_client observer;
static char messages[65536];
static bool bus_started, observer_attached, solver_started;
static char cache_base[64];
static char index_path[PATH_MAX], narrow_index_path[PATH_MAX];
static float ra0, dec0, image_ra, image_dec;
static uint32_t rng_state = 20261027;

static float frand(void) {
	rng_state = rng_state * 1664525u + 1013904223u;
	return (rng_state >> 8) / (float)(1u << 24);
}

// -------------------------------------------------------------------------------- observer client

static observation *find_observation(const char *device, const char *name) {
	observation *free_entry = NULL;
	for (unsigned i = 0; i < ARRAY_SIZE(cache); i++) {
		if (!*cache[i].name) {
			if (!free_entry) {
				free_entry = cache + i;
			}
		} else if (!strcmp(cache[i].device, device) && !strcmp(cache[i].name, name)) {
			return cache + i;
		}
	}
	if (free_entry) {
		INDIGO_COPY_NAME(free_entry->device, device);
		INDIGO_COPY_NAME(free_entry->name, name);
	}
	return free_entry;
}

static void add_message(const char *device, const char *message) {
	if (message && *message && strlen(messages) + strlen(device) + strlen(message) + 4 < sizeof(messages)) {
		strcat(messages, device);
		strcat(messages, ": ");
		strcat(messages, message);
		strcat(messages, "\n");
	}
}

static indigo_result observe(indigo_property *property, bool update, const char *message) {
	pthread_mutex_lock(&cache_mutex);
	add_message(property->device, message);
	observation *entry = find_observation(property->device, property->name);
	if (entry) {
		indigo_release_property(entry->property);
		entry->property = indigo_copy_property(NULL, property);
		entry->revision++;
		if (update && property->state <= INDIGO_ALERT_STATE) {
			entry->states[property->state]++;
		}
	}
	pthread_mutex_unlock(&cache_mutex);
	return INDIGO_OK;
}

static indigo_result defined(indigo_client *client, indigo_device *device, indigo_property *property, const char *message) {
	return observe(property, false, message);
}

static indigo_result updated(indigo_client *client, indigo_device *device, indigo_property *property, const char *message) {
	return observe(property, true, message);
}

static indigo_result deleted(indigo_client *client, indigo_device *device, indigo_property *property, const char *message) {
	pthread_mutex_lock(&cache_mutex);
	for (unsigned i = 0; i < ARRAY_SIZE(cache); i++) {
		observation *entry = cache + i;
		if (*entry->name && !strcmp(entry->device, property->device) && (!*property->name || !strcmp(entry->name, property->name))) {
			indigo_release_property(entry->property);
			memset(entry, 0, sizeof(*entry));
		}
	}
	pthread_mutex_unlock(&cache_mutex);
	return INDIGO_OK;
}

static indigo_result message_received(indigo_client *client, indigo_device *device, indigo_property *property, const char *message) {
	pthread_mutex_lock(&cache_mutex);
	add_message(device->name, message);
	pthread_mutex_unlock(&cache_mutex);
	return INDIGO_OK;
}

static bool exists(const char *name) {
	pthread_mutex_lock(&cache_mutex);
	observation *entry = find_observation(SOLVER, name);
	bool result = entry && entry->property;
	pthread_mutex_unlock(&cache_mutex);
	return result;
}

static int state(const char *name) {
	pthread_mutex_lock(&cache_mutex);
	observation *entry = find_observation(SOLVER, name);
	int result = entry && entry->property ? (int)entry->property->state : -1;
	pthread_mutex_unlock(&cache_mutex);
	return result;
}

static unsigned state_count(const char *name, indigo_property_state property_state) {
	pthread_mutex_lock(&cache_mutex);
	observation *entry = find_observation(SOLVER, name);
	unsigned result = entry ? entry->states[property_state] : 0;
	pthread_mutex_unlock(&cache_mutex);
	return result;
}

static bool item_lookup(const char *name, const char *item_name, indigo_item *result) {
	bool found = false;
	pthread_mutex_lock(&cache_mutex);
	observation *entry = find_observation(SOLVER, name);
	if (entry && entry->property) {
		for (int i = 0; i < entry->property->count; i++) {
			if (!strcmp(entry->property->items[i].name, item_name)) {
				*result = entry->property->items[i];
				found = true;
				break;
			}
		}
	}
	pthread_mutex_unlock(&cache_mutex);
	return found;
}

static bool has_item(const char *name, const char *item_name) {
	indigo_item item;
	return item_lookup(name, item_name, &item);
}

static bool switch_value(const char *name, const char *item_name) {
	indigo_item item;
	return item_lookup(name, item_name, &item) && item.sw.value;
}

static double number_value(const char *name, const char *item_name) {
	indigo_item item;
	return item_lookup(name, item_name, &item) ? item.number.value : NAN;
}

static bool message_seen(const char *text) {
	pthread_mutex_lock(&cache_mutex);
	bool result = strstr(messages, text) != NULL;
	pthread_mutex_unlock(&cache_mutex);
	return result;
}

static void clear_messages(void) {
	pthread_mutex_lock(&cache_mutex);
	messages[0] = 0;
	pthread_mutex_unlock(&cache_mutex);
}

static bool set_hint(const char *item_name, double value) {
	REQUIRE(indigo_change_number_property_1(&observer, SOLVER, AGENT_PLATESOLVER_HINTS_PROPERTY_NAME, item_name, value) == INDIGO_OK);
	REQUIRE(WAIT_UNTIL(number_value(AGENT_PLATESOLVER_HINTS_PROPERTY_NAME, item_name) == value, 10));
	return true;
}

// -------------------------------------------------------------------------------- synthetic index and image

// A patch of random catalog stars around (97.9°, 5.1°), indexed like indigo_solver_indexer does: all quads with
// their code variants, projected around a tangent point near the field, sorted by hash and stored as the 5° index
static bool write_synthetic_index(const char *path) {
	indigo_solver_star catalog[CATALOG_STAR_COUNT];
	ra0 = 97.9 * DEG_TO_RAD;
	dec0 = 5.1 * DEG_TO_RAD;
	for (int i = 0; i < CATALOG_STAR_COUNT; i++) {
		memset(catalog + i, 0, sizeof(indigo_solver_star));
		catalog[i].id = i;
		catalog[i].ra = ra0 + (frand() - 0.5) * 3.2 * DEG_TO_RAD;
		catalog[i].dec = dec0 + (frand() - 0.5) * 2.4 * DEG_TO_RAD;
		REQUIRE(indigo_radec_to_xy(ra0, dec0 + 0.4 * DEG_TO_RAD, 0, CATALOG_SCALE, 1000, 1000, -1, catalog[i].ra, catalog[i].dec, &catalog[i].x, &catalog[i].y));
	}
	int capacity = 40000, count = 0;
	indigo_solver_quad *quads = malloc(capacity * sizeof(indigo_solver_quad));
	for (int i = 0; i < CATALOG_STAR_COUNT; i++) {
		for (int j = i + 1; j < CATALOG_STAR_COUNT; j++) {
			for (int k = j + 1; k < CATALOG_STAR_COUNT; k++) {
				for (int l = k + 1; l < CATALOG_STAR_COUNT; l++) {
					if (count + INDIGO_SOLVER_MAX_QUAD_VARIANTS > capacity) {
						capacity *= 2;
						quads = realloc(quads, capacity * sizeof(indigo_solver_quad));
					}
					count += indigo_solver_make_quad_variants(quads + count, INDIGO_SOLVER_MAX_QUAD_VARIANTS, catalog + i, catalog + j, catalog + k, catalog + l);
				}
			}
		}
	}
	indigo_solver_catalog index;
	bool ok = indigo_solver_catalog_build(catalog, CATALOG_STAR_COUNT, quads, count, 5, &index) && indigo_solver_write_index(path, &index);
	indigo_solver_free_catalog(&index);
	free(quads);
	REQUIRE(ok);
	return true;
}

// A 16 bit mono RAW frame of the catalog patch: flat background with noise and gaussian stars
static indigo_raw_header *render_image(long *size) {
	*size = sizeof(indigo_raw_header) + IMAGE_WIDTH * IMAGE_HEIGHT * 2;
	indigo_raw_header *image = calloc(1, *size);
	image->signature = INDIGO_RAW_MONO16;
	image->width = IMAGE_WIDTH;
	image->height = IMAGE_HEIGHT;
	uint16_t *pixels = (uint16_t *)(image + 1);
	for (long i = 0; i < IMAGE_WIDTH * IMAGE_HEIGHT; i++) {
		pixels[i] = 1000 + (int)(frand() * 40);
	}
	image_ra = ra0 + 0.1 * DEG_TO_RAD;
	image_dec = dec0 - 0.05 * DEG_TO_RAD;
	indigo_solver_catalog index;
	if (!indigo_solver_load_index(index_path, &index) || index.star_count != CATALOG_STAR_COUNT) {
		indigo_solver_free_catalog(&index);
		free(image);
		return NULL;
	}
	indigo_solver_index_star stars[CATALOG_STAR_COUNT];
	memcpy(stars, index.stars, sizeof(stars));
	indigo_solver_free_catalog(&index);
	for (int i = 0; i < CATALOG_STAR_COUNT; i++) {
		float x, y;
		if (indigo_radec_to_xy(image_ra, image_dec, IMAGE_ANGLE, IMAGE_SCALE, IMAGE_WIDTH, IMAGE_HEIGHT, -1, stars[i].ra, stars[i].dec, &x, &y)) {
			for (int dy = -6; dy <= 6; dy++) {
				for (int dx = -6; dx <= 6; dx++) {
					int px = (int)rint(x) + dx, py = (int)rint(y) + dy;
					if (px >= 0 && px < IMAGE_WIDTH && py >= 0 && py < IMAGE_HEIGHT) {
						float r2 = (px - x) * (px - x) + (py - y) * (py - y);
						int value = pixels[py * IMAGE_WIDTH + px] + (int)(30000 * exp(-r2 / (2 * 1.5 * 1.5)));
						pixels[py * IMAGE_WIDTH + px] = value > 65535 ? 65535 : value;
					}
				}
			}
		}
	}
	return image;
}

// -------------------------------------------------------------------------------- lifecycle

static bool setup(void) {
	indigo_set_log_level(getenv("INDIGO_TEST_DEBUG") ? INDIGO_LOG_DEBUG : INDIGO_LOG_ERROR);
	char dir[PATH_MAX];
	snprintf(dir, sizeof(dir), "%s/solver", cache_base);
	mkdir(dir, 0755);
	indigo_solver_index_path(index_path, sizeof(index_path), dir, 5);
	REQUIRE(write_synthetic_index(index_path));
	// the same synthetic index under the 0.5 degree name, so the fractional scale item is offered too
	indigo_solver_index_path(narrow_index_path, sizeof(narrow_index_path), dir, 0.5);
	REQUIRE(strstr(narrow_index_path, "index-00.5deg-gaia.isix") != NULL);
	REQUIRE(write_synthetic_index(narrow_index_path));
	REQUIRE(indigo_start() == INDIGO_OK);
	bus_started = true;
	INDIGO_COPY_NAME(observer.name, "Solver observer");
	observer.version = INDIGO_VERSION_CURRENT;
	observer.define_property = defined;
	observer.update_property = updated;
	observer.delete_property = deleted;
	observer.send_message = message_received;
	REQUIRE(indigo_attach_client(&observer) == INDIGO_OK);
	observer_attached = true;
	REQUIRE(indigo_agent_solver(INDIGO_DRIVER_INIT, NULL) == INDIGO_OK);
	solver_started = true;
	REQUIRE(WAIT_UNTIL(exists(INDEX_PROPERTY) && exists(AGENT_PLATESOLVER_USE_INDEX_PROPERTY_NAME) && exists(AGENT_PLATESOLVER_WCS_PROPERTY_NAME), 10));
	return true;
}

static void cleanup(void) {
	if (solver_started) {
		indigo_agent_solver(INDIGO_DRIVER_SHUTDOWN, NULL);
	}
	if (observer_attached) {
		indigo_detach_client(&observer);
	}
	if (bus_started) {
		indigo_stop();
	}
	unlink(index_path);
	unlink(narrow_index_path);
}

static bool select_use_index(void) {
	REQUIRE(has_item(AGENT_PLATESOLVER_USE_INDEX_PROPERTY_NAME, INDEX_ITEM));
	REQUIRE(indigo_change_switch_property_1(&observer, SOLVER, AGENT_PLATESOLVER_USE_INDEX_PROPERTY_NAME, INDEX_ITEM, true) == INDIGO_OK);
	REQUIRE(WAIT_UNTIL(switch_value(AGENT_PLATESOLVER_USE_INDEX_PROPERTY_NAME, INDEX_ITEM), 10));
	return true;
}

static bool solve_image(void *image, long size, const char *format) {
	unsigned ok_before = state_count(AGENT_PLATESOLVER_WCS_PROPERTY_NAME, INDIGO_OK_STATE);
	unsigned alert_before = state_count(AGENT_PLATESOLVER_WCS_PROPERTY_NAME, INDIGO_ALERT_STATE);
	REQUIRE(indigo_change_blob_property_1(&observer, SOLVER, AGENT_PLATESOLVER_IMAGE_PROPERTY_NAME, AGENT_PLATESOLVER_IMAGE_ITEM_NAME, image, size, format, "") == INDIGO_OK);
	REQUIRE(WAIT_UNTIL(state_count(AGENT_PLATESOLVER_WCS_PROPERTY_NAME, INDIGO_OK_STATE) > ok_before || state_count(AGENT_PLATESOLVER_WCS_PROPERTY_NAME, INDIGO_ALERT_STATE) > alert_before, 60));
	return true;
}

static bool prepare_full_resolution(void);

// -------------------------------------------------------------------------------- cases

// An index file present in the cache directory is reported as installed and offered for solving
static void index_property_reflects_installed_files(void) {
	ASSERT_TRUE(switch_value(INDEX_PROPERTY, INDEX_ITEM));
	ASSERT_TRUE(switch_value(INDEX_PROPERTY, "INDEX_00_5DEG_GAIA"));
	ASSERT_FALSE(has_item(INDEX_PROPERTY, "INDEX_00_5DEG_TYC2"));
	ASSERT_FALSE(switch_value(INDEX_PROPERTY, "INDEX_01DEG_TYC2"));
	ASSERT_FALSE(switch_value(INDEX_PROPERTY, "INDEX_20DEG_TYC2"));
	ASSERT_TRUE(has_item(AGENT_PLATESOLVER_USE_INDEX_PROPERTY_NAME, INDEX_ITEM));
	ASSERT_TRUE(has_item(AGENT_PLATESOLVER_USE_INDEX_PROPERTY_NAME, "INDEX_00_5DEG_GAIA"));
	ASSERT_FALSE(has_item(AGENT_PLATESOLVER_USE_INDEX_PROPERTY_NAME, "INDEX_01DEG_TYC2"));
	ASSERT_FALSE(switch_value(AGENT_PLATESOLVER_USE_INDEX_PROPERTY_NAME, INDEX_ITEM));
}

// A RAW frame of the indexed field is solved with the selected index; downsample 1 keeps the full centroid precision
static void solve_raw_image(void) {
	ASSERT_TRUE(prepare_full_resolution());
	long size;
	indigo_raw_header *image = render_image(&size);
	ASSERT_TRUE(image != NULL);
	bool sent = solve_image(image, size, ".raw");
	free(image);
	ASSERT_TRUE(sent);
	ASSERT_EQ_INT(INDIGO_OK_STATE, state(AGENT_PLATESOLVER_WCS_PROPERTY_NAME));
	ASSERT_TRUE(message_seen("Solved: "));
	ASSERT_TRUE(message_seen(" stars matched, rms "));
	double ra = number_value(AGENT_PLATESOLVER_WCS_PROPERTY_NAME, AGENT_PLATESOLVER_WCS_RA_ITEM_NAME) * 15 * DEG_TO_RAD;
	double dec = number_value(AGENT_PLATESOLVER_WCS_PROPERTY_NAME, AGENT_PLATESOLVER_WCS_DEC_ITEM_NAME) * DEG_TO_RAD;
	// the star detector and the renderer differ by a fraction of a pixel in their pixel centre convention
	ASSERT_TRUE(indigo_angular_distance(ra, dec, image_ra, image_dec) < 10 * ARCSEC_TO_RAD);
	ASSERT_TRUE(number_value(AGENT_PLATESOLVER_WCS_PROPERTY_NAME, AGENT_PLATESOLVER_WCS_EPOCH_ITEM_NAME) == 2000);
	double scale = number_value(AGENT_PLATESOLVER_WCS_PROPERTY_NAME, AGENT_PLATESOLVER_WCS_SCALE_ITEM_NAME);
	ASSERT_TRUE(fabs(scale / (IMAGE_SCALE * RAD_TO_DEG) - 1) < 0.003);
	ASSERT_TRUE(fabs(number_value(AGENT_PLATESOLVER_WCS_PROPERTY_NAME, AGENT_PLATESOLVER_WCS_WIDTH_ITEM_NAME) - IMAGE_WIDTH * scale) < 1e-6);
	ASSERT_TRUE(fabs(number_value(AGENT_PLATESOLVER_WCS_PROPERTY_NAME, AGENT_PLATESOLVER_WCS_HEIGHT_ITEM_NAME) - IMAGE_HEIGHT * scale) < 1e-6);
	double angle = number_value(AGENT_PLATESOLVER_WCS_PROPERTY_NAME, AGENT_PLATESOLVER_WCS_ANGLE_ITEM_NAME);
	ASSERT_TRUE(fabs(angle - IMAGE_ANGLE * RAD_TO_DEG) < 0.2);
	ASSERT_TRUE(number_value(AGENT_PLATESOLVER_WCS_PROPERTY_NAME, AGENT_PLATESOLVER_WCS_PARITY_ITEM_NAME) == -1);
	ASSERT_TRUE(number_value(AGENT_PLATESOLVER_WCS_PROPERTY_NAME, AGENT_PLATESOLVER_WCS_INDEX_ITEM_NAME) == 5);
	ASSERT_TRUE(number_value(AGENT_PLATESOLVER_WCS_PROPERTY_NAME, AGENT_PLATESOLVER_WCS_STATE_ITEM_NAME) == INDIGO_SOLVER_STATE_IDLE);
}

// The default downsampling bins the frame 2 x 2 before detection, the solution is reported in unbinned pixels
static void solve_downsampled_image(void) {
	ASSERT_TRUE(select_use_index());
	ASSERT_TRUE(indigo_change_number_property_1(&observer, SOLVER, AGENT_PLATESOLVER_HINTS_PROPERTY_NAME, AGENT_PLATESOLVER_HINTS_EPOCH_ITEM_NAME, 2000) == INDIGO_OK);
	ASSERT_TRUE(indigo_change_number_property_1(&observer, SOLVER, AGENT_PLATESOLVER_HINTS_PROPERTY_NAME, AGENT_PLATESOLVER_HINTS_DOWNSAMPLE_ITEM_NAME, 2) == INDIGO_OK);
	long size;
	indigo_raw_header *image = render_image(&size);
	ASSERT_TRUE(image != NULL);
	bool sent = solve_image(image, size, ".raw");
	free(image);
	ASSERT_TRUE(sent);
	ASSERT_EQ_INT(INDIGO_OK_STATE, state(AGENT_PLATESOLVER_WCS_PROPERTY_NAME));
	double ra = number_value(AGENT_PLATESOLVER_WCS_PROPERTY_NAME, AGENT_PLATESOLVER_WCS_RA_ITEM_NAME) * 15 * DEG_TO_RAD;
	double dec = number_value(AGENT_PLATESOLVER_WCS_PROPERTY_NAME, AGENT_PLATESOLVER_WCS_DEC_ITEM_NAME) * DEG_TO_RAD;
	// binning halves the centroid precision and shifts the centre by half a binned pixel
	ASSERT_TRUE(indigo_angular_distance(ra, dec, image_ra, image_dec) < 30 * ARCSEC_TO_RAD);
	double scale = number_value(AGENT_PLATESOLVER_WCS_PROPERTY_NAME, AGENT_PLATESOLVER_WCS_SCALE_ITEM_NAME);
	ASSERT_TRUE(fabs(scale / (IMAGE_SCALE * RAD_TO_DEG) - 1) < 0.005);
	ASSERT_TRUE(fabs(number_value(AGENT_PLATESOLVER_WCS_PROPERTY_NAME, AGENT_PLATESOLVER_WCS_WIDTH_ITEM_NAME) - IMAGE_WIDTH * scale) < 1e-6);
	ASSERT_TRUE(fabs(number_value(AGENT_PLATESOLVER_WCS_PROPERTY_NAME, AGENT_PLATESOLVER_WCS_ANGLE_ITEM_NAME) - IMAGE_ANGLE * RAD_TO_DEG) < 0.3);
}

// Without a selected index the solve is refused with an explanation
static void solve_without_selected_index_fails(void) {
	ASSERT_FALSE(switch_value(AGENT_PLATESOLVER_USE_INDEX_PROPERTY_NAME, INDEX_ITEM));
	long size;
	indigo_raw_header *image = render_image(&size);
	ASSERT_TRUE(image != NULL);
	bool sent = solve_image(image, size, ".raw");
	free(image);
	ASSERT_TRUE(sent);
	ASSERT_EQ_INT(INDIGO_ALERT_STATE, state(AGENT_PLATESOLVER_WCS_PROPERTY_NAME));
	ASSERT_TRUE(message_seen("No index files are selected"));
}

// The solution of the rendered frame, whatever format it arrived in
static bool solution_matches_rendered_frame(void) {
	REQUIRE(state(AGENT_PLATESOLVER_WCS_PROPERTY_NAME) == INDIGO_OK_STATE);
	double ra = number_value(AGENT_PLATESOLVER_WCS_PROPERTY_NAME, AGENT_PLATESOLVER_WCS_RA_ITEM_NAME) * 15 * DEG_TO_RAD;
	double dec = number_value(AGENT_PLATESOLVER_WCS_PROPERTY_NAME, AGENT_PLATESOLVER_WCS_DEC_ITEM_NAME) * DEG_TO_RAD;
	REQUIRE(indigo_angular_distance(ra, dec, image_ra, image_dec) < 10 * ARCSEC_TO_RAD);
	double scale = number_value(AGENT_PLATESOLVER_WCS_PROPERTY_NAME, AGENT_PLATESOLVER_WCS_SCALE_ITEM_NAME);
	REQUIRE(fabs(scale / (IMAGE_SCALE * RAD_TO_DEG) - 1) < 0.003);
	REQUIRE(fabs(number_value(AGENT_PLATESOLVER_WCS_PROPERTY_NAME, AGENT_PLATESOLVER_WCS_WIDTH_ITEM_NAME) - IMAGE_WIDTH * scale) < 1e-6);
	REQUIRE(fabs(number_value(AGENT_PLATESOLVER_WCS_PROPERTY_NAME, AGENT_PLATESOLVER_WCS_HEIGHT_ITEM_NAME) - IMAGE_HEIGHT * scale) < 1e-6);
	REQUIRE(fabs(number_value(AGENT_PLATESOLVER_WCS_PROPERTY_NAME, AGENT_PLATESOLVER_WCS_ANGLE_ITEM_NAME) - IMAGE_ANGLE * RAD_TO_DEG) < 0.2);
	REQUIRE(number_value(AGENT_PLATESOLVER_WCS_PROPERTY_NAME, AGENT_PLATESOLVER_WCS_PARITY_ITEM_NAME) == -1);
	return true;
}

// Full resolution, J2000, no position, parity or depth hint
static bool prepare_full_resolution(void) {
	REQUIRE(select_use_index());
	REQUIRE(set_hint(AGENT_PLATESOLVER_HINTS_EPOCH_ITEM_NAME, 2000));
	REQUIRE(set_hint(AGENT_PLATESOLVER_HINTS_DOWNSAMPLE_ITEM_NAME, 1));
	REQUIRE(set_hint(AGENT_PLATESOLVER_HINTS_RADIUS_ITEM_NAME, 0));
	REQUIRE(set_hint(AGENT_PLATESOLVER_HINTS_PARITY_ITEM_NAME, 0));
	REQUIRE(set_hint(AGENT_PLATESOLVER_HINTS_DEPTH_ITEM_NAME, 0));
	clear_messages();
	return true;
}

// Renders the frame, uploads it as RAW and returns whether the upload was accepted
static bool solve_rendered_raw(void) {
	long size;
	indigo_raw_header *image = render_image(&size);
	REQUIRE(image != NULL);
	bool sent = solve_image(image, size, ".raw");
	free(image);
	return sent;
}

// The position hint half a degree from the catalog centre (the frame is 0.1 degree from it) with a 2 degree
// radius keeps the solution, in J2000 and given in JNow with the JNow epoch hint (the solution is then in JNow)
static void solve_with_position_hint(void) {
	ASSERT_TRUE(prepare_full_resolution());
	ASSERT_TRUE(set_hint(AGENT_PLATESOLVER_HINTS_RADIUS_ITEM_NAME, 2));
	ASSERT_TRUE(set_hint(AGENT_PLATESOLVER_HINTS_RA_ITEM_NAME, (ra0 + 0.5 * DEG_TO_RAD) * RAD_TO_DEG / 15));
	ASSERT_TRUE(set_hint(AGENT_PLATESOLVER_HINTS_DEC_ITEM_NAME, dec0 * RAD_TO_DEG));
	ASSERT_TRUE(solve_rendered_raw());
	ASSERT_TRUE(solution_matches_rendered_frame());
	ASSERT_TRUE(message_seen("stars matched"));
	double ra = ra0 * RAD_TO_DEG / 15, dec = dec0 * RAD_TO_DEG;
	indigo_j2k_to_jnow(&ra, &dec);
	clear_messages();
	ASSERT_TRUE(set_hint(AGENT_PLATESOLVER_HINTS_EPOCH_ITEM_NAME, 0));
	ASSERT_TRUE(set_hint(AGENT_PLATESOLVER_HINTS_RA_ITEM_NAME, ra + 0.5 / 15));
	ASSERT_TRUE(set_hint(AGENT_PLATESOLVER_HINTS_DEC_ITEM_NAME, dec - 0.3));
	ASSERT_TRUE(solve_rendered_raw());
	ASSERT_EQ_INT(INDIGO_OK_STATE, state(AGENT_PLATESOLVER_WCS_PROPERTY_NAME));
	ASSERT_TRUE(number_value(AGENT_PLATESOLVER_WCS_PROPERTY_NAME, AGENT_PLATESOLVER_WCS_EPOCH_ITEM_NAME) == 0);
	double wcs_ra = number_value(AGENT_PLATESOLVER_WCS_PROPERTY_NAME, AGENT_PLATESOLVER_WCS_RA_ITEM_NAME), wcs_dec = number_value(AGENT_PLATESOLVER_WCS_PROPERTY_NAME, AGENT_PLATESOLVER_WCS_DEC_ITEM_NAME);
	indigo_jnow_to_j2k(&wcs_ra, &wcs_dec);
	ASSERT_TRUE(indigo_angular_distance(wcs_ra * 15 * DEG_TO_RAD, wcs_dec * DEG_TO_RAD, image_ra, image_dec) < 10 * ARCSEC_TO_RAD);
}

// A position hint 30 degrees away leaves no catalog quads in the cone
static void wrong_position_hint_fails(void) {
	ASSERT_TRUE(prepare_full_resolution());
	ASSERT_TRUE(set_hint(AGENT_PLATESOLVER_HINTS_RADIUS_ITEM_NAME, 2));
	ASSERT_TRUE(set_hint(AGENT_PLATESOLVER_HINTS_RA_ITEM_NAME, (ra0 + 30 * DEG_TO_RAD) * RAD_TO_DEG / 15));
	ASSERT_TRUE(set_hint(AGENT_PLATESOLVER_HINTS_DEC_ITEM_NAME, dec0 * RAD_TO_DEG));
	ASSERT_TRUE(solve_rendered_raw());
	ASSERT_EQ_INT(INDIGO_ALERT_STATE, state(AGENT_PLATESOLVER_WCS_PROPERTY_NAME));
	ASSERT_TRUE(message_seen("No solution found"));
}

// The rendered frame has parity -1: the opposite hint rejects its solution, the matching hint keeps it
static void parity_hint_rejects_mirror(void) {
	ASSERT_TRUE(prepare_full_resolution());
	ASSERT_TRUE(set_hint(AGENT_PLATESOLVER_HINTS_PARITY_ITEM_NAME, 1));
	ASSERT_TRUE(solve_rendered_raw());
	ASSERT_EQ_INT(INDIGO_ALERT_STATE, state(AGENT_PLATESOLVER_WCS_PROPERTY_NAME));
	ASSERT_TRUE(message_seen("Solution has the wrong parity"));
	clear_messages();
	ASSERT_TRUE(set_hint(AGENT_PLATESOLVER_HINTS_PARITY_ITEM_NAME, -1));
	ASSERT_TRUE(solve_rendered_raw());
	ASSERT_TRUE(solution_matches_rendered_frame());
}

// The depth hint below the detected star count solves with the brightest stars
static void solve_with_depth_hint(void) {
	ASSERT_TRUE(prepare_full_resolution());
	ASSERT_TRUE(set_hint(AGENT_PLATESOLVER_HINTS_DEPTH_ITEM_NAME, 12));
	ASSERT_TRUE(solve_rendered_raw());
	ASSERT_TRUE(solution_matches_rendered_frame());
}

// The messages contain the texts in this order, each after the previous one
static bool messages_in_order(const char **texts, int count) {
	pthread_mutex_lock(&cache_mutex);
	const char *position = messages;
	for (int i = 0; i < count && position != NULL; i++) {
		position = strstr(position, texts[i]);
		if (position != NULL) {
			position += strlen(texts[i]);
		}
	}
	pthread_mutex_unlock(&cache_mutex);
	return position != NULL;
}

static bool messages_in_order_or_print(const char **texts, int count) {
	if (messages_in_order(texts, count)) {
		return true;
	}
	pthread_mutex_lock(&cache_mutex);
	fprintf(stderr, "Messages out of the expected order:\n%s\n", messages);
	pthread_mutex_unlock(&cache_mutex);
	return false;
}

// Both synthetic indexes selected and no pixel scale: the first stage runs on every index, the largest first, the
// next stage in the opposite order starting with the index loaded last. The 0.5° file is another random patch, only
// the 5° index matches the frame; the depth hint 4 leaves the first stage without quads, so the frame is solved in
// the second stage with the 5° index after the 0.5° one
static void blind_search_goes_stage_by_stage(void) {
	ASSERT_TRUE(prepare_full_resolution());
	ASSERT_TRUE(indigo_change_switch_property_1(&observer, SOLVER, AGENT_PLATESOLVER_USE_INDEX_PROPERTY_NAME, "INDEX_00_5DEG_GAIA", true) == INDIGO_OK);
	ASSERT_TRUE(WAIT_UNTIL(switch_value(AGENT_PLATESOLVER_USE_INDEX_PROPERTY_NAME, "INDEX_00_5DEG_GAIA") && switch_value(AGENT_PLATESOLVER_USE_INDEX_PROPERTY_NAME, INDEX_ITEM), 10));
	ASSERT_TRUE(set_hint(AGENT_PLATESOLVER_HINTS_SCALE_ITEM_NAME, 0));
	ASSERT_TRUE(set_hint(AGENT_PLATESOLVER_HINTS_DEPTH_ITEM_NAME, 4));
	clear_messages();
	ASSERT_TRUE(solve_rendered_raw());
	ASSERT_TRUE(solution_matches_rendered_frame());
	ASSERT_TRUE(number_value(AGENT_PLATESOLVER_WCS_PROPERTY_NAME, AGENT_PLATESOLVER_WCS_INDEX_ITEM_NAME) == 5);
	const char *order[] = { "Solving with Tycho-2 5° index", "Solving with Gaia DR3 0.5° index", "Solving with Gaia DR3 0.5° index", "Solving with Tycho-2 5° index", "Solved: " };
	ASSERT_TRUE(messages_in_order_or_print(order, 5));
	const char *three_times[] = { "Solving with Tycho-2 5° index", "Solving with Tycho-2 5° index", "Solving with Tycho-2 5° index" };
	ASSERT_FALSE(messages_in_order(three_times, 3));
}

// With the pixel scale the index nearest to 0.7 x the 3.6° x 2.7° frame among the selected ones, 5°, is searched
// first, through all stages, and solves it; the 0.5° index is never tried
static void scaled_search_uses_fitting_index_first(void) {
	ASSERT_TRUE(prepare_full_resolution());
	ASSERT_TRUE(indigo_change_switch_property_1(&observer, SOLVER, AGENT_PLATESOLVER_USE_INDEX_PROPERTY_NAME, "INDEX_00_5DEG_GAIA", true) == INDIGO_OK);
	ASSERT_TRUE(WAIT_UNTIL(switch_value(AGENT_PLATESOLVER_USE_INDEX_PROPERTY_NAME, "INDEX_00_5DEG_GAIA") && switch_value(AGENT_PLATESOLVER_USE_INDEX_PROPERTY_NAME, INDEX_ITEM), 10));
	ASSERT_TRUE(set_hint(AGENT_PLATESOLVER_HINTS_SCALE_ITEM_NAME, IMAGE_SCALE * RAD_TO_DEG));
	ASSERT_TRUE(set_hint(AGENT_PLATESOLVER_HINTS_DEPTH_ITEM_NAME, 4));
	clear_messages();
	ASSERT_TRUE(solve_rendered_raw());
	ASSERT_TRUE(solution_matches_rendered_frame());
	ASSERT_TRUE(number_value(AGENT_PLATESOLVER_WCS_PROPERTY_NAME, AGENT_PLATESOLVER_WCS_INDEX_ITEM_NAME) == 5);
	const char *order[] = { "Solving with Tycho-2 5° index", "Solved: " };
	ASSERT_TRUE(messages_in_order_or_print(order, 2));
	ASSERT_FALSE(message_seen("Solving with Gaia DR3 0.5° index"));
	const char *five_twice[] = { "Solving with Tycho-2 5° index", "Solving with Tycho-2 5° index" };
	ASSERT_FALSE(messages_in_order(five_twice, 2));
}

// A RAW frame with the BAYERPAT appendix of a colour camera and a FITS with a BAYERPAT card are binned 2 x 2
// before detection and still report the WCS in unbinned pixels
static void bayer_raw_is_binned(void) {
	ASSERT_TRUE(prepare_full_resolution());
	long size;
	indigo_raw_header *image = render_image(&size);
	ASSERT_TRUE(image != NULL);
	const char appendix[] = "SIMPLE=T;BAYERPAT='RGGB';";
	indigo_raw_header *bayer = malloc(size + sizeof(appendix));
	memcpy(bayer, image, size);
	memcpy((char *)bayer + size, appendix, sizeof(appendix));
	free(image);
	bool sent = solve_image(bayer, size + sizeof(appendix), ".raw");
	free(bayer);
	ASSERT_TRUE(sent);
	ASSERT_TRUE(solution_matches_rendered_frame());
}

static void bayer_fits_is_binned(void) {
	ASSERT_TRUE(prepare_full_resolution());
	long size;
	indigo_raw_header *image = render_image(&size);
	ASSERT_TRUE(image != NULL);
	indigo_fits_keyword keywords[] = { { INDIGO_FITS_STRING, "BAYERPAT", .string = "RGGB", "Bayer color pattern" }, { 0 } };
	char *fits = NULL;
	int fits_size = 0;
	ASSERT_TRUE(indigo_raw_to_fits((char *)image, (int)size, &fits, &fits_size, keywords) == INDIGO_OK);
	free(image);
	bool sent = solve_image(fits, fits_size, ".fits");
	free(fits);
	ASSERT_TRUE(sent);
	ASSERT_TRUE(solution_matches_rendered_frame());
}

// A three plane FITS with unequal channels and an RGB JPEG are reduced to luminance and solved
static void solve_rgb_fits_image(void) {
	ASSERT_TRUE(prepare_full_resolution());
	long size;
	indigo_raw_header *image = render_image(&size);
	ASSERT_TRUE(image != NULL);
	long pixels = IMAGE_WIDTH * IMAGE_HEIGHT;
	indigo_raw_header *rgb = calloc(1, sizeof(indigo_raw_header) + pixels * 6);
	*rgb = *image;
	rgb->signature = INDIGO_RAW_RGB48;
	uint16_t *in = (uint16_t *)(image + 1), *out = (uint16_t *)(rgb + 1);
	for (long i = 0; i < pixels; i++) {
		out[3 * i] = in[i] / 3;
		out[3 * i + 1] = in[i];
		out[3 * i + 2] = in[i] / 5;
	}
	free(image);
	char *fits = NULL;
	int fits_size = 0;
	ASSERT_TRUE(indigo_raw_to_fits((char *)rgb, (int)(sizeof(indigo_raw_header) + pixels * 6), &fits, &fits_size, NULL) == INDIGO_OK);
	free(rgb);
	ASSERT_TRUE(strstr(fits, "NAXIS3  =") != NULL);
	bool sent = solve_image(fits, fits_size, ".fits");
	free(fits);
	ASSERT_TRUE(sent);
	ASSERT_TRUE(solution_matches_rendered_frame());
}

static void solve_colour_jpeg_image(void) {
	ASSERT_TRUE(prepare_full_resolution());
	long size;
	indigo_raw_header *image = render_image(&size);
	ASSERT_TRUE(image != NULL);
	uint8_t *rgb = malloc(IMAGE_WIDTH * IMAGE_HEIGHT * 3);
	for (long i = 0; i < IMAGE_WIDTH * IMAGE_HEIGHT; i++) {
		uint8_t value = ((uint16_t *)(image + 1))[i] >> 8;
		rgb[3 * i] = value / 2;
		rgb[3 * i + 1] = value;
		rgb[3 * i + 2] = value / 4;
	}
	free(image);
	struct jpeg_compress_struct cinfo;
	struct jpeg_error_mgr jerr;
	unsigned char *jpeg = NULL;
	unsigned long jpeg_size = 0;
	cinfo.err = jpeg_std_error(&jerr);
	jpeg_create_compress(&cinfo);
	jpeg_mem_dest(&cinfo, &jpeg, &jpeg_size);
	cinfo.image_width = IMAGE_WIDTH;
	cinfo.image_height = IMAGE_HEIGHT;
	cinfo.input_components = 3;
	cinfo.in_color_space = JCS_RGB;
	jpeg_set_defaults(&cinfo);
	jpeg_set_quality(&cinfo, 90, TRUE);
	jpeg_start_compress(&cinfo, TRUE);
	while (cinfo.next_scanline < cinfo.image_height) {
		JSAMPROW row = rgb + (size_t)cinfo.next_scanline * IMAGE_WIDTH * 3;
		jpeg_write_scanlines(&cinfo, &row, 1);
	}
	jpeg_finish_compress(&cinfo);
	jpeg_destroy_compress(&cinfo);
	free(rgb);
	bool sent = solve_image(jpeg, (long)jpeg_size, ".jpeg");
	free(jpeg);
	ASSERT_TRUE(sent);
	ASSERT_TRUE(solution_matches_rendered_frame());
}


// A FITS upload written by the INDIGO FITS writer (BITPIX 16, BZERO 32768) is solved like the RAW frame
static void solve_fits_image(void) {
	ASSERT_TRUE(prepare_full_resolution());
	long size;
	indigo_raw_header *image = render_image(&size);
	ASSERT_TRUE(image != NULL);
	char *fits = NULL;
	int fits_size = 0;
	ASSERT_TRUE(indigo_raw_to_fits((char *)image, (int)size, &fits, &fits_size, NULL) == INDIGO_OK);
	free(image);
	bool sent = solve_image(fits, fits_size, ".fits");
	free(fits);
	ASSERT_TRUE(sent);
	ASSERT_TRUE(solution_matches_rendered_frame());
}

// A floating point FITS (BITPIX -32, values in electrons scaled far beyond 16 bits) is mapped onto 16 bits and solved
static void solve_float_fits_image(void) {
	ASSERT_TRUE(prepare_full_resolution());
	long size;
	indigo_raw_header *image = render_image(&size);
	ASSERT_TRUE(image != NULL);
	long pixels = IMAGE_WIDTH * IMAGE_HEIGHT;
	long fits_size = ((2880 + pixels * 4 + 2879) / 2880) * 2880;
	char *fits = malloc(fits_size);
	memset(fits, ' ', fits_size);
	const char *cards[] = { "SIMPLE  =                    T", "BITPIX  =                  -32", "NAXIS   =                    2", "NAXIS1  =", "NAXIS2  =", "BZERO   =                  0.0", "BSCALE  =                  1.0", "END" };
	for (int i = 0; i < 8; i++) {
		char card[81];
		if (i == 3) {
			snprintf(card, sizeof(card), "NAXIS1  = %20d", IMAGE_WIDTH);
		} else if (i == 4) {
			snprintf(card, sizeof(card), "NAXIS2  = %20d", IMAGE_HEIGHT);
		} else {
			snprintf(card, sizeof(card), "%s", cards[i]);
		}
		memcpy(fits + i * 80, card, strlen(card));
	}
	uint16_t *in = (uint16_t *)(image + 1);
	uint8_t *out = (uint8_t *)fits + 2880;
	for (long i = 0; i < pixels; i++) {
		float value = in[i] * 12.5f - 1000;
		uint32_t bits;
		memcpy(&bits, &value, sizeof(bits));
		out[4 * i] = bits >> 24;
		out[4 * i + 1] = bits >> 16;
		out[4 * i + 2] = bits >> 8;
		out[4 * i + 3] = bits;
	}
	free(image);
	bool sent = solve_image(fits, fits_size, ".fits");
	free(fits);
	ASSERT_TRUE(sent);
	ASSERT_TRUE(solution_matches_rendered_frame());
}

// An 8 bit mono RAW and a 16 bit RGB RAW are converted to 16 bit mono and solved
static void solve_mono8_raw_image(void) {
	ASSERT_TRUE(prepare_full_resolution());
	long size;
	indigo_raw_header *image = render_image(&size);
	ASSERT_TRUE(image != NULL);
	long pixels = IMAGE_WIDTH * IMAGE_HEIGHT;
	indigo_raw_header *mono8 = calloc(1, sizeof(indigo_raw_header) + pixels);
	*mono8 = *image;
	mono8->signature = INDIGO_RAW_MONO8;
	for (long i = 0; i < pixels; i++) {
		((uint8_t *)(mono8 + 1))[i] = ((uint16_t *)(image + 1))[i] >> 8;
	}
	free(image);
	bool sent = solve_image(mono8, sizeof(indigo_raw_header) + pixels, ".raw");
	free(mono8);
	ASSERT_TRUE(sent);
	ASSERT_TRUE(solution_matches_rendered_frame());
}

static void solve_rgb48_raw_image(void) {
	ASSERT_TRUE(prepare_full_resolution());
	long size;
	indigo_raw_header *image = render_image(&size);
	ASSERT_TRUE(image != NULL);
	long pixels = IMAGE_WIDTH * IMAGE_HEIGHT;
	indigo_raw_header *rgb = calloc(1, sizeof(indigo_raw_header) + pixels * 6);
	*rgb = *image;
	rgb->signature = INDIGO_RAW_RGB48;
	uint16_t *in = (uint16_t *)(image + 1), *out = (uint16_t *)(rgb + 1);
	for (long i = 0; i < pixels; i++) {
		out[3 * i] = in[i] / 2;
		out[3 * i + 1] = in[i];
		out[3 * i + 2] = in[i] - in[i] / 2;
	}
	free(image);
	bool sent = solve_image(rgb, sizeof(indigo_raw_header) + pixels * 6, ".raw");
	free(rgb);
	ASSERT_TRUE(sent);
	ASSERT_TRUE(solution_matches_rendered_frame());
}

// A JPEG upload (8 bit grayscale, quality 90) is decoded and solved
static void solve_jpeg_image(void) {
	ASSERT_TRUE(prepare_full_resolution());
	long size;
	indigo_raw_header *image = render_image(&size);
	ASSERT_TRUE(image != NULL);
	uint8_t *gray = malloc(IMAGE_WIDTH * IMAGE_HEIGHT);
	for (long i = 0; i < IMAGE_WIDTH * IMAGE_HEIGHT; i++) {
		gray[i] = ((uint16_t *)(image + 1))[i] >> 8;
	}
	free(image);
	struct jpeg_compress_struct cinfo;
	struct jpeg_error_mgr jerr;
	unsigned char *jpeg = NULL;
	unsigned long jpeg_size = 0;
	cinfo.err = jpeg_std_error(&jerr);
	jpeg_create_compress(&cinfo);
	jpeg_mem_dest(&cinfo, &jpeg, &jpeg_size);
	cinfo.image_width = IMAGE_WIDTH;
	cinfo.image_height = IMAGE_HEIGHT;
	cinfo.input_components = 1;
	cinfo.in_color_space = JCS_GRAYSCALE;
	jpeg_set_defaults(&cinfo);
	jpeg_set_quality(&cinfo, 90, TRUE);
	jpeg_start_compress(&cinfo, TRUE);
	while (cinfo.next_scanline < cinfo.image_height) {
		JSAMPROW row = gray + (size_t)cinfo.next_scanline * IMAGE_WIDTH;
		jpeg_write_scanlines(&cinfo, &row, 1);
	}
	jpeg_finish_compress(&cinfo);
	jpeg_destroy_compress(&cinfo);
	free(gray);
	bool sent = solve_image(jpeg, (long)jpeg_size, ".jpeg");
	free(jpeg);
	ASSERT_TRUE(sent);
	ASSERT_TRUE(solution_matches_rendered_frame());
}

// Data in no known format is refused, a FITS shorter than its header says is refused
static void unsupported_image_rejected(void) {
	ASSERT_TRUE(select_use_index());
	char garbage[4096];
	for (int i = 0; i < (int)sizeof(garbage); i++) {
		garbage[i] = (char)(frand() * 256);
	}
	garbage[0] = 'X';
	ASSERT_TRUE(solve_image(garbage, sizeof(garbage), ".bin"));
	ASSERT_EQ_INT(INDIGO_ALERT_STATE, state(AGENT_PLATESOLVER_WCS_PROPERTY_NAME));
	ASSERT_TRUE(message_seen("Unsupported image format"));
	char fits[2880 * 2];
	memset(fits, ' ', sizeof(fits));
	const char *cards[] = { "SIMPLE  =                    T", "BITPIX  =                   16", "NAXIS   =                    2", "NAXIS1  =                  100", "NAXIS2  =                  100", "END" };
	for (int i = 0; i < 6; i++) {
		memcpy(fits + i * 80, cards[i], strlen(cards[i]));
	}
	ASSERT_TRUE(solve_image(fits, sizeof(fits), ".fits"));
	ASSERT_EQ_INT(INDIGO_ALERT_STATE, state(AGENT_PLATESOLVER_WCS_PROPERTY_NAME));
	ASSERT_TRUE(message_seen("Truncated FITS image"));
}

// Clearing an installed index deletes its file and withdraws it from the usable set
static void deselecting_index_removes_file(void) {
	ASSERT_TRUE(access(narrow_index_path, R_OK) == 0);
	ASSERT_TRUE(indigo_change_switch_property_1(&observer, SOLVER, INDEX_PROPERTY, "INDEX_00_5DEG_GAIA", false) == INDIGO_OK);
	ASSERT_TRUE(WAIT_UNTIL(state(INDEX_PROPERTY) == INDIGO_OK_STATE && !switch_value(INDEX_PROPERTY, "INDEX_00_5DEG_GAIA"), 10));
	ASSERT_TRUE(access(narrow_index_path, R_OK) != 0);
	ASSERT_TRUE(WAIT_UNTIL(exists(AGENT_PLATESOLVER_USE_INDEX_PROPERTY_NAME) && !has_item(AGENT_PLATESOLVER_USE_INDEX_PROPERTY_NAME, "INDEX_00_5DEG_GAIA"), 10));
	ASSERT_TRUE(access(index_path, R_OK) == 0);
	ASSERT_TRUE(indigo_change_switch_property_1(&observer, SOLVER, INDEX_PROPERTY, INDEX_ITEM, false) == INDIGO_OK);
	ASSERT_TRUE(WAIT_UNTIL(state(INDEX_PROPERTY) == INDIGO_OK_STATE && !switch_value(INDEX_PROPERTY, INDEX_ITEM), 10));
	ASSERT_TRUE(access(index_path, R_OK) != 0);
	ASSERT_TRUE(WAIT_UNTIL(exists(AGENT_PLATESOLVER_USE_INDEX_PROPERTY_NAME) && !has_item(AGENT_PLATESOLVER_USE_INDEX_PROPERTY_NAME, INDEX_ITEM), 10));
}

static indigo_test_case tests[] = {
	{ "index_property_reflects_installed_files", index_property_reflects_installed_files },
	{ "solve_raw_image", solve_raw_image },
	{ "solve_downsampled_image", solve_downsampled_image },
	{ "solve_without_selected_index_fails", solve_without_selected_index_fails },
	{ "solve_fits_image", solve_fits_image },
	{ "solve_float_fits_image", solve_float_fits_image },
	{ "solve_mono8_raw_image", solve_mono8_raw_image },
	{ "solve_rgb48_raw_image", solve_rgb48_raw_image },
	{ "solve_jpeg_image", solve_jpeg_image },
	{ "solve_with_position_hint", solve_with_position_hint },
	{ "wrong_position_hint_fails", wrong_position_hint_fails },
	{ "parity_hint_rejects_mirror", parity_hint_rejects_mirror },
	{ "solve_with_depth_hint", solve_with_depth_hint },
	{ "blind_search_goes_stage_by_stage", blind_search_goes_stage_by_stage },
	{ "scaled_search_uses_fitting_index_first", scaled_search_uses_fitting_index_first },
	{ "bayer_raw_is_binned", bayer_raw_is_binned },
	{ "bayer_fits_is_binned", bayer_fits_is_binned },
	{ "solve_rgb_fits_image", solve_rgb_fits_image },
	{ "solve_colour_jpeg_image", solve_colour_jpeg_image },
	{ "unsupported_image_rejected", unsupported_image_rejected },
	{ "deselecting_index_removes_file", deselecting_index_removes_file },
};

// every case runs in its own process with a fresh bus, private home and cache directory
int main(int argc, char **argv) {
	const char *filter = argc > 1 ? argv[1] : NULL;
	int result = 0, executed = 0, passed = 0, selected = 0;
	for (int i = 0; i < (int)ARRAY_SIZE(tests); i++) {
		if (filter == NULL || strstr(tests[i].name, filter)) {
			selected++;
		}
	}
	indigo_test_plan(SUITE, selected, filter);
	for (int i = 0; i < (int)ARRAY_SIZE(tests); i++) {
		if (filter != NULL && !strstr(tests[i].name, filter)) {
			continue;
		}
		executed++;
		pid_t child = fork();
		if (child == 0) {
			alarm(300);
			snprintf(cache_base, sizeof(cache_base), "/tmp/indigo-agent-solver.XXXXXX");
			if (mkdtemp(cache_base) == NULL) {
				exit(1);
			}
			setenv("INDIGO_CACHE_BASE", cache_base, 1);
			if (!indigo_test_use_private_home()) {
				exit(1);
			}
			bool ready = setup();
			int status = ready ? indigo_run_tests(SUITE, tests + i, 1) : 1;
			cleanup();
			char dir[PATH_MAX];
			snprintf(dir, sizeof(dir), "%s/solver", cache_base);
			rmdir(dir);
			rmdir(cache_base);
			indigo_test_remove_private_home();
			exit(status || indigo_test_failures ? 1 : 0);
		}
		int status = -1;
		if (child < 0 || waitpid(child, &status, 0) != child || !WIFEXITED(status) || WEXITSTATUS(status)) {
			fprintf(stderr, "Failed case: %s (status %d)\n", tests[i].name, status);
			result = 1;
		} else {
			passed++;
		}
	}
	indigo_test_plan_recorded = false;
	fprintf(stderr, "%s: %d of %d cases passed\n", SUITE, passed, executed);
	return result;
}
