// Copyright (c) 2026 INDIGO initiative
// All rights reserved.
//
// You may use this software under the terms of 'INDIGO Astronomy
// open-source license' (see LICENSE.md).
//
// THIS SOFTWARE IS PROVIDED BY THE AUTHORS 'AS IS' AND ANY EXPRESS
// OR IMPLIED WARRANTIES, INCLUDING, BUT NOT LIMITED TO, THE IMPLIED
// WARRANTIES OF MERCHANTABILITY AND FITNESS FOR A PARTICULAR PURPOSE
// ARE DISCLAIMED. IN NO EVENT SHALL THE AUTHOR BE LIABLE FOR ANY
// DIRECT, INDIRECT, INCIDENTAL, SPECIAL, EXEMPLARY, OR CONSEQUENTIAL
// DAMAGES (INCLUDING, BUT NOT LIMITED TO, PROCUREMENT OF SUBSTITUTE
// GOODS OR SERVICES; LOSS OF USE, DATA, OR PROFITS; OR BUSINESS
// INTERRUPTION) HOWEVER CAUSED AND ON ANY THEORY OF LIABILITY,
// WHETHER IN CONTRACT, STRICT LIABILITY, OR TORT (INCLUDING
// NEGLIGENCE OR OTHERWISE) ARISING IN ANY WAY OUT OF THE USE OF THIS
// SOFTWARE, EVEN IF ADVISED OF THE POSSIBILITY OF SUCH DAMAGE.

// Code is generated by AI

// Polar aligner coverage for indigo_polaralign_mlastro against the standalone
// MLAstro RPA simulator over a real PTY. The controller acknowledges every
// command with a single "ok\n"/"error: ...\n" line, pushes completion and
// error lines on its own, and reports live axis position in its '?'
// telemetry frame (AzPH/AlPH from home, Mpos since the last motion start);
// the driver decides a move is finished by polling that frame once a second
// until STATUS leaves MOVING/ALIGNING/HOMING, so most scenarios below wait
// across several polls rather than a single request/response round trip.
// Every command the simulator receives is recorded in <ready-file>.events,
// which the cases read to prove which protocol path the driver took.

#include <indigo_drivers/polaralign_mlastro/indigo_polaralign_mlastro.h>

#include "serial_simulator_test_common.h"

#ifndef POLARALIGN_MLASTRO_SIMULATOR_EXECUTABLE
#define POLARALIGN_MLASTRO_SIMULATOR_EXECUTABLE "build/integration/polaralign_mlastro_simulator"
#endif

#define X_MLASTRO_SPEED_PROPERTY_NAME                "X_MLASTRO_SPEED"
#define X_MLASTRO_SPEED_ITEM_NAME                    "SPEED"
#define X_MLASTRO_BACKLASH_ENABLE_PROPERTY_NAME      "X_MLASTRO_BACKLASH_ENABLE"
#define X_MLASTRO_BACKLASH_ENABLE_ENABLED_ITEM_NAME  "ENABLED"
#define X_MLASTRO_BACKLASH_ENABLE_DISABLED_ITEM_NAME "DISABLED"
#define X_MLASTRO_BACKLASH_STEPS_PROPERTY_NAME       "X_MLASTRO_BACKLASH_STEPS"
#define X_MLASTRO_BACKLASH_STEPS_ALT_ITEM_NAME       "ALT"
#define X_MLASTRO_BACKLASH_STEPS_AZ_ITEM_NAME        "AZ"
#define X_MLASTRO_STATUS_PROPERTY_NAME               "X_MLASTRO_STATUS"
#define X_MLASTRO_STATUS_ITEM_NAME                   "STATUS"
#define X_MLASTRO_HOMED_PROPERTY_NAME                "X_MLASTRO_HOMED"
#define X_MLASTRO_HOMED_ITEM_NAME                    "HOMED"
#define X_MLASTRO_GOTO_HOME_PROPERTY_NAME            "X_MLASTRO_GOTO_HOME"
#define X_MLASTRO_GOTO_HOME_ITEM_NAME                "GOTO_HOME"
#define X_MLASTRO_CLEAR_HOME_PROPERTY_NAME           "X_MLASTRO_CLEAR_HOME"
#define X_MLASTRO_CLEAR_HOME_ITEM_NAME               "CLEAR_HOME"
#define X_MLASTRO_RESET_ERROR_PROPERTY_NAME          "X_MLASTRO_RESET_ERROR"
#define X_MLASTRO_RESET_ERROR_ITEM_NAME              "RESET_ERROR"

static const simulator_driver_case mlastro_polaralign = {
	"MLAstro RPA",
	"indigo_polaralign_mlastro",
	"MLAstro RPA",
	indigo_polaralign_mlastro,
	false,
	NULL, 0, NULL, 0, NULL, 0, NULL, 0
};

static bool start_mlastro(external_serial_simulator *simulator, const char * const *arguments) {
	if (arguments == NULL) {
		return start_external_serial_simulator(simulator, POLARALIGN_MLASTRO_SIMULATOR_EXECUTABLE);
	}
	return start_external_serial_simulator_with_args(simulator, POLARALIGN_MLASTRO_SIMULATOR_EXECUTABLE, arguments);
}

// -------------------------------------------------------------------------------- simulator files

static void simulator_path(const external_serial_simulator *simulator, const char *suffix, char *path, size_t size) {
	snprintf(path, size, "%s.%s", simulator->ready_file, suffix);
}

// Runtime actions are consumed by the simulator's next background tick.
static bool arm_control(const external_serial_simulator *simulator, const char *action) {
	char path[PATH_MAX];
	simulator_path(simulator, "control", path, sizeof(path));
	FILE *file = fopen(path, "w");
	if (file == NULL) {
		return false;
	}
	fprintf(file, "%s\n", action);
	return fclose(file) == 0;
}

// Counts recorded commands equal to command, or, with command NULL, every
// command other than the '?' telemetry poll.
static int event_count(const external_serial_simulator *simulator, const char *command) {
	char path[PATH_MAX];
	char line[256];
	int count = 0;
	simulator_path(simulator, "events", path, sizeof(path));
	FILE *file = fopen(path, "r");
	if (file == NULL) {
		return 0;
	}
	while (fgets(line, sizeof(line), file) != NULL) {
		line[strcspn(line, "\r\n")] = '\0';
		if (command == NULL ? strcmp(line, "?") != 0 : !strcmp(line, command)) {
			count++;
		}
	}
	fclose(file);
	return count;
}

static int event_count_containing(const external_serial_simulator *simulator, const char *fragment) {
	char path[PATH_MAX];
	char line[256];
	int count = 0;
	simulator_path(simulator, "events", path, sizeof(path));
	FILE *file = fopen(path, "r");
	if (file == NULL) {
		return 0;
	}
	while (fgets(line, sizeof(line), file) != NULL) {
		if (strstr(line, fragment) != NULL) {
			count++;
		}
	}
	fclose(file);
	return count;
}

static bool expect_event(const external_serial_simulator *simulator, const char *command, int expected_count) {
	int count = event_count(simulator, command);
	if (count != expected_count) {
		fprintf(stderr, "    '%s' was recorded %d times, expected %d\n", command, count, expected_count);
		return false;
	}
	return true;
}

// -------------------------------------------------------------------------------- property helpers

static double number_of(const char *property_name, const char *item_name) {
	return cached_number_value(property_name, item_name);
}

static const char *text_of(const char *property_name, const char *item_name) {
	indigo_item *item = find_cached_item(property_name, item_name);
	return item == NULL ? "" : item->text.value;
}

static const char *info_text(const char *item_name) {
	return text_of(INFO_PROPERTY_NAME, item_name);
}

static bool wait_for_switch_value(const char *property_name, const char *item_name, bool value) {
	for (int i = 0; i < 100; i++) {
		indigo_item *item = find_cached_item(property_name, item_name);
		if (item != NULL && item->sw.value == value) {
			return true;
		}
		indigo_usleep(100000);
	}
	return false;
}

static bool wait_for_status(const char *status) {
	for (int i = 0; i < 100; i++) {
		if (!strcmp(text_of(X_MLASTRO_STATUS_PROPERTY_NAME, X_MLASTRO_STATUS_ITEM_NAME), status)) {
			return true;
		}
		indigo_usleep(100000);
	}
	fprintf(stderr, "    controller status is '%s', expected '%s'\n", text_of(X_MLASTRO_STATUS_PROPERTY_NAME, X_MLASTRO_STATUS_ITEM_NAME), status);
	return false;
}

static bool change_offset(double alt_arcmin, double az_arcmin) {
	static const char *items[] = { POLARALIGN_OFFSET_ALT_ITEM_NAME, POLARALIGN_OFFSET_AZ_ITEM_NAME };
	const double values[] = { alt_arcmin, az_arcmin };
	return indigo_change_number_property(&simulator_test_client, mlastro_polaralign.device_name, POLARALIGN_OFFSET_PROPERTY_NAME, 2, items, values) == INDIGO_OK;
}

static bool press(const char *property_name, const char *item_name) {
	return indigo_change_switch_property_1(&simulator_test_client, mlastro_polaralign.device_name, property_name, item_name, true) == INDIGO_OK;
}

// A new offset request is answered with an ALERT or a BUSY state published
// after the given revision; waiting on the revision keeps a stale state from
// the previous request from satisfying the wait.
static bool wait_for_offset_state_after(indigo_property_state state, unsigned int revision) {
	return wait_for_property_state_seen_after(POLARALIGN_OFFSET_PROPERTY_NAME, state, revision);
}

// The simulated axes move at 0.6 deg/s at the default speed level; this
// bounds how long a wait may take for a move of up to a few degrees.
static bool wait_for_offset_settled(void) {
	for (int i = 0; i < 2000; i++) {
		indigo_property *property = find_cached_property(POLARALIGN_OFFSET_PROPERTY_NAME);
		if (property != NULL && property->state != INDIGO_BUSY_STATE) {
			return true;
		}
		indigo_usleep(10000);
	}
	return false;
}

static bool move_to(double alt_arcmin, double az_arcmin) {
	unsigned int revision = property_state_revision(POLARALIGN_OFFSET_PROPERTY_NAME, INDIGO_BUSY_STATE);
	if (!change_offset(alt_arcmin, az_arcmin) || !wait_for_offset_state_after(INDIGO_BUSY_STATE, revision) || !wait_for_offset_settled()) {
		return false;
	}
	indigo_property *property = find_cached_property(POLARALIGN_OFFSET_PROPERTY_NAME);
	return property != NULL && property->state == INDIGO_OK_STATE && wait_for_number_item_value(POLARALIGN_OFFSET_PROPERTY_NAME, POLARALIGN_OFFSET_ALT_ITEM_NAME, alt_arcmin, .5) && wait_for_number_item_value(POLARALIGN_OFFSET_PROPERTY_NAME, POLARALIGN_OFFSET_AZ_ITEM_NAME, az_arcmin, .5);
}

// -------------------------------------------------------------------------------- metadata

static void metadata_and_property_completeness(void) {
	external_serial_simulator simulator = { 0 };
	bool online = false;
	SERIAL_CHECK_TRUE(start_mlastro(&simulator, NULL));
	SERIAL_CHECK_TRUE(start_serial_driver(&mlastro_polaralign, simulator.port));
	online = true;
	SERIAL_CHECK_TRUE(context.connected && context.last_connection_state == INDIGO_OK_STATE);

	assert_device_interface(INDIGO_INTERFACE_POLARALIGN);

	static const char *offset_items[] = { POLARALIGN_OFFSET_ALT_ITEM_NAME, POLARALIGN_OFFSET_AZ_ITEM_NAME };
	static const char *steps_items[] = { POLARALIGN_STEPS_PER_DEGREE_ALT_ITEM_NAME, POLARALIGN_STEPS_PER_DEGREE_AZ_ITEM_NAME };
	static const char *direction_items[] = { POLARALIGN_DIRECTION_NORMAL_ITEM_NAME, POLARALIGN_DIRECTION_REVERSED_ITEM_NAME };
	static const char *limit_items[] = { POLARALIGN_LIMITS_MIN_POSITION_ALT_ITEM_NAME, POLARALIGN_LIMITS_MAX_POSITION_ALT_ITEM_NAME, POLARALIGN_LIMITS_MIN_POSITION_AZ_ITEM_NAME, POLARALIGN_LIMITS_MAX_POSITION_AZ_ITEM_NAME };
	static const char *backlash_steps_items[] = { X_MLASTRO_BACKLASH_STEPS_ALT_ITEM_NAME, X_MLASTRO_BACKLASH_STEPS_AZ_ITEM_NAME };
	static const char *backlash_enable_items[] = { X_MLASTRO_BACKLASH_ENABLE_ENABLED_ITEM_NAME, X_MLASTRO_BACKLASH_ENABLE_DISABLED_ITEM_NAME };

	assert_property_has_items(POLARALIGN_OFFSET_PROPERTY_NAME, offset_items, ARRAY_SIZE(offset_items));
	assert_property_has_item(POLARALIGN_ABORT_MOTION_PROPERTY_NAME, POLARALIGN_ABORT_MOTION_ITEM_NAME);
	assert_property_has_items(POLARALIGN_STEPS_PER_DEGREE_PROPERTY_NAME, steps_items, ARRAY_SIZE(steps_items));
	assert_property_has_items(POLARALIGN_DIRECTION_ALT_PROPERTY_NAME, direction_items, ARRAY_SIZE(direction_items));
	assert_property_has_items(POLARALIGN_DIRECTION_AZ_PROPERTY_NAME, direction_items, ARRAY_SIZE(direction_items));
	assert_property_has_item(POLARALIGN_RESET_POSITION_ALT_PROPERTY_NAME, POLARALIGN_RESET_POSITION_ITEM_NAME);
	assert_property_has_item(POLARALIGN_RESET_POSITION_AZ_PROPERTY_NAME, POLARALIGN_RESET_POSITION_ITEM_NAME);
	assert_property_has_items(POLARALIGN_LIMITS_PROPERTY_NAME, limit_items, ARRAY_SIZE(limit_items));

	assert_property_has_item(X_MLASTRO_SPEED_PROPERTY_NAME, X_MLASTRO_SPEED_ITEM_NAME);
	assert_property_has_items(X_MLASTRO_BACKLASH_ENABLE_PROPERTY_NAME, backlash_enable_items, ARRAY_SIZE(backlash_enable_items));
	assert_property_has_items(X_MLASTRO_BACKLASH_STEPS_PROPERTY_NAME, backlash_steps_items, ARRAY_SIZE(backlash_steps_items));
	assert_property_has_item(X_MLASTRO_STATUS_PROPERTY_NAME, X_MLASTRO_STATUS_ITEM_NAME);
	assert_property_has_item(X_MLASTRO_HOMED_PROPERTY_NAME, X_MLASTRO_HOMED_ITEM_NAME);
	assert_property_has_item(X_MLASTRO_GOTO_HOME_PROPERTY_NAME, X_MLASTRO_GOTO_HOME_ITEM_NAME);
	assert_property_has_item(X_MLASTRO_CLEAR_HOME_PROPERTY_NAME, X_MLASTRO_CLEAR_HOME_ITEM_NAME);
	assert_property_has_item(X_MLASTRO_RESET_ERROR_PROPERTY_NAME, X_MLASTRO_RESET_ERROR_ITEM_NAME);
cleanup:
	if (online) { stop_serial_driver(&mlastro_polaralign); }
	stop_external_serial_simulator(&simulator);
}

static void identity_and_firmware_reach_info(void) {
	external_serial_simulator simulator = { 0 };
	bool online = false;
	const char *arguments[] = { "--firmware", "firmware 9.9.9", NULL };
	SERIAL_CHECK_TRUE(start_mlastro(&simulator, arguments));
	SERIAL_CHECK_TRUE(start_serial_driver(&mlastro_polaralign, simulator.port));
	online = true;
	indigo_property *info = find_cached_property(INFO_PROPERTY_NAME);
	SERIAL_CHECK_TRUE(info != NULL && info->count >= 8);
	printf("INFO model='%s' firmware='%s' serial='%s'\n", info_text(INFO_DEVICE_MODEL_ITEM_NAME), info_text(INFO_DEVICE_FW_REVISION_ITEM_NAME), info_text(INFO_DEVICE_SERIAL_NUM_ITEM_NAME));
	SERIAL_CHECK_TRUE(!strcmp(info_text(INFO_DEVICE_FW_REVISION_ITEM_NAME), "firmware 9.9.9"));
	SERIAL_CHECK_TRUE(!strcmp(info_text(INFO_DEVICE_MODEL_ITEM_NAME), "MLAstro RPA"));
	SERIAL_CHECK_TRUE(!strcmp(info_text(INFO_DEVICE_SERIAL_NUM_ITEM_NAME), "AA:BB:CC:DD:EE:F0"));
	disconnect_serial_device(&mlastro_polaralign);
	SERIAL_CHECK_TRUE(!context.connected);
	SERIAL_CHECK_TRUE(!strcmp(info_text(INFO_DEVICE_MODEL_ITEM_NAME), "Unknown"));
	SERIAL_CHECK_TRUE(!strcmp(info_text(INFO_DEVICE_FW_REVISION_ITEM_NAME), "Unknown"));
	online = false;
	tear_down_serial_driver(&mlastro_polaralign);
cleanup:
	if (online) { stop_serial_driver(&mlastro_polaralign); }
	stop_external_serial_simulator(&simulator);
}

// Older firmware answers the handshake with a bare "ok", without firmware
// version or serial number; the connection must still succeed.
static void legacy_handshake_connects_without_identity(void) {
	external_serial_simulator simulator = { 0 };
	bool online = false;
	const char *arguments[] = { "--legacy-handshake", NULL };
	SERIAL_CHECK_TRUE(start_mlastro(&simulator, arguments));
	SERIAL_CHECK_TRUE(start_serial_driver(&mlastro_polaralign, simulator.port));
	online = true;
	SERIAL_CHECK_TRUE(context.connected && context.last_connection_state == INDIGO_OK_STATE);
	SERIAL_CHECK_TRUE(!strcmp(info_text(INFO_DEVICE_MODEL_ITEM_NAME), "MLAstro RPA"));
	SERIAL_CHECK_TRUE(!strcmp(info_text(INFO_DEVICE_FW_REVISION_ITEM_NAME), "Unknown"));
	SERIAL_CHECK_TRUE(!strcmp(info_text(INFO_DEVICE_SERIAL_NUM_ITEM_NAME), "Unknown"));
cleanup:
	if (online) { stop_serial_driver(&mlastro_polaralign); }
	stop_external_serial_simulator(&simulator);
}

// Opening the port resets most ESP32 boards, which print their boot log and
// ignore the handshake until the firmware is up; the driver has to retry.
static void handshake_is_retried_through_boot_noise(void) {
	external_serial_simulator simulator = { 0 };
	bool online = false;
	const char *arguments[] = { "--boot-noise", "2", NULL };
	SERIAL_CHECK_TRUE(start_mlastro(&simulator, arguments));
	SERIAL_CHECK_TRUE(start_serial_driver(&mlastro_polaralign, simulator.port));
	online = true;
	SERIAL_CHECK_TRUE(context.connected && context.last_connection_state == INDIGO_OK_STATE);
	SERIAL_CHECK_TRUE(expect_event(&simulator, "[MLAstroRPA-TC]", 3));
	SERIAL_CHECK_TRUE(!strcmp(info_text(INFO_DEVICE_SERIAL_NUM_ITEM_NAME), "AA:BB:CC:DD:EE:F0"));
cleanup:
	if (online) { stop_serial_driver(&mlastro_polaralign); }
	stop_external_serial_simulator(&simulator);
}

// -------------------------------------------------------------------------------- motion

// A single-axis change uses the angle-input + move commands in relative mode,
// which the driver selects on connect: the simulator starts in jog mode, where
// the same command would run to the soft limit instead.
static void single_axis_move_uses_relative_move(void) {
	external_serial_simulator simulator = { 0 };
	bool online = false;
	SERIAL_CHECK_TRUE(start_mlastro(&simulator, NULL));
	SERIAL_CHECK_TRUE(start_serial_driver(&mlastro_polaralign, simulator.port));
	online = true;
	SERIAL_CHECK_TRUE(expect_event(&simulator, "JoRe:1", 1));
	SERIAL_CHECK_TRUE(move_to(0, 120)); // +2 deg azimuth
	SERIAL_CHECK_TRUE(expect_event(&simulator, "ReDe:2,ReAM:0,ReAS:0,MAzR:1", 1));
	SERIAL_CHECK_TRUE(event_count_containing(&simulator, "AAll") == 0);
	SERIAL_CHECK_TRUE(move_to(-45, 120)); // -45 arcmin altitude
	SERIAL_CHECK_TRUE(expect_event(&simulator, "ReDe:0,ReAM:45,ReAS:0,MAlD:1", 1));
cleanup:
	if (online) { stop_serial_driver(&mlastro_polaralign); }
	stop_external_serial_simulator(&simulator);
}

// A simultaneous change on both axes uses the chained alignment-error command
// (AzED/.../AAll:1) instead, mirroring the INDI reference driver.
static void combined_axis_move_uses_alignment_command(void) {
	external_serial_simulator simulator = { 0 };
	bool online = false;
	SERIAL_CHECK_TRUE(start_mlastro(&simulator, NULL));
	SERIAL_CHECK_TRUE(start_serial_driver(&mlastro_polaralign, simulator.port));
	online = true;
	SERIAL_CHECK_TRUE(move_to(60, -60)); // +1 deg alt, -1 deg az
	SERIAL_CHECK_TRUE(expect_event(&simulator, "AzED:1,AzEM:0,AzES:0,AzDi:0,AlED:1,AlEM:0,AlES:0,AlDi:1,AAll:1", 1));
	SERIAL_CHECK_TRUE(wait_for_status("ALIGN_COMPLETED"));
cleanup:
	if (online) { stop_serial_driver(&mlastro_polaralign); }
	stop_external_serial_simulator(&simulator);
}

// The position is AzPH/AlPH, the angle from home; Mpos only counts the angle
// moved since the last motion started. A driver reading Mpos is right after
// the first move and wrong after every later one.
static void consecutive_moves_track_position_from_home(void) {
	external_serial_simulator simulator = { 0 };
	bool online = false;
	SERIAL_CHECK_TRUE(start_mlastro(&simulator, NULL));
	SERIAL_CHECK_TRUE(start_serial_driver(&mlastro_polaralign, simulator.port));
	online = true;
	SERIAL_CHECK_TRUE(move_to(0, 60));
	SERIAL_CHECK_TRUE(move_to(0, 120));
	SERIAL_CHECK_TRUE(expect_event(&simulator, "ReDe:1,ReAM:0,ReAS:0,MAzR:1", 2));
	SERIAL_CHECK_TRUE(move_to(30, 120));
	SERIAL_CHECK_TRUE(expect_event(&simulator, "ReDe:0,ReAM:30,ReAS:0,MAlU:1", 1));
	indigo_usleep(1500000); // a couple more polls must not move the reported position
	SERIAL_CHECK_TRUE(wait_for_number_item_value(POLARALIGN_OFFSET_PROPERTY_NAME, POLARALIGN_OFFSET_AZ_ITEM_NAME, 120, .5));
	SERIAL_CHECK_TRUE(wait_for_number_item_value(POLARALIGN_OFFSET_PROPERTY_NAME, POLARALIGN_OFFSET_ALT_ITEM_NAME, 30, .5));
cleanup:
	if (online) { stop_serial_driver(&mlastro_polaralign); }
	stop_external_serial_simulator(&simulator);
}

// A difference below half an arcsecond rounds to a zero-length move: it must
// neither be sent on its own nor turn a single-axis move into AAll.
static void sub_arcsecond_difference_is_not_sent(void) {
	external_serial_simulator simulator = { 0 };
	bool online = false;
	SERIAL_CHECK_TRUE(start_mlastro(&simulator, NULL));
	SERIAL_CHECK_TRUE(start_serial_driver(&mlastro_polaralign, simulator.port));
	online = true;
	SERIAL_CHECK_TRUE(move_to(0, 60));
	SERIAL_CHECK_TRUE(move_to(30, 60.001)); // 0.06 arcsec on azimuth
	SERIAL_CHECK_TRUE(expect_event(&simulator, "ReDe:0,ReAM:30,ReAS:0,MAlU:1", 1));
	SERIAL_CHECK_TRUE(event_count_containing(&simulator, "AAll") == 0);
	int commands = event_count(&simulator, NULL);
	unsigned int revision = property_state_revision(POLARALIGN_OFFSET_PROPERTY_NAME, INDIGO_OK_STATE);
	SERIAL_CHECK_TRUE(change_offset(30.004, 60.001));
	SERIAL_CHECK_TRUE(wait_for_offset_state_after(INDIGO_OK_STATE, revision));
	indigo_usleep(1500000);
	SERIAL_CHECK_TRUE(event_count(&simulator, NULL) == commands);
cleanup:
	if (online) { stop_serial_driver(&mlastro_polaralign); }
	stop_external_serial_simulator(&simulator);
}

// A target outside the controller's own soft limits is refused with "error:
// Soft Limit"; the position must stay exactly where it was.
static void soft_limit_violation_is_rejected(void) {
	external_serial_simulator simulator = { 0 };
	bool online = false;
	SERIAL_CHECK_TRUE(start_mlastro(&simulator, NULL));
	SERIAL_CHECK_TRUE(start_serial_driver(&mlastro_polaralign, simulator.port));
	online = true;
	unsigned int revision = property_state_revision(POLARALIGN_OFFSET_PROPERTY_NAME, INDIGO_ALERT_STATE);
	SERIAL_CHECK_TRUE(change_offset(0, 1200)); // 20 deg, simulator default az limit is +-9 deg
	SERIAL_CHECK_TRUE(wait_for_offset_state_after(INDIGO_ALERT_STATE, revision));
	SERIAL_CHECK_TRUE(wait_for_number_item_value(POLARALIGN_OFFSET_PROPERTY_NAME, POLARALIGN_OFFSET_AZ_ITEM_NAME, 0, 0));
cleanup:
	if (online) { stop_serial_driver(&mlastro_polaralign); }
	stop_external_serial_simulator(&simulator);
}

// Widening the soft limits through POLARALIGN_LIMITS makes a previously
// rejected target reachable.
static void widening_limits_allows_a_previously_rejected_target(void) {
	external_serial_simulator simulator = { 0 };
	bool online = false;
	SERIAL_CHECK_TRUE(start_mlastro(&simulator, NULL));
	SERIAL_CHECK_TRUE(start_serial_driver(&mlastro_polaralign, simulator.port));
	online = true;
	static const char *limit_items[] = { POLARALIGN_LIMITS_MIN_POSITION_AZ_ITEM_NAME, POLARALIGN_LIMITS_MAX_POSITION_AZ_ITEM_NAME };
	const double limits[] = { -1200, 1200 };
	SERIAL_CHECK_TRUE(indigo_change_number_property(&simulator_test_client, mlastro_polaralign.device_name, POLARALIGN_LIMITS_PROPERTY_NAME, 2, limit_items, limits) == INDIGO_OK);
	SERIAL_CHECK_TRUE(wait_for_property_state(POLARALIGN_LIMITS_PROPERTY_NAME, INDIGO_OK_STATE));
	SERIAL_CHECK_TRUE(expect_event(&simulator, "AzL1:-20.00,AzL2:20.00", 1));
	SERIAL_CHECK_TRUE(move_to(0, 600)); // 10 deg, now within the widened +-20 deg limit
cleanup:
	if (online) { stop_serial_driver(&mlastro_polaralign); }
	stop_external_serial_simulator(&simulator);
}

// STOP:1 is a soft stop: the axes keep decelerating after the reply. The
// position they come to rest at must still reach the client, and it must be
// the position the driver computes the next move from.
static void abort_decelerates_and_publishes_final_position(void) {
	external_serial_simulator simulator = { 0 };
	bool online = false;
	SERIAL_CHECK_TRUE(start_mlastro(&simulator, NULL));
	SERIAL_CHECK_TRUE(start_serial_driver(&mlastro_polaralign, simulator.port));
	online = true;
	unsigned int revision = property_state_revision(POLARALIGN_OFFSET_PROPERTY_NAME, INDIGO_ALERT_STATE);
	SERIAL_CHECK_TRUE(change_offset(0, 480)); // 8 deg, ~13s of simulated travel
	SERIAL_CHECK_TRUE(wait_for_property_state(POLARALIGN_OFFSET_PROPERTY_NAME, INDIGO_BUSY_STATE));
	indigo_usleep(1500000); // let it get underway
	SERIAL_CHECK_TRUE(press(POLARALIGN_ABORT_MOTION_PROPERTY_NAME, POLARALIGN_ABORT_MOTION_ITEM_NAME));
	SERIAL_CHECK_TRUE(wait_for_offset_state_after(INDIGO_ALERT_STATE, revision));
	SERIAL_CHECK_TRUE(wait_for_property_state(POLARALIGN_ABORT_MOTION_PROPERTY_NAME, INDIGO_OK_STATE));
	SERIAL_CHECK_TRUE(expect_event(&simulator, "STOP:1", 1));
	double aborted_az = number_of(POLARALIGN_OFFSET_PROPERTY_NAME, POLARALIGN_OFFSET_AZ_ITEM_NAME);
	SERIAL_CHECK_TRUE(wait_for_status("READY"));
	indigo_usleep(1500000);
	double stopped_az = number_of(POLARALIGN_OFFSET_PROPERTY_NAME, POLARALIGN_OFFSET_AZ_ITEM_NAME);
	printf("aborted at %.2f', came to rest at %.2f'\n", aborted_az, stopped_az);
	SERIAL_CHECK_TRUE(stopped_az > aborted_az + 1); // the deceleration was published
	SERIAL_CHECK_TRUE(stopped_az > 6 && stopped_az < 474); // stopped mid-flight, not at 0 or 480
	indigo_usleep(1500000);
	SERIAL_CHECK_TRUE(fabs(number_of(POLARALIGN_OFFSET_PROPERTY_NAME, POLARALIGN_OFFSET_AZ_ITEM_NAME) - stopped_az) < .01);
	// one degree from the published position is exactly one degree on the device
	SERIAL_CHECK_TRUE(move_to(0, stopped_az + 60));
	SERIAL_CHECK_TRUE(expect_event(&simulator, "ReDe:1,ReAM:0,ReAS:0,MAzR:1", 1));
cleanup:
	if (online) { stop_serial_driver(&mlastro_polaralign); }
	stop_external_serial_simulator(&simulator);
}

// A StallGuard hard limit stops the controller in ERROR: the move fails,
// further motion is refused as "System Locked" until X_MLASTRO_RESET_ERROR
// sends ReER:1, and afterwards only moves away from the limit are accepted.
static void hard_limit_alerts_until_error_is_reset(void) {
	external_serial_simulator simulator = { 0 };
	bool online = false;
	const char *arguments[] = { "--hard-limit-az", "1.0", NULL };
	SERIAL_CHECK_TRUE(start_mlastro(&simulator, arguments));
	SERIAL_CHECK_TRUE(start_serial_driver(&mlastro_polaralign, simulator.port));
	online = true;
	unsigned int revision = property_state_revision(POLARALIGN_OFFSET_PROPERTY_NAME, INDIGO_ALERT_STATE);
	SERIAL_CHECK_TRUE(change_offset(0, 120)); // 2 deg, the hard limit trips at 1 deg
	SERIAL_CHECK_TRUE(wait_for_offset_state_after(INDIGO_ALERT_STATE, revision));
	SERIAL_CHECK_TRUE(wait_for_status("ERROR"));
	SERIAL_CHECK_TRUE(wait_for_property_state(X_MLASTRO_STATUS_PROPERTY_NAME, INDIGO_ALERT_STATE));
	SERIAL_CHECK_TRUE(wait_for_number_item_value(POLARALIGN_OFFSET_PROPERTY_NAME, POLARALIGN_OFFSET_AZ_ITEM_NAME, 60, .5));

	revision = property_state_revision(POLARALIGN_OFFSET_PROPERTY_NAME, INDIGO_ALERT_STATE);
	SERIAL_CHECK_TRUE(change_offset(0, 0));
	SERIAL_CHECK_TRUE(wait_for_offset_state_after(INDIGO_ALERT_STATE, revision)); // System Locked
	SERIAL_CHECK_TRUE(wait_for_number_item_value(POLARALIGN_OFFSET_PROPERTY_NAME, POLARALIGN_OFFSET_AZ_ITEM_NAME, 60, .5));

	SERIAL_CHECK_TRUE(press(X_MLASTRO_RESET_ERROR_PROPERTY_NAME, X_MLASTRO_RESET_ERROR_ITEM_NAME));
	SERIAL_CHECK_TRUE(wait_for_property_state(X_MLASTRO_RESET_ERROR_PROPERTY_NAME, INDIGO_OK_STATE));
	SERIAL_CHECK_TRUE(expect_event(&simulator, "ReER:1", 1));
	SERIAL_CHECK_TRUE(wait_for_status("READY"));
	SERIAL_CHECK_TRUE(wait_for_property_state(X_MLASTRO_STATUS_PROPERTY_NAME, INDIGO_OK_STATE));

	revision = property_state_revision(POLARALIGN_OFFSET_PROPERTY_NAME, INDIGO_ALERT_STATE);
	SERIAL_CHECK_TRUE(change_offset(0, 90));
	SERIAL_CHECK_TRUE(wait_for_offset_state_after(INDIGO_ALERT_STATE, revision)); // Hard Limit
	SERIAL_CHECK_TRUE(move_to(0, 0));
cleanup:
	if (online) { stop_serial_driver(&mlastro_polaralign); }
	stop_external_serial_simulator(&simulator);
}

// -------------------------------------------------------------------------------- unsolicited lines

// The controller pushes "AAll:COMPLETED" on its own when an alignment ends;
// when that push lands between a command and its reply it must not be taken
// for the reply.
static void completion_push_is_not_taken_for_a_reply(void) {
	external_serial_simulator simulator = { 0 };
	bool online = false;
	const char *arguments[] = { "--defer-push", NULL };
	SERIAL_CHECK_TRUE(start_mlastro(&simulator, arguments));
	SERIAL_CHECK_TRUE(start_serial_driver(&mlastro_polaralign, simulator.port));
	online = true;
	SERIAL_CHECK_TRUE(move_to(60, -60));
	SERIAL_CHECK_TRUE(wait_for_status("ALIGN_COMPLETED"));
	unsigned int revision = property_state_revision(X_MLASTRO_SPEED_PROPERTY_NAME, INDIGO_OK_STATE);
	SERIAL_CHECK_TRUE(indigo_change_number_property_1(&simulator_test_client, mlastro_polaralign.device_name, X_MLASTRO_SPEED_PROPERTY_NAME, X_MLASTRO_SPEED_ITEM_NAME, 4) == INDIGO_OK);
	SERIAL_CHECK_TRUE(wait_for_property_state_seen_after(X_MLASTRO_SPEED_PROPERTY_NAME, INDIGO_OK_STATE, revision));
	SERIAL_CHECK_TRUE(expect_event(&simulator, "SLvl:4", 1));
	SERIAL_CHECK_TRUE(wait_for_number_item_value(X_MLASTRO_SPEED_PROPERTY_NAME, X_MLASTRO_SPEED_ITEM_NAME, 4, 0));
	SERIAL_CHECK_TRUE(find_cached_property(X_MLASTRO_SPEED_PROPERTY_NAME)->state == INDIGO_OK_STATE);
cleanup:
	if (online) { stop_serial_driver(&mlastro_polaralign); }
	stop_external_serial_simulator(&simulator);
}

// Reloading the Web UI takes control back: the controller pushes
// "DISCONNECTED" and ignores everything until a new handshake. The driver
// must notice and go offline instead of polling a device it no longer drives.
static void releasing_serial_control_disconnects(void) {
	external_serial_simulator simulator = { 0 };
	bool online = false;
	SERIAL_CHECK_TRUE(start_mlastro(&simulator, NULL));
	SERIAL_CHECK_TRUE(start_serial_driver(&mlastro_polaralign, simulator.port));
	online = true;
	SERIAL_CHECK_TRUE(arm_control(&simulator, "disconnect"));
	for (int i = 0; i < 100 && context.connected; i++) {
		indigo_usleep(100000);
	}
	SERIAL_CHECK_TRUE(!context.connected);
	SERIAL_CHECK_TRUE(context.last_connection_state == INDIGO_ALERT_STATE);
	SERIAL_CHECK_TRUE(expect_event(&simulator, "Disconnect", 0));
	online = false;
	tear_down_serial_driver(&mlastro_polaralign);
cleanup:
	if (online) { stop_serial_driver(&mlastro_polaralign); }
	stop_external_serial_simulator(&simulator);
}

// Disconnecting sends "Disconnect" so the firmware hands control back to the
// Web UI, as the NINA plugin does; a reconnect takes it again.
static void disconnect_hands_control_back(void) {
	external_serial_simulator simulator = { 0 };
	bool online = false;
	SERIAL_CHECK_TRUE(start_mlastro(&simulator, NULL));
	SERIAL_CHECK_TRUE(start_serial_driver(&mlastro_polaralign, simulator.port));
	online = true;
	disconnect_serial_device(&mlastro_polaralign);
	SERIAL_CHECK_TRUE(!context.connected);
	SERIAL_CHECK_TRUE(expect_event(&simulator, "Disconnect", 1));
	SERIAL_CHECK_TRUE(connect_serial_device(&mlastro_polaralign, simulator.port));
	SERIAL_CHECK_TRUE(expect_event(&simulator, "[MLAstroRPA-TC]", 2));
	SERIAL_CHECK_TRUE(move_to(0, 30));
cleanup:
	if (online) { stop_serial_driver(&mlastro_polaralign); }
	stop_external_serial_simulator(&simulator);
}

// -------------------------------------------------------------------------------- home reference

// The controller has one shared zero reference for both axes: SetH:1 zeros
// whichever POLARALIGN_RESET_POSITION_* fired it, but the simulator (like
// the real firmware) applies it to both axes at once.
static void reset_position_shares_the_home_reference(void) {
	external_serial_simulator simulator = { 0 };
	bool online = false;
	SERIAL_CHECK_TRUE(start_mlastro(&simulator, NULL));
	SERIAL_CHECK_TRUE(start_serial_driver(&mlastro_polaralign, simulator.port));
	online = true;
	SERIAL_CHECK_TRUE(move_to(60, -60));
	SERIAL_CHECK_TRUE(press(POLARALIGN_RESET_POSITION_ALT_PROPERTY_NAME, POLARALIGN_RESET_POSITION_ITEM_NAME));
	SERIAL_CHECK_TRUE(wait_for_property_state(POLARALIGN_RESET_POSITION_ALT_PROPERTY_NAME, INDIGO_OK_STATE));
	SERIAL_CHECK_TRUE(expect_event(&simulator, "SetH:1", 1));
	SERIAL_CHECK_TRUE(wait_for_number_item_value(POLARALIGN_OFFSET_PROPERTY_NAME, POLARALIGN_OFFSET_ALT_ITEM_NAME, 0, .5));
	// the azimuth axis was zeroed too, by the same shared SetH:1
	SERIAL_CHECK_TRUE(wait_for_number_item_value(POLARALIGN_OFFSET_PROPERTY_NAME, POLARALIGN_OFFSET_AZ_ITEM_NAME, 0, .5));
	indigo_item *homed = find_cached_item(X_MLASTRO_HOMED_PROPERTY_NAME, X_MLASTRO_HOMED_ITEM_NAME);
	SERIAL_CHECK_TRUE(homed != NULL && homed->light.value == INDIGO_OK_STATE);
	// and the next move is measured from the new reference
	SERIAL_CHECK_TRUE(move_to(0, 30));
	SERIAL_CHECK_TRUE(expect_event(&simulator, "ReDe:0,ReAM:30,ReAS:0,MAzR:1", 1));
cleanup:
	if (online) { stop_serial_driver(&mlastro_polaralign); }
	stop_external_serial_simulator(&simulator);
}

// X_MLASTRO_GOTO_HOME (RetH:1) is refused until a home reference exists, and
// X_MLASTRO_CLEAR_HOME (RstH:1) forgets it again.
static void goto_home_requires_a_reference_and_clear_home_forgets_it(void) {
	external_serial_simulator simulator = { 0 };
	bool online = false;
	SERIAL_CHECK_TRUE(start_mlastro(&simulator, NULL));
	SERIAL_CHECK_TRUE(start_serial_driver(&mlastro_polaralign, simulator.port));
	online = true;
	SERIAL_CHECK_TRUE(press(X_MLASTRO_GOTO_HOME_PROPERTY_NAME, X_MLASTRO_GOTO_HOME_ITEM_NAME));
	SERIAL_CHECK_TRUE(wait_for_property_state(X_MLASTRO_GOTO_HOME_PROPERTY_NAME, INDIGO_ALERT_STATE));

	SERIAL_CHECK_TRUE(press(POLARALIGN_RESET_POSITION_AZ_PROPERTY_NAME, POLARALIGN_RESET_POSITION_ITEM_NAME));
	SERIAL_CHECK_TRUE(wait_for_property_state(POLARALIGN_RESET_POSITION_AZ_PROPERTY_NAME, INDIGO_OK_STATE));
	SERIAL_CHECK_TRUE(move_to(60, 60));
	unsigned int revision = property_state_revision(POLARALIGN_OFFSET_PROPERTY_NAME, INDIGO_BUSY_STATE);
	SERIAL_CHECK_TRUE(press(X_MLASTRO_GOTO_HOME_PROPERTY_NAME, X_MLASTRO_GOTO_HOME_ITEM_NAME));
	SERIAL_CHECK_TRUE(wait_for_property_state(X_MLASTRO_GOTO_HOME_PROPERTY_NAME, INDIGO_OK_STATE));
	SERIAL_CHECK_TRUE(wait_for_offset_state_after(INDIGO_BUSY_STATE, revision));
	SERIAL_CHECK_TRUE(wait_for_offset_settled());
	SERIAL_CHECK_TRUE(find_cached_property(POLARALIGN_OFFSET_PROPERTY_NAME)->state == INDIGO_OK_STATE);
	SERIAL_CHECK_TRUE(wait_for_number_item_value(POLARALIGN_OFFSET_PROPERTY_NAME, POLARALIGN_OFFSET_ALT_ITEM_NAME, 0, .5));
	SERIAL_CHECK_TRUE(wait_for_number_item_value(POLARALIGN_OFFSET_PROPERTY_NAME, POLARALIGN_OFFSET_AZ_ITEM_NAME, 0, .5));
	SERIAL_CHECK_TRUE(wait_for_status("HOME_COMPLETED"));

	SERIAL_CHECK_TRUE(press(X_MLASTRO_CLEAR_HOME_PROPERTY_NAME, X_MLASTRO_CLEAR_HOME_ITEM_NAME));
	SERIAL_CHECK_TRUE(wait_for_property_state(X_MLASTRO_CLEAR_HOME_PROPERTY_NAME, INDIGO_OK_STATE));
	indigo_item *homed = find_cached_item(X_MLASTRO_HOMED_PROPERTY_NAME, X_MLASTRO_HOMED_ITEM_NAME);
	SERIAL_CHECK_TRUE(homed != NULL && homed->light.value == INDIGO_IDLE_STATE);
cleanup:
	if (online) { stop_serial_driver(&mlastro_polaralign); }
	stop_external_serial_simulator(&simulator);
}

// -------------------------------------------------------------------------------- settings

static void direction_and_steps_per_degree_round_trip(void) {
	external_serial_simulator simulator = { 0 };
	bool online = false;
	SERIAL_CHECK_TRUE(start_mlastro(&simulator, NULL));
	SERIAL_CHECK_TRUE(start_serial_driver(&mlastro_polaralign, simulator.port));
	online = true;
	SERIAL_CHECK_TRUE(press(POLARALIGN_DIRECTION_ALT_PROPERTY_NAME, POLARALIGN_DIRECTION_REVERSED_ITEM_NAME));
	SERIAL_CHECK_TRUE(wait_for_property_state(POLARALIGN_DIRECTION_ALT_PROPERTY_NAME, INDIGO_OK_STATE));
	SERIAL_CHECK_TRUE(wait_for_switch_value(POLARALIGN_DIRECTION_ALT_PROPERTY_NAME, POLARALIGN_DIRECTION_REVERSED_ITEM_NAME, true));
	SERIAL_CHECK_TRUE(expect_event(&simulator, "AlRD:1", 1));

	static const char *step_items[] = { POLARALIGN_STEPS_PER_DEGREE_ALT_ITEM_NAME, POLARALIGN_STEPS_PER_DEGREE_AZ_ITEM_NAME };
	const double steps[] = { 1600, 6400 };
	SERIAL_CHECK_TRUE(indigo_change_number_property(&simulator_test_client, mlastro_polaralign.device_name, POLARALIGN_STEPS_PER_DEGREE_PROPERTY_NAME, 2, step_items, steps) == INDIGO_OK);
	SERIAL_CHECK_TRUE(wait_for_property_state(POLARALIGN_STEPS_PER_DEGREE_PROPERTY_NAME, INDIGO_OK_STATE));
	SERIAL_CHECK_TRUE(wait_for_number_item_value(POLARALIGN_STEPS_PER_DEGREE_PROPERTY_NAME, step_items[0], 1600, 0));
	SERIAL_CHECK_TRUE(wait_for_number_item_value(POLARALIGN_STEPS_PER_DEGREE_PROPERTY_NAME, step_items[1], 6400, 0));
	SERIAL_CHECK_TRUE(expect_event(&simulator, "AzSD:6400,AlSD:1600", 1));
cleanup:
	if (online) { stop_serial_driver(&mlastro_polaralign); }
	stop_external_serial_simulator(&simulator);
}

static void speed_and_backlash_round_trip(void) {
	external_serial_simulator simulator = { 0 };
	bool online = false;
	SERIAL_CHECK_TRUE(start_mlastro(&simulator, NULL));
	SERIAL_CHECK_TRUE(start_serial_driver(&mlastro_polaralign, simulator.port));
	online = true;
	SERIAL_CHECK_TRUE(indigo_change_number_property_1(&simulator_test_client, mlastro_polaralign.device_name, X_MLASTRO_SPEED_PROPERTY_NAME, X_MLASTRO_SPEED_ITEM_NAME, 5) == INDIGO_OK);
	SERIAL_CHECK_TRUE(wait_for_property_state(X_MLASTRO_SPEED_PROPERTY_NAME, INDIGO_OK_STATE));
	SERIAL_CHECK_TRUE(wait_for_number_item_value(X_MLASTRO_SPEED_PROPERTY_NAME, X_MLASTRO_SPEED_ITEM_NAME, 5, 0));

	SERIAL_CHECK_TRUE(press(X_MLASTRO_BACKLASH_ENABLE_PROPERTY_NAME, X_MLASTRO_BACKLASH_ENABLE_ENABLED_ITEM_NAME));
	SERIAL_CHECK_TRUE(wait_for_property_state(X_MLASTRO_BACKLASH_ENABLE_PROPERTY_NAME, INDIGO_OK_STATE));
	SERIAL_CHECK_TRUE(wait_for_switch_value(X_MLASTRO_BACKLASH_ENABLE_PROPERTY_NAME, X_MLASTRO_BACKLASH_ENABLE_ENABLED_ITEM_NAME, true));

	static const char *backlash_items[] = { X_MLASTRO_BACKLASH_STEPS_ALT_ITEM_NAME, X_MLASTRO_BACKLASH_STEPS_AZ_ITEM_NAME };
	const double backlash[] = { 12, 34 };
	SERIAL_CHECK_TRUE(indigo_change_number_property(&simulator_test_client, mlastro_polaralign.device_name, X_MLASTRO_BACKLASH_STEPS_PROPERTY_NAME, 2, backlash_items, backlash) == INDIGO_OK);
	SERIAL_CHECK_TRUE(wait_for_property_state(X_MLASTRO_BACKLASH_STEPS_PROPERTY_NAME, INDIGO_OK_STATE));
	SERIAL_CHECK_TRUE(wait_for_number_item_value(X_MLASTRO_BACKLASH_STEPS_PROPERTY_NAME, backlash_items[0], 12, 0));
	SERIAL_CHECK_TRUE(wait_for_number_item_value(X_MLASTRO_BACKLASH_STEPS_PROPERTY_NAME, backlash_items[1], 34, 0));
	SERIAL_CHECK_TRUE(expect_event(&simulator, "SLvl:5", 1));
	SERIAL_CHECK_TRUE(expect_event(&simulator, "Back:1", 1));
	SERIAL_CHECK_TRUE(expect_event(&simulator, "AzBl:34", 1));
	SERIAL_CHECK_TRUE(expect_event(&simulator, "AlBl:12", 1));
cleanup:
	if (online) { stop_serial_driver(&mlastro_polaralign); }
	stop_external_serial_simulator(&simulator);
}

static void status_text_tracks_controller_state(void) {
	external_serial_simulator simulator = { 0 };
	bool online = false;
	SERIAL_CHECK_TRUE(start_mlastro(&simulator, NULL));
	SERIAL_CHECK_TRUE(start_serial_driver(&mlastro_polaralign, simulator.port));
	online = true;
	SERIAL_CHECK_TRUE(!strcmp(text_of(X_MLASTRO_STATUS_PROPERTY_NAME, X_MLASTRO_STATUS_ITEM_NAME), "READY"));
	SERIAL_CHECK_TRUE(change_offset(0, 480)); // 8 deg, long enough to observe MOVING
	SERIAL_CHECK_TRUE(wait_for_status("MOVING"));
	unsigned int revision = property_state_revision(POLARALIGN_OFFSET_PROPERTY_NAME, INDIGO_ALERT_STATE);
	SERIAL_CHECK_TRUE(press(POLARALIGN_ABORT_MOTION_PROPERTY_NAME, POLARALIGN_ABORT_MOTION_ITEM_NAME));
	SERIAL_CHECK_TRUE(wait_for_offset_state_after(INDIGO_ALERT_STATE, revision));
	SERIAL_CHECK_TRUE(wait_for_status("READY"));
cleanup:
	if (online) { stop_serial_driver(&mlastro_polaralign); }
	stop_external_serial_simulator(&simulator);
}

// -------------------------------------------------------------------------------- lifecycle

static void reconnect_resumes_polling(void) {
	external_serial_simulator simulator = { 0 };
	bool online = false;
	SERIAL_CHECK_TRUE(start_mlastro(&simulator, NULL));
	SERIAL_CHECK_TRUE(start_serial_driver(&mlastro_polaralign, simulator.port));
	online = true;
	SERIAL_CHECK_TRUE(move_to(0, 60));
	disconnect_serial_device(&mlastro_polaralign);
	SERIAL_CHECK_TRUE(!context.connected);
	SERIAL_CHECK_TRUE(connect_serial_device(&mlastro_polaralign, simulator.port));
	// the controller kept its position across the reconnect
	SERIAL_CHECK_TRUE(wait_for_number_item_value(POLARALIGN_OFFSET_PROPERTY_NAME, POLARALIGN_OFFSET_AZ_ITEM_NAME, 60, .5));
	SERIAL_CHECK_TRUE(move_to(0, 90));
	SERIAL_CHECK_TRUE(expect_event(&simulator, "ReDe:0,ReAM:30,ReAS:0,MAzR:1", 1));
cleanup:
	if (online) { stop_serial_driver(&mlastro_polaralign); }
	stop_external_serial_simulator(&simulator);
}

static void repeated_disconnect_is_tolerated(void) {
	external_serial_simulator simulator = { 0 };
	bool online = false;
	SERIAL_CHECK_TRUE(start_mlastro(&simulator, NULL));
	SERIAL_CHECK_TRUE(start_serial_driver(&mlastro_polaralign, simulator.port));
	online = true;
	disconnect_serial_device(&mlastro_polaralign);
	SERIAL_CHECK_TRUE(!context.connected);
	disconnect_serial_device(&mlastro_polaralign);
	SERIAL_CHECK_TRUE(!context.connected);
	online = false;
	tear_down_serial_driver(&mlastro_polaralign);
cleanup:
	if (online) { stop_serial_driver(&mlastro_polaralign); }
	stop_external_serial_simulator(&simulator);
}

// The open only succeeds once the [MLAstroRPA-TC] handshake replies, so a
// port with nothing behind it has to be refused rather than reported connected.
static void vanished_port_is_refused(void) {
	external_serial_simulator simulator = { 0 };
	SERIAL_CHECK_TRUE(start_mlastro(&simulator, NULL));
	SERIAL_CHECK_TRUE(bring_up_serial_driver(&mlastro_polaralign));
	stop_external_serial_simulator(&simulator);
	SERIAL_CHECK_TRUE(!connect_serial_device(&mlastro_polaralign, simulator.port));
	SERIAL_CHECK_TRUE(!context.connected);
cleanup:
	tear_down_serial_driver(&mlastro_polaralign);
}

int main(void) {
	indigo_test_use_private_home();
	const indigo_test_case tests[] = {
		{ "metadata_and_property_completeness", metadata_and_property_completeness },
		{ "identity_and_firmware_reach_info", identity_and_firmware_reach_info },
		{ "legacy_handshake_connects_without_identity", legacy_handshake_connects_without_identity },
		{ "handshake_is_retried_through_boot_noise", handshake_is_retried_through_boot_noise },
		{ "single_axis_move_uses_relative_move", single_axis_move_uses_relative_move },
		{ "combined_axis_move_uses_alignment_command", combined_axis_move_uses_alignment_command },
		{ "consecutive_moves_track_position_from_home", consecutive_moves_track_position_from_home },
		{ "sub_arcsecond_difference_is_not_sent", sub_arcsecond_difference_is_not_sent },
		{ "soft_limit_violation_is_rejected", soft_limit_violation_is_rejected },
		{ "widening_limits_allows_a_previously_rejected_target", widening_limits_allows_a_previously_rejected_target },
		{ "abort_decelerates_and_publishes_final_position", abort_decelerates_and_publishes_final_position },
		{ "hard_limit_alerts_until_error_is_reset", hard_limit_alerts_until_error_is_reset },
		{ "completion_push_is_not_taken_for_a_reply", completion_push_is_not_taken_for_a_reply },
		{ "releasing_serial_control_disconnects", releasing_serial_control_disconnects },
		{ "disconnect_hands_control_back", disconnect_hands_control_back },
		{ "reset_position_shares_the_home_reference", reset_position_shares_the_home_reference },
		{ "goto_home_requires_a_reference_and_clear_home_forgets_it", goto_home_requires_a_reference_and_clear_home_forgets_it },
		{ "direction_and_steps_per_degree_round_trip", direction_and_steps_per_degree_round_trip },
		{ "speed_and_backlash_round_trip", speed_and_backlash_round_trip },
		{ "status_text_tracks_controller_state", status_text_tracks_controller_state },
		{ "reconnect_resumes_polling", reconnect_resumes_polling },
		{ "repeated_disconnect_is_tolerated", repeated_disconnect_is_tolerated },
		{ "vanished_port_is_refused", vanished_port_is_refused }
	};
	int result = indigo_run_tests("MLAstro RPA serial simulator integration tests", tests, ARRAY_SIZE(tests));
	indigo_test_remove_private_home();
	return result;
}
