// Copyright (c) 2026 INDIGO initiative
// All rights reserved.
//
// You may use this software under the terms of 'INDIGO Astronomy
// open-source license' (see LICENSE.md).
//
// THIS SOFTWARE IS PROVIDED BY THE AUTHORS 'AS IS' AND ANY EXPRESS
// OR IMPLIED WARRANTIES, INCLUDING, BUT NOT LIMITED TO, THE IMPLIED
// WARRANTIES OF MERCHANTABILITY AND FITNESS FOR A PARTICULAR PURPOSE
// ARE DISCLAIMED. IN NO EVENT SHALL THE AUTHOR BE LIABLE FOR ANY
// DIRECT, INDIRECT, INCIDENTAL, SPECIAL, EXEMPLARY, OR CONSEQUENTIAL
// DAMAGES (INCLUDING, BUT NOT LIMITED TO, PROCUREMENT OF SUBSTITUTE
// GOODS OR SERVICES; LOSS OF USE, DATA, OR PROFITS; OR BUSINESS
// INTERRUPTION) HOWEVER CAUSED AND ON ANY THEORY OF LIABILITY,
// WHETHER IN CONTRACT, STRICT LIABILITY, OR TORT (INCLUDING
// NEGLIGENCE OR OTHERWISE) ARISING IN ANY WAY OUT OF THE USE OF THIS
// SOFTWARE, EVEN IF ADVISED OF THE POSSIBILITY OF SUCH DAMAGE.

// Code is generated by AI

#include <stdio.h>
#include <limits.h>
#include <string.h>
#include <unistd.h>
#include <indigo/indigo_bus.h>
#include <indigo/indigo_uni_io.h>
#include "../../indigo_drivers/agent_alpaca/indigo_alpaca_common.h"
#include "../test_runner.h"

static void imagearray_response(void *image, long image_size, bool imagebytes, bool gzip, char *response, size_t response_size) {
	indigo_device device = { 0 };
	INDIGO_COPY_NAME(device.name, "Alpaca cache test");
	indigo_property *property = indigo_init_blob_property(NULL, device.name, "CCD_IMAGE", "Test", "Image", INDIGO_OK_STATE, 1);
	indigo_init_blob_item(property->items, "IMAGE", "Image");
	property->items[0].blob.value = image;
	property->items[0].blob.size = image_size;
	INDIGO_COPY_NAME(property->items[0].blob.format, ".raw");
	indigo_use_blob_caching = true;
	ASSERT_EQ_INT(INDIGO_OK, indigo_update_property(&device, property, NULL));
	indigo_alpaca_device alpaca = { 0 };
	alpaca.ccd.imageready = property->items;
	char path[] = "/tmp/indigo-alpaca-cache-XXXXXX";
	int descriptor = mkstemp(path);
	ASSERT_TRUE(descriptor >= 0);
	indigo_uni_handle *output = indigo_uni_create_file_handle(descriptor, 0);
	ASSERT_TRUE(output != NULL);
	indigo_alpaca_ccd_get_imagearray(&alpaca, 1, output, 7, 9, gzip, imagebytes);
	indigo_uni_close(&output);
	FILE *file = fopen(path, "rb");
	ASSERT_TRUE(file != NULL);
	size_t count = fread(response, 1, response_size - 1, file);
	response[count] = 0;
	fclose(file);
	unlink(path);
	indigo_release_property(property);
}

static void imagearray_preserves_column_order(void) {
	struct {
		indigo_raw_header header;
		unsigned char pixels[4];
	} image = { { INDIGO_RAW_MONO8, 2, 2 }, { 1, 2, 3, 4 } };
	char response[2048];
	ASSERT_EQ_INT(INDIGO_OK, indigo_start());
	imagearray_response(&image, sizeof(image), false, false, response, sizeof(response));
	ASSERT_TRUE(strstr(response, "\"Value\": [[1, 3], [2, 4]]") != NULL);
	ASSERT_TRUE(strstr(response, "\"ErrorNumber\": 0") != NULL);
	ASSERT_TRUE(strstr(response, "\"ClientTransactionID\": 7") != NULL);
	ASSERT_EQ_INT(INDIGO_OK, indigo_stop());
}

static void imagearray_rejects_invalid_raw_frames(void) {
	struct {
		indigo_raw_header header;
		unsigned char pixels[24];
	} image = { { INDIGO_RAW_MONO8, 2, 2 }, { 0 } };
	char response[2048];
	char expected[64];
	snprintf(expected, sizeof(expected), "\"ErrorNumber\": %d", indigo_alpaca_error_InvalidOperation);
	const indigo_raw_header invalid[] = {
		{ INDIGO_RAW_MONO8, 0, 2 }, { INDIGO_RAW_MONO8, 2, 0 }, { 0, 2, 2 },
		{ INDIGO_RAW_MONO8, UINT32_MAX, 2 }, { INDIGO_RAW_RGB48, 32768, 32768 }
	};
	ASSERT_EQ_INT(INDIGO_OK, indigo_start());
	for (unsigned mode = 0; mode < 4; mode++) {
		for (unsigned i = 0; i < sizeof(invalid) / sizeof(invalid[0]); i++) {
			image.header = invalid[i];
			imagearray_response(&image, sizeof(image), mode & 1, mode & 2, response, sizeof(response));
			ASSERT_TRUE(strstr(response, expected) != NULL);
			ASSERT_TRUE(strstr(response, "\"ClientTransactionID\": 7") != NULL);
			ASSERT_TRUE(strstr(response, "\"ServerTransactionID\": 9") != NULL);
			ASSERT_TRUE(strstr(response, "\"Value\"") == NULL);
			ASSERT_TRUE(strstr(response, "Content-Type: application/json") != NULL);
		}
		image.header = (indigo_raw_header) { INDIGO_RAW_MONO8, 2, 2 };
		for (long size = 1; size < (long)sizeof(image.header); size++) {
			imagearray_response(&image, size, mode & 1, mode & 2, response, sizeof(response));
			ASSERT_TRUE(strstr(response, expected) != NULL);
		}
		const indigo_raw_type types[] = { INDIGO_RAW_MONO8, INDIGO_RAW_MONO16, INDIGO_RAW_RGB24, INDIGO_RAW_RGB48 };
		const int bytes_per_pixel[] = { 1, 2, 3, 6 };
		for (unsigned i = 0; i < sizeof(types) / sizeof(types[0]); i++) {
			image.header.signature = types[i];
			imagearray_response(&image, sizeof(image.header) + 4 * bytes_per_pixel[i] - 1, mode & 1, mode & 2, response, sizeof(response));
			ASSERT_TRUE(strstr(response, expected) != NULL);
		}
	}
	ASSERT_EQ_INT(INDIGO_OK, indigo_stop());
}

static void imagearray_preserves_rgb48_planes_and_imagebytes_order(void) {
	struct {
		indigo_raw_header header;
		uint16_t pixels[12];
	} image = { { INDIGO_RAW_RGB48, 2, 2 }, { 1, 2, 3, 4, 5, 6, 7, 8, 9, 10, 11, 65535 } };
	char response[2048];
	ASSERT_EQ_INT(INDIGO_OK, indigo_start());
	imagearray_response(&image, sizeof(image), false, false, response, sizeof(response));
	ASSERT_TRUE(strstr(response, "\"Rank\": 3, \"Value\": [[[1, 2, 3], [7, 8, 9]], [[4, 5, 6], [10, 11, 65535]]]") != NULL);
	imagearray_response(&image, sizeof(image), true, false, response, sizeof(response));
	char expected_length[64];
	snprintf(expected_length, sizeof(expected_length), "Content-Length: %lu\r\n", (unsigned long)sizeof(indigo_alpaca_metadata) + sizeof(image.pixels));
	ASSERT_TRUE(strstr(response, expected_length) != NULL);
	char *body = strstr(response, "\r\n\r\n");
	ASSERT_TRUE(body != NULL);
	indigo_alpaca_metadata metadata;
	memcpy(&metadata, body + 4, sizeof(metadata));
	ASSERT_EQ_INT(3, metadata.rank);
	ASSERT_EQ_INT(2, metadata.dimension1);
	ASSERT_EQ_INT(2, metadata.dimension2);
	ASSERT_EQ_INT(3, metadata.dimension3);
	ASSERT_EQ_INT(indigo_alpaca_type_uint16, metadata.transmission_element_type);
	const uint16_t expected[] = { 1, 2, 3, 7, 8, 9, 4, 5, 6, 10, 11, 65535 };
	ASSERT_TRUE(memcmp(body + 4 + sizeof(metadata), expected, sizeof(expected)) == 0);
	ASSERT_EQ_INT(INDIGO_OK, indigo_stop());
}

int main(int argc, char **argv) {
	indigo_test_use_private_home();
	indigo_test_case tests[] = {
		{ "imagearray_preserves_column_order", imagearray_preserves_column_order },
		{ "imagearray_rejects_invalid_raw_frames", imagearray_rejects_invalid_raw_frames },
		{ "imagearray_preserves_rgb48_planes_and_imagebytes_order", imagearray_preserves_rgb48_planes_and_imagebytes_order }
	};
	int result = indigo_run_tests("agent_alpaca cache tests", tests, sizeof(tests) / sizeof(tests[0]));
	indigo_test_remove_private_home();
	return result;
}
