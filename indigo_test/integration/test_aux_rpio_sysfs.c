// Copyright (c) 2026 INDIGO initiative
// All rights reserved.
//
// You may use this software under the terms of 'INDIGO Astronomy
// open-source license' (see LICENSE.md).
//
// THIS SOFTWARE IS PROVIDED BY THE AUTHORS 'AS IS' AND ANY EXPRESS
// OR IMPLIED WARRANTIES, INCLUDING, BUT NOT LIMITED TO, THE IMPLIED
// WARRANTIES OF MERCHANTABILITY AND FITNESS FOR A PARTICULAR PURPOSE
// ARE DISCLAIMED. IN NO EVENT SHALL THE AUTHOR BE LIABLE FOR ANY
// DIRECT, INDIRECT, INCIDENTAL, SPECIAL, EXEMPLARY, OR CONSEQUENTIAL
// DAMAGES (INCLUDING, BUT NOT LIMITED TO, PROCUREMENT OF SUBSTITUTE
// GOODS OR SERVICES; LOSS OF USE, DATA, OR PROFITS; OR BUSINESS
// INTERRUPTION) HOWEVER CAUSED AND ON ANY THEORY OF LIABILITY,
// WHETHER IN CONTRACT, STRICT LIABILITY, OR TORT (INCLUDING
// NEGLIGENCE OR OTHERWISE) ARISING IN ANY WAY OUT OF THE USE OF THIS
// SOFTWARE, EVEN IF ADVISED OF THE POSSIBILITY OF SUCH DAMAGE.

// Code is generated by AI

/** Characterization suite for the Raspberry Pi GPIO AUX driver.
 \file test_aux_rpio_sysfs.c
 The driver reaches the hardware only through the legacy sysfs GPIO and PWM
 interfaces, so the whole boundary is faked by replacing open/close/read/write
 and stat when the driver is compiled for this test. The fake models the kernel
 side: export creates a pin node, direction and value behave like their sysfs
 counterparts, and every interaction is appended to an ordered trace that can be
 compared before and after a refactoring step.
 */

#include <errno.h>
#include <fcntl.h>
#include <pthread.h>
#include <stdarg.h>
#include <stdbool.h>
#include <dirent.h>
#include <stdio.h>
#include <stdlib.h>
#include <string.h>
#include <sys/stat.h>
#include <sys/types.h>

#include <indigo_linux_drivers/aux_rpio/indigo_aux_rpio.h>

#include "serial_simulator_test_common.h"
#include "sysfs_gpio_fake.h"

#define RPIO_DEVICE_NAME "Raspberry Pi GPIO"
static const int driver_input_pins[8] = { 19, 17, 27, 22, 23, 24, 25, 20 };
static const int driver_output_pins[8] = { 18, 12, 13, 26, 16, 5, 6, 21 };

// --------------------------------------------------------------------------- scenarios

static const simulator_driver_case driver = { "Raspberry Pi GPIO", "indigo_aux_rpio", RPIO_DEVICE_NAME, indigo_aux_rpio, false, NULL, 0, NULL, 0, NULL, 0, NULL, 0 };

// start_serial_driver() tears the driver down itself when the connection fails,
// so a test that expects a failed connection must not tear it down again. These
// wrappers track whether the driver is still running and make every cleanup
// path idempotent.
static bool driver_running;

static int failures_at_bring_up;

static bool bring_up_driver(int gpio_base, bool pwm_chip_present) {
	fake_reset(gpio_base, pwm_chip_present);
	failures_at_bring_up = indigo_test_failures;
	driver_running = bring_up_serial_driver(&driver);
	return driver_running;
}

static bool connect_driver(void) {
	return connect_serial_device(&driver, NULL);
}

static bool start_driver(int gpio_base, bool pwm_chip_present) {
	if (!bring_up_driver(gpio_base, pwm_chip_present)) {
		return false;
	}
	return connect_driver();
}

static void stop_driver(void) {
	if (indigo_test_failures != failures_at_bring_up || getenv("INDIGO_TEST_TRACE") != NULL) {
		fake_dump_trace(indigo_current_test_name);
	}
	if (driver_running) {
		stop_serial_driver(&driver);
		driver_running = false;
	}
}

// assert_not_defined_property() answers whether a property was ever defined:
// the shared client removes a deleted property from the cache but keeps its
// name in the defined list. A property that has to be gone right now is
// therefore checked against the cache instead.
static void assert_property_deleted(const char *name) {
	if (find_cached_property(name) != NULL) {
		fprintf(stderr, "Property %s is still defined\n", name);
	}
	ASSERT_TRUE(find_cached_property(name) == NULL);
}

// PWM is opt-in, so a scenario that exercises it has to ask for it before the
// device is connected.
static bool start_driver_with_pwm(int gpio_base) {
	if (!bring_up_driver(gpio_base, true)) {
		return false;
	}
	if (indigo_change_switch_property_1(&simulator_test_client, RPIO_DEVICE_NAME, "X_AUX_PWM", "ENABLED", true) != INDIGO_OK) {
		return false;
	}
	// The property is already in OK state before the change, so the state is
	// not a signal that the change has landed; the item value is.
	for (int i = 0; i < 50; i++) {
		indigo_item *item = find_cached_item("X_AUX_PWM", "ENABLED");
		if (item != NULL && item->sw.value) {
			return connect_driver();
		}
		indigo_usleep(100000);
	}
	printf("X_AUX_PWM did not switch to ENABLED\n");
	return false;
}

static void record_reference_trace(const char *name) {
	const char *directory = getenv("INDIGO_SIMULATOR_TRACE_DIR");
	char path[512];
	if (directory == NULL) {
		return;
	}
	snprintf(path, sizeof(path), "%s/%s.events", directory, name);
	if (!fake_write_trace_file(path)) {
		printf("could not write reference trace to %s\n", path);
	}
}

static void contract(void) {
	indigo_driver_info info = { 0 };
	SERIAL_CHECK_TRUE(bring_up_driver(0, false));
	driver.entry(INDIGO_DRIVER_INFO, &info);
	ASSERT_STREQ("indigo_aux_rpio", info.name);
	ASSERT_STREQ("Raspberry Pi GPIO", info.description);
	ASSERT_EQ_INT(0x03000009, info.version);
	ASSERT_FALSE(info.multi_device_support);
	enumerate_simulator_device();
	assert_defined_property(INFO_PROPERTY_NAME);
	assert_defined_property(CONFIG_PROPERTY_NAME);
	assert_defined_property(CONNECTION_PROPERTY_NAME);
	assert_defined_property(AUX_OUTLET_NAMES_PROPERTY_NAME);
	assert_defined_property("X_AUX_PWM");
	assert_switch_item_value("X_AUX_PWM", "DISABLED", true);
	assert_defined_property(AUX_SENSOR_NAMES_PROPERTY_NAME);
	assert_not_defined_property(DEVICE_PORT_PROPERTY_NAME);
	assert_not_defined_property(AUX_GPIO_OUTLETS_PROPERTY_NAME);
	assert_not_defined_property(AUX_GPIO_SENSORS_PROPERTY_NAME);
	assert_device_interface(INDIGO_INTERFACE_AUX_GPIO);
	SERIAL_CHECK_TRUE(connect_driver());
	assert_defined_property(AUX_GPIO_OUTLETS_PROPERTY_NAME);
	assert_defined_property(AUX_OUTLET_PULSE_LENGTHS_PROPERTY_NAME);
	assert_defined_property(AUX_GPIO_SENSORS_PROPERTY_NAME);
	assert_property_has_item(AUX_GPIO_OUTLETS_PROPERTY_NAME, AUX_GPIO_OUTLETS_OUTLET_8_ITEM_NAME);
	assert_property_has_item(AUX_GPIO_SENSORS_PROPERTY_NAME, AUX_GPIO_SENSOR_NAME_8_ITEM_NAME);
cleanup:
	stop_driver();
}

static void connect_exports_every_pin(void) {
	SERIAL_CHECK_TRUE(start_driver(0, false));
	for (int i = 0; i < 8; i++) {
		ASSERT_TRUE(fake_pin_exported(driver_output_pins[i]));
		ASSERT_TRUE(fake_pin_exported(driver_input_pins[i]));
		ASSERT_FALSE(fake_pin_is_input(driver_output_pins[i]));
		ASSERT_TRUE(fake_pin_is_input(driver_input_pins[i]));
	}
	ASSERT_TRUE(fake_trace_contains("export 18"));
	ASSERT_TRUE(fake_trace_contains("direction 18 out"));
	ASSERT_TRUE(fake_trace_contains("export 19"));
	ASSERT_EQ_INT(16, fake_exported_pin_count());
	record_reference_trace("connect_exports_every_pin");
cleanup:
	stop_driver();
}

// D1 reproducer. The header controller of a Raspberry Pi 5 has base 571, so the
// driver must offset every BCM number by the base of the controller it found.
static void connect_offsets_pins_by_the_controller_base(void) {
	SERIAL_CHECK_TRUE(start_driver(571, false));
	for (int i = 0; i < 8; i++) {
		ASSERT_TRUE(fake_pin_exported(driver_output_pins[i]));
		ASSERT_TRUE(fake_pin_exported(driver_input_pins[i]));
	}
	ASSERT_TRUE(fake_trace_contains("export 589"));
	ASSERT_TRUE(fake_trace_contains("direction 589 out"));
	ASSERT_EQ_INT(-1, fake_trace_index_of("export 18"));
cleanup:
	stop_driver();
}

static void outputs_are_written_and_read_back(void) {
	SERIAL_CHECK_TRUE(start_driver(0, false));
	unsigned int revision = property_revision(AUX_GPIO_OUTLETS_PROPERTY_NAME);
	ASSERT_EQ_INT(INDIGO_OK, indigo_change_switch_property_1(&simulator_test_client, RPIO_DEVICE_NAME, AUX_GPIO_OUTLETS_PROPERTY_NAME, AUX_GPIO_OUTLETS_OUTLET_3_ITEM_NAME, true));
	SERIAL_CHECK_TRUE(wait_for_property_state_after(AUX_GPIO_OUTLETS_PROPERTY_NAME, INDIGO_OK_STATE, revision));
	ASSERT_EQ_INT(1, fake_pin_value(driver_output_pins[2]));
	ASSERT_TRUE(fake_trace_contains("value 13 1"));
	assert_switch_item_value(AUX_GPIO_OUTLETS_PROPERTY_NAME, AUX_GPIO_OUTLETS_OUTLET_3_ITEM_NAME, true);
	revision = property_revision(AUX_GPIO_OUTLETS_PROPERTY_NAME);
	ASSERT_EQ_INT(INDIGO_OK, indigo_change_switch_property_1(&simulator_test_client, RPIO_DEVICE_NAME, AUX_GPIO_OUTLETS_PROPERTY_NAME, AUX_GPIO_OUTLETS_OUTLET_3_ITEM_NAME, false));
	SERIAL_CHECK_TRUE(wait_for_property_state_after(AUX_GPIO_OUTLETS_PROPERTY_NAME, INDIGO_OK_STATE, revision));
	ASSERT_EQ_INT(0, fake_pin_value(driver_output_pins[2]));
	ASSERT_TRUE(fake_trace_contains("value 13 0"));
cleanup:
	stop_driver();
}

static void pulsed_output_returns_to_zero(void) {
	SERIAL_CHECK_TRUE(start_driver(0, false));
	ASSERT_EQ_INT(INDIGO_OK, indigo_change_number_property_1(&simulator_test_client, RPIO_DEVICE_NAME, AUX_OUTLET_PULSE_LENGTHS_PROPERTY_NAME, AUX_GPIO_OUTLETS_OUTLET_4_ITEM_NAME, 200));
	SERIAL_CHECK_TRUE(wait_for_property_state(AUX_OUTLET_PULSE_LENGTHS_PROPERTY_NAME, INDIGO_OK_STATE));
	ASSERT_EQ_INT(INDIGO_OK, indigo_change_switch_property_1(&simulator_test_client, RPIO_DEVICE_NAME, AUX_GPIO_OUTLETS_PROPERTY_NAME, AUX_GPIO_OUTLETS_OUTLET_4_ITEM_NAME, true));
	SERIAL_CHECK_TRUE(wait_for_property_state(AUX_GPIO_OUTLETS_PROPERTY_NAME, INDIGO_OK_STATE));
	ASSERT_EQ_INT(1, fake_pin_value(driver_output_pins[3]));
	for (int i = 0; i < 200 && fake_pin_value(driver_output_pins[3]) != 0; i++) {
		indigo_usleep(10000);
	}
	ASSERT_EQ_INT(0, fake_pin_value(driver_output_pins[3]));
	assert_switch_item_value(AUX_GPIO_OUTLETS_PROPERTY_NAME, AUX_GPIO_OUTLETS_OUTLET_4_ITEM_NAME, false);
cleanup:
	stop_driver();
}

static void inputs_are_polled_and_published(void) {
	SERIAL_CHECK_TRUE(start_driver(0, false));
	fake_set_pin_value(driver_input_pins[0], 1);
	fake_set_pin_value(driver_input_pins[5], 1);
	SERIAL_CHECK_TRUE(wait_for_number_item_value(AUX_GPIO_SENSORS_PROPERTY_NAME, AUX_GPIO_SENSOR_NAME_1_ITEM_NAME, 1, 0.01));
	SERIAL_CHECK_TRUE(wait_for_number_item_value(AUX_GPIO_SENSORS_PROPERTY_NAME, AUX_GPIO_SENSOR_NAME_6_ITEM_NAME, 1, 0.01));
	ASSERT_NEAR(0, cached_number_value(AUX_GPIO_SENSORS_PROPERTY_NAME, AUX_GPIO_SENSOR_NAME_2_ITEM_NAME), 0.01);
	ASSERT_TRUE(fake_trace_count_of("read value 19") > 0);
cleanup:
	stop_driver();
}

static void pwm_channels_are_programmed_when_present(void) {
	SERIAL_CHECK_TRUE(start_driver_with_pwm(0));
	assert_defined_property(AUX_GPIO_OUTLET_FREQUENCIES_PROPERTY_NAME);
	assert_defined_property(AUX_GPIO_OUTLET_DUTY_PROPERTY_NAME);
	ASSERT_TRUE(fake_trace_contains("pwm-export 0"));
	ASSERT_TRUE(fake_trace_contains("pwm-export 1"));
	ASSERT_TRUE(fake_trace_contains("pwm-period 0 10000000"));
	ASSERT_TRUE(fake_trace_contains("pwm-duty 0 10000000"));
	ASSERT_FALSE(fake_pin_exported(driver_output_pins[0]));
	ASSERT_FALSE(fake_pin_exported(driver_output_pins[1]));
	unsigned int revision = property_revision(AUX_GPIO_OUTLET_FREQUENCIES_PROPERTY_NAME);
	ASSERT_EQ_INT(INDIGO_OK, indigo_change_number_property_1(&simulator_test_client, RPIO_DEVICE_NAME, AUX_GPIO_OUTLET_FREQUENCIES_PROPERTY_NAME, AUX_GPIO_OUTLETS_OUTLET_1_ITEM_NAME, 200));
	SERIAL_CHECK_TRUE(wait_for_property_state_after(AUX_GPIO_OUTLET_FREQUENCIES_PROPERTY_NAME, INDIGO_OK_STATE, revision));
	ASSERT_TRUE(fake_trace_contains("pwm-period 0 5000000"));
	record_reference_trace("pwm_channels_are_programmed_when_present");
cleanup:
	stop_driver();
}

// The default is off, so a PWM chip that exists but may not be wired to any
// header pin never takes the two outputs away from plain GPIO.
static void pwm_is_off_by_default(void) {
	SERIAL_CHECK_TRUE(start_driver(0, true));
	ASSERT_EQ_INT(0, fake_trace_count_of("pwm-export"));
	for (int i = 0; i < 8; i++) {
		ASSERT_TRUE(fake_pin_exported(driver_output_pins[i]));
	}
	ASSERT_EQ_INT(16, fake_exported_pin_count());
cleanup:
	stop_driver();
}

static void pwm_properties_are_hidden_without_a_chip(void) {
	SERIAL_CHECK_TRUE(start_driver(0, false));
	ASSERT_EQ_INT(0, fake_trace_count_of("pwm-export"));
	// With PWM switched off the driver does not look for a chip at all.
	ASSERT_EQ_INT(0, fake_trace_count_of("opendir /sys/class/pwm"));
	ASSERT_EQ_INT(0, fake_trace_count_of("opendir-enoent /sys/class/pwm"));
	ASSERT_TRUE(fake_pin_exported(driver_output_pins[0]));
	ASSERT_TRUE(fake_pin_exported(driver_output_pins[1]));
cleanup:
	stop_driver();
}

// D6 reproducer. A failed PWM readback must not be turned into a period of zero
// and written back to the device, and must not publish inf or nan.
static void failed_pwm_readback_is_not_written_back(void) {
	SERIAL_CHECK_TRUE(start_driver_with_pwm(0));
	pthread_mutex_lock(&fake.mutex);
	fake.pwm_read_fails = true;
	fake.trace_count = 0;
	pthread_mutex_unlock(&fake.mutex);
	ASSERT_EQ_INT(INDIGO_OK, indigo_change_number_property_1(&simulator_test_client, RPIO_DEVICE_NAME, AUX_GPIO_OUTLET_DUTY_PROPERTY_NAME, AUX_GPIO_OUTLETS_OUTLET_1_ITEM_NAME, 50));
	SERIAL_CHECK_TRUE(wait_for_property_state(AUX_GPIO_OUTLET_DUTY_PROPERTY_NAME, INDIGO_OK_STATE));
	ASSERT_EQ_INT(0, fake_trace_count_of("pwm-period 0 0"));
	ASSERT_EQ_INT(0, fake_trace_count_of("pwm-duty 0 0"));
cleanup:
	pthread_mutex_lock(&fake.mutex);
	fake.pwm_read_fails = false;
	pthread_mutex_unlock(&fake.mutex);
	stop_driver();
}

// D4 and D7 reproducer. A rejected export must fail the connection with a clear
// state, and must not leave the connection switch with no item set.
static void rejected_export_fails_the_connection_cleanly(void) {
	SERIAL_CHECK_TRUE(bring_up_driver(0, false));
	pthread_mutex_lock(&fake.mutex);
	fake.fail_export_after = 0;
	pthread_mutex_unlock(&fake.mutex);
	enumerate_simulator_device();
	ASSERT_EQ_INT(INDIGO_OK, indigo_change_switch_property_1(&simulator_test_client, RPIO_DEVICE_NAME, CONNECTION_PROPERTY_NAME, CONNECTION_CONNECTED_ITEM_NAME, true));
	SERIAL_CHECK_TRUE(wait_for_property_not_busy(CONNECTION_PROPERTY_NAME));
	assert_switch_item_value(CONNECTION_PROPERTY_NAME, CONNECTION_CONNECTED_ITEM_NAME, false);
	assert_switch_item_value(CONNECTION_PROPERTY_NAME, CONNECTION_DISCONNECTED_ITEM_NAME, true);
	ASSERT_TRUE(fake_trace_contains("export-fail 18"));
cleanup:
	stop_driver();
}

// D7 reproducer. An export that fails partway through must roll back the pins
// that were already exported by the same attempt.
static void failed_connect_rolls_back_exported_pins(void) {
	SERIAL_CHECK_TRUE(bring_up_driver(0, false));
	pthread_mutex_lock(&fake.mutex);
	fake.fail_export_after = 5;
	pthread_mutex_unlock(&fake.mutex);
	enumerate_simulator_device();
	ASSERT_EQ_INT(INDIGO_OK, indigo_change_switch_property_1(&simulator_test_client, RPIO_DEVICE_NAME, CONNECTION_PROPERTY_NAME, CONNECTION_CONNECTED_ITEM_NAME, true));
	SERIAL_CHECK_TRUE(wait_for_property_not_busy(CONNECTION_PROPERTY_NAME));
	ASSERT_EQ_INT(0, fake_exported_pin_count());
cleanup:
	stop_driver();
}

// D5 reproducer. A zero length read of a value file is a failure, not the
// value zero read out of an uninitialized buffer.
static void empty_value_read_is_an_error(void) {
	SERIAL_CHECK_TRUE(start_driver(0, false));
	unsigned int revision = property_revision(AUX_GPIO_SENSORS_PROPERTY_NAME);
	pthread_mutex_lock(&fake.mutex);
	fake.value_read_empty = true;
	pthread_mutex_unlock(&fake.mutex);
	SERIAL_CHECK_TRUE(wait_for_property_state_seen_after(AUX_GPIO_SENSORS_PROPERTY_NAME, INDIGO_ALERT_STATE, revision));
cleanup:
	pthread_mutex_lock(&fake.mutex);
	fake.value_read_empty = false;
	pthread_mutex_unlock(&fake.mutex);
	stop_driver();
}

// D9 reproducer. Connect must not spend a fixed second sleeping.
static void connect_does_not_sleep_for_a_fixed_second(void) {
	SERIAL_CHECK_TRUE(start_driver(0, false));
	printf("connect slept %ld us in %d calls\n", fake.slept_total, fake.sleep_calls);
	ASSERT_TRUE(fake.slept_total < 200000);
cleanup:
	stop_driver();
}

static void connect_tolerates_a_late_direction_file(void) {
	SERIAL_CHECK_TRUE(bring_up_driver(0, false));
	pthread_mutex_lock(&fake.mutex);
	fake.direction_appears_late = true;
	pthread_mutex_unlock(&fake.mutex);
	SERIAL_CHECK_TRUE(connect_driver());
	for (int i = 0; i < 8; i++) {
		ASSERT_FALSE(fake_pin_is_input(driver_output_pins[i]));
		ASSERT_TRUE(fake_pin_is_input(driver_input_pins[i]));
	}
cleanup:
	stop_driver();
}

static void names_are_applied_to_labels(void) {
	SERIAL_CHECK_TRUE(start_driver(0, false));
	ASSERT_EQ_INT(INDIGO_OK, indigo_change_text_property_1_raw(&simulator_test_client, RPIO_DEVICE_NAME, AUX_OUTLET_NAMES_PROPERTY_NAME, AUX_GPIO_OUTLET_NAME_1_ITEM_NAME, "Dew heater"));
	SERIAL_CHECK_TRUE(wait_for_property_state(AUX_OUTLET_NAMES_PROPERTY_NAME, INDIGO_OK_STATE));
	indigo_item *item = find_cached_item(AUX_GPIO_OUTLETS_PROPERTY_NAME, AUX_GPIO_OUTLETS_OUTLET_1_ITEM_NAME);
	SERIAL_CHECK_TRUE(item != NULL);
	ASSERT_STREQ("Dew heater", item->label);
	ASSERT_EQ_INT(INDIGO_OK, indigo_change_text_property_1_raw(&simulator_test_client, RPIO_DEVICE_NAME, AUX_SENSOR_NAMES_PROPERTY_NAME, AUX_GPIO_SENSOR_NAME_1_ITEM_NAME, "Rain"));
	SERIAL_CHECK_TRUE(wait_for_property_state(AUX_SENSOR_NAMES_PROPERTY_NAME, INDIGO_OK_STATE));
	item = find_cached_item(AUX_GPIO_SENSORS_PROPERTY_NAME, AUX_GPIO_SENSOR_NAME_1_ITEM_NAME);
	SERIAL_CHECK_TRUE(item != NULL);
	ASSERT_STREQ("Rain", item->label);
cleanup:
	stop_driver();
}

static void disconnect_unexports_and_reconnect_works(void) {
	SERIAL_CHECK_TRUE(start_driver(0, false));
	ASSERT_EQ_INT(16, fake_exported_pin_count());
	disconnect_serial_device(&driver);
	ASSERT_EQ_INT(0, fake_exported_pin_count());
	ASSERT_TRUE(fake_trace_contains("unexport 18"));
	assert_property_deleted(AUX_GPIO_OUTLETS_PROPERTY_NAME);
	assert_property_deleted(AUX_OUTLET_PULSE_LENGTHS_PROPERTY_NAME);
	assert_property_deleted(AUX_GPIO_SENSORS_PROPERTY_NAME);
	SERIAL_CHECK_TRUE(connect_driver());
	ASSERT_EQ_INT(16, fake_exported_pin_count());
	assert_defined_property(AUX_GPIO_OUTLETS_PROPERTY_NAME);
cleanup:
	stop_driver();
}

static void shutdown_is_rejected_while_connected(void) {
	SERIAL_CHECK_TRUE(start_driver(0, false));
	ASSERT_EQ_INT(INDIGO_BUSY, driver.entry(INDIGO_DRIVER_SHUTDOWN, NULL));
	ASSERT_EQ_INT(16, fake_exported_pin_count());
cleanup:
	stop_driver();
}

static void repeated_init_and_shutdown(void) {
	for (int i = 0; i < 3; i++) {
		SERIAL_CHECK_TRUE(start_driver(0, false));
		ASSERT_EQ_INT(INDIGO_OK, driver.entry(INDIGO_DRIVER_INIT, NULL));
		stop_driver();
		ASSERT_EQ_INT(0, fake_exported_pin_count());
	}
	return;
cleanup:
	stop_driver();
}

int main(void) {
	setvbuf(stdout, NULL, _IONBF, 0);
	alarm(300);
	pthread_mutex_init(&fake.mutex, NULL);
	const indigo_test_case tests[] = {
		{ "driver metadata, interface and property contract", contract },
		{ "connect exports and configures every pin", connect_exports_every_pin },
		{ "pins are offset by the controller base", connect_offsets_pins_by_the_controller_base },
		{ "outputs are written and read back", outputs_are_written_and_read_back },
		{ "pulsed output returns to zero", pulsed_output_returns_to_zero },
		{ "inputs are polled and published", inputs_are_polled_and_published },
		{ "PWM is off by default", pwm_is_off_by_default },
		{ "PWM channels are programmed when present", pwm_channels_are_programmed_when_present },
		{ "plain GPIO is used when no PWM chip is present", pwm_properties_are_hidden_without_a_chip },
		{ "failed PWM readback is not written back", failed_pwm_readback_is_not_written_back },
		{ "rejected export fails the connection cleanly", rejected_export_fails_the_connection_cleanly },
		{ "failed connect rolls back exported pins", failed_connect_rolls_back_exported_pins },
		{ "empty value read is an error", empty_value_read_is_an_error },
		{ "connect does not sleep for a fixed second", connect_does_not_sleep_for_a_fixed_second },
		{ "connect tolerates a late direction file", connect_tolerates_a_late_direction_file },
		{ "names are applied to labels", names_are_applied_to_labels },
		{ "disconnect unexports and reconnect works", disconnect_unexports_and_reconnect_works },
		{ "shutdown is rejected while connected", shutdown_is_rejected_while_connected },
		{ "repeated initialization and shutdown", repeated_init_and_shutdown }
	};
	// A single scenario can be selected while a failure is being investigated,
	// so one case can be run with its full trace instead of the whole suite.
	const char *filter = getenv("INDIGO_TEST_FILTER");
	if (filter != NULL) {
		indigo_test_case selected[ARRAY_SIZE(tests)];
		int count = 0;
		for (int i = 0; i < (int)ARRAY_SIZE(tests); i++) {
			if (strstr(tests[i].name, filter) != NULL) {
				selected[count++] = tests[i];
			}
		}
		return indigo_run_tests("aux_rpio fake sysfs integration tests", selected, count);
	}
	return indigo_run_tests("aux_rpio fake sysfs integration tests", tests, ARRAY_SIZE(tests));
}
