// Copyright (c) 2026 INDIGO initiative
// All rights reserved.
//
// You may use this software under the terms of 'INDIGO Astronomy
// open-source license' (see LICENSE.md).
//
// THIS SOFTWARE IS PROVIDED BY THE AUTHORS 'AS IS' AND ANY EXPRESS
// OR IMPLIED WARRANTIES, INCLUDING, BUT NOT LIMITED TO, THE IMPLIED
// WARRANTIES OF MERCHANTABILITY AND FITNESS FOR A PARTICULAR PURPOSE
// ARE DISCLAIMED. IN NO EVENT SHALL THE AUTHOR BE LIABLE FOR ANY
// DIRECT, INDIRECT, INCIDENTAL, SPECIAL, EXEMPLARY, OR CONSEQUENTIAL
// DAMAGES (INCLUDING, BUT NOT LIMITED TO, PROCUREMENT OF SUBSTITUTE
// GOODS OR SERVICES; LOSS OF USE, DATA, OR PROFITS; OR BUSINESS
// INTERRUPTION) HOWEVER CAUSED AND ON ANY THEORY OF LIABILITY,
// WHETHER IN CONTRACT, STRICT LIABILITY, OR TORT (INCLUDING
// NEGLIGENCE OR OTHERWISE) ARISING IN ANY WAY OUT OF THE USE OF THIS
// SOFTWARE, EVEN IF ADVISED OF THE POSSIBILITY OF SUCH DAMAGE.

// Code is generated by AI

// AUX lightbox coverage for indigo_aux_geoptikflat against the standalone Geoptik simulator over a
// real PTY. The Geoptik flat field generator speaks the Alnitak generic command set documented in
// ../../indigo_drivers/aux_flipflat/Alnitak_GenericCommandsR4.pdf, so the contract checked here is
// the exact command text on the wire (">POOO", ">VOOO", ">Bxxx", ">LOOO", ">DOOO"), the position of
// the firmware version inside "*Viivvv", the percent to 0-255 intensity conversion, the replay of
// the persistent light state on connect, and the rejection of replies that do not echo the
// operation that was sent.

#include <indigo_drivers/aux_geoptikflat/indigo_aux_geoptikflat.h>

#include "serial_simulator_test_common.h"

#ifndef AUX_GEOPTIKFLAT_SIMULATOR_EXECUTABLE
#define AUX_GEOPTIKFLAT_SIMULATOR_EXECUTABLE "build/integration/aux_geoptikflat_simulator"
#endif

static const simulator_driver_case geoptikflat = {
	"Geoptik flat field generator",
	"indigo_aux_geoptikflat",
	"Geoptik Flat Generator",
	indigo_aux_geoptikflat,
	false,
	NULL, 0, NULL, 0, NULL, 0, NULL, 0
};

static const char *geoptikflat_base_properties[] = {
	INFO_PROPERTY_NAME,
	CONFIG_PROPERTY_NAME,
	PROFILE_NAME_PROPERTY_NAME,
	PROFILE_PROPERTY_NAME,
	DEVICE_PORT_PROPERTY_NAME,
	DEVICE_PORTS_PROPERTY_NAME,
	ADDITIONAL_INSTANCES_PROPERTY_NAME,
	CONNECTION_PROPERTY_NAME
};

static const char *geoptikflat_hidden_properties[] = {
	SIMULATION_PROPERTY_NAME,
	DEVICE_BAUDRATE_PROPERTY_NAME,
	AUTHENTICATION_PROPERTY_NAME,
	AUX_COVER_PROPERTY_NAME,
	AUX_POWER_OUTLET_PROPERTY_NAME
};

static const char *geoptikflat_connected_properties[] = {
	AUX_LIGHT_SWITCH_PROPERTY_NAME,
	AUX_LIGHT_INTENSITY_PROPERTY_NAME
};

// -------------------------------------------------------------------------------- simulator glue

static bool start_geoptikflat(external_serial_simulator *simulator, const char *device_id, const char *firmware) {
	if (device_id == NULL) {
		return start_external_serial_simulator(simulator, AUX_GEOPTIKFLAT_SIMULATOR_EXECUTABLE);
	}
	const char *arguments[] = { "--device-id", device_id, "--firmware", firmware, NULL };
	return start_external_serial_simulator_with_args(simulator, AUX_GEOPTIKFLAT_SIMULATOR_EXECUTABLE, arguments);
}

static void simulator_path(const external_serial_simulator *simulator, const char *suffix, char *path, size_t size) {
	snprintf(path, size, "%s.%s", simulator->ready_file, suffix);
}

// The simulator consumes one armed fault with the first command whose operation matches selector,
// so a fault can be aimed at ">B" without disturbing the ">POOO"/">VOOO" handshake around it.
static bool arm_fault(const external_serial_simulator *simulator, const char *action, const char *selector) {
	char path[PATH_MAX];
	simulator_path(simulator, "control", path, sizeof(path));
	FILE *file = fopen(path, "w");
	if (file == NULL) {
		return false;
	}
	fprintf(file, "%s %s\n", action, selector);
	return fclose(file) == 0;
}

static void clear_events(const external_serial_simulator *simulator) {
	char path[PATH_MAX];
	simulator_path(simulator, "events", path, sizeof(path));
	unlink(path);
}

static int event_count(const external_serial_simulator *simulator, const char *command) {
	char path[PATH_MAX];
	char line[64];
	int count = 0;
	simulator_path(simulator, "events", path, sizeof(path));
	FILE *file = fopen(path, "r");
	if (file == NULL) {
		return 0;
	}
	while (fgets(line, sizeof(line), file) != NULL) {
		line[strcspn(line, "\r\n")] = '\0';
		if (!strcmp(line, command)) {
			count++;
		}
	}
	fclose(file);
	return count;
}

static bool wait_for_event(const external_serial_simulator *simulator, const char *command, int expected_count) {
	for (int i = 0; i < 100; i++) {
		if (event_count(simulator, command) >= expected_count) {
			return true;
		}
		indigo_usleep(100000);
	}
	fprintf(stderr, "'%s' was recorded %d times, expected %d\n", command, event_count(simulator, command), expected_count);
	return false;
}

// Read the whole recorded command stream so a case can assert the order of the handshake.
static bool events_start_with(const external_serial_simulator *simulator, const char * const *commands, int count) {
	char path[PATH_MAX];
	char line[64];
	simulator_path(simulator, "events", path, sizeof(path));
	FILE *file = fopen(path, "r");
	if (file == NULL) {
		fprintf(stderr, "no command was recorded\n");
		return false;
	}
	bool matched = true;
	for (int i = 0; i < count; i++) {
		if (fgets(line, sizeof(line), file) == NULL) {
			fprintf(stderr, "command %d is missing, expected '%s'\n", i, commands[i]);
			matched = false;
			break;
		}
		line[strcspn(line, "\r\n")] = '\0';
		if (strcmp(line, commands[i])) {
			fprintf(stderr, "command %d is '%s', expected '%s'\n", i, line, commands[i]);
			matched = false;
			break;
		}
	}
	fclose(file);
	return matched;
}

// -------------------------------------------------------------------------------- request helpers

// The harness keeps an append-only list of every property it has ever seen defined, so the live
// visibility of the connection-dependent properties is read from the property cache, which does
// follow deletion.
static bool connected_properties_published(bool expected) {
	for (int i = 0; i < ARRAY_SIZE(geoptikflat_connected_properties); i++) {
		if ((find_cached_property(geoptikflat_connected_properties[i]) != NULL) != expected) {
			fprintf(stderr, "%s is %spublished\n", geoptikflat_connected_properties[i], expected ? "not " : "");
			return false;
		}
	}
	return true;
}

static const char *info_text(const char *item_name) {
	indigo_item *item = find_cached_item(INFO_PROPERTY_NAME, item_name);
	return item == NULL ? "" : item->text.value;
}

static bool change_intensity(double percent, indigo_property_state expected_state) {
	unsigned int revision = property_revision(AUX_LIGHT_INTENSITY_PROPERTY_NAME);
	if (indigo_change_number_property_1(&simulator_test_client, geoptikflat.device_name, AUX_LIGHT_INTENSITY_PROPERTY_NAME, AUX_LIGHT_INTENSITY_ITEM_NAME, percent) != INDIGO_OK) {
		return false;
	}
	return wait_for_property_state_after(AUX_LIGHT_INTENSITY_PROPERTY_NAME, expected_state, revision);
}

static bool change_light(const char *item_name, indigo_property_state expected_state) {
	unsigned int revision = property_revision(AUX_LIGHT_SWITCH_PROPERTY_NAME);
	if (indigo_change_switch_property_1(&simulator_test_client, geoptikflat.device_name, AUX_LIGHT_SWITCH_PROPERTY_NAME, item_name, true) != INDIGO_OK) {
		return false;
	}
	return wait_for_property_state_after(AUX_LIGHT_SWITCH_PROPERTY_NAME, expected_state, revision);
}

// Leave the persistent AUX_LIGHT_SWITCH and AUX_LIGHT_INTENSITY at their attach-time defaults so a
// case that saved a configuration cannot decide what the next case connects with.
static bool restore_saved_defaults(void) {
	return change_intensity(50, INDIGO_OK_STATE) && change_light(AUX_LIGHT_SWITCH_OFF_ITEM_NAME, INDIGO_OK_STATE) && save_configuration();
}

// -------------------------------------------------------------------------------- cases

// Driver metadata, the published property inventory before and after connection, the shape of both
// driver properties, and the identity the documented handshake produces.
static void identity_inventory_and_handshake(void) {
	external_serial_simulator simulator = { 0 };
	bool online = false;
	indigo_driver_info info;
	memset(&info, 0, sizeof(info));
	assert_simulator_driver_info(&geoptikflat);
	SERIAL_CHECK_TRUE(start_geoptikflat(&simulator, NULL, NULL));
	SERIAL_CHECK_TRUE(bring_up_serial_driver(&geoptikflat));
	online = true;
	enumerate_simulator_device();
	assert_device_interface(INDIGO_INTERFACE_AUX_LIGHTBOX);
	assert_defined_properties(geoptikflat_base_properties, ARRAY_SIZE(geoptikflat_base_properties));
	assert_not_defined_properties(geoptikflat_hidden_properties, ARRAY_SIZE(geoptikflat_hidden_properties));
	assert_not_defined_properties(geoptikflat_connected_properties, ARRAY_SIZE(geoptikflat_connected_properties));
	assert_defined_property_count(ARRAY_SIZE(geoptikflat_base_properties));
	SERIAL_CHECK_TRUE(!strcmp(info_text(INFO_DEVICE_MODEL_ITEM_NAME), "Unknown"));
	SERIAL_CHECK_TRUE(!strcmp(info_text(INFO_DEVICE_FW_REVISION_ITEM_NAME), "Unknown"));
	clear_events(&simulator);
	SERIAL_CHECK_TRUE(connect_serial_device(&geoptikflat, simulator.port));
	assert_serial_aux_class_property_completeness();
	assert_defined_properties(geoptikflat_connected_properties, ARRAY_SIZE(geoptikflat_connected_properties));
	assert_not_defined_properties(geoptikflat_hidden_properties, ARRAY_SIZE(geoptikflat_hidden_properties));
	assert_defined_property_count(ARRAY_SIZE(geoptikflat_base_properties) + ARRAY_SIZE(geoptikflat_connected_properties));
	indigo_property *light = find_cached_property(AUX_LIGHT_SWITCH_PROPERTY_NAME);
	indigo_property *intensity = find_cached_property(AUX_LIGHT_INTENSITY_PROPERTY_NAME);
	indigo_item *intensity_item = find_cached_item(AUX_LIGHT_INTENSITY_PROPERTY_NAME, AUX_LIGHT_INTENSITY_ITEM_NAME);
	SERIAL_CHECK_TRUE(light != NULL && light->type == INDIGO_SWITCH_VECTOR && light->perm == INDIGO_RW_PERM && light->rule == INDIGO_ONE_OF_MANY_RULE && light->count == 2);
	assert_property_has_item(AUX_LIGHT_SWITCH_PROPERTY_NAME, AUX_LIGHT_SWITCH_ON_ITEM_NAME);
	assert_property_has_item(AUX_LIGHT_SWITCH_PROPERTY_NAME, AUX_LIGHT_SWITCH_OFF_ITEM_NAME);
	SERIAL_CHECK_TRUE(intensity != NULL && intensity->type == INDIGO_NUMBER_VECTOR && intensity->perm == INDIGO_RW_PERM && intensity->count == 1);
	SERIAL_CHECK_TRUE(intensity_item != NULL && intensity_item->number.min == 0 && intensity_item->number.max == 100 && intensity_item->number.step == 1 && !strcmp(intensity_item->number.format, "%g"));
	assert_number_item_in_range(AUX_LIGHT_INTENSITY_PROPERTY_NAME, AUX_LIGHT_INTENSITY_ITEM_NAME);
	assert_switch_item_value(AUX_LIGHT_SWITCH_PROPERTY_NAME, AUX_LIGHT_SWITCH_OFF_ITEM_NAME, true);
	SERIAL_CHECK_TRUE(intensity_item->number.value == 50);
	// Ping, version, then the two commands that push the attach-time state into the device.
	static const char *handshake[] = { ">POOO", ">VOOO", ">B127", ">DOOO" };
	SERIAL_CHECK_TRUE(wait_for_event(&simulator, ">DOOO", 1));
	SERIAL_CHECK_TRUE(events_start_with(&simulator, handshake, ARRAY_SIZE(handshake)));
	SERIAL_CHECK_EQ_INT(INDIGO_OK, geoptikflat.entry(INDIGO_DRIVER_INFO, &info));
	SERIAL_CHECK_TRUE(!strcmp(info_text(INFO_DEVICE_MODEL_ITEM_NAME), info.description));
	SERIAL_CHECK_TRUE(!strcmp(info_text(INFO_DEVICE_FW_REVISION_ITEM_NAME), "003"));
	SERIAL_CHECK_EQ_INT(INDIGO_DRIVER_API_3, INDIGO_DRIVER_API_GENERATION(info.version));
cleanup:
	if (online) {
		stop_serial_driver(&geoptikflat);
	}
	stop_external_serial_simulator(&simulator);
}

// "*Viivvv" puts the two digit product id in front of the firmware version, so the reported
// revision must not carry the id and must not be accepted when the payload is missing entirely.
static void firmware_is_read_from_the_documented_offset(void) {
	external_serial_simulator simulator = { 0 };
	bool online = false;
	SERIAL_CHECK_TRUE(start_geoptikflat(&simulator, "15", "142"));
	SERIAL_CHECK_TRUE(start_serial_driver(&geoptikflat, simulator.port));
	online = true;
	SERIAL_CHECK_TRUE(!strcmp(info_text(INFO_DEVICE_FW_REVISION_ITEM_NAME), "142"));
	disconnect_serial_device(&geoptikflat);
	SERIAL_CHECK_TRUE(!strcmp(info_text(INFO_DEVICE_FW_REVISION_ITEM_NAME), "Unknown"));
	SERIAL_CHECK_TRUE(!strcmp(info_text(INFO_DEVICE_MODEL_ITEM_NAME), "Unknown"));
	SERIAL_CHECK_TRUE(arm_fault(&simulator, "short", "V"));
	SERIAL_CHECK_TRUE(!connect_serial_device(&geoptikflat, simulator.port));
	SERIAL_CHECK_TRUE(wait_for_property_state(CONNECTION_PROPERTY_NAME, INDIGO_ALERT_STATE));
	SERIAL_CHECK_TRUE(!strcmp(info_text(INFO_DEVICE_FW_REVISION_ITEM_NAME), "Unknown"));
	SERIAL_CHECK_TRUE(connect_serial_device(&geoptikflat, simulator.port));
	SERIAL_CHECK_TRUE(!strcmp(info_text(INFO_DEVICE_FW_REVISION_ITEM_NAME), "142"));
cleanup:
	if (online) {
		stop_serial_driver(&geoptikflat);
	}
	stop_external_serial_simulator(&simulator);
}

// AUX_LIGHT_INTENSITY is a percentage; the device takes 0-255 in ">Bxxx".
static void intensity_maps_percent_to_the_device_scale(void) {
	external_serial_simulator simulator = { 0 };
	bool online = false;
	static const struct { double percent; const char *command; } steps[] = {
		{ 0, ">B000" },
		{ 25, ">B063" },
		{ 50, ">B127" },
		{ 75, ">B191" },
		{ 100, ">B255" }
	};
	SERIAL_CHECK_TRUE(start_geoptikflat(&simulator, NULL, NULL));
	SERIAL_CHECK_TRUE(start_serial_driver(&geoptikflat, simulator.port));
	online = true;
	clear_events(&simulator);
	for (int i = 0; i < ARRAY_SIZE(steps); i++) {
		SERIAL_CHECK_TRUE(change_intensity(steps[i].percent, INDIGO_OK_STATE));
		SERIAL_CHECK_TRUE(wait_for_event(&simulator, steps[i].command, 1));
		SERIAL_CHECK_TRUE(cached_number_value(AUX_LIGHT_INTENSITY_PROPERTY_NAME, AUX_LIGHT_INTENSITY_ITEM_NAME) == steps[i].percent);
	}
cleanup:
	if (online) {
		stop_serial_driver(&geoptikflat);
	}
	stop_external_serial_simulator(&simulator);
}

// The one-of-many switch maps to the documented ">LOOO" and ">DOOO" commands.
static void light_switch_sends_the_documented_commands(void) {
	external_serial_simulator simulator = { 0 };
	bool online = false;
	SERIAL_CHECK_TRUE(start_geoptikflat(&simulator, NULL, NULL));
	SERIAL_CHECK_TRUE(start_serial_driver(&geoptikflat, simulator.port));
	online = true;
	clear_events(&simulator);
	SERIAL_CHECK_TRUE(change_light(AUX_LIGHT_SWITCH_ON_ITEM_NAME, INDIGO_OK_STATE));
	SERIAL_CHECK_TRUE(wait_for_event(&simulator, ">LOOO", 1));
	assert_switch_item_value(AUX_LIGHT_SWITCH_PROPERTY_NAME, AUX_LIGHT_SWITCH_ON_ITEM_NAME, true);
	assert_switch_item_value(AUX_LIGHT_SWITCH_PROPERTY_NAME, AUX_LIGHT_SWITCH_OFF_ITEM_NAME, false);
	SERIAL_CHECK_TRUE(change_light(AUX_LIGHT_SWITCH_OFF_ITEM_NAME, INDIGO_OK_STATE));
	SERIAL_CHECK_TRUE(wait_for_event(&simulator, ">DOOO", 1));
	assert_switch_item_value(AUX_LIGHT_SWITCH_PROPERTY_NAME, AUX_LIGHT_SWITCH_ON_ITEM_NAME, false);
	assert_switch_item_value(AUX_LIGHT_SWITCH_PROPERTY_NAME, AUX_LIGHT_SWITCH_OFF_ITEM_NAME, true);
	SERIAL_CHECK_EQ_INT(0, event_count(&simulator, ">B127"));
cleanup:
	if (online) {
		stop_serial_driver(&geoptikflat);
	}
	stop_external_serial_simulator(&simulator);
}

// A reply that does not echo the operation that was sent is not an answer to it. Every rejected
// request must be reported and must not stop the next one from succeeding.
static void unmatched_replies_fail_the_request(void) {
	external_serial_simulator simulator = { 0 };
	bool online = false;
	static const char *faults[] = { "drop", "malformed", "mismatch" };
	SERIAL_CHECK_TRUE(start_geoptikflat(&simulator, NULL, NULL));
	SERIAL_CHECK_TRUE(start_serial_driver(&geoptikflat, simulator.port));
	online = true;
	for (int i = 0; i < ARRAY_SIZE(faults); i++) {
		SERIAL_CHECK_TRUE(change_intensity(30, INDIGO_OK_STATE));
		SERIAL_CHECK_TRUE(arm_fault(&simulator, faults[i], "B"));
		SERIAL_CHECK_TRUE(change_intensity(60, INDIGO_ALERT_STATE));
		SERIAL_CHECK_TRUE(change_intensity(60, INDIGO_OK_STATE));
		SERIAL_CHECK_TRUE(change_light(AUX_LIGHT_SWITCH_OFF_ITEM_NAME, INDIGO_OK_STATE));
		SERIAL_CHECK_TRUE(arm_fault(&simulator, faults[i], "L"));
		SERIAL_CHECK_TRUE(change_light(AUX_LIGHT_SWITCH_ON_ITEM_NAME, INDIGO_ALERT_STATE));
		SERIAL_CHECK_TRUE(change_light(AUX_LIGHT_SWITCH_ON_ITEM_NAME, INDIGO_OK_STATE));
	}
cleanup:
	if (online) {
		stop_serial_driver(&geoptikflat);
	}
	stop_external_serial_simulator(&simulator);
}

// An unsolicited line in front of the real reply desynchronizes the exchange; the leftover must be
// drained by the discard that precedes the next command rather than answering it.
static void a_stale_reply_is_discarded_before_the_next_command(void) {
	external_serial_simulator simulator = { 0 };
	bool online = false;
	SERIAL_CHECK_TRUE(start_geoptikflat(&simulator, NULL, NULL));
	SERIAL_CHECK_TRUE(start_serial_driver(&geoptikflat, simulator.port));
	online = true;
	SERIAL_CHECK_TRUE(change_intensity(20, INDIGO_OK_STATE));
	SERIAL_CHECK_TRUE(arm_fault(&simulator, "stale", "B"));
	SERIAL_CHECK_TRUE(change_intensity(40, INDIGO_ALERT_STATE));
	SERIAL_CHECK_TRUE(change_intensity(40, INDIGO_OK_STATE));
	SERIAL_CHECK_TRUE(change_light(AUX_LIGHT_SWITCH_ON_ITEM_NAME, INDIGO_OK_STATE));
cleanup:
	if (online) {
		stop_serial_driver(&geoptikflat);
	}
	stop_external_serial_simulator(&simulator);
}

// Both driver properties are persistent. A restored configuration has to reach the device, and the
// restored state has to be pushed again by the next connection rather than the attach-time default.
static void configuration_roundtrip_reaches_the_device(void) {
	external_serial_simulator simulator = { 0 };
	bool online = false;
	SERIAL_CHECK_TRUE(start_geoptikflat(&simulator, NULL, NULL));
	SERIAL_CHECK_TRUE(start_serial_driver(&geoptikflat, simulator.port));
	online = true;
	SERIAL_CHECK_TRUE(change_intensity(75, INDIGO_OK_STATE));
	SERIAL_CHECK_TRUE(change_light(AUX_LIGHT_SWITCH_ON_ITEM_NAME, INDIGO_OK_STATE));
	SERIAL_CHECK_TRUE(save_configuration());
	disconnect_serial_device(&geoptikflat);
	tear_down_serial_driver(&geoptikflat);
	online = false;
	clear_events(&simulator);
	SERIAL_CHECK_TRUE(start_serial_driver(&geoptikflat, simulator.port));
	online = true;
	// A freshly attached device connects with the attach-time defaults, not with the saved state.
	static const char *defaults[] = { ">POOO", ">VOOO", ">B127", ">DOOO" };
	SERIAL_CHECK_TRUE(wait_for_event(&simulator, ">DOOO", 1));
	SERIAL_CHECK_TRUE(events_start_with(&simulator, defaults, ARRAY_SIZE(defaults)));
	SERIAL_CHECK_TRUE(cached_number_value(AUX_LIGHT_INTENSITY_PROPERTY_NAME, AUX_LIGHT_INTENSITY_ITEM_NAME) == 50);
	clear_events(&simulator);
	unsigned int revision = property_revision(CONFIG_PROPERTY_NAME);
	SERIAL_CHECK_EQ_INT(INDIGO_OK, indigo_change_switch_property_1(&simulator_test_client, geoptikflat.device_name, CONFIG_PROPERTY_NAME, CONFIG_LOAD_ITEM_NAME, true));
	SERIAL_CHECK_TRUE(wait_for_property_state_after(CONFIG_PROPERTY_NAME, INDIGO_OK_STATE, revision));
	// The restore replays the saved values as ordinary change requests, so the device follows them.
	SERIAL_CHECK_TRUE(wait_for_event(&simulator, ">B191", 1));
	SERIAL_CHECK_TRUE(wait_for_event(&simulator, ">LOOO", 1));
	SERIAL_CHECK_TRUE(wait_for_number_item_value(AUX_LIGHT_INTENSITY_PROPERTY_NAME, AUX_LIGHT_INTENSITY_ITEM_NAME, 75, 0));
	assert_switch_item_value(AUX_LIGHT_SWITCH_PROPERTY_NAME, AUX_LIGHT_SWITCH_ON_ITEM_NAME, true);
	disconnect_serial_device(&geoptikflat);
	clear_events(&simulator);
	SERIAL_CHECK_TRUE(connect_serial_device(&geoptikflat, simulator.port));
	static const char *restored[] = { ">POOO", ">VOOO", ">B191", ">LOOO" };
	SERIAL_CHECK_TRUE(wait_for_event(&simulator, ">LOOO", 1));
	SERIAL_CHECK_TRUE(events_start_with(&simulator, restored, ARRAY_SIZE(restored)));
	SERIAL_CHECK_TRUE(restore_saved_defaults());
cleanup:
	if (online) {
		stop_serial_driver(&geoptikflat);
	}
	stop_external_serial_simulator(&simulator);
}

// A handshake that fails at any of its steps must leave the device disconnected with the serial
// port released, and must not prevent a later connection from succeeding.
static void handshake_failures_leave_the_device_disconnected(void) {
	external_serial_simulator simulator = { 0 };
	bool online = false;
	SERIAL_CHECK_TRUE(start_geoptikflat(&simulator, NULL, NULL));
	SERIAL_CHECK_TRUE(bring_up_serial_driver(&geoptikflat));
	online = true;
	enumerate_simulator_device();
	SERIAL_CHECK_EQ_INT(INDIGO_OK, indigo_change_text_property_1_raw(&simulator_test_client, geoptikflat.device_name, DEVICE_PORT_PROPERTY_NAME, DEVICE_PORT_ITEM_NAME, "/dev/indigo-nonexistent-geoptikflat-test"));
	unsigned int revision = property_revision(CONNECTION_PROPERTY_NAME);
	SERIAL_CHECK_EQ_INT(INDIGO_OK, indigo_change_switch_property_1(&simulator_test_client, geoptikflat.device_name, CONNECTION_PROPERTY_NAME, CONNECTION_CONNECTED_ITEM_NAME, true));
	SERIAL_CHECK_TRUE(wait_for_property_state_seen_after(CONNECTION_PROPERTY_NAME, INDIGO_ALERT_STATE, revision));
	SERIAL_CHECK_TRUE(!context.connected);
	assert_switch_item_value(CONNECTION_PROPERTY_NAME, CONNECTION_DISCONNECTED_ITEM_NAME, true);
	SERIAL_CHECK_TRUE(connected_properties_published(false));
	static const char *steps[] = { "P", "V" };
	for (int i = 0; i < ARRAY_SIZE(steps); i++) {
		SERIAL_CHECK_TRUE(arm_fault(&simulator, "drop", steps[i]));
		SERIAL_CHECK_TRUE(!connect_serial_device(&geoptikflat, simulator.port));
		SERIAL_CHECK_TRUE(wait_for_property_state(CONNECTION_PROPERTY_NAME, INDIGO_ALERT_STATE));
		SERIAL_CHECK_TRUE(!context.connected);
		SERIAL_CHECK_TRUE(find_cached_property(AUX_LIGHT_SWITCH_PROPERTY_NAME) == NULL);
	}
	SERIAL_CHECK_TRUE(arm_fault(&simulator, "mismatch", "P"));
	SERIAL_CHECK_TRUE(!connect_serial_device(&geoptikflat, simulator.port));
	SERIAL_CHECK_TRUE(!context.connected);
	SERIAL_CHECK_TRUE(connect_serial_device(&geoptikflat, simulator.port));
	SERIAL_CHECK_TRUE(change_intensity(35, INDIGO_OK_STATE));
cleanup:
	if (online) {
		disconnect_serial_device(&geoptikflat);
		tear_down_serial_driver(&geoptikflat);
	}
	stop_external_serial_simulator(&simulator);
}

// Losing the port while connected must be reported on the request that discovers it, and a fresh
// device on the same port must be usable again after a reconnect.
static void transport_loss_is_reported_and_reconnect_recovers(void) {
	external_serial_simulator simulator = { 0 };
	bool online = false;
	SERIAL_CHECK_TRUE(start_geoptikflat(&simulator, NULL, NULL));
	SERIAL_CHECK_TRUE(start_serial_driver(&geoptikflat, simulator.port));
	online = true;
	SERIAL_CHECK_TRUE(change_light(AUX_LIGHT_SWITCH_ON_ITEM_NAME, INDIGO_OK_STATE));
	SERIAL_CHECK_TRUE(arm_fault(&simulator, "close", "B"));
	SERIAL_CHECK_TRUE(change_intensity(45, INDIGO_ALERT_STATE));
	SERIAL_CHECK_TRUE(change_light(AUX_LIGHT_SWITCH_OFF_ITEM_NAME, INDIGO_ALERT_STATE));
	disconnect_serial_device(&geoptikflat);
	stop_external_serial_simulator(&simulator);
	SERIAL_CHECK_TRUE(start_geoptikflat(&simulator, NULL, NULL));
	SERIAL_CHECK_TRUE(connect_serial_device(&geoptikflat, simulator.port));
	SERIAL_CHECK_TRUE(change_intensity(45, INDIGO_OK_STATE));
	SERIAL_CHECK_TRUE(change_light(AUX_LIGHT_SWITCH_OFF_ITEM_NAME, INDIGO_OK_STATE));
cleanup:
	if (online) {
		disconnect_serial_device(&geoptikflat);
		tear_down_serial_driver(&geoptikflat);
	}
	stop_external_serial_simulator(&simulator);
}

// A redundant disconnect is a no-op, and the driver refuses to unload while a device is connected.
static void repeated_disconnect_and_refused_shutdown(void) {
	external_serial_simulator simulator = { 0 };
	bool online = false;
	SERIAL_CHECK_TRUE(start_geoptikflat(&simulator, NULL, NULL));
	SERIAL_CHECK_TRUE(start_serial_driver(&geoptikflat, simulator.port));
	online = true;
	SERIAL_CHECK_EQ_INT(INDIGO_BUSY, geoptikflat.entry(INDIGO_DRIVER_SHUTDOWN, NULL));
	SERIAL_CHECK_TRUE(context.connected);
	disconnect_serial_device(&geoptikflat);
	SERIAL_CHECK_TRUE(!context.connected);
	SERIAL_CHECK_TRUE(connected_properties_published(false));
	disconnect_serial_device(&geoptikflat);
	SERIAL_CHECK_TRUE(!context.connected);
	SERIAL_CHECK_TRUE(connect_serial_device(&geoptikflat, simulator.port));
	SERIAL_CHECK_TRUE(change_light(AUX_LIGHT_SWITCH_OFF_ITEM_NAME, INDIGO_OK_STATE));
cleanup:
	if (online) {
		disconnect_serial_device(&geoptikflat);
		tear_down_serial_driver(&geoptikflat);
	}
	stop_external_serial_simulator(&simulator);
}

int main(void) {
	// AUX_LIGHT_SWITCH and AUX_LIGHT_INTENSITY are persistent, so without a private HOME the cases
	// would save into, and restore from, the user's own configuration folder.
	if (!indigo_test_use_private_home()) {
		return 1;
	}
	const indigo_test_case tests[] = {
		{ "identity_inventory_and_handshake", identity_inventory_and_handshake },
		{ "firmware_is_read_from_the_documented_offset", firmware_is_read_from_the_documented_offset },
		{ "intensity_maps_percent_to_the_device_scale", intensity_maps_percent_to_the_device_scale },
		{ "light_switch_sends_the_documented_commands", light_switch_sends_the_documented_commands },
		{ "unmatched_replies_fail_the_request", unmatched_replies_fail_the_request },
		{ "a_stale_reply_is_discarded_before_the_next_command", a_stale_reply_is_discarded_before_the_next_command },
		{ "configuration_roundtrip_reaches_the_device", configuration_roundtrip_reaches_the_device },
		{ "handshake_failures_leave_the_device_disconnected", handshake_failures_leave_the_device_disconnected },
		{ "transport_loss_is_reported_and_reconnect_recovers", transport_loss_is_reported_and_reconnect_recovers },
		{ "repeated_disconnect_and_refused_shutdown", repeated_disconnect_and_refused_shutdown }
	};
	int result = indigo_run_tests("Geoptik flat field generator serial simulator integration tests", tests, ARRAY_SIZE(tests));
	indigo_test_remove_private_home();
	return result;
}
