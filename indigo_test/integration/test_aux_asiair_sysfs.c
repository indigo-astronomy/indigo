// Copyright (c) 2026 INDIGO initiative
// All rights reserved.
//
// You may use this software under the terms of 'INDIGO Astronomy
// open-source license' (see LICENSE.md).
//
// THIS SOFTWARE IS PROVIDED BY THE AUTHORS 'AS IS' AND ANY EXPRESS
// OR IMPLIED WARRANTIES, INCLUDING, BUT NOT LIMITED TO, THE IMPLIED
// WARRANTIES OF MERCHANTABILITY AND FITNESS FOR A PARTICULAR PURPOSE
// ARE DISCLAIMED. IN NO EVENT SHALL THE AUTHOR BE LIABLE FOR ANY
// DIRECT, INDIRECT, INCIDENTAL, SPECIAL, EXEMPLARY, OR CONSEQUENTIAL
// DAMAGES (INCLUDING, BUT NOT LIMITED TO, PROCUREMENT OF SUBSTITUTE
// GOODS OR SERVICES; LOSS OF USE, DATA, OR PROFITS; OR BUSINESS
// INTERRUPTION) HOWEVER CAUSED AND ON ANY THEORY OF LIABILITY,
// WHETHER IN CONTRACT, STRICT LIABILITY, OR TORT (INCLUDING
// NEGLIGENCE OR OTHERWISE) ARISING IN ANY WAY OUT OF THE USE OF THIS
// SOFTWARE, EVEN IF ADVISED OF THE POSSIBILITY OF SUCH DAMAGE.

// Code is generated by AI

/** Characterization suite for the ZWO ASIAIR power port AUX driver.
 \file test_aux_asiair_sysfs.c
 The driver drives four power ports on the Raspberry Pi header through the
 legacy sysfs GPIO and PWM interfaces, so the boundary is replaced by the
 shared fake in sysfs_gpio_fake.h. Unlike the Raspberry Pi GPIO driver it has
 no inputs, and its two PWM channels drive the first and the fourth output
 rather than the first two.
 */

#include <indigo_linux_drivers/aux_asiair/indigo_aux_asiair.h>

#include "serial_simulator_test_common.h"
#include "sysfs_gpio_fake.h"

#define ASIAIR_DEVICE_NAME "ZWO Power Ports ASIAIR"
#define ASIAIR_OUTPUT_COUNT 4

// Output #1 is PWM channel 0 and Output #4 is PWM channel 1.
static const int driver_output_pins[ASIAIR_OUTPUT_COUNT] = { 12, 13, 26, 18 };
static const int driver_plain_pins[2] = { 13, 26 };

static const simulator_driver_case driver = { "ZWO Power Ports ASIAIR", "indigo_aux_asiair", ASIAIR_DEVICE_NAME, indigo_aux_asiair, false, NULL, 0, NULL, 0, NULL, 0, NULL, 0 };

static bool driver_running;
static int failures_at_bring_up;

static bool bring_up_driver(int gpio_base, bool pwm_chip_present) {
	fake_reset(gpio_base, pwm_chip_present);
	failures_at_bring_up = indigo_test_failures;
	driver_running = bring_up_serial_driver(&driver);
	return driver_running;
}

static bool connect_driver(void) {
	return connect_serial_device(&driver, NULL);
}

static bool start_driver(int gpio_base, bool pwm_chip_present) {
	if (!bring_up_driver(gpio_base, pwm_chip_present)) {
		return false;
	}
	return connect_driver();
}

static void stop_driver(void) {
	if (indigo_test_failures != failures_at_bring_up || getenv("INDIGO_TEST_TRACE") != NULL) {
		fake_dump_trace(indigo_current_test_name);
	}
	if (driver_running) {
		stop_serial_driver(&driver);
		driver_running = false;
	}
}

static void assert_property_deleted(const char *name) {
	if (find_cached_property(name) != NULL) {
		fprintf(stderr, "Property %s is still defined\n", name);
	}
	ASSERT_TRUE(find_cached_property(name) == NULL);
}

// PWM is opt-in, so a scenario that exercises it has to ask for it before the
// device is connected.
static bool start_driver_with_pwm(int gpio_base) {
	if (!bring_up_driver(gpio_base, true)) {
		return false;
	}
	if (indigo_change_switch_property_1(&simulator_test_client, ASIAIR_DEVICE_NAME, "X_AUX_PWM", "ENABLED", true) != INDIGO_OK) {
		return false;
	}
	// The property is already in OK state before the change, so the state is
	// not a signal that the change has landed; the item value is.
	for (int i = 0; i < 50; i++) {
		indigo_item *item = find_cached_item("X_AUX_PWM", "ENABLED");
		if (item != NULL && item->sw.value) {
			return connect_driver();
		}
		indigo_usleep(100000);
	}
	printf("X_AUX_PWM did not switch to ENABLED\n");
	return false;
}

static void record_reference_trace(const char *name) {
	const char *directory = getenv("INDIGO_SIMULATOR_TRACE_DIR");
	char path[512];
	if (directory == NULL) {
		return;
	}
	snprintf(path, sizeof(path), "%s/%s.events", directory, name);
	if (!fake_write_trace_file(path)) {
		printf("could not write reference trace to %s\n", path);
	}
}

static void contract(void) {
	indigo_driver_info info = { 0 };
	SERIAL_CHECK_TRUE(bring_up_driver(0, false));
	driver.entry(INDIGO_DRIVER_INFO, &info);
	ASSERT_STREQ("indigo_aux_asiair", info.name);
	ASSERT_STREQ("ZWO Power Ports ASIAIR", info.description);
	ASSERT_EQ_INT(0x03000004, info.version);
	ASSERT_FALSE(info.multi_device_support);
	enumerate_simulator_device();
	assert_defined_property(INFO_PROPERTY_NAME);
	assert_defined_property(CONFIG_PROPERTY_NAME);
	assert_defined_property(CONNECTION_PROPERTY_NAME);
	assert_defined_property(AUX_OUTLET_NAMES_PROPERTY_NAME);
	assert_defined_property("X_AUX_PWM");
	assert_switch_item_value("X_AUX_PWM", "DISABLED", true);
	assert_not_defined_property(DEVICE_PORT_PROPERTY_NAME);
	// The ASIAIR has no inputs at all.
	assert_not_defined_property(AUX_SENSOR_NAMES_PROPERTY_NAME);
	assert_not_defined_property(AUX_GPIO_SENSORS_PROPERTY_NAME);
	assert_device_interface(INDIGO_INTERFACE_AUX_GPIO);
	SERIAL_CHECK_TRUE(connect_driver());
	assert_defined_property(AUX_GPIO_OUTLETS_PROPERTY_NAME);
	assert_defined_property(AUX_OUTLET_PULSE_LENGTHS_PROPERTY_NAME);
	assert_not_defined_property(AUX_GPIO_SENSORS_PROPERTY_NAME);
	assert_property_has_item(AUX_GPIO_OUTLETS_PROPERTY_NAME, AUX_GPIO_OUTLETS_OUTLET_4_ITEM_NAME);
cleanup:
	stop_driver();
}

static void connect_exports_every_pin(void) {
	SERIAL_CHECK_TRUE(start_driver(0, false));
	for (int i = 0; i < ASIAIR_OUTPUT_COUNT; i++) {
		ASSERT_TRUE(fake_pin_exported(driver_output_pins[i]));
		ASSERT_FALSE(fake_pin_is_input(driver_output_pins[i]));
	}
	ASSERT_TRUE(fake_trace_contains("export 12"));
	ASSERT_TRUE(fake_trace_contains("direction 12 out"));
	ASSERT_EQ_INT(ASIAIR_OUTPUT_COUNT, fake_exported_pin_count());
	record_reference_trace("connect_exports_every_pin");
cleanup:
	stop_driver();
}

// D1 reproducer. On a Raspberry Pi 5 the header controller has base 571.
static void connect_offsets_pins_by_the_controller_base(void) {
	SERIAL_CHECK_TRUE(start_driver(571, false));
	for (int i = 0; i < ASIAIR_OUTPUT_COUNT; i++) {
		ASSERT_TRUE(fake_pin_exported(driver_output_pins[i]));
	}
	ASSERT_TRUE(fake_trace_contains("export 583"));
	ASSERT_EQ_INT(-1, fake_trace_index_of("export 12"));
cleanup:
	stop_driver();
}

static void outputs_are_written_and_read_back(void) {
	SERIAL_CHECK_TRUE(start_driver(0, false));
	unsigned int revision = property_revision(AUX_GPIO_OUTLETS_PROPERTY_NAME);
	ASSERT_EQ_INT(INDIGO_OK, indigo_change_switch_property_1(&simulator_test_client, ASIAIR_DEVICE_NAME, AUX_GPIO_OUTLETS_PROPERTY_NAME, AUX_GPIO_OUTLETS_OUTLET_2_ITEM_NAME, true));
	SERIAL_CHECK_TRUE(wait_for_property_state_after(AUX_GPIO_OUTLETS_PROPERTY_NAME, INDIGO_OK_STATE, revision));
	ASSERT_EQ_INT(1, fake_pin_value(driver_plain_pins[0]));
	assert_switch_item_value(AUX_GPIO_OUTLETS_PROPERTY_NAME, AUX_GPIO_OUTLETS_OUTLET_2_ITEM_NAME, true);
	revision = property_revision(AUX_GPIO_OUTLETS_PROPERTY_NAME);
	ASSERT_EQ_INT(INDIGO_OK, indigo_change_switch_property_1(&simulator_test_client, ASIAIR_DEVICE_NAME, AUX_GPIO_OUTLETS_PROPERTY_NAME, AUX_GPIO_OUTLETS_OUTLET_2_ITEM_NAME, false));
	SERIAL_CHECK_TRUE(wait_for_property_state_after(AUX_GPIO_OUTLETS_PROPERTY_NAME, INDIGO_OK_STATE, revision));
	ASSERT_EQ_INT(0, fake_pin_value(driver_plain_pins[0]));
cleanup:
	stop_driver();
}

static void pulsed_output_returns_to_zero(void) {
	SERIAL_CHECK_TRUE(start_driver(0, false));
	ASSERT_EQ_INT(INDIGO_OK, indigo_change_number_property_1(&simulator_test_client, ASIAIR_DEVICE_NAME, AUX_OUTLET_PULSE_LENGTHS_PROPERTY_NAME, AUX_GPIO_OUTLETS_OUTLET_3_ITEM_NAME, 200));
	SERIAL_CHECK_TRUE(wait_for_property_state(AUX_OUTLET_PULSE_LENGTHS_PROPERTY_NAME, INDIGO_OK_STATE));
	ASSERT_EQ_INT(INDIGO_OK, indigo_change_switch_property_1(&simulator_test_client, ASIAIR_DEVICE_NAME, AUX_GPIO_OUTLETS_PROPERTY_NAME, AUX_GPIO_OUTLETS_OUTLET_3_ITEM_NAME, true));
	SERIAL_CHECK_TRUE(wait_for_property_state(AUX_GPIO_OUTLETS_PROPERTY_NAME, INDIGO_OK_STATE));
	ASSERT_EQ_INT(1, fake_pin_value(driver_plain_pins[1]));
	for (int i = 0; i < 200 && fake_pin_value(driver_plain_pins[1]) != 0; i++) {
		indigo_usleep(10000);
	}
	ASSERT_EQ_INT(0, fake_pin_value(driver_plain_pins[1]));
	assert_switch_item_value(AUX_GPIO_OUTLETS_PROPERTY_NAME, AUX_GPIO_OUTLETS_OUTLET_3_ITEM_NAME, false);
cleanup:
	stop_driver();
}

// The two PWM channels drive Output #1 and Output #4, so those two pins must
// not be exported as plain GPIO while the middle two must.
static void pwm_channels_drive_the_first_and_the_fourth_output(void) {
	SERIAL_CHECK_TRUE(start_driver_with_pwm(0));
	assert_defined_property(AUX_GPIO_OUTLET_FREQUENCIES_PROPERTY_NAME);
	assert_defined_property(AUX_GPIO_OUTLET_DUTY_PROPERTY_NAME);
	ASSERT_TRUE(fake_trace_contains("pwm-export 0"));
	ASSERT_TRUE(fake_trace_contains("pwm-export 1"));
	ASSERT_FALSE(fake_pin_exported(driver_output_pins[0]));
	ASSERT_FALSE(fake_pin_exported(driver_output_pins[3]));
	ASSERT_TRUE(fake_pin_exported(driver_output_pins[1]));
	ASSERT_TRUE(fake_pin_exported(driver_output_pins[2]));
	unsigned int revision = property_revision(AUX_GPIO_OUTLETS_PROPERTY_NAME);
	ASSERT_EQ_INT(INDIGO_OK, indigo_change_switch_property_1(&simulator_test_client, ASIAIR_DEVICE_NAME, AUX_GPIO_OUTLETS_PROPERTY_NAME, AUX_GPIO_OUTLETS_OUTLET_4_ITEM_NAME, true));
	SERIAL_CHECK_TRUE(wait_for_property_state_after(AUX_GPIO_OUTLETS_PROPERTY_NAME, INDIGO_OK_STATE, revision));
	// Output #4 is channel 1, not channel 3.
	ASSERT_TRUE(fake_trace_contains("pwm-enable 1 1"));
	record_reference_trace("pwm_channels_drive_the_first_and_the_fourth_output");
cleanup:
	stop_driver();
}

// The default is off, so a PWM chip that exists but may not be wired to any
// header pin never takes the two ports away from plain GPIO.
static void pwm_is_off_by_default(void) {
	SERIAL_CHECK_TRUE(start_driver(0, true));
	ASSERT_EQ_INT(0, fake_trace_count_of("pwm-export"));
	for (int i = 0; i < ASIAIR_OUTPUT_COUNT; i++) {
		ASSERT_TRUE(fake_pin_exported(driver_output_pins[i]));
	}
	ASSERT_EQ_INT(ASIAIR_OUTPUT_COUNT, fake_exported_pin_count());
cleanup:
	stop_driver();
}

static void plain_gpio_without_a_pwm_chip(void) {
	SERIAL_CHECK_TRUE(start_driver(0, false));
	ASSERT_EQ_INT(0, fake_trace_count_of("pwm-export"));
	ASSERT_TRUE(fake_pin_exported(driver_output_pins[0]));
	ASSERT_TRUE(fake_pin_exported(driver_output_pins[3]));
cleanup:
	stop_driver();
}

// D6 reproducer.
static void failed_pwm_readback_is_not_written_back(void) {
	SERIAL_CHECK_TRUE(start_driver_with_pwm(0));
	pthread_mutex_lock(&fake.mutex);
	fake.pwm_read_fails = true;
	fake.trace_count = 0;
	pthread_mutex_unlock(&fake.mutex);
	ASSERT_EQ_INT(INDIGO_OK, indigo_change_number_property_1(&simulator_test_client, ASIAIR_DEVICE_NAME, AUX_GPIO_OUTLET_DUTY_PROPERTY_NAME, AUX_GPIO_OUTLETS_OUTLET_1_ITEM_NAME, 50));
	SERIAL_CHECK_TRUE(wait_for_property_state(AUX_GPIO_OUTLET_DUTY_PROPERTY_NAME, INDIGO_OK_STATE));
	ASSERT_EQ_INT(0, fake_trace_count_of("pwm-period 0 0"));
	ASSERT_EQ_INT(0, fake_trace_count_of("pwm-duty 0 0"));
cleanup:
	pthread_mutex_lock(&fake.mutex);
	fake.pwm_read_fails = false;
	pthread_mutex_unlock(&fake.mutex);
	stop_driver();
}

// D4 and D7 reproducer.
static void rejected_export_fails_the_connection_cleanly(void) {
	SERIAL_CHECK_TRUE(bring_up_driver(0, false));
	pthread_mutex_lock(&fake.mutex);
	fake.fail_export_after = 0;
	pthread_mutex_unlock(&fake.mutex);
	enumerate_simulator_device();
	ASSERT_EQ_INT(INDIGO_OK, indigo_change_switch_property_1(&simulator_test_client, ASIAIR_DEVICE_NAME, CONNECTION_PROPERTY_NAME, CONNECTION_CONNECTED_ITEM_NAME, true));
	SERIAL_CHECK_TRUE(wait_for_property_not_busy(CONNECTION_PROPERTY_NAME));
	assert_switch_item_value(CONNECTION_PROPERTY_NAME, CONNECTION_CONNECTED_ITEM_NAME, false);
	assert_switch_item_value(CONNECTION_PROPERTY_NAME, CONNECTION_DISCONNECTED_ITEM_NAME, true);
cleanup:
	stop_driver();
}

// D7 reproducer.
static void failed_connect_rolls_back_exported_pins(void) {
	SERIAL_CHECK_TRUE(bring_up_driver(0, false));
	pthread_mutex_lock(&fake.mutex);
	fake.fail_export_after = 2;
	pthread_mutex_unlock(&fake.mutex);
	enumerate_simulator_device();
	ASSERT_EQ_INT(INDIGO_OK, indigo_change_switch_property_1(&simulator_test_client, ASIAIR_DEVICE_NAME, CONNECTION_PROPERTY_NAME, CONNECTION_CONNECTED_ITEM_NAME, true));
	SERIAL_CHECK_TRUE(wait_for_property_not_busy(CONNECTION_PROPERTY_NAME));
	ASSERT_EQ_INT(0, fake_exported_pin_count());
cleanup:
	stop_driver();
}

// D9 reproducer.
static void connect_does_not_sleep_for_a_fixed_second(void) {
	SERIAL_CHECK_TRUE(start_driver(0, false));
	printf("connect slept %ld us in %d calls\n", fake.slept_total, fake.sleep_calls);
	ASSERT_TRUE(fake.slept_total < 200000);
cleanup:
	stop_driver();
}

static void names_are_applied_to_labels(void) {
	SERIAL_CHECK_TRUE(start_driver(0, false));
	ASSERT_EQ_INT(INDIGO_OK, indigo_change_text_property_1_raw(&simulator_test_client, ASIAIR_DEVICE_NAME, AUX_OUTLET_NAMES_PROPERTY_NAME, AUX_GPIO_OUTLET_NAME_1_ITEM_NAME, "Mount"));
	SERIAL_CHECK_TRUE(wait_for_property_state(AUX_OUTLET_NAMES_PROPERTY_NAME, INDIGO_OK_STATE));
	indigo_item *item = find_cached_item(AUX_GPIO_OUTLETS_PROPERTY_NAME, AUX_GPIO_OUTLETS_OUTLET_1_ITEM_NAME);
	SERIAL_CHECK_TRUE(item != NULL);
	ASSERT_STREQ("Mount", item->label);
cleanup:
	stop_driver();
}

static void disconnect_unexports_and_reconnect_works(void) {
	SERIAL_CHECK_TRUE(start_driver(0, false));
	ASSERT_EQ_INT(ASIAIR_OUTPUT_COUNT, fake_exported_pin_count());
	disconnect_serial_device(&driver);
	ASSERT_EQ_INT(0, fake_exported_pin_count());
	assert_property_deleted(AUX_GPIO_OUTLETS_PROPERTY_NAME);
	assert_property_deleted(AUX_OUTLET_PULSE_LENGTHS_PROPERTY_NAME);
	SERIAL_CHECK_TRUE(connect_driver());
	ASSERT_EQ_INT(ASIAIR_OUTPUT_COUNT, fake_exported_pin_count());
cleanup:
	stop_driver();
}

static void shutdown_is_rejected_while_connected(void) {
	SERIAL_CHECK_TRUE(start_driver(0, false));
	ASSERT_EQ_INT(INDIGO_BUSY, driver.entry(INDIGO_DRIVER_SHUTDOWN, NULL));
	ASSERT_EQ_INT(ASIAIR_OUTPUT_COUNT, fake_exported_pin_count());
cleanup:
	stop_driver();
}

static void repeated_init_and_shutdown(void) {
	for (int i = 0; i < 3; i++) {
		SERIAL_CHECK_TRUE(start_driver(0, false));
		ASSERT_EQ_INT(INDIGO_OK, driver.entry(INDIGO_DRIVER_INIT, NULL));
		stop_driver();
		ASSERT_EQ_INT(0, fake_exported_pin_count());
	}
	return;
cleanup:
	stop_driver();
}

int main(void) {
	setvbuf(stdout, NULL, _IONBF, 0);
	alarm(300);
	pthread_mutex_init(&fake.mutex, NULL);
	const indigo_test_case tests[] = {
		{ "driver metadata, interface and property contract", contract },
		{ "connect exports and configures every pin", connect_exports_every_pin },
		{ "pins are offset by the controller base", connect_offsets_pins_by_the_controller_base },
		{ "outputs are written and read back", outputs_are_written_and_read_back },
		{ "pulsed output returns to zero", pulsed_output_returns_to_zero },
		{ "PWM is off by default", pwm_is_off_by_default },
		{ "PWM drives the first and the fourth output", pwm_channels_drive_the_first_and_the_fourth_output },
		{ "plain GPIO is used when no PWM chip is present", plain_gpio_without_a_pwm_chip },
		{ "failed PWM readback is not written back", failed_pwm_readback_is_not_written_back },
		{ "rejected export fails the connection cleanly", rejected_export_fails_the_connection_cleanly },
		{ "failed connect rolls back exported pins", failed_connect_rolls_back_exported_pins },
		{ "connect does not sleep for a fixed second", connect_does_not_sleep_for_a_fixed_second },
		{ "names are applied to labels", names_are_applied_to_labels },
		{ "disconnect unexports and reconnect works", disconnect_unexports_and_reconnect_works },
		{ "shutdown is rejected while connected", shutdown_is_rejected_while_connected },
		{ "repeated initialization and shutdown", repeated_init_and_shutdown }
	};
	const char *filter = getenv("INDIGO_TEST_FILTER");
	if (filter != NULL) {
		indigo_test_case selected[ARRAY_SIZE(tests)];
		int count = 0;
		for (int i = 0; i < (int)ARRAY_SIZE(tests); i++) {
			if (strstr(tests[i].name, filter) != NULL) {
				selected[count++] = tests[i];
			}
		}
		return indigo_run_tests("aux_asiair fake sysfs integration tests", selected, count);
	}
	return indigo_run_tests("aux_asiair fake sysfs integration tests", tests, ARRAY_SIZE(tests));
}
