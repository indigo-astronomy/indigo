// Copyright (c) 2026 INDIGO initiative
// All rights reserved.
//
// You may use this software under the terms of 'INDIGO Astronomy
// open-source license' (see LICENSE.md).
//
// THIS SOFTWARE IS PROVIDED BY THE AUTHORS 'AS IS' AND ANY EXPRESS
// OR IMPLIED WARRANTIES, INCLUDING, BUT NOT LIMITED TO, THE IMPLIED
// WARRANTIES OF MERCHANTABILITY AND FITNESS FOR A PARTICULAR PURPOSE
// ARE DISCLAIMED. IN NO EVENT SHALL THE AUTHOR BE LIABLE FOR ANY
// DIRECT, INDIRECT, INCIDENTAL, SPECIAL, EXEMPLARY, OR CONSEQUENTIAL
// DAMAGES (INCLUDING, BUT NOT LIMITED TO, PROCUREMENT OF SUBSTITUTE
// GOODS OR SERVICES; LOSS OF USE, DATA, OR PROFITS; OR BUSINESS
// INTERRUPTION) HOWEVER CAUSED AND ON ANY THEORY OF LIABILITY,
// WHETHER IN CONTRACT, STRICT LIABILITY, OR TORT (INCLUDING
// NEGLIGENCE OR OTHERWISE) ARISING IN ANY WAY OUT OF THE USE OF THIS
// SOFTWARE, EVEN IF ADVISED OF THE POSSIBILITY OF SUCH DAMAGE.

// Code is generated by AI

// Harness shared by the ccd_fli, focuser_fli and wheel_fli fake SDK tests. It
// replaces libusb hot plug and device attachment for the driver under test,
// keeps one property cache per attached logical device and provides the waits
// and assertions the three suites need. Include fli_fake_sdk.h first.

#ifndef FLI_SDK_TEST_COMMON_H
#define FLI_SDK_TEST_COMMON_H

#include <indigo/indigo_bus.h>
#include <indigo/indigo_client.h>
#include <indigo/indigo_driver.h>
#include <indigo/indigo_usb_utils.h>

#include "../test_runner.h"

#ifndef ARRAY_SIZE
#define ARRAY_SIZE(array) ((int)(sizeof(array) / sizeof((array)[0])))
#endif

#define FLI_TEST_DEVICES    FLI_FAKE_DEVICES
#define FLI_TEST_PROPERTIES 48

#define FLI_CHECK_TRUE(condition) do { \
	if (!(condition)) { \
		fprintf(stderr, "%s:%d: assertion failed: %s\n", __FILE__, __LINE__, #condition); \
		indigo_test_failures++; \
		goto cleanup; \
	} \
} while (0)

#define FLI_CHECK_EQ_INT(expected, actual) do { \
	int expected_value = (expected); \
	int actual_value = (actual); \
	if (expected_value != actual_value) { \
		fprintf(stderr, "%s:%d: expected %d, got %d\n", __FILE__, __LINE__, expected_value, actual_value); \
		indigo_test_failures++; \
		goto cleanup; \
	} \
} while (0)

typedef struct {
	char name[INDIGO_NAME_SIZE];
	indigo_property *properties[FLI_TEST_PROPERTIES];
	int updates[FLI_TEST_PROPERTIES];
} fli_observed_device;

static fli_observed_device fli_observed[FLI_TEST_DEVICES];
static pthread_mutex_t fli_observation_mutex = PTHREAD_MUTEX_INITIALIZER;
static const char * const *fli_observed_names;
static int fli_observed_name_count;
static libusb_hotplug_callback_fn fli_usb_callback;
static int fli_usb_devices[FLI_TEST_DEVICES];
static atomic_int fli_usb_refs, fli_invalid_usb_unref;
static atomic_int fli_attached, fli_attach_attempts;
static atomic_int fli_registration_error, fli_descriptor_error;

static void fli_observe(const char * const *names, int count) {
	fli_observed_names = names;
	fli_observed_name_count = count;
}

static bool fli_is_observed(const char *name) {
	for (int i = 0; i < fli_observed_name_count; i++) {
		if (!strcmp(fli_observed_names[i], name)) {
			return true;
		}
	}
	return false;
}

static int fli_device_index(const char *name) {
	for (int i = 0; i < FLI_TEST_DEVICES; i++) {
		if (fli_observed[i].name[0] && !strcmp(fli_observed[i].name, name)) {
			return i;
		}
	}
	return -1;
}

static int fli_find_device(const char *prefix) {
	for (int i = 0; i < FLI_TEST_DEVICES; i++) {
		if (fli_observed[i].name[0] && !strncmp(fli_observed[i].name, prefix, strlen(prefix))) {
			return i;
		}
	}
	return -1;
}

static int fli_property_slot(int index, const char *name, bool create) {
	int empty = -1;
	for (int i = 0; i < FLI_TEST_PROPERTIES; i++) {
		if (fli_observed[index].properties[i] && !strcmp(fli_observed[index].properties[i]->name, name)) {
			return i;
		}
		if (fli_observed[index].properties[i] == NULL && empty < 0) {
			empty = i;
		}
	}
	return create ? empty : -1;
}

static indigo_result fli_observe_define(indigo_client *client, indigo_device *device, indigo_property *property, const char *message) {
	int index = fli_device_index(property->device);
	if (index < 0 || !fli_is_observed(property->name)) {
		return INDIGO_OK;
	}
	pthread_mutex_lock(&fli_observation_mutex);
	int slot = fli_property_slot(index, property->name, true);
	if (slot >= 0) {
		indigo_release_property(fli_observed[index].properties[slot]);
		fli_observed[index].properties[slot] = indigo_copy_property(NULL, property);
		fli_observed[index].updates[slot]++;
	}
	pthread_mutex_unlock(&fli_observation_mutex);
	return INDIGO_OK;
}

static indigo_result fli_observe_delete(indigo_client *client, indigo_device *device, indigo_property *property, const char *message) {
	int index = fli_device_index(property->device);
	if (index < 0) {
		return INDIGO_OK;
	}
	pthread_mutex_lock(&fli_observation_mutex);
	for (int i = 0; i < FLI_TEST_PROPERTIES; i++) {
		indigo_property *cached = fli_observed[index].properties[i];
		if (cached && (!property->name[0] || !strcmp(cached->name, property->name))) {
			indigo_release_property(cached);
			fli_observed[index].properties[i] = NULL;
		}
	}
	pthread_mutex_unlock(&fli_observation_mutex);
	return INDIGO_OK;
}

static indigo_client fli_test_client = {
	.name = "FLI fake SDK test",
	.version = INDIGO_VERSION_CURRENT,
	.define_property = fli_observe_define,
	.update_property = fli_observe_define,
	.delete_property = fli_observe_delete
};

static indigo_property *fli_snapshot(int index, const char *name) {
	if (index < 0 || index >= FLI_TEST_DEVICES) {
		return NULL;
	}
	pthread_mutex_lock(&fli_observation_mutex);
	int slot = fli_property_slot(index, name, false);
	indigo_property *copy = slot < 0 ? NULL : indigo_copy_property(NULL, fli_observed[index].properties[slot]);
	pthread_mutex_unlock(&fli_observation_mutex);
	return copy;
}

static indigo_item *fli_snapshot_item(indigo_property *property, const char *item_name) {
	for (int i = 0; property != NULL && i < property->count; i++) {
		if (!strcmp(property->items[i].name, item_name)) {
			return property->items + i;
		}
	}
	return NULL;
}

static int fli_property_state(int index, const char *name) {
	indigo_property *property = fli_snapshot(index, name);
	int state = property ? (int)property->state : -1;
	indigo_release_property(property);
	return state;
}

static bool fli_number_is(int index, const char *property_name, const char *item_name, double expected) {
	indigo_property *property = fli_snapshot(index, property_name);
	indigo_item *item = fli_snapshot_item(property, item_name);
	bool result = item != NULL && fabs(item->number.value - expected) < 0.001;
	if (!result) {
		fprintf(stderr, "%s.%s: expected %g, received %g\n", property_name, item_name, expected, item ? item->number.value : NAN);
	}
	indigo_release_property(property);
	return result;
}

static bool fli_number_max(int index, const char *property_name, const char *item_name, double expected) {
	indigo_property *property = fli_snapshot(index, property_name);
	indigo_item *item = fli_snapshot_item(property, item_name);
	bool result = item != NULL && fabs(item->number.max - expected) < 0.001;
	if (!result) {
		fprintf(stderr, "%s.%s max: expected %g, received %g\n", property_name, item_name, expected, item ? item->number.max : NAN);
	}
	indigo_release_property(property);
	return result;
}

static bool fli_text_is(int index, const char *property_name, const char *item_name, const char *expected) {
	indigo_property *property = fli_snapshot(index, property_name);
	indigo_item *item = fli_snapshot_item(property, item_name);
	bool result = item != NULL && !strcmp(item->text.value, expected);
	if (!result) {
		fprintf(stderr, "%s.%s: expected \"%s\", received \"%s\"\n", property_name, item_name, expected, item ? item->text.value : "(none)");
	}
	indigo_release_property(property);
	return result;
}

static bool fli_switch_is(int index, const char *property_name, const char *item_name, bool expected) {
	indigo_property *property = fli_snapshot(index, property_name);
	indigo_item *item = fli_snapshot_item(property, item_name);
	bool result = item != NULL && item->sw.value == expected;
	if (!result) {
		fprintf(stderr, "%s.%s: expected %s\n", property_name, item_name, expected ? "on" : "off");
	}
	indigo_release_property(property);
	return result;
}

static bool fli_switch_is_quiet(int index, const char *property_name, const char *item_name, bool expected) {
	indigo_property *property = fli_snapshot(index, property_name);
	indigo_item *item = fli_snapshot_item(property, item_name);
	bool result = item != NULL && item->sw.value == expected;
	indigo_release_property(property);
	return result;
}

static bool fli_property_count(int index, const char *property_name, int expected) {
	indigo_property *property = fli_snapshot(index, property_name);
	bool result = property != NULL && property->count == expected;
	if (!result) {
		fprintf(stderr, "%s count: expected %d, received %d\n", property_name, expected, property ? property->count : -1);
	}
	indigo_release_property(property);
	return result;
}

static bool fli_assert_interface(int index, int expected) {
	indigo_property *property = fli_snapshot(index, INFO_PROPERTY_NAME);
	indigo_item *item = fli_snapshot_item(property, INFO_DEVICE_INTERFACE_ITEM_NAME);
	bool result = item != NULL && (atoi(item->text.value) & expected) == expected;
	if (!result) {
		fprintf(stderr, "Interface: expected %d in \"%s\"\n", expected, item ? item->text.value : "(none)");
	}
	indigo_release_property(property);
	return result;
}

static int fli_updates(int index, const char *property_name) {
	if (index < 0 || index >= FLI_TEST_DEVICES) {
		return 0;
	}
	pthread_mutex_lock(&fli_observation_mutex);
	int slot = fli_property_slot(index, property_name, false);
	int count = slot < 0 ? 0 : fli_observed[index].updates[slot];
	pthread_mutex_unlock(&fli_observation_mutex);
	return count;
}

static bool fli_wait_state(int index, const char *property_name, indigo_property_state state) {
	for (int i = 0; i < 300; i++) {
		if (fli_property_state(index, property_name) == (int)state) {
			return true;
		}
		indigo_usleep(50000);
	}
	fprintf(stderr, "%s never reached state %d (current %d)\n", property_name, state, fli_property_state(index, property_name));
	return false;
}

static bool fli_wait_attached(int expected) {
	for (int i = 0; i < 300; i++) {
		if (atomic_load(&fli_attached) == expected) {
			return true;
		}
		indigo_usleep(50000);
	}
	fprintf(stderr, "Attached %d devices, expected %d\n", atomic_load(&fli_attached), expected);
	return false;
}

static bool fli_set_switch(int index, const char *property_name, const char *item_name, bool value) {
	return indigo_change_switch_property_1(&fli_test_client, fli_observed[index].name, property_name, item_name, value) == INDIGO_OK;
}

static bool fli_set_number(int index, const char *property_name, const char *item_name, double value, indigo_property_state expected) {
	if (indigo_change_number_property_1(&fli_test_client, fli_observed[index].name, property_name, item_name, value) != INDIGO_OK) {
		return false;
	}
	return fli_wait_state(index, property_name, expected);
}

// A connection change publishes BUSY before its handler runs, so the settled
// state is only meaningful once the driver has published again.
static bool fli_wait_connection(int index, bool connected, int before) {
	for (int i = 0; i < 400; i++) {
		if (fli_updates(index, CONNECTION_PROPERTY_NAME) > before) {
			indigo_property *property = fli_snapshot(index, CONNECTION_PROPERTY_NAME);
			indigo_item *item = fli_snapshot_item(property, connected ? CONNECTION_CONNECTED_ITEM_NAME : CONNECTION_DISCONNECTED_ITEM_NAME);
			bool settled = property != NULL && property->state != INDIGO_BUSY_STATE && item != NULL && item->sw.value;
			indigo_release_property(property);
			if (settled) {
				return true;
			}
		}
		indigo_usleep(25000);
	}
	return false;
}

static bool fli_connect_expect(int index, bool expected) {
	int before = fli_updates(index, CONNECTION_PROPERTY_NAME);
	if (!fli_set_switch(index, CONNECTION_PROPERTY_NAME, CONNECTION_CONNECTED_ITEM_NAME, true)) {
		return false;
	}
	if (!fli_wait_connection(index, expected, before)) {
		fprintf(stderr, "Connection never settled %s (state %d)\n", expected ? "connected" : "disconnected", fli_property_state(index, CONNECTION_PROPERTY_NAME));
		return false;
	}
	return fli_property_state(index, CONNECTION_PROPERTY_NAME) == (expected ? INDIGO_OK_STATE : INDIGO_ALERT_STATE);
}

static bool fli_connect(int index) {
	return fli_connect_expect(index, true);
}

static bool fli_disconnect(int index) {
	int before = fli_updates(index, CONNECTION_PROPERTY_NAME);
	if (!fli_set_switch(index, CONNECTION_PROPERTY_NAME, CONNECTION_DISCONNECTED_ITEM_NAME, true)) {
		return false;
	}
	return fli_wait_connection(index, false, before);
}

static void fli_release_observations(void) {
	pthread_mutex_lock(&fli_observation_mutex);
	for (int i = 0; i < FLI_TEST_DEVICES; i++) {
		for (int j = 0; j < FLI_TEST_PROPERTIES; j++) {
			indigo_release_property(fli_observed[i].properties[j]);
			fli_observed[i].properties[j] = NULL;
			fli_observed[i].updates[j] = 0;
		}
		fli_observed[i].name[0] = 0;
	}
	pthread_mutex_unlock(&fli_observation_mutex);
}

typedef indigo_result (*fli_driver_entry)(indigo_driver_action action, indigo_driver_info *info);

static bool fli_driver_up(fli_driver_entry entry) {
	fli_release_observations();
	atomic_store(&fli_attached, 0);
	atomic_store(&fli_attach_attempts, 0);
	atomic_store(&fli_usb_refs, 0);
	atomic_store(&fli_invalid_usb_unref, 0);
	if (indigo_start() != INDIGO_OK || indigo_attach_client(&fli_test_client) != INDIGO_OK) {
		return false;
	}
	return entry(INDIGO_DRIVER_INIT, NULL) == INDIGO_OK;
}

// Every attached device has to be disconnected before the driver accepts
// SHUTDOWN, and the disconnect has to be observed, not just requested.
static void fli_driver_down(fli_driver_entry entry) {
	for (int i = 0; i < FLI_TEST_DEVICES; i++) {
		if (fli_observed[i].name[0] && fli_switch_is_quiet(i, CONNECTION_PROPERTY_NAME, CONNECTION_CONNECTED_ITEM_NAME, true)) {
			fli_disconnect(i);
		}
	}
	ASSERT_EQ_INT(INDIGO_OK, entry(INDIGO_DRIVER_SHUTDOWN, NULL));
	indigo_detach_client(&fli_test_client);
	ASSERT_EQ_INT(INDIGO_OK, indigo_stop());
	fli_release_observations();
	ASSERT_EQ_INT(0, atomic_load(&fli_invalid_usb_unref));
}

// ----------------------------------------------------------------- mocks

indigo_result fli_test_attach(indigo_device *device) {
	atomic_fetch_add(&fli_attach_attempts, 1);
	for (int i = 0; i < FLI_TEST_DEVICES; i++) {
		if (fli_observed[i].name[0] == 0) {
			snprintf(fli_observed[i].name, sizeof(fli_observed[i].name), "%s", device->name);
			break;
		}
	}
	indigo_result result = indigo_attach_device(device);
	if (result == INDIGO_OK) {
		atomic_fetch_add(&fli_attached, 1);
	}
	return result;
}

indigo_result fli_test_detach(indigo_device *device) {
	indigo_result result = indigo_detach_device(device);
	for (int i = 0; i < FLI_TEST_DEVICES; i++) {
		if (!strcmp(fli_observed[i].name, device->name)) {
			pthread_mutex_lock(&fli_observation_mutex);
			for (int j = 0; j < FLI_TEST_PROPERTIES; j++) {
				indigo_release_property(fli_observed[i].properties[j]);
				fli_observed[i].properties[j] = NULL;
			}
			fli_observed[i].name[0] = 0;
			pthread_mutex_unlock(&fli_observation_mutex);
			break;
		}
	}
	atomic_fetch_sub(&fli_attached, 1);
	return result;
}

void fli_test_usb_start(void) {
}

int LIBUSB_CALL fli_test_usb_register(libusb_context *ctx, int events, int flags, int vid, int pid, int cls, libusb_hotplug_callback_fn callback, void *data, libusb_hotplug_callback_handle *handle) {
	if (atomic_load(&fli_registration_error)) {
		return LIBUSB_ERROR_IO;
	}
	fli_usb_callback = callback;
	// LIBUSB_HOTPLUG_ENUMERATE makes libusb report the devices that are
	// already present, which is how the driver finds them at INIT.
	for (int i = 0; i < FLI_TEST_DEVICES; i++) {
		if (fli_fake_devices[i].present) {
			callback(NULL, (libusb_device *)(fli_usb_devices + i), LIBUSB_HOTPLUG_EVENT_DEVICE_ARRIVED, NULL);
		}
	}
	return LIBUSB_SUCCESS;
}

int fli_test_usb_register_sim(libusb_context *ctx, libusb_hotplug_event events, libusb_hotplug_flag flags, int vid, int pid, int cls, libusb_hotplug_callback_fn callback, void *data, libusb_hotplug_callback_handle *handle) {
	return fli_test_usb_register(ctx, events, flags, vid, pid, cls, callback, data, handle);
}

void LIBUSB_CALL fli_test_usb_deregister(libusb_context *ctx, libusb_hotplug_callback_handle handle) {
	fli_usb_callback = NULL;
}

int fli_test_usb_deregister_poll(libusb_context *ctx, libusb_hotplug_callback_handle handle) {
	fli_usb_callback = NULL;
	return LIBUSB_SUCCESS;
}

libusb_device *LIBUSB_CALL fli_test_usb_ref(libusb_device *device) {
	atomic_fetch_add(&fli_usb_refs, 1);
	return device;
}

void LIBUSB_CALL fli_test_usb_unref(libusb_device *device) {
	if (atomic_fetch_sub(&fli_usb_refs, 1) <= 0) {
		atomic_fetch_add(&fli_invalid_usb_unref, 1);
	}
}

int LIBUSB_CALL fli_test_usb_descriptor(libusb_device *device, struct libusb_device_descriptor *descriptor) {
	memset(descriptor, 0, sizeof(*descriptor));
	descriptor->idVendor = 0x0f18;
	descriptor->idProduct = 0x0006;
	return atomic_load(&fli_descriptor_error) ? LIBUSB_ERROR_IO : LIBUSB_SUCCESS;
}

static void fli_usb_event(int index, bool arrived) {
	if (fli_usb_callback != NULL) {
		fli_usb_callback(NULL, (libusb_device *)(fli_usb_devices + index), arrived ? LIBUSB_HOTPLUG_EVENT_DEVICE_ARRIVED : LIBUSB_HOTPLUG_EVENT_DEVICE_LEFT, NULL);
	}
}

#endif /* FLI_SDK_TEST_COMMON_H */
