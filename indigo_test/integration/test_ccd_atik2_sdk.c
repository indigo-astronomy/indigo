// Copyright (c) 2026 INDIGO initiative
// All rights reserved.
//
// You may use this software under the terms of 'INDIGO Astronomy
// open-source license' (see LICENSE.md).
//
// THIS SOFTWARE IS PROVIDED BY THE AUTHORS 'AS IS' AND ANY EXPRESS
// OR IMPLIED WARRANTIES, INCLUDING, BUT NOT LIMITED TO, THE IMPLIED
// WARRANTIES OF MERCHANTABILITY AND FITNESS FOR A PARTICULAR PURPOSE
// ARE DISCLAIMED. IN NO EVENT SHALL THE AUTHOR BE LIABLE FOR ANY
// DIRECT, INDIRECT, INCIDENTAL, SPECIAL, EXEMPLARY, OR CONSEQUENTIAL
// DAMAGES (INCLUDING, BUT NOT LIMITED TO, PROCUREMENT OF SUBSTITUTE
// GOODS OR SERVICES; LOSS OF USE, DATA, OR PROFITS; OR BUSINESS
// INTERRUPTION) HOWEVER CAUSED AND ON ANY THEORY OF LIABILITY,
// WHETHER IN CONTRACT, STRICT LIABILITY, OR TORT (INCLUDING
// NEGLIGENCE OR OTHERWISE) ARISING IN ANY WAY OUT OF THE USE OF THIS
// SOFTWARE, EVEN IF ADVISED OF THE POSSIBILITY OF SUCH DAMAGE.

// Code is generated by AI

#include <stdatomic.h>
#include <stdbool.h>
#include <stddef.h>
#include <pthread.h>
#include <unistd.h>
#include <indigo/indigo_usb_utils.h>
#include <indigo/indigo_ccd_driver.h>
#include <indigo_mac_drivers/ccd_atik2/indigo_ccd_atik2.h>
#include <indigo_drivers/wheel_atik/bin_externals/libatik/include/libatik.h>
#include "simulator_test_common.h"
#include "ccd_test_noise.h"

#define CAMERAS 6
#define LOGICAL_DEVICES (CAMERAS * 3)
#define PROPERTIES 80

typedef struct {
	atomic_bool visible, opened;
	bool guider, wheel, cooler;
	libatik_device_context context;
	char name[64];
	atomic_int opens, closes, starts, aborts, reads, cooler_checks, relay, wheel_position, wheel_target, wheel_polls, wheel_sets;
	double exposure, cooler_power, temperature, cooler_target;
	bool cooler_on, dark, preview, wheel_stuck;
	int left, top, width, height, bx, by;
} mock_camera;

typedef struct {
	char name[INDIGO_NAME_SIZE];
	indigo_property *properties[PROPERTIES];
	int updates[PROPERTIES];
} observed_device;

static mock_camera cameras[CAMERAS];
static observed_device observed[LOGICAL_DEVICES];
static indigo_device *logical[LOGICAL_DEVICES];
static int request_revisions[LOGICAL_DEVICES][PROPERTIES];
static int usb_devices[CAMERAS];
static libusb_hotplug_callback_fn usb_callback;
static pthread_mutex_t observation_mutex = PTHREAD_MUTEX_INITIALIZER;
static atomic_int attached, lock_count, unbalanced_unlock, usb_refs, invalid_usb_unref, updates_after_detach;
static atomic_int fail_register, fail_descriptor, fail_attach, fail_queue, fail_lock, wrong_vendor, malformed_context, malformed_image, false_wheel_set_result;
static atomic_int blobs, bad_blob, sdk_after_close, sdk_active, sdk_overlap, clock_shift, gates_entered;
static _Atomic(const char *) fail_call;
static indigo_queue *driver_queue;
static pthread_t bus_thread;
static atomic_int sdk_on_bus;
static pthread_mutex_t gate_mutex = PTHREAD_MUTEX_INITIALIZER;
static pthread_cond_t gate_condition = PTHREAD_COND_INITIALIZER;
static const char *gate_call;
static bool gate_release;

bool libatik_debug_level;
bool libatik_use_syslog;
void (*atik_log)(const char *format, ...);
const char *libatik_version = "fake-1.0";
const char *libatik_os = "test";
const char *libatik_arch = "test";

static void enter_gate(const char *name) {
	pthread_mutex_lock(&gate_mutex);
	if (gate_call && !strcmp(gate_call, name)) {
		atomic_fetch_add(&gates_entered, 1);
		while (!gate_release) {
			pthread_cond_wait(&gate_condition, &gate_mutex);
		}
	}
	pthread_mutex_unlock(&gate_mutex);
}

static void arm_gate(const char *name) {
	pthread_mutex_lock(&gate_mutex);
	gate_call = name;
	gate_release = false;
	atomic_store(&gates_entered, 0);
	pthread_mutex_unlock(&gate_mutex);
}

static void release_gate(void) {
	pthread_mutex_lock(&gate_mutex);
	gate_call = NULL;
	gate_release = true;
	pthread_cond_broadcast(&gate_condition);
	pthread_mutex_unlock(&gate_mutex);
}

static void block_queue(indigo_device *device) {
	enter_gate("queue");
}

static int camera_index_from_device(libusb_device *device) {
	return (int *)device - usb_devices;
}

static mock_camera *camera_from_context(libatik_device_context *context) {
	for (int i = 0; i < CAMERAS; i++) {
		if (&cameras[i].context == context) {
			return cameras + i;
		}
	}
	return NULL;
}

static bool failed(const char *name) {
	const char *failure = atomic_load(&fail_call);
	return failure && !strcmp(failure, name);
}

static mock_camera *sdk_enter(libatik_device_context *context, const char *name) {
	mock_camera *camera = camera_from_context(context);
	if (!camera || !camera->opened) {
		atomic_fetch_add(&sdk_after_close, 1);
	}
	if (atomic_fetch_add(&sdk_active, 1)) {
		atomic_fetch_add(&sdk_overlap, 1);
	}
	if (pthread_equal(bus_thread, pthread_self())) {
		atomic_fetch_add(&sdk_on_bus, 1);
	}
	enter_gate(name);
	return camera;
}

static void sdk_leave(void) {
	atomic_fetch_sub(&sdk_active, 1);
}

static int device_index(const char *name) {
	int index = -1;
	sscanf(name, "Atik2 test %d", &index);
	return index >= 0 && index < CAMERAS ? 3 * index + (strstr(name, "(guider)") ? 1 : strstr(name, "(wheel)") ? 2 : 0) : -1;
}

static int property_index(int index, const char *name, bool create) {
	int empty = -1;
	for (int i = 0; i < PROPERTIES; i++) {
		if (observed[index].properties[i] && !strcmp(observed[index].properties[i]->name, name)) {
			return i;
		}
		if (!observed[index].properties[i] && empty < 0) {
			empty = i;
		}
	}
	return create ? empty : -1;
}

static indigo_result observe(indigo_client *client, indigo_device *device, indigo_property *property, const char *message) {
	int index = device_index(property->device);
	if (index < 0) {
		return INDIGO_OK;
	}
	if (!logical[index]) {
		atomic_fetch_add(&updates_after_detach, 1);
	}
	pthread_mutex_lock(&observation_mutex);
	int slot = property_index(index, property->name, true);
	if (slot >= 0) {
		indigo_release_property(observed[index].properties[slot]);
		observed[index].properties[slot] = indigo_copy_property(NULL, property);
		observed[index].updates[slot]++;
	}
	pthread_mutex_unlock(&observation_mutex);
	return INDIGO_OK;
}

static indigo_result observe_delete(indigo_client *client, indigo_device *device, indigo_property *property, const char *message) {
	int index = device_index(property->device);
	if (index < 0) {
		return INDIGO_OK;
	}
	pthread_mutex_lock(&observation_mutex);
	for (int i = 0; i < PROPERTIES; i++) {
		indigo_property *cached = observed[index].properties[i];
		if (cached && (!property->name[0] || !strcmp(cached->name, property->name))) {
			indigo_release_property(cached);
			observed[index].properties[i] = NULL;
		}
	}
	pthread_mutex_unlock(&observation_mutex);
	return INDIGO_OK;
}

static indigo_result observe_image(indigo_client *client, indigo_device *device, indigo_property *property, const char *message) {
	if (!strcmp(property->name, "CCD_IMAGE") && property->state == INDIGO_OK_STATE && property->items[0].blob.size > 0 && !strcmp(property->items[0].blob.format, ".raw")) {
		indigo_raw_header header = { 0 };
		memcpy(&header, property->items[0].blob.value, sizeof(header));
		mock_camera *camera = cameras + device_index(device->name) / 3;
		bool valid = header.signature == INDIGO_RAW_MONO16 && header.width == camera->width / camera->bx && header.height == camera->height / camera->by;
		for (int i = 0; valid && i < header.width * header.height; i++) {
			uint16_t pixel = 0;
			memcpy(&pixel, (char *)property->items[0].blob.value + sizeof(header) + 2 * i, 2);
			valid = pixel == ccd_test_noise((camera->top + i / header.width * camera->by) * camera->context.width + camera->left + i % header.width * camera->bx, 0);
		}
		if (!valid) {
			atomic_fetch_add(&bad_blob, 1);
		}
		atomic_fetch_add(&blobs, 1);
	}
	return observe(client, device, property, message);
}

static indigo_client test_client = { .name = "Atik2 fake SDK", .version = INDIGO_VERSION_CURRENT, .define_property = observe, .update_property = observe_image, .delete_property = observe_delete };

indigo_result atik2_test_attach(indigo_device *device) {
	int index = device_index(device->name);
	if (index < 0 || atomic_load(&fail_attach) == index + 1) {
		return INDIGO_FAILED;
	}
	logical[index] = device;
	snprintf(observed[index].name, INDIGO_NAME_SIZE, "%s", device->name);
	indigo_result result = indigo_attach_device(device);
	if (result == INDIGO_OK) {
		atomic_fetch_add(&attached, 1);
	}
	return result;
}

indigo_result atik2_test_detach(indigo_device *device) {
	int index = device_index(device->name);
	indigo_result result = indigo_detach_device(device);
	logical[index] = NULL;
	atomic_fetch_sub(&attached, 1);
	return result;
}

static indigo_property *snapshot(int index, const char *name) {
	pthread_mutex_lock(&observation_mutex);
	int slot = property_index(index, name, false);
	indigo_property *copy = slot < 0 ? NULL : indigo_copy_property(NULL, observed[index].properties[slot]);
	pthread_mutex_unlock(&observation_mutex);
	return copy;
}

static int state(int index, const char *name) {
	indigo_property *property = snapshot(index, name);
	int result = property ? property->state : -1;
	indigo_release_property(property);
	return result;
}

static double value(int index, const char *property_name, const char *item_name) {
	indigo_property *property = snapshot(index, property_name);
	double result = -99999;
	if (property) {
		indigo_item *item = indigo_get_item(property, item_name);
		if (item) {
			result = item->number.value;
		}
	}
	indigo_release_property(property);
	return result;
}

static bool wait_state(int index, const char *name, int expected) {
	for (int i = 0; i < 500; i++) {
		pthread_mutex_lock(&observation_mutex);
		int slot = property_index(index, name, false);
		bool ready = slot >= 0 && observed[index].properties[slot]->state == expected && observed[index].updates[slot] > request_revisions[index][slot];
		pthread_mutex_unlock(&observation_mutex);
		if (ready) {
			return true;
		}
		indigo_usleep(10000);
	}
	fprintf(stderr, "device %d property %s: expected %d, got %d\n", index, name, expected, state(index, name));
	return false;
}

static bool wait_count(atomic_int *counter, int expected) {
	for (int i = 0; i < 500; i++) {
		if (atomic_load(counter) == expected) {
			return true;
		}
		indigo_usleep(10000);
	}
	return false;
}

static void remember_request(const char *device, const char *property) {
	int index = device_index(device);
	pthread_mutex_lock(&observation_mutex);
	int slot = index < 0 ? -1 : property_index(index, property, false);
	if (slot >= 0) {
		request_revisions[index][slot] = observed[index].updates[slot];
	}
	pthread_mutex_unlock(&observation_mutex);
}

static bool request_number(int index, const char *property, const char *item, double requested, int expected) {
	remember_request(observed[index].name, property);
	return indigo_change_number_property_1(&test_client, observed[index].name, property, item, requested) == INDIGO_OK && wait_state(index, property, expected);
}

static bool request_numbers(int index, const char *property, int count, const char **items, double *values, int expected) {
	remember_request(observed[index].name, property);
	return indigo_change_number_property(&test_client, observed[index].name, property, count, items, values) == INDIGO_OK && wait_state(index, property, expected);
}

static bool request_switch(int index, const char *property, const char *item, int expected) {
	remember_request(observed[index].name, property);
	return indigo_change_switch_property_1(&test_client, observed[index].name, property, item, true) == INDIGO_OK && wait_state(index, property, expected);
}

static bool connect_device(int index, bool connect) {
	return request_switch(index, "CONNECTION", connect ? "CONNECTED" : "DISCONNECTED", INDIGO_OK_STATE);
}

void atik2_test_usb_start(void) {
}

indigo_result atik2_test_lock(indigo_device *device) {
	if (atomic_load(&fail_lock)) {
		return INDIGO_FAILED;
	}
	atomic_fetch_add(&lock_count, 1);
	return INDIGO_OK;
}

indigo_result atik2_test_unlock(indigo_device *device) {
	if (atomic_load(&lock_count) <= 0) {
		atomic_fetch_add(&unbalanced_unlock, 1);
		return INDIGO_FAILED;
	}
	atomic_fetch_sub(&lock_count, 1);
	return INDIGO_OK;
}

indigo_queue *atik2_test_queue_create(indigo_device *device) {
	if (atomic_load(&fail_queue)) {
		return NULL;
	}
	return driver_queue = indigo_queue_create(device);
}

double atik2_test_monotonic_time(void) {
	return indigo_monotonic_time() + atomic_load(&clock_shift);
}

void atik2_test_execute_in(indigo_device *device, double delay, indigo_timer_callback callback) {
	indigo_execute_handler_in(device, delay == 5 ? .05 : delay == .5 ? .01 : delay, callback);
}

int LIBUSB_CALL atik2_test_usb_register(libusb_context *context, int events, int flags, int vid, int pid, int cls, libusb_hotplug_callback_fn callback, void *data, libusb_hotplug_callback_handle *handle) {
	if (atomic_load(&fail_register)) {
		return LIBUSB_ERROR_OTHER;
	}
	usb_callback = callback;
	callback(NULL, (libusb_device *)(usb_devices + 0), LIBUSB_HOTPLUG_EVENT_DEVICE_ARRIVED, NULL);
	return LIBUSB_SUCCESS;
}

int atik2_test_usb_register_sim(libusb_context *context, libusb_hotplug_event events, libusb_hotplug_flag flags, int vid, int pid, int cls, libusb_hotplug_callback_fn callback, void *data, libusb_hotplug_callback_handle *handle) {
	return atik2_test_usb_register(context, events, flags, vid, pid, cls, callback, data, handle);
}

void LIBUSB_CALL atik2_test_usb_deregister(libusb_context *context, libusb_hotplug_callback_handle handle) {
	usb_callback = NULL;
}

int atik2_test_usb_deregister_poll(libusb_context *context, libusb_hotplug_callback_handle handle) {
	usb_callback = NULL;
	return LIBUSB_SUCCESS;
}

libusb_device *LIBUSB_CALL atik2_test_usb_ref(libusb_device *device) {
	atomic_fetch_add(&usb_refs, 1);
	return device;
}

void LIBUSB_CALL atik2_test_usb_unref(libusb_device *device) {
	if (atomic_fetch_sub(&usb_refs, 1) <= 0) {
		atomic_fetch_add(&invalid_usb_unref, 1);
	}
}

int LIBUSB_CALL atik2_test_usb_descriptor(libusb_device *device, struct libusb_device_descriptor *descriptor) {
	memset(descriptor, 0, sizeof(*descriptor));
	descriptor->idVendor = atomic_load(&wrong_vendor) ? 0xffff : camera_index_from_device(device) % 2 ? ATIK_VID2 : ATIK_VID1;
	descriptor->idProduct = 0x1001;
	return atomic_load(&fail_descriptor) ? LIBUSB_ERROR_IO : LIBUSB_SUCCESS;
}

indigo_result atik2_test_usb_path(libusb_device *device, char *path) {
	snprintf(path, INDIGO_NAME_SIZE, "1-%d", camera_index_from_device(device) + 1);
	return INDIGO_OK;
}

static void usb_event(int index, bool arrive) {
	if (usb_callback) {
		usb_callback(NULL, (libusb_device *)(usb_devices + index), arrive ? LIBUSB_HOTPLUG_EVENT_DEVICE_ARRIVED : LIBUSB_HOTPLUG_EVENT_DEVICE_LEFT, NULL);
	}
}

bool libatik_camera(libusb_device *device, libatik_camera_type *type, const char **name, bool *is_guider, bool *has_filterwheel) {
	int index = camera_index_from_device(device);
	if (index < 0 || index >= CAMERAS || !cameras[index].visible || failed(__func__)) {
		return false;
	}
	*type = ATIK_IC24;
	*name = cameras[index].name;
	*is_guider = cameras[index].guider;
	*has_filterwheel = cameras[index].wheel;
	return true;
}

bool libatik_open(libusb_device *device, libatik_device_context **context) {
	int index = camera_index_from_device(device);
	if (index < 0 || index >= CAMERAS || failed(__func__)) {
		return false;
	}
	mock_camera *camera = cameras + index;
	camera->opened = true;
	atomic_fetch_add(&camera->opens, 1);
	*context = &camera->context;
	return true;
}

void libatik_close(libatik_device_context *context) {
	mock_camera *camera = sdk_enter(context, __func__);
	if (camera) {
		camera->opened = false;
		atomic_fetch_add(&camera->closes, 1);
	}
	sdk_leave();
}

bool libatik_reset(libatik_device_context *context) {
	return true;
}

bool libatik_start_exposure(libatik_device_context *context, bool dark) {
	mock_camera *camera = sdk_enter(context, __func__);
	bool result = camera && !failed(__func__);
	if (result) {
		camera->dark = dark;
		camera->exposure = 0;
		atomic_fetch_add(&camera->starts, 1);
	}
	sdk_leave();
	return result;
}

bool libatik_abort_exposure(libatik_device_context *context) {
	mock_camera *camera = sdk_enter(context, __func__);
	bool result = camera && !failed(__func__);
	if (result) {
		atomic_fetch_add(&camera->aborts, 1);
	}
	sdk_leave();
	return result;
}

bool libatik_read_pixels(libatik_device_context *context, double delay, bool preview, int x, int y, int width, int height, int xbin, int ybin, unsigned short *image, int *image_width, int *image_height) {
	mock_camera *camera = sdk_enter(context, __func__);
	bool result = camera && !failed(__func__) && width > 0 && height > 0 && xbin > 0 && ybin > 0;
	if (result) {
		camera->exposure = delay;
		camera->preview = preview;
		camera->left = x;
		camera->top = y;
		camera->width = width;
		camera->height = height;
		camera->bx = xbin;
		camera->by = ybin;
		if (delay > 0) {
			indigo_usleep(delay * 1000000);
		}
		*image_width = width / xbin + atomic_load(&malformed_image);
		*image_height = height / ybin;
		for (int row = 0; row < height / ybin; row++) {
			for (int column = 0; column < width / xbin; column++) {
				image[row * (width / xbin) + column] = ccd_test_noise((y + row * ybin) * context->width + x + column * xbin, 0);
			}
		}
		atomic_fetch_add(&camera->reads, 1);
	}
	sdk_leave();
	return result;
}

bool libatik_set_cooler(libatik_device_context *context, bool status, double temperature) {
	mock_camera *camera = sdk_enter(context, __func__);
	bool result = camera && !failed(__func__);
	if (result) {
		camera->cooler_on = status;
		camera->cooler_target = temperature;
	}
	sdk_leave();
	return result;
}

bool libatik_check_cooler(libatik_device_context *context, bool *status, double *power, double *temperature) {
	mock_camera *camera = sdk_enter(context, __func__);
	bool result = camera && !failed(__func__);
	if (result) {
		*status = camera->cooler_on;
		*power = camera->cooler_power;
		*temperature = camera->temperature;
		atomic_fetch_add(&camera->cooler_checks, 1);
	}
	sdk_leave();
	return result;
}

bool libatik_set_filter_wheel(libatik_device_context *context, int filter) {
	mock_camera *camera = sdk_enter(context, __func__);
	bool accepted = camera && !failed(__func__);
	if (camera) {
		atomic_fetch_add(&camera->wheel_sets, 1);
	}
	if (accepted) {
		atomic_store(&camera->wheel_target, filter);
		atomic_store(&camera->wheel_polls, camera->wheel_stuck ? 1000 : 2);
	}
	sdk_leave();
	return accepted && !atomic_load(&false_wheel_set_result);
}

bool libatik_check_filter_wheel(libatik_device_context *context, int *filter) {
	mock_camera *camera = sdk_enter(context, __func__);
	bool result = camera && !failed(__func__);
	if (result) {
		if (atomic_load(&camera->wheel_polls) > 0) {
			if (atomic_fetch_sub(&camera->wheel_polls, 1) == 1) {
				atomic_store(&camera->wheel_position, atomic_load(&camera->wheel_target));
				*filter = atomic_load(&camera->wheel_position);
			} else {
				*filter = 0;
			}
		} else {
			*filter = atomic_load(&camera->wheel_position);
		}
	}
	sdk_leave();
	return result;
}

bool libatik_guide_relays(libatik_device_context *context, unsigned short mask) {
	mock_camera *camera = sdk_enter(context, __func__);
	bool result = camera && !failed(__func__);
	if (result) {
		atomic_store(&camera->relay, mask);
	}
	sdk_leave();
	return result;
}

static void metadata_and_properties(void) {
	indigo_driver_info info = { 0 };
	ASSERT_EQ_INT(INDIGO_OK, indigo_ccd_atik2(INDIGO_DRIVER_INFO, &info));
	ASSERT_EQ_INT(0x03000009, info.version);
	const unsigned interfaces[] = { INDIGO_INTERFACE_CCD, INDIGO_INTERFACE_GUIDER, INDIGO_INTERFACE_WHEEL };
	for (int i = 0; i < 3; i++) {
		indigo_property *property = snapshot(i, "INFO");
		ASSERT_TRUE(property != NULL);
		indigo_item *item = indigo_get_item(property, "DEVICE_INTERFACE");
		ASSERT_TRUE(item != NULL);
		ASSERT_TRUE((strtoul(item->text.value, NULL, 10) & interfaces[i]) != 0);
		indigo_release_property(property);
	}
	ASSERT_EQ_INT(-1, state(0, "CCD_INFO"));
	ASSERT_TRUE(connect_device(0, true));
	const char *properties[] = { "CCD_INFO", "CCD_EXPOSURE", "CCD_ABORT_EXPOSURE", "CCD_FRAME", "CCD_BIN", "CCD_MODE", "CCD_IMAGE_FORMAT", "CCD_IMAGE", "CCD_READ_MODE", "CCD_COOLER", "CCD_TEMPERATURE", "CCD_COOLER_POWER" };
	for (int i = 0; i < ARRAY_SIZE(properties); i++) {
		ASSERT_TRUE(state(0, properties[i]) >= 0);
	}
	indigo_property *mode = snapshot(0, "CCD_MODE");
	ASSERT_EQ_INT(3, mode->count);
	indigo_release_property(mode);
	ASSERT_TRUE(connect_device(0, false));
	cameras[0].context.has_cooler = false;
	ASSERT_TRUE(connect_device(0, true));
	ASSERT_EQ_INT(-1, state(0, "CCD_COOLER"));
}

static void shared_lifecycle(void) {
	const int orders[][3] = { { 0, 1, 2 }, { 0, 2, 1 }, { 1, 0, 2 }, { 1, 2, 0 }, { 2, 0, 1 }, { 2, 1, 0 } };
	for (int i = 0; i < ARRAY_SIZE(orders); i++) {
		int opens = cameras[0].opens;
		for (int j = 0; j < 3; j++) {
			ASSERT_TRUE(connect_device(orders[i][j], true));
		}
		ASSERT_EQ_INT(opens + 1, cameras[0].opens);
		ASSERT_EQ_INT(INDIGO_BUSY, indigo_ccd_atik2(INDIGO_DRIVER_SHUTDOWN, NULL));
		ASSERT_TRUE(connect_device(0, false));
		ASSERT_TRUE(request_number(1, "GUIDER_GUIDE_RA", "EAST", 20, INDIGO_OK_STATE));
		ASSERT_TRUE(connect_device(1, false));
		ASSERT_TRUE(request_number(2, "WHEEL_SLOT", "SLOT", 3, INDIGO_OK_STATE));
		ASSERT_TRUE(connect_device(2, false));
		ASSERT_EQ_INT(cameras[0].opens, cameras[0].closes);
	}
}

static void initialization_failures(void) {
	fail_lock = 1;
	ASSERT_TRUE(request_switch(0, "CONNECTION", "CONNECTED", INDIGO_ALERT_STATE));
	ASSERT_EQ_INT(0, lock_count);
	fail_lock = 0;
	fail_call = "libatik_open";
	ASSERT_TRUE(request_switch(0, "CONNECTION", "CONNECTED", INDIGO_ALERT_STATE));
	ASSERT_EQ_INT(0, lock_count);
	fail_call = NULL;
	malformed_context = 1;
	cameras[0].context.width = 0;
	ASSERT_TRUE(request_switch(0, "CONNECTION", "CONNECTED", INDIGO_ALERT_STATE));
	cameras[0].context.width = 64;
	malformed_context = 0;
	fail_call = "libatik_check_cooler";
	ASSERT_TRUE(request_switch(0, "CONNECTION", "CONNECTED", INDIGO_ALERT_STATE));
	fail_call = NULL;
	ASSERT_TRUE(connect_device(0, true));
	ASSERT_TRUE(connect_device(0, false));
}

static void shared_connection_rollback(void) {
	for (int i = 0; i < 3; i++) {
		fail_call = "libatik_open";
		ASSERT_TRUE(request_switch(i, "CONNECTION", "CONNECTED", INDIGO_ALERT_STATE));
		ASSERT_EQ_INT(0, lock_count);
		ASSERT_FALSE(cameras[0].opened);
		fail_call = NULL;
		ASSERT_TRUE(connect_device(i, true));
		ASSERT_TRUE(connect_device(i, false));
	}
	ASSERT_TRUE(connect_device(1, true));
	int opens = cameras[0].opens;
	fail_call = "libatik_check_cooler";
	ASSERT_TRUE(request_switch(0, "CONNECTION", "CONNECTED", INDIGO_ALERT_STATE));
	ASSERT_TRUE(cameras[0].opened);
	ASSERT_EQ_INT(opens, cameras[0].opens);
	fail_call = NULL;
	ASSERT_TRUE(request_number(1, "GUIDER_GUIDE_RA", "EAST", 20, INDIGO_OK_STATE));
	ASSERT_TRUE(connect_device(0, true));
	ASSERT_TRUE(connect_device(1, false));
	ASSERT_TRUE(request_number(0, "CCD_EXPOSURE", "EXPOSURE", .02, INDIGO_OK_STATE));
}

static void malformed_initialization(void) {
	double *double_fields[] = { &cameras[0].context.pixel_width, &cameras[0].context.pixel_height, &cameras[0].context.min_exposure };
	for (int i = 0; i < ARRAY_SIZE(double_fields); i++) {
		double saved = *double_fields[i];
		*double_fields[i] = i == 2 ? 0 : NAN;
		ASSERT_TRUE(request_switch(0, "CONNECTION", "CONNECTED", INDIGO_ALERT_STATE));
		ASSERT_EQ_INT(0, lock_count);
		*double_fields[i] = saved;
	}
	int *integer_fields[] = { &cameras[0].context.height, &cameras[0].context.max_bin_hor, &cameras[0].context.max_bin_vert };
	for (int i = 0; i < ARRAY_SIZE(integer_fields); i++) {
		int saved = *integer_fields[i];
		*integer_fields[i] = 0;
		ASSERT_TRUE(request_switch(0, "CONNECTION", "CONNECTED", INDIGO_ALERT_STATE));
		*integer_fields[i] = saved;
	}
	cameras[0].cooler_power = 101;
	ASSERT_TRUE(request_switch(0, "CONNECTION", "CONNECTED", INDIGO_ALERT_STATE));
	cameras[0].cooler_power = 35;
	cameras[0].temperature = NAN;
	ASSERT_TRUE(request_switch(0, "CONNECTION", "CONNECTED", INDIGO_ALERT_STATE));
	cameras[0].temperature = 12;
	ASSERT_TRUE(connect_device(0, true));
}

static void capability_profiles(void) {
	ASSERT_EQ_INT(INDIGO_OK, indigo_ccd_atik2(INDIGO_DRIVER_SHUTDOWN, NULL));
	cameras[0].guider = cameras[0].wheel = cameras[0].cooler = false;
	cameras[0].context.has_guider_port = cameras[0].context.has_filter_wheel = cameras[0].context.has_cooler = false;
	ASSERT_EQ_INT(INDIGO_OK, indigo_ccd_atik2(INDIGO_DRIVER_INIT, NULL));
	ASSERT_TRUE(wait_count(&attached, 1));
	ASSERT_TRUE(connect_device(0, true));
	ASSERT_EQ_INT(-1, state(0, "CCD_COOLER"));
	ASSERT_TRUE(connect_device(0, false));
	cameras[1].visible = true;
	cameras[1].guider = cameras[1].context.has_guider_port = true;
	usb_event(1, true);
	ASSERT_TRUE(wait_count(&attached, 3));
	cameras[2].visible = true;
	cameras[2].wheel = cameras[2].context.has_filter_wheel = true;
	usb_event(2, true);
	ASSERT_TRUE(wait_count(&attached, 5));
	ASSERT_TRUE(connect_device(4, true));
	ASSERT_TRUE(request_number(4, "GUIDER_GUIDE_DEC", "SOUTH", 20, INDIGO_OK_STATE));
	ASSERT_TRUE(connect_device(4, false));
	ASSERT_TRUE(connect_device(8, true));
	ASSERT_TRUE(request_number(8, "WHEEL_SLOT", "SLOT", 2, INDIGO_OK_STATE));
}

static void exposure_modes_and_timing(void) {
	ASSERT_TRUE(connect_device(0, true));
	ASSERT_TRUE(request_switch(0, "CCD_IMAGE_FORMAT", "RAW", INDIGO_OK_STATE));
	double start = indigo_monotonic_time();
	ASSERT_TRUE(request_number(0, "CCD_EXPOSURE", "EXPOSURE", .05, INDIGO_OK_STATE));
	ASSERT_TRUE(indigo_monotonic_time() - start >= .045);
	ASSERT_TRUE(request_switch(0, "CCD_FRAME_TYPE", "BIAS", INDIGO_OK_STATE));
	ASSERT_TRUE(request_number(0, "CCD_EXPOSURE", "EXPOSURE", .5, INDIGO_OK_STATE));
	ASSERT_TRUE(fabs(cameras[0].exposure - cameras[0].context.min_exposure) < .0001);
	ASSERT_TRUE(request_switch(0, "CCD_FRAME_TYPE", "DARK", INDIGO_OK_STATE));
	ASSERT_TRUE(request_number(0, "CCD_EXPOSURE", "EXPOSURE", 1.05, INDIGO_OK_STATE));
	ASSERT_TRUE(cameras[0].dark);
	ASSERT_TRUE(request_switch(0, "CCD_FRAME_TYPE", "DARKFLAT", INDIGO_OK_STATE));
	ASSERT_TRUE(request_number(0, "CCD_EXPOSURE", "EXPOSURE", 1.01, INDIGO_OK_STATE));
	ASSERT_TRUE(cameras[0].dark);
	ASSERT_TRUE(request_switch(0, "CCD_FRAME_TYPE", "FLAT", INDIGO_OK_STATE));
	ASSERT_TRUE(request_number(0, "CCD_EXPOSURE", "EXPOSURE", 1.01, INDIGO_OK_STATE));
	ASSERT_FALSE(cameras[0].dark);
	ASSERT_TRUE(request_switch(0, "CCD_READ_MODE", "HIGH_SPEED", INDIGO_OK_STATE));
	ASSERT_TRUE(request_number(0, "CCD_EXPOSURE", "EXPOSURE", .02, INDIGO_OK_STATE));
	ASSERT_TRUE(cameras[0].preview);
	ASSERT_EQ_INT(6, blobs);
	ASSERT_EQ_INT(0, bad_blob);
}

static void geometry_and_payload(void) {
	ASSERT_TRUE(connect_device(0, true));
	ASSERT_TRUE(request_switch(0, "CCD_IMAGE_FORMAT", "RAW", INDIGO_OK_STATE));
	ASSERT_TRUE(request_switch(0, "CCD_MODE", "BIN_2x2", INDIGO_OK_STATE));
	const char *items[] = { "LEFT", "TOP", "WIDTH", "HEIGHT" };
	double values[] = { 5, 7, 32, 24 };
	ASSERT_TRUE(request_numbers(0, "CCD_FRAME", 4, items, values, INDIGO_OK_STATE));
	ASSERT_TRUE(request_number(0, "CCD_EXPOSURE", "EXPOSURE", .02, INDIGO_OK_STATE));
	ASSERT_EQ_INT(4, cameras[0].left);
	ASSERT_EQ_INT(6, cameras[0].top);
	ASSERT_EQ_INT(2, cameras[0].bx);
	ASSERT_EQ_INT(0, bad_blob);
	ASSERT_TRUE(request_number(0, "CCD_BIN", "HORIZONTAL", 4, INDIGO_ALERT_STATE));
}

static void mode_and_bin_contract(void) {
	ASSERT_TRUE(connect_device(0, true));
	ASSERT_TRUE(request_switch(0, "CCD_IMAGE_FORMAT", "RAW", INDIGO_OK_STATE));
	const char *modes[] = { "BIN_1x1", "BIN_2x2", "BIN_4x4" };
	for (int i = 0; i < ARRAY_SIZE(modes); i++) {
		ASSERT_TRUE(request_switch(0, "CCD_MODE", modes[i], INDIGO_OK_STATE));
		ASSERT_EQ_INT(1 << i, (int)value(0, "CCD_BIN", "HORIZONTAL"));
		ASSERT_EQ_INT(1 << i, (int)value(0, "CCD_BIN", "VERTICAL"));
		ASSERT_TRUE(request_number(0, "CCD_EXPOSURE", "EXPOSURE", .02, INDIGO_OK_STATE));
		ASSERT_EQ_INT(1 << i, cameras[0].bx);
	}
	ASSERT_TRUE(request_number(0, "CCD_BIN", "HORIZONTAL", 3, INDIGO_ALERT_STATE));
}

static void acquisition_failures_and_abort(void) {
	ASSERT_TRUE(connect_device(0, true));
	fail_call = "libatik_read_pixels";
	ASSERT_TRUE(request_number(0, "CCD_EXPOSURE", "EXPOSURE", .02, INDIGO_ALERT_STATE));
	fail_call = NULL;
	malformed_image = 1;
	ASSERT_TRUE(request_number(0, "CCD_EXPOSURE", "EXPOSURE", .02, INDIGO_ALERT_STATE));
	malformed_image = 0;
	fail_call = "libatik_start_exposure";
	ASSERT_TRUE(request_number(0, "CCD_EXPOSURE", "EXPOSURE", 1.1, INDIGO_ALERT_STATE));
	fail_call = NULL;
	ASSERT_TRUE(request_number(0, "CCD_EXPOSURE", "EXPOSURE", 2, INDIGO_BUSY_STATE));
	ASSERT_TRUE(wait_count(&cameras[0].starts, 1));
	ASSERT_TRUE(request_number(0, "CCD_BIN", "HORIZONTAL", 2, INDIGO_ALERT_STATE));
	ASSERT_TRUE(request_switch(0, "CCD_ABORT_EXPOSURE", "ABORT_EXPOSURE", INDIGO_OK_STATE));
	ASSERT_EQ_INT(1, cameras[0].aborts);
	ASSERT_TRUE(request_number(0, "CCD_EXPOSURE", "EXPOSURE", .02, INDIGO_OK_STATE));
}

static void abort_failure_and_deadline(void) {
	ASSERT_TRUE(connect_device(0, true));
	ASSERT_TRUE(request_number(0, "CCD_EXPOSURE", "EXPOSURE", 2, INDIGO_BUSY_STATE));
	ASSERT_TRUE(wait_count(&cameras[0].starts, 1));
	fail_call = "libatik_abort_exposure";
	ASSERT_TRUE(request_switch(0, "CCD_ABORT_EXPOSURE", "ABORT_EXPOSURE", INDIGO_ALERT_STATE));
	fail_call = NULL;
	ASSERT_TRUE(request_number(0, "CCD_EXPOSURE", "EXPOSURE", .02, INDIGO_OK_STATE));
	ASSERT_EQ_INT(1, cameras[0].aborts);
	ASSERT_TRUE(request_number(0, "CCD_EXPOSURE", "EXPOSURE", 1.05, INDIGO_BUSY_STATE));
	ASSERT_TRUE(wait_count(&cameras[0].starts, 2));
	clock_shift = 200;
	ASSERT_TRUE(wait_state(0, "CCD_EXPOSURE", INDIGO_ALERT_STATE));
	clock_shift = 0;
	ASSERT_TRUE(request_number(0, "CCD_EXPOSURE", "EXPOSURE", .02, INDIGO_OK_STATE));
}

static void pending_start_abort(void) {
	ASSERT_TRUE(connect_device(0, true));
	arm_gate("queue");
	indigo_execute_handler(logical[0], block_queue);
	ASSERT_TRUE(wait_count(&gates_entered, 1));
	ASSERT_TRUE(request_number(0, "CCD_EXPOSURE", "EXPOSURE", 2, INDIGO_BUSY_STATE));
	remember_request(observed[0].name, "CCD_ABORT_EXPOSURE");
	ASSERT_EQ_INT(INDIGO_OK, indigo_change_switch_property_1(&test_client, observed[0].name, "CCD_ABORT_EXPOSURE", "ABORT_EXPOSURE", true));
	release_gate();
	ASSERT_TRUE(wait_state(0, "CCD_ABORT_EXPOSURE", INDIGO_OK_STATE));
	ASSERT_EQ_INT(0, cameras[0].starts);
	ASSERT_TRUE(request_number(0, "CCD_EXPOSURE", "EXPOSURE", .02, INDIGO_OK_STATE));
}

static void readout_disconnect_and_removal(void) {
	ASSERT_TRUE(connect_device(0, true));
	arm_gate("libatik_read_pixels");
	ASSERT_TRUE(request_number(0, "CCD_EXPOSURE", "EXPOSURE", .02, INDIGO_BUSY_STATE));
	ASSERT_TRUE(wait_count(&gates_entered, 1));
	remember_request(observed[0].name, "CONNECTION");
	ASSERT_EQ_INT(INDIGO_OK, indigo_change_switch_property_1(&test_client, observed[0].name, "CONNECTION", "DISCONNECTED", true));
	indigo_usleep(50000);
	ASSERT_TRUE(cameras[0].opened);
	release_gate();
	ASSERT_TRUE(wait_state(0, "CONNECTION", INDIGO_OK_STATE));
	ASSERT_FALSE(cameras[0].opened);
	ASSERT_TRUE(connect_device(0, true));
	arm_gate("libatik_read_pixels");
	ASSERT_TRUE(request_number(0, "CCD_EXPOSURE", "EXPOSURE", .02, INDIGO_BUSY_STATE));
	ASSERT_TRUE(wait_count(&gates_entered, 1));
	cameras[0].visible = false;
	usb_event(0, false);
	indigo_usleep(50000);
	ASSERT_EQ_INT(1, attached);
	ASSERT_TRUE(cameras[0].opened);
	release_gate();
	ASSERT_TRUE(wait_count(&attached, 0));
	ASSERT_FALSE(cameras[0].opened);
	cameras[0].visible = true;
	usb_event(0, true);
	ASSERT_TRUE(wait_count(&attached, 3));
	ASSERT_TRUE(connect_device(0, true));
	ASSERT_TRUE(request_number(0, "CCD_EXPOSURE", "EXPOSURE", .02, INDIGO_OK_STATE));
}

static void countdown_with_occupied_queue(void) {
	ASSERT_TRUE(connect_device(0, true));
	ASSERT_TRUE(request_number(0, "CCD_EXPOSURE", "EXPOSURE", 1.5, INDIGO_BUSY_STATE));
	ASSERT_TRUE(wait_count(&cameras[0].starts, 1));
	arm_gate("queue");
	indigo_execute_handler(logical[0], block_queue);
	ASSERT_TRUE(wait_count(&gates_entered, 1));
	double deadline = indigo_monotonic_time() + 2;
	while (value(0, "CCD_EXPOSURE", "EXPOSURE") > 1 && indigo_monotonic_time() < deadline) {
		indigo_usleep(10000);
	}
	bool progressed = value(0, "CCD_EXPOSURE", "EXPOSURE") <= 1;
	release_gate();
	ASSERT_TRUE(progressed);
	ASSERT_TRUE(wait_state(0, "CCD_EXPOSURE", INDIGO_OK_STATE));
}

static void cooling_and_polling(void) {
	ASSERT_TRUE(connect_device(0, true));
	ASSERT_TRUE(request_number(0, "CCD_TEMPERATURE", "TEMPERATURE", -10.5, INDIGO_BUSY_STATE));
	for (int i = 0; i < 100 && !cameras[0].cooler_on; i++) {
		indigo_usleep(10000);
	}
	ASSERT_TRUE(cameras[0].cooler_on);
	ASSERT_TRUE(fabs(cameras[0].cooler_target + 10.5) < .001);
	cameras[0].temperature = -10.4;
	for (int i = 0; i < 100 && state(0, "CCD_TEMPERATURE") != INDIGO_OK_STATE; i++) {
		indigo_usleep(10000);
	}
	ASSERT_EQ_INT(INDIGO_OK_STATE, state(0, "CCD_TEMPERATURE"));
	fail_call = "libatik_check_cooler";
	for (int i = 0; i < 100 && state(0, "CCD_COOLER_POWER") != INDIGO_ALERT_STATE; i++) {
		indigo_usleep(10000);
	}
	ASSERT_EQ_INT(INDIGO_ALERT_STATE, state(0, "CCD_COOLER_POWER"));
	fail_call = NULL;
	ASSERT_TRUE(request_switch(0, "CCD_COOLER", "OFF", INDIGO_OK_STATE));
	ASSERT_FALSE(cameras[0].cooler_on);
	ASSERT_TRUE(connect_device(0, false));
	int checks = cameras[0].cooler_checks;
	indigo_usleep(100000);
	ASSERT_EQ_INT(checks, cameras[0].cooler_checks);
}

static void cooling_failures_and_exclusion(void) {
	ASSERT_TRUE(connect_device(0, true));
	fail_call = "libatik_set_cooler";
	ASSERT_TRUE(request_number(0, "CCD_TEMPERATURE", "TEMPERATURE", -5, INDIGO_ALERT_STATE));
	ASSERT_TRUE(request_switch(0, "CCD_COOLER", "ON", INDIGO_ALERT_STATE));
	fail_call = NULL;
	int checks = cameras[0].cooler_checks;
	ASSERT_TRUE(request_number(0, "CCD_EXPOSURE", "EXPOSURE", 2, INDIGO_BUSY_STATE));
	indigo_usleep(150000);
	ASSERT_EQ_INT(checks, cameras[0].cooler_checks);
	ASSERT_TRUE(request_switch(0, "CCD_ABORT_EXPOSURE", "ABORT_EXPOSURE", INDIGO_OK_STATE));
	cameras[0].cooler_on = false;
	ASSERT_TRUE(request_switch(0, "CCD_COOLER", "ON", INDIGO_OK_STATE));
	ASSERT_TRUE(cameras[0].cooler_on);
}

static void guider_operations(void) {
	ASSERT_TRUE(connect_device(1, true));
	ASSERT_TRUE(request_number(1, "GUIDER_GUIDE_RA", "EAST", 500, INDIGO_BUSY_STATE));
	ASSERT_TRUE(request_number(1, "GUIDER_GUIDE_DEC", "NORTH", 20, INDIGO_OK_STATE));
	ASSERT_EQ_INT(ATIK_GUIDE_EAST, cameras[0].relay);
	ASSERT_TRUE(request_number(1, "GUIDER_GUIDE_RA", "WEST", 20, INDIGO_OK_STATE));
	ASSERT_EQ_INT(0, cameras[0].relay);
	ASSERT_TRUE(request_number(1, "GUIDER_GUIDE_DEC", "SOUTH", 500, INDIGO_BUSY_STATE));
	ASSERT_TRUE(request_number(1, "GUIDER_GUIDE_DEC", "SOUTH", 0, INDIGO_OK_STATE));
	fail_call = "libatik_guide_relays";
	ASSERT_TRUE(request_number(1, "GUIDER_GUIDE_RA", "EAST", 20, INDIGO_ALERT_STATE));
	fail_call = NULL;
	ASSERT_TRUE(request_number(1, "GUIDER_GUIDE_RA", "EAST", 20, INDIGO_OK_STATE));
}

static void guider_failures_and_disconnect(void) {
	fail_call = "libatik_guide_relays";
	ASSERT_TRUE(request_switch(1, "CONNECTION", "CONNECTED", INDIGO_ALERT_STATE));
	fail_call = NULL;
	ASSERT_TRUE(connect_device(1, true));
	const char *items[] = { "NORTH", "SOUTH", "EAST", "WEST" };
	for (int i = 0; i < ARRAY_SIZE(items); i++) {
		ASSERT_TRUE(request_number(1, i < 2 ? "GUIDER_GUIDE_DEC" : "GUIDER_GUIDE_RA", items[i], 20, INDIGO_OK_STATE));
	}
	ASSERT_TRUE(request_number(1, "GUIDER_GUIDE_RA", "EAST", 200, INDIGO_BUSY_STATE));
	fail_call = "libatik_guide_relays";
	ASSERT_TRUE(wait_state(1, "GUIDER_GUIDE_RA", INDIGO_ALERT_STATE));
	fail_call = NULL;
	ASSERT_TRUE(request_number(1, "GUIDER_GUIDE_RA", "WEST", 20, INDIGO_OK_STATE));
	ASSERT_TRUE(connect_device(1, false));
	ASSERT_EQ_INT(0, cameras[0].relay);
}

static void wheel_operations(void) {
	ASSERT_TRUE(connect_device(2, true));
	ASSERT_TRUE(request_number(2, "WHEEL_SLOT", "SLOT", 1, INDIGO_OK_STATE));
	ASSERT_EQ_INT(0, cameras[0].wheel_polls);
	ASSERT_TRUE(request_number(2, "WHEEL_SLOT", "SLOT", 5, INDIGO_OK_STATE));
	ASSERT_EQ_INT(5, cameras[0].wheel_position);
	false_wheel_set_result = 1;
	ASSERT_TRUE(request_number(2, "WHEEL_SLOT", "SLOT", 4, INDIGO_OK_STATE));
	ASSERT_EQ_INT(4, cameras[0].wheel_position);
	false_wheel_set_result = 0;
	int sets = cameras[0].wheel_sets;
	fail_call = "libatik_set_filter_wheel";
	ASSERT_TRUE(request_number(2, "WHEEL_SLOT", "SLOT", 2, INDIGO_BUSY_STATE));
	ASSERT_TRUE(wait_count(&cameras[0].wheel_sets, sets + 1));
	clock_shift = 100;
	ASSERT_TRUE(wait_state(2, "WHEEL_SLOT", INDIGO_ALERT_STATE));
	clock_shift = 0;
	fail_call = "libatik_check_filter_wheel";
	ASSERT_TRUE(request_number(2, "WHEEL_SLOT", "SLOT", 2, INDIGO_ALERT_STATE));
	fail_call = NULL;
	cameras[0].wheel_stuck = true;
	ASSERT_TRUE(request_number(2, "WHEEL_SLOT", "SLOT", 3, INDIGO_BUSY_STATE));
	ASSERT_TRUE(wait_count(&cameras[0].wheel_target, 3));
	remember_request(observed[2].name, "WHEEL_SLOT");
	ASSERT_EQ_INT(INDIGO_OK, indigo_change_number_property_1(&test_client, observed[2].name, "WHEEL_SLOT", "SLOT", 4));
	indigo_usleep(50000);
	ASSERT_EQ_INT(3, cameras[0].wheel_target);
	clock_shift = 100;
	ASSERT_TRUE(wait_state(2, "WHEEL_SLOT", INDIGO_ALERT_STATE));
	clock_shift = 0;
	cameras[0].wheel_stuck = false;
	atomic_store(&cameras[0].wheel_polls, 0);
	atomic_store(&cameras[0].wheel_position, 3);
	ASSERT_TRUE(connect_device(2, false));
	cameras[0].context.filter_count = 7;
	ASSERT_TRUE(connect_device(2, true));
	ASSERT_EQ_INT(7, (int)value(2, "WHEEL_SLOT", "SLOT") == 3 ? cameras[0].context.filter_count : 0);
}

static void wheel_initialization_failures(void) {
	fail_call = "libatik_check_filter_wheel";
	ASSERT_TRUE(request_switch(2, "CONNECTION", "CONNECTED", INDIGO_ALERT_STATE));
	fail_call = NULL;
	cameras[0].context.filter_count = 0;
	ASSERT_TRUE(request_switch(2, "CONNECTION", "CONNECTED", INDIGO_ALERT_STATE));
	cameras[0].context.filter_count = 65;
	ASSERT_TRUE(request_switch(2, "CONNECTION", "CONNECTED", INDIGO_ALERT_STATE));
	cameras[0].context.filter_count = 5;
	cameras[0].wheel_position = 0;
	ASSERT_TRUE(request_switch(2, "CONNECTION", "CONNECTED", INDIGO_ALERT_STATE));
	cameras[0].wheel_position = 1;
	ASSERT_TRUE(connect_device(2, true));
	ASSERT_TRUE(request_number(2, "WHEEL_SLOT", "SLOT", 5, INDIGO_OK_STATE));
}

static void hotplug_and_capacity(void) {
	for (int i = 1; i < 4; i++) {
		cameras[i].visible = true;
		usb_event(i, true);
	}
	indigo_queue_drain(driver_queue);
	ASSERT_EQ_INT(5, attached);
	usb_event(1, true);
	indigo_queue_drain(driver_queue);
	ASSERT_EQ_INT(5, attached);
	ASSERT_TRUE(connect_device(3, true));
	cameras[0].visible = false;
	usb_event(0, false);
	ASSERT_TRUE(wait_count(&attached, 2));
	ASSERT_TRUE(request_number(3, "CCD_EXPOSURE", "EXPOSURE", .02, INDIGO_OK_STATE));
	cameras[0].visible = true;
	usb_event(0, true);
	ASSERT_TRUE(wait_count(&attached, 5));
}

static void hotplug_filters_and_attach_rollback(void) {
	ASSERT_EQ_INT(INDIGO_OK, indigo_ccd_atik2(INDIGO_DRIVER_SHUTDOWN, NULL));
	wrong_vendor = 1;
	ASSERT_EQ_INT(INDIGO_OK, indigo_ccd_atik2(INDIGO_DRIVER_INIT, NULL));
	indigo_queue_drain(driver_queue);
	ASSERT_EQ_INT(0, attached);
	wrong_vendor = 0;
	fail_call = "libatik_camera";
	usb_event(0, true);
	indigo_queue_drain(driver_queue);
	ASSERT_EQ_INT(0, attached);
	fail_call = NULL;
	fail_attach = 1;
	usb_event(0, true);
	indigo_queue_drain(driver_queue);
	ASSERT_EQ_INT(0, attached);
	fail_attach = 2;
	usb_event(0, true);
	indigo_queue_drain(driver_queue);
	ASSERT_EQ_INT(2, attached);
	ASSERT_TRUE(connect_device(0, true));
	ASSERT_TRUE(request_number(0, "CCD_EXPOSURE", "EXPOSURE", .02, INDIGO_OK_STATE));
	ASSERT_TRUE(connect_device(0, false));
	cameras[0].visible = false;
	usb_event(0, false);
	ASSERT_TRUE(wait_count(&attached, 0));
	cameras[0].visible = true;
	fail_attach = 3;
	usb_event(0, true);
	indigo_queue_drain(driver_queue);
	ASSERT_EQ_INT(2, attached);
	cameras[0].visible = false;
	usb_event(0, false);
	ASSERT_TRUE(wait_count(&attached, 0));
	fail_attach = 0;
	cameras[0].visible = true;
	usb_event(0, true);
	ASSERT_TRUE(wait_count(&attached, 3));
}

static void repeated_init_shutdown(void) {
	ASSERT_EQ_INT(INDIGO_OK, indigo_ccd_atik2(INDIGO_DRIVER_SHUTDOWN, NULL));
	ASSERT_EQ_INT(INDIGO_OK, indigo_ccd_atik2(INDIGO_DRIVER_SHUTDOWN, NULL));
	ASSERT_EQ_INT(INDIGO_OK, indigo_ccd_atik2(INDIGO_DRIVER_INIT, NULL));
	ASSERT_TRUE(wait_count(&attached, 3));
	ASSERT_EQ_INT(INDIGO_OK, indigo_ccd_atik2(INDIGO_DRIVER_INIT, NULL));
	ASSERT_TRUE(connect_device(2, true));
	ASSERT_EQ_INT(INDIGO_BUSY, indigo_ccd_atik2(INDIGO_DRIVER_SHUTDOWN, NULL));
	ASSERT_TRUE(connect_device(2, false));
}

static void driver_lifecycle_and_races(void) {
	ASSERT_EQ_INT(INDIGO_OK, indigo_ccd_atik2(INDIGO_DRIVER_SHUTDOWN, NULL));
	fail_register = 1;
	ASSERT_EQ_INT(INDIGO_FAILED, indigo_ccd_atik2(INDIGO_DRIVER_INIT, NULL));
	fail_register = 0;
	fail_queue = 1;
	ASSERT_EQ_INT(INDIGO_FAILED, indigo_ccd_atik2(INDIGO_DRIVER_INIT, NULL));
	fail_queue = 0;
	fail_descriptor = 1;
	ASSERT_EQ_INT(INDIGO_OK, indigo_ccd_atik2(INDIGO_DRIVER_INIT, NULL));
	indigo_queue_drain(driver_queue);
	ASSERT_EQ_INT(0, attached);
	fail_descriptor = 0;
	wrong_vendor = 1;
	usb_event(0, true);
	indigo_queue_drain(driver_queue);
	ASSERT_EQ_INT(0, attached);
	wrong_vendor = 0;
	usb_event(0, true);
	ASSERT_TRUE(wait_count(&attached, 3));
	ASSERT_TRUE(connect_device(0, true));
	ASSERT_TRUE(request_number(0, "CCD_EXPOSURE", "EXPOSURE", 2, INDIGO_BUSY_STATE));
	cameras[0].visible = false;
	usb_event(0, false);
	ASSERT_TRUE(wait_count(&attached, 0));
	ASSERT_FALSE(cameras[0].opened);
	cameras[0].visible = true;
	usb_event(0, true);
	ASSERT_TRUE(wait_count(&attached, 3));
	ASSERT_TRUE(connect_device(0, true));
	ASSERT_TRUE(request_number(0, "CCD_EXPOSURE", "EXPOSURE", .02, INDIGO_OK_STATE));
}

static void clear_observations(void) {
	pthread_mutex_lock(&observation_mutex);
	for (int i = 0; i < LOGICAL_DEVICES; i++) {
		for (int j = 0; j < PROPERTIES; j++) {
			indigo_release_property(observed[i].properties[j]);
			observed[i].properties[j] = NULL;
			observed[i].updates[j] = 0;
		}
		logical[i] = NULL;
		observed[i].name[0] = 0;
	}
	pthread_mutex_unlock(&observation_mutex);
}

static void begin_fixture(void) {
	release_gate();
	clear_observations();
	memset(cameras, 0, sizeof(cameras));
	memset(request_revisions, 0, sizeof(request_revisions));
	attached = lock_count = unbalanced_unlock = usb_refs = invalid_usb_unref = updates_after_detach = 0;
	fail_register = fail_descriptor = fail_attach = fail_queue = fail_lock = wrong_vendor = malformed_context = malformed_image = false_wheel_set_result = 0;
	blobs = bad_blob = sdk_after_close = sdk_active = sdk_overlap = clock_shift = sdk_on_bus = gates_entered = 0;
	fail_call = NULL;
	for (int i = 0; i < CAMERAS; i++) {
		snprintf(cameras[i].name, sizeof(cameras[i].name), "Atik2 test %d", i);
		cameras[i].context.width = 64;
		cameras[i].context.height = 48;
		cameras[i].context.pixel_width = 4.54;
		cameras[i].context.pixel_height = 4.54;
		cameras[i].context.max_bin_hor = 4;
		cameras[i].context.max_bin_vert = 4;
		cameras[i].context.min_exposure = .01;
		cameras[i].context.filter_count = 5;
		cameras[i].cooler_power = 35;
		cameras[i].temperature = 12;
		cameras[i].wheel_position = cameras[i].wheel_target = 1;
	}
	cameras[0].visible = true;
	cameras[0].guider = cameras[0].wheel = cameras[0].cooler = true;
	cameras[0].context.has_guider_port = cameras[0].context.has_filter_wheel = cameras[0].context.has_cooler = true;
	ASSERT_EQ_INT(INDIGO_OK, indigo_ccd_atik2(INDIGO_DRIVER_INIT, NULL));
	ASSERT_TRUE(wait_count(&attached, 3));
}

static void end_fixture(void) {
	release_gate();
	fail_call = NULL;
	clock_shift = fail_attach = fail_register = fail_queue = fail_lock = 0;
	for (int i = LOGICAL_DEVICES - 1; i >= 0; i--) {
		if (logical[i]) {
			indigo_property *connection = snapshot(i, "CONNECTION");
			bool connected = connection && connection->items[0].sw.value;
			indigo_release_property(connection);
			if (connected) {
				ASSERT_TRUE(connect_device(i, false));
			}
		}
	}
	ASSERT_EQ_INT(INDIGO_OK, indigo_ccd_atik2(INDIGO_DRIVER_SHUTDOWN, NULL));
	ASSERT_EQ_INT(0, attached);
	ASSERT_EQ_INT(0, lock_count);
	ASSERT_EQ_INT(0, unbalanced_unlock);
	ASSERT_EQ_INT(0, usb_refs);
	ASSERT_EQ_INT(0, invalid_usb_unref);
	ASSERT_EQ_INT(0, sdk_after_close);
	ASSERT_EQ_INT(0, sdk_overlap);
	ASSERT_EQ_INT(0, sdk_on_bus);
	ASSERT_EQ_INT(0, updates_after_detach);
}

int main(int argc, char **argv) {
	setvbuf(stdout, NULL, _IONBF, 0);
	bus_thread = pthread_self();
	indigo_set_log_level(INDIGO_LOG_ERROR);
	indigo_start();
	indigo_attach_client(&test_client);
	const indigo_test_case tests[] = {
		{ "metadata_and_properties", metadata_and_properties },
		{ "shared_lifecycle", shared_lifecycle },
		{ "initialization_failures", initialization_failures },
		{ "shared_connection_rollback", shared_connection_rollback },
		{ "malformed_initialization", malformed_initialization },
		{ "capability_profiles", capability_profiles },
		{ "exposure_modes_and_timing", exposure_modes_and_timing },
		{ "geometry_and_payload", geometry_and_payload },
		{ "mode_and_bin_contract", mode_and_bin_contract },
		{ "acquisition_failures_and_abort", acquisition_failures_and_abort },
		{ "abort_failure_and_deadline", abort_failure_and_deadline },
		{ "pending_start_abort", pending_start_abort },
		{ "readout_disconnect_and_removal", readout_disconnect_and_removal },
		{ "countdown_with_occupied_queue", countdown_with_occupied_queue },
		{ "cooling_and_polling", cooling_and_polling },
		{ "cooling_failures_and_exclusion", cooling_failures_and_exclusion },
		{ "guider_operations", guider_operations },
		{ "guider_failures_and_disconnect", guider_failures_and_disconnect },
		{ "wheel_operations", wheel_operations },
		{ "wheel_initialization_failures", wheel_initialization_failures },
		{ "hotplug_and_capacity", hotplug_and_capacity },
		{ "hotplug_filters_and_attach_rollback", hotplug_filters_and_attach_rollback },
		{ "repeated_init_shutdown", repeated_init_shutdown },
		{ "driver_lifecycle_and_races", driver_lifecycle_and_races }
	};
	int result = 0, selected = 0;
	for (int i = 0; i < ARRAY_SIZE(tests); i++) {
		if (argc > 1 && !strstr(tests[i].name, argv[1])) {
			continue;
		}
		selected++;
		alarm(30);
		begin_fixture();
		result |= indigo_run_tests("Atik2 fake SDK", tests + i, 1);
		end_fixture();
		alarm(0);
	}
	indigo_detach_client(&test_client);
	indigo_stop();
	clear_observations();
	return !selected || result || indigo_test_failures;
}
