// Copyright (c) 2026 INDIGO initiative
// All rights reserved.
//
// You may use this software under the terms of 'INDIGO Astronomy
// open-source license' (see LICENSE.md).
//
// THIS SOFTWARE IS PROVIDED BY THE AUTHORS 'AS IS' AND ANY EXPRESS
// OR IMPLIED WARRANTIES, INCLUDING, BUT NOT LIMITED TO, THE IMPLIED
// WARRANTIES OF MERCHANTABILITY AND FITNESS FOR A PARTICULAR PURPOSE
// ARE DISCLAIMED. IN NO EVENT SHALL THE AUTHOR BE LIABLE FOR ANY
// DIRECT, INDIRECT, INCIDENTAL, SPECIAL, EXEMPLARY, OR CONSEQUENTIAL
// DAMAGES (INCLUDING, BUT NOT LIMITED TO, PROCUREMENT OF SUBSTITUTE
// GOODS OR SERVICES; LOSS OF USE, DATA, OR PROFITS; OR BUSINESS
// INTERRUPTION) HOWEVER CAUSED AND ON ANY THEORY OF LIABILITY,
// WHETHER IN CONTRACT, STRICT LIABILITY, OR TORT (INCLUDING
// NEGLIGENCE OR OTHERWISE) ARISING IN ANY WAY OUT OF THE USE OF THIS
// SOFTWARE, EVEN IF ADVISED OF THE POSSIBILITY OF SUCH DAMAGE.

// Code is generated by AI

// Shared compliance suite for the two hot-plugged HID filter wheels. The file
// is compiled once per driver; TEST_KIND selects the transport that is faked,
// 1 for the raw two byte HID protocol of the Starlight Xpress wheel and 2 for
// the libatik calls of the Atik wheel. Everything above the transport is the
// same driver shape, so the scenarios are shared.

#include <stdatomic.h>
#include <stdint.h>

#include <indigo/indigo_driver.h>
#include <indigo/indigo_usb_utils.h>
#include <indigo/indigo_uni_io.h>
#if TEST_KIND == 2
#include <libatik.h>
#endif

#include "serial_simulator_test_common.h"

extern indigo_result TEST_ENTRY(indigo_driver_action, indigo_driver_info *);

static const simulator_driver_case wheel = { TEST_LABEL, TEST_DRIVER, TEST_NAME, TEST_ENTRY, false, NULL, 0, NULL, 0, NULL, 0, NULL, 0 };

// ----------------------------------------------------------------- fake wheel

// The wheel the fake transport models. A move takes move_polls readbacks to
// complete, so a test can observe BUSY before the wheel arrives.
static atomic_int slot_count = 7, current_slot = 1, target_slot = 1, move_polls, pending_polls;
static atomic_int opened, closed, io_calls, io_after_close, references, attached;
static atomic_int fail_open, fail_query, fail_set, fail_queue, fail_register, fail_attach;
static atomic_int queries, sets, last_set;
static libusb_hotplug_callback_fn hotplug;
static indigo_queue *driver_queue;
static indigo_uni_handle handle;

static void reset_fake(void) {
	atomic_store(&slot_count, 7);
	atomic_store(&current_slot, 1);
	atomic_store(&target_slot, 1);
	atomic_store(&move_polls, 2);
	atomic_store(&pending_polls, 0);
	atomic_store(&opened, 0);
	atomic_store(&closed, 0);
	atomic_store(&io_calls, 0);
	atomic_store(&io_after_close, 0);
	atomic_store(&references, 0);
	atomic_store(&attached, 0);
	atomic_store(&fail_open, 0);
	atomic_store(&fail_query, 0);
	atomic_store(&fail_set, 0);
	atomic_store(&fail_queue, 0);
	atomic_store(&fail_register, 0);
	atomic_store(&fail_attach, 0);
	atomic_store(&queries, 0);
	atomic_store(&sets, 0);
	atomic_store(&last_set, 0);
	hotplug = NULL;
}

// Every transfer is counted, and a transfer on a closed wheel is recorded
// separately so a test can prove the driver stopped talking to it.
static bool transfer(void) {
	atomic_fetch_add(&io_calls, 1);
	if (atomic_load(&opened) == atomic_load(&closed)) {
		atomic_fetch_add(&io_after_close, 1);
		return false;
	}
	return true;
}

static bool model_query(int *count, int *slot) {
	if (!transfer() || atomic_exchange(&fail_query, 0)) {
		return false;
	}
	atomic_fetch_add(&queries, 1);
	if (atomic_load(&pending_polls) > 0) {
		atomic_fetch_sub(&pending_polls, 1);
	} else {
		atomic_store(&current_slot, atomic_load(&target_slot));
	}
	*count = atomic_load(&slot_count);
	*slot = atomic_load(&current_slot);
	return true;
}

static bool model_set(int slot) {
	if (!transfer() || atomic_exchange(&fail_set, 0)) {
		return false;
	}
	atomic_fetch_add(&sets, 1);
	atomic_store(&last_set, slot);
	atomic_store(&target_slot, slot);
	atomic_store(&pending_polls, atomic_load(&move_polls));
	return true;
}

// ----------------------------------------------------------------- fake boundary

indigo_queue *wheel_queue_create(indigo_device *device) {
	if (atomic_exchange(&fail_queue, 0)) {
		return NULL;
	}
	return driver_queue = indigo_queue_create(device);
}

void wheel_usb_start(void) { }

int LIBUSB_CALL wheel_usb_register(libusb_context *ctx, int events, int flags, int vid, int pid, int cls, libusb_hotplug_callback_fn fn, void *data, libusb_hotplug_callback_handle *registration) {
	if (atomic_exchange(&fail_register, 0)) {
		return LIBUSB_ERROR_OTHER;
	}
	hotplug = fn;
	*registration = 1;
	fn(NULL, (libusb_device *)(uintptr_t)1, LIBUSB_HOTPLUG_EVENT_DEVICE_ARRIVED, NULL);
	return 0;
}

void LIBUSB_CALL wheel_usb_deregister(libusb_context *ctx, libusb_hotplug_callback_handle registration) {
	hotplug = NULL;
}

int wheel_usb_register_sim(libusb_context *ctx, libusb_hotplug_event events, libusb_hotplug_flag flags, int vid, int pid, int cls, libusb_hotplug_callback_fn fn, void *data, libusb_hotplug_callback_handle *registration) {
	return wheel_usb_register(ctx, events, flags, vid, pid, cls, fn, data, registration);
}

int wheel_usb_deregister_poll(libusb_context *ctx, libusb_hotplug_callback_handle registration) {
	wheel_usb_deregister(ctx, registration);
	return 0;
}

libusb_device * LIBUSB_CALL wheel_usb_ref(libusb_device *device) {
	atomic_fetch_add(&references, 1);
	return device;
}

void LIBUSB_CALL wheel_usb_unref(libusb_device *device) {
	atomic_fetch_sub(&references, 1);
}

indigo_result wheel_usb_path(libusb_device *device, char *path) {
	strcpy(path, "1");
	return INDIGO_OK;
}

indigo_result wheel_attach_device(indigo_device *device) {
	if (atomic_exchange(&fail_attach, 0)) {
		return INDIGO_FAILED;
	}
	indigo_result result = indigo_attach_device(device);
	if (result == INDIGO_OK) {
		atomic_fetch_add(&attached, 1);
	}
	return result;
}

indigo_result wheel_detach_device(indigo_device *device) {
	indigo_result result = indigo_detach_device(device);
	atomic_fetch_sub(&attached, 1);
	return result;
}

indigo_uni_handle *wheel_hid_open(const int vid, const int pid, int level) {
	if (atomic_exchange(&fail_open, 0)) {
		return NULL;
	}
	atomic_fetch_add(&opened, 1);
	handle.hid_device = &handle;
	return &handle;
}

void wheel_hid_close(indigo_uni_handle **opened_handle) {
	if (*opened_handle != NULL) {
		atomic_fetch_add(&closed, 1);
		*opened_handle = NULL;
	}
}

#if TEST_KIND == 1

// The Starlight Xpress wheel answers every two byte request with the current
// slot and the number of slots; a request with the high bit set starts a move.
long wheel_hid_write(indigo_uni_handle *opened_handle, const char *buffer, long length) {
	if (opened_handle == NULL) {
		return -1;
	}
	unsigned char command = (unsigned char)buffer[0];
	if (command & 0x80) {
		return model_set(command & 0x7f) ? length : -1;
	}
	return transfer() ? length : -1;
}

long wheel_hid_read(indigo_uni_handle *opened_handle, void *buffer, long length) {
	int count = 0, slot = 0;
	if (opened_handle == NULL) {
		return -1;
	}
	if (!model_query(&count, &slot)) {
		return -1;
	}
	((unsigned char *)buffer)[0] = (unsigned char)slot;
	((unsigned char *)buffer)[1] = (unsigned char)count;
	return 2;
}

#else

bool libatik_wheel_query(hid_device *device, int *count, int *slot) {
	return model_query(count, slot);
}

bool libatik_wheel_set(hid_device *device, int slot) {
	return model_set(slot);
}

#endif

// ----------------------------------------------------------------- helpers

static bool state_seen(const char *property, indigo_property_state state, unsigned int revision) {
	if (wait_for_property_state_seen_after(property, state, revision)) {
		return true;
	}
	indigo_property *cached = find_cached_property(property);
	fprintf(stderr, "%s never published state %d (current %d)\n", property, state, cached == NULL ? -1 : cached->state);
	return false;
}

static bool select_slot(int slot, indigo_property_state state) {
	unsigned int revision = property_state_revision(WHEEL_SLOT_PROPERTY_NAME, state);
	return indigo_change_number_property_1(&simulator_test_client, wheel.device_name, WHEEL_SLOT_PROPERTY_NAME, WHEEL_SLOT_ITEM_NAME, slot) == INDIGO_OK && state_seen(WHEEL_SLOT_PROPERTY_NAME, state, revision);
}

// The driver publishes the busy state from its change macro before the handler
// has sent anything, so a command assertion has to wait for the wheel.
static bool slot_commanded(int slot) {
	for (int i = 0; i < 200; i++) {
		if (atomic_load(&last_set) == slot) {
			return true;
		}
		indigo_usleep(25000);
	}
	fprintf(stderr, "Slot %d was never commanded, last command was %d\n", slot, atomic_load(&last_set));
	return false;
}

static bool slot_is(int slot) {
	for (int i = 0; i < 400; i++) {
		indigo_property *property = find_cached_property(WHEEL_SLOT_PROPERTY_NAME);
		indigo_item *item = find_cached_item(WHEEL_SLOT_PROPERTY_NAME, WHEEL_SLOT_ITEM_NAME);
		if (property != NULL && item != NULL && property->state == INDIGO_OK_STATE && (int)item->number.value == slot) {
			return true;
		}
		indigo_usleep(25000);
	}
	indigo_property *property = find_cached_property(WHEEL_SLOT_PROPERTY_NAME);
	indigo_item *item = find_cached_item(WHEEL_SLOT_PROPERTY_NAME, WHEEL_SLOT_ITEM_NAME);
	fprintf(stderr, "Wheel did not settle at slot %d (value %g, state %d)\n", slot, item == NULL ? NAN : item->number.value, property == NULL ? -1 : property->state);
	return false;
}

// The wheel is attached by the arrival event the fake registration replays, so
// bringing the driver up is enough to make the device appear.
static bool driver_up(void) {
	reset_fake();
	if (!bring_up_serial_driver(&wheel)) {
		return false;
	}
	indigo_queue_drain(driver_queue);
	return true;
}

static bool connect_wheel(void) {
	return connect_serial_device(&wheel, NULL);
}

// A wheel that has to be probed before it answers can take longer to refuse a
// connection than the shared helper waits for.
static bool connection_refused(void) {
	for (int i = 0; i < 300; i++) {
		if (!context.connected && context.last_connection_state == INDIGO_ALERT_STATE) {
			return true;
		}
		indigo_usleep(100000);
	}
	fprintf(stderr, "Connection was not refused, connected %d state %d\n", context.connected, context.last_connection_state);
	return false;
}

static bool driver_start(void) {
	return driver_up() && connect_wheel();
}

static void driver_stop(void) {
	if (context.connected) {
		disconnect_serial_device(&wheel);
	}
	tear_down_serial_driver(&wheel);
	ASSERT_EQ_INT(0, attached);
	ASSERT_EQ_INT(0, references);
	ASSERT_EQ_INT(opened, closed);
	ASSERT_EQ_INT(0, io_after_close);
}

static void plug(void) {
	hotplug(NULL, (libusb_device *)(uintptr_t)1, LIBUSB_HOTPLUG_EVENT_DEVICE_ARRIVED, NULL);
	indigo_queue_drain(driver_queue);
}

static void unplug(void) {
	hotplug(NULL, (libusb_device *)(uintptr_t)1, LIBUSB_HOTPLUG_EVENT_DEVICE_LEFT, NULL);
	indigo_queue_drain(driver_queue);
}

// ----------------------------------------------------------------- identity and lifecycle

static void metadata(void) {
	assert_simulator_driver_info(&wheel);
	SERIAL_CHECK_TRUE(driver_start());
	SERIAL_CHECK_TRUE(context.connected && context.last_connection_state == INDIGO_OK_STATE);
	assert_device_interface(INDIGO_INTERFACE_WHEEL);
	// The wheel is named after the USB path it was found on.
	SERIAL_CHECK_EQ_INT(1, attached);
	SERIAL_CHECK_TRUE(opened == 1);
cleanup:
	driver_stop();
}

static void property_contract(void) {
	SERIAL_CHECK_TRUE(driver_up());
	reset_simulator_context(&wheel);
	enumerate_simulator_device();
	SERIAL_CHECK_TRUE(!has_defined_property(WHEEL_SLOT_PROPERTY_NAME));
	SERIAL_CHECK_TRUE(connect_wheel());
	assert_property_has_item(WHEEL_SLOT_PROPERTY_NAME, WHEEL_SLOT_ITEM_NAME);
	assert_defined_property(WHEEL_SLOT_NAME_PROPERTY_NAME);
	assert_defined_property(WHEEL_SLOT_OFFSET_PROPERTY_NAME);
	// The controller reports how many slots it has, and all three properties
	// have to follow it.
	indigo_item *slot = find_cached_item(WHEEL_SLOT_PROPERTY_NAME, WHEEL_SLOT_ITEM_NAME);
	SERIAL_CHECK_TRUE(slot != NULL && slot->number.min == 1 && slot->number.max == 7);
	SERIAL_CHECK_EQ_INT(7, find_cached_property(WHEEL_SLOT_NAME_PROPERTY_NAME)->count);
	SERIAL_CHECK_EQ_INT(7, find_cached_property(WHEEL_SLOT_OFFSET_PROPERTY_NAME)->count);
	SERIAL_CHECK_TRUE(slot_is(1));
	disconnect_serial_device(&wheel);
	for (int i = 0; i < 50 && find_cached_property(WHEEL_SLOT_PROPERTY_NAME) != NULL; i++) {
		indigo_usleep(100000);
	}
	SERIAL_CHECK_TRUE(find_cached_property(WHEEL_SLOT_PROPERTY_NAME) == NULL);
cleanup:
	driver_stop();
}

// A wheel with a different number of slots, standing on a different slot, has
// to rebuild all three properties when it is connected again.
static void slot_count_rebuilt(void) {
	SERIAL_CHECK_TRUE(driver_start());
	SERIAL_CHECK_EQ_INT(7, find_cached_property(WHEEL_SLOT_NAME_PROPERTY_NAME)->count);
	disconnect_serial_device(&wheel);
	atomic_store(&slot_count, 5);
	atomic_store(&current_slot, 3);
	atomic_store(&target_slot, 3);
	SERIAL_CHECK_TRUE(connect_wheel());
	indigo_item *slot = find_cached_item(WHEEL_SLOT_PROPERTY_NAME, WHEEL_SLOT_ITEM_NAME);
	SERIAL_CHECK_TRUE(slot != NULL && slot->number.max == 5);
	SERIAL_CHECK_EQ_INT(5, find_cached_property(WHEEL_SLOT_NAME_PROPERTY_NAME)->count);
	SERIAL_CHECK_EQ_INT(5, find_cached_property(WHEEL_SLOT_OFFSET_PROPERTY_NAME)->count);
	SERIAL_CHECK_TRUE(slot_is(3));
	SERIAL_CHECK_TRUE(select_slot(5, INDIGO_BUSY_STATE));
	SERIAL_CHECK_TRUE(slot_is(5));
cleanup:
	driver_stop();
}

#if TEST_KIND == 1

// A turning Starlight Xpress wheel answers the query with slot 0 and a valid slot count, which a
// client sees whenever it connects during a move or right after power up. The driver connects,
// publishes the slot as busy and resolves it from the wheel itself, without commanding anything.
// Refusing that connection was the defect the hardware run found.
static void unknown_initial_slot(void) {
	SERIAL_CHECK_TRUE(driver_up());
	atomic_store(&current_slot, 0);
	atomic_store(&target_slot, 3);
	atomic_store(&pending_polls, 3);
	SERIAL_CHECK_TRUE(connect_wheel());
	SERIAL_CHECK_TRUE(context.connected && context.last_connection_state == INDIGO_OK_STATE);
	// The slot count is readable even while the slot is not, so the property contract is complete.
	indigo_item *slot = find_cached_item(WHEEL_SLOT_PROPERTY_NAME, WHEEL_SLOT_ITEM_NAME);
	SERIAL_CHECK_TRUE(slot != NULL && slot->number.min == 1 && slot->number.max == 7);
	SERIAL_CHECK_EQ_INT(7, find_cached_property(WHEEL_SLOT_NAME_PROPERTY_NAME)->count);
	SERIAL_CHECK_TRUE(slot_is(3));
	SERIAL_CHECK_EQ_INT(0, sets);
	// The wheel is fully usable once it has arrived.
	SERIAL_CHECK_TRUE(select_slot(5, INDIGO_BUSY_STATE));
	SERIAL_CHECK_TRUE(slot_is(5));
cleanup:
	driver_stop();
}

#else

// The Atik wheel is probed until it reports a slot, so a wheel that never finds one is refused.
static void unknown_initial_slot(void) {
	SERIAL_CHECK_TRUE(driver_up());
	atomic_store(&current_slot, 0);
	atomic_store(&target_slot, 0);
	SERIAL_CHECK_TRUE(!connect_wheel());
	SERIAL_CHECK_TRUE(connection_refused());
	SERIAL_CHECK_EQ_INT(opened, closed);
	SERIAL_CHECK_TRUE(find_cached_property(WHEEL_SLOT_PROPERTY_NAME) == NULL);
	// Once the wheel reports a slot the same device connects.
	atomic_store(&current_slot, 2);
	atomic_store(&target_slot, 2);
	SERIAL_CHECK_TRUE(connect_wheel());
	SERIAL_CHECK_TRUE(slot_is(2));
cleanup:
	driver_stop();
}

#endif

static void open_failure(void) {
	SERIAL_CHECK_TRUE(driver_up());
	atomic_store(&fail_open, 1);
	SERIAL_CHECK_TRUE(!connect_wheel());
	SERIAL_CHECK_TRUE(!context.connected);
	SERIAL_CHECK_EQ_INT(0, opened);
	// A failed open must not leave a handle behind.
	SERIAL_CHECK_TRUE(connect_wheel());
	SERIAL_CHECK_EQ_INT(1, opened);
	SERIAL_CHECK_TRUE(slot_is(1));
cleanup:
	driver_stop();
}

// A wheel that stops answering while connecting is refused and its handle is
// released again.
static void initial_query_failure(void) {
	SERIAL_CHECK_TRUE(driver_up());
	atomic_store(&fail_query, 1);
	SERIAL_CHECK_TRUE(!connect_wheel());
	SERIAL_CHECK_TRUE(connection_refused());
	SERIAL_CHECK_EQ_INT(opened, closed);
	SERIAL_CHECK_TRUE(connect_wheel());
	SERIAL_CHECK_TRUE(slot_is(1));
cleanup:
	driver_stop();
}

static void repeated_init_shutdown(void) {
	for (int i = 0; i < 3; i++) {
		SERIAL_CHECK_TRUE(driver_start());
		disconnect_serial_device(&wheel);
		SERIAL_CHECK_TRUE(!context.connected);
		tear_down_serial_driver(&wheel);
		SERIAL_CHECK_EQ_INT(0, attached);
		SERIAL_CHECK_EQ_INT(0, references);
		SERIAL_CHECK_EQ_INT(opened, closed);
	}
	return;
cleanup:
	driver_stop();
}

static void shutdown_rejected_while_connected(void) {
	SERIAL_CHECK_TRUE(driver_start());
	SERIAL_CHECK_EQ_INT(INDIGO_BUSY, wheel.entry(INDIGO_DRIVER_SHUTDOWN, NULL));
	// The rejected shutdown must leave the connected wheel operational.
	SERIAL_CHECK_TRUE(select_slot(4, INDIGO_BUSY_STATE));
	SERIAL_CHECK_TRUE(slot_is(4));
cleanup:
	driver_stop();
}

// ----------------------------------------------------------------- hot-plug

static void hotplug_events(void) {
	SERIAL_CHECK_TRUE(driver_start());
	SERIAL_CHECK_EQ_INT(1, attached);
	// A repeated arrival for the same wheel must not attach it twice.
	plug();
	SERIAL_CHECK_EQ_INT(1, attached);
	disconnect_serial_device(&wheel);
	unplug();
	SERIAL_CHECK_EQ_INT(0, attached);
	SERIAL_CHECK_EQ_INT(opened, closed);
	// A removal nobody asked about is harmless.
	unplug();
	SERIAL_CHECK_EQ_INT(0, attached);
	plug();
	SERIAL_CHECK_EQ_INT(1, attached);
	SERIAL_CHECK_TRUE(connect_wheel());
	SERIAL_CHECK_TRUE(slot_is(1));
cleanup:
	driver_stop();
}

// A wheel unplugged while it is connected has to be closed and detached, and
// nothing may be sent to it afterwards.
static void removal_while_connected(void) {
	SERIAL_CHECK_TRUE(driver_start());
	SERIAL_CHECK_TRUE(select_slot(6, INDIGO_BUSY_STATE));
	unplug();
	SERIAL_CHECK_EQ_INT(0, attached);
	SERIAL_CHECK_EQ_INT(opened, closed);
	int calls = io_calls;
	indigo_usleep(1500000);
	SERIAL_CHECK_EQ_INT(calls, io_calls);
	SERIAL_CHECK_EQ_INT(0, io_after_close);
	plug();
	SERIAL_CHECK_TRUE(connect_wheel());
	SERIAL_CHECK_TRUE(select_slot(2, INDIGO_BUSY_STATE));
	SERIAL_CHECK_TRUE(slot_is(2));
cleanup:
	driver_stop();
}

static void init_rollback(void) {
	reset_fake();
	atomic_store(&fail_queue, 1);
	SERIAL_CHECK_TRUE(!bring_up_serial_driver(&wheel));
	SERIAL_CHECK_EQ_INT(0, attached);
	SERIAL_CHECK_TRUE(hotplug == NULL);
	atomic_store(&fail_register, 1);
	SERIAL_CHECK_TRUE(!bring_up_serial_driver(&wheel));
	SERIAL_CHECK_EQ_INT(0, attached);
	SERIAL_CHECK_EQ_INT(0, references);
	// A wheel whose attachment fails must not leave a reference or a device.
	atomic_store(&fail_attach, 1);
	SERIAL_CHECK_TRUE(bring_up_serial_driver(&wheel));
	indigo_queue_drain(driver_queue);
	SERIAL_CHECK_EQ_INT(0, attached);
	SERIAL_CHECK_EQ_INT(0, references);
	plug();
	SERIAL_CHECK_EQ_INT(1, attached);
	SERIAL_CHECK_TRUE(connect_wheel());
	SERIAL_CHECK_TRUE(slot_is(1));
cleanup:
	driver_stop();
}

// ----------------------------------------------------------------- positioning

// The wheel is driven to the first, the last and an intermediate slot, and the
// driver has to command the slot number the client asked for.
static void positioning(void) {
	static const int slots[] = { 4, 7, 1, 3 };
	SERIAL_CHECK_TRUE(driver_start());
	SERIAL_CHECK_TRUE(slot_is(1));
	for (int i = 0; i < ARRAY_SIZE(slots); i++) {
		SERIAL_CHECK_TRUE(select_slot(slots[i], INDIGO_BUSY_STATE));
		SERIAL_CHECK_TRUE(slot_commanded(slots[i]));
		SERIAL_CHECK_TRUE(slot_is(slots[i]));
		SERIAL_CHECK_TRUE(wait_for_number_item_value(WHEEL_SLOT_PROPERTY_NAME, WHEEL_SLOT_ITEM_NAME, slots[i], 0));
	}
cleanup:
	driver_stop();
}

// The slot the wheel already stands on settles immediately and no move command
// is sent for it.
static void already_selected_slot(void) {
	SERIAL_CHECK_TRUE(driver_start());
	SERIAL_CHECK_TRUE(select_slot(5, INDIGO_BUSY_STATE));
	SERIAL_CHECK_TRUE(slot_is(5));
	int moves = sets;
	SERIAL_CHECK_TRUE(select_slot(5, INDIGO_OK_STATE));
	SERIAL_CHECK_EQ_INT(moves, sets);
	SERIAL_CHECK_TRUE(slot_is(5));
cleanup:
	driver_stop();
}

// A move is reported as busy until the wheel says it arrived.
static void motion_progress(void) {
	SERIAL_CHECK_TRUE(driver_start());
	atomic_store(&move_polls, 4);
	int before = atomic_load(&queries);
	SERIAL_CHECK_TRUE(select_slot(6, INDIGO_BUSY_STATE));
	SERIAL_CHECK_TRUE(slot_commanded(6));
	// The wheel is polled until it reports the requested slot, and the property
	// stays busy for the whole turn.
	for (int i = 0; i < 200 && atomic_load(&queries) < before + 2; i++) {
		indigo_usleep(25000);
	}
	SERIAL_CHECK_TRUE(atomic_load(&queries) >= before + 2);
	SERIAL_CHECK_TRUE(find_cached_property(WHEEL_SLOT_PROPERTY_NAME)->state == INDIGO_BUSY_STATE);
	SERIAL_CHECK_TRUE(slot_is(6));
	SERIAL_CHECK_TRUE(atomic_load(&queries) >= before + 4);
cleanup:
	driver_stop();
}

// A move command the wheel does not accept must be reported, and the wheel has
// to stay usable afterwards.
static void move_command_failure(void) {
	SERIAL_CHECK_TRUE(driver_start());
	atomic_store(&fail_set, 1);
	SERIAL_CHECK_TRUE(select_slot(3, INDIGO_ALERT_STATE));
	SERIAL_CHECK_TRUE(select_slot(3, INDIGO_BUSY_STATE));
	SERIAL_CHECK_TRUE(slot_is(3));
cleanup:
	driver_stop();
}

// A readback that fails while the wheel is turning must be reported instead of
// leaving the property busy forever.
static void poll_failure(void) {
	SERIAL_CHECK_TRUE(driver_start());
	atomic_store(&move_polls, 4);
	SERIAL_CHECK_TRUE(select_slot(6, INDIGO_BUSY_STATE));
	atomic_store(&fail_query, 1);
	SERIAL_CHECK_TRUE(state_seen(WHEEL_SLOT_PROPERTY_NAME, INDIGO_ALERT_STATE, property_state_revision(WHEEL_SLOT_PROPERTY_NAME, INDIGO_ALERT_STATE)));
	atomic_store(&move_polls, 1);
	SERIAL_CHECK_TRUE(select_slot(2, INDIGO_BUSY_STATE));
	SERIAL_CHECK_TRUE(slot_is(2));
cleanup:
	driver_stop();
}

// Disconnecting while the wheel is turning stops the polling and closes the
// wheel without another transfer.
static void disconnect_during_motion(void) {
	SERIAL_CHECK_TRUE(driver_start());
	atomic_store(&move_polls, 20);
	SERIAL_CHECK_TRUE(select_slot(6, INDIGO_BUSY_STATE));
	disconnect_serial_device(&wheel);
	SERIAL_CHECK_TRUE(!context.connected);
	SERIAL_CHECK_EQ_INT(opened, closed);
	int calls = io_calls;
	indigo_usleep(1500000);
	SERIAL_CHECK_EQ_INT(calls, io_calls);
	SERIAL_CHECK_EQ_INT(0, io_after_close);
	atomic_store(&move_polls, 1);
	SERIAL_CHECK_TRUE(connect_wheel());
	SERIAL_CHECK_TRUE(select_slot(2, INDIGO_BUSY_STATE));
	SERIAL_CHECK_TRUE(slot_is(2));
cleanup:
	driver_stop();
}

// ----------------------------------------------------------------- runner

int main(void) {
	setvbuf(stdout, NULL, _IONBF, 0);
	alarm(300);
	const indigo_test_case tests[] = {
		{ "metadata", metadata },
		{ "property_contract", property_contract },
		{ "slot_count_rebuilt", slot_count_rebuilt },
		{ "unknown_initial_slot", unknown_initial_slot },
		{ "open_failure", open_failure },
		{ "initial_query_failure", initial_query_failure },
		{ "repeated_init_shutdown", repeated_init_shutdown },
		{ "shutdown_rejected_while_connected", shutdown_rejected_while_connected },
		{ "hotplug_events", hotplug_events },
		{ "removal_while_connected", removal_while_connected },
		{ "init_rollback", init_rollback },
		{ "positioning", positioning },
		{ "already_selected_slot", already_selected_slot },
		{ "motion_progress", motion_progress },
		{ "move_command_failure", move_command_failure },
		{ "poll_failure", poll_failure },
		{ "disconnect_during_motion", disconnect_during_motion }
	};
	return indigo_run_tests(TEST_LABEL, tests, ARRAY_SIZE(tests));
}
