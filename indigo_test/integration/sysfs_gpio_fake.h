// Copyright (c) 2026 INDIGO initiative
// All rights reserved.
//
// You may use this software under the terms of 'INDIGO Astronomy
// open-source license' (see LICENSE.md).
//
// THIS SOFTWARE IS PROVIDED BY THE AUTHORS 'AS IS' AND ANY EXPRESS
// OR IMPLIED WARRANTIES, INCLUDING, BUT NOT LIMITED TO, THE IMPLIED
// WARRANTIES OF MERCHANTABILITY AND FITNESS FOR A PARTICULAR PURPOSE
// ARE DISCLAIMED. IN NO EVENT SHALL THE AUTHOR BE LIABLE FOR ANY
// DIRECT, INDIRECT, INCIDENTAL, SPECIAL, EXEMPLARY, OR CONSEQUENTIAL
// DAMAGES (INCLUDING, BUT NOT LIMITED TO, PROCUREMENT OF SUBSTITUTE
// GOODS OR SERVICES; LOSS OF USE, DATA, OR PROFITS; OR BUSINESS
// INTERRUPTION) HOWEVER CAUSED AND ON ANY THEORY OF LIABILITY,
// WHETHER IN CONTRACT, STRICT LIABILITY, OR TORT (INCLUDING
// NEGLIGENCE OR OTHERWISE) ARISING IN ANY WAY OUT OF THE USE OF THIS
// SOFTWARE, EVEN IF ADVISED OF THE POSSIBILITY OF SUCH DAMAGE.

// Code is generated by AI

/** Fake legacy sysfs GPIO and PWM boundary shared by the drivers that use it.
 \file sysfs_gpio_fake.h

 The Raspberry Pi GPIO and the ZWO ASIAIR power port drivers reach the hardware
 only through /sys/class/gpio and /sys/class/pwm, so a test replaces those
 system calls when the driver is compiled for it. The fake models the kernel
 side: a controller with a configurable base, export creating a pin node whose
 direction defaults to in, direction and value files, PWM channels, and an
 ordered timestamp-free trace of every interaction.

 Failure injection is set directly on the fake state after a reset.
 */

#ifndef sysfs_gpio_fake_h
#define sysfs_gpio_fake_h

#include <dirent.h>
#include <errno.h>
#include <fcntl.h>
#include <pthread.h>
#include <stdarg.h>
#include <stdbool.h>
#include <stdio.h>
#include <stdlib.h>
#include <string.h>
#include <sys/stat.h>
#include <sys/types.h>

#define FAKE_MAX_PINS 1024
#define FAKE_MAX_FDS 64
#define FAKE_FD_BASE 5000
#define FAKE_PWM_CHANNELS 4
#define FAKE_TRACE_MAX 4096
#define FAKE_TRACE_LINE 96

typedef enum {
	FAKE_NODE_NONE = 0,
	FAKE_NODE_GPIO_EXPORT,
	FAKE_NODE_GPIO_UNEXPORT,
	FAKE_NODE_PIN_DIRECTION,
	FAKE_NODE_PIN_VALUE,
	FAKE_NODE_PWM_EXPORT,
	FAKE_NODE_PWM_UNEXPORT,
	FAKE_NODE_PWM_ENABLE,
	FAKE_NODE_PWM_PERIOD,
	FAKE_NODE_PWM_DUTY,
	FAKE_NODE_CHIP_LABEL,
	FAKE_NODE_CHIP_BASE,
	FAKE_NODE_CHIP_NGPIO,
	FAKE_NODE_PWM_NPWM
} fake_node_kind;

typedef struct {
	bool exported;
	bool direction_present;
	bool is_input;
	int value;
} fake_pin;

typedef struct {
	bool exported;
	int enable;
	int period;
	int duty_cycle;
} fake_pwm_channel;

typedef struct {
	int base;
	int lines;
	const char *label;
} fake_gpiochip;

typedef struct {
	bool used;
	fake_node_kind kind;
	int index;
	int flags;
	int read_offset;
} fake_descriptor;

static struct {
	pthread_mutex_t mutex;
	int gpio_base;
	bool pwm_chip_present;
	int fail_export_after;
	bool fail_direction_write;
	bool fail_value_write;
	bool value_read_empty;
	bool value_read_unterminated;
	bool pwm_read_fails;
	bool pwm_zero_period;
	bool direction_appears_late;
	int export_writes;
	long slept_total;
	int sleep_calls;
	fake_gpiochip chips[8];
	int chip_count;
	fake_pin pins[FAKE_MAX_PINS];
	fake_pwm_channel pwm[FAKE_PWM_CHANNELS];
	fake_descriptor descriptors[FAKE_MAX_FDS];
	char trace[FAKE_TRACE_MAX][FAKE_TRACE_LINE];
	int trace_count;
} fake;

static void fake_reset(int gpio_base, bool pwm_chip_present) {
	pthread_mutex_lock(&fake.mutex);
	memset(fake.pins, 0, sizeof(fake.pins));
	memset(fake.pwm, 0, sizeof(fake.pwm));
	memset(fake.descriptors, 0, sizeof(fake.descriptors));
	fake.gpio_base = gpio_base;
	fake.pwm_chip_present = pwm_chip_present;
	// Base 0 models a Raspberry Pi 4 and earlier, where the header controller
	// is the only one and starts at 0. Any other base models a Raspberry Pi 5,
	// where four gpio-brcmstb banks are published next to the header
	// controller and only the pinctrl one owns the 40-pin connector.
	if (gpio_base == 0) {
		fake.chips[0] = (fake_gpiochip){ 0, 54, "pinctrl-bcm2835" };
		fake.chip_count = 1;
	} else {
		fake.chips[0] = (fake_gpiochip){ 512, 17, "gpio-brcmstb@107d517c00" };
		fake.chips[1] = (fake_gpiochip){ 529, 6, "gpio-brcmstb@107d517c20" };
		fake.chips[2] = (fake_gpiochip){ 535, 32, "gpio-brcmstb@107d508500" };
		fake.chips[3] = (fake_gpiochip){ 567, 4, "gpio-brcmstb@107d508520" };
		fake.chips[4] = (fake_gpiochip){ gpio_base, 54, "pinctrl-rp1" };
		fake.chip_count = 5;
	}
	fake.fail_export_after = -1;
	fake.fail_direction_write = false;
	fake.fail_value_write = false;
	fake.value_read_empty = false;
	fake.value_read_unterminated = false;
	fake.pwm_read_fails = false;
	fake.pwm_zero_period = false;
	fake.direction_appears_late = false;
	fake.export_writes = 0;
	fake.slept_total = 0;
	fake.sleep_calls = 0;
	fake.trace_count = 0;
	pthread_mutex_unlock(&fake.mutex);
}

static void fake_trace(const char *format, ...) {
	va_list args;
	va_start(args, format);
	if (fake.trace_count < FAKE_TRACE_MAX) {
		vsnprintf(fake.trace[fake.trace_count], FAKE_TRACE_LINE, format, args);
		fake.trace_count++;
	}
	va_end(args);
}

static int fake_trace_count_of(const char *prefix) {
	int count = 0;
	pthread_mutex_lock(&fake.mutex);
	for (int i = 0; i < fake.trace_count; i++) {
		if (!strncmp(fake.trace[i], prefix, strlen(prefix))) {
			count++;
		}
	}
	pthread_mutex_unlock(&fake.mutex);
	return count;
}

static bool fake_trace_contains(const char *line) {
	bool found = false;
	pthread_mutex_lock(&fake.mutex);
	for (int i = 0; i < fake.trace_count; i++) {
		if (!strcmp(fake.trace[i], line)) {
			found = true;
			break;
		}
	}
	pthread_mutex_unlock(&fake.mutex);
	return found;
}

static int fake_trace_index_of(const char *line) {
	int index = -1;
	pthread_mutex_lock(&fake.mutex);
	for (int i = 0; i < fake.trace_count; i++) {
		if (!strcmp(fake.trace[i], line)) {
			index = i;
			break;
		}
	}
	pthread_mutex_unlock(&fake.mutex);
	return index;
}

static void fake_dump_trace(const char *label) {
	pthread_mutex_lock(&fake.mutex);
	printf("--- trace %s (%d events)\n", label, fake.trace_count);
	for (int i = 0; i < fake.trace_count; i++) {
		printf("%4d %s\n", i, fake.trace[i]);
	}
	pthread_mutex_unlock(&fake.mutex);
}

static bool fake_write_trace_file(const char *path) {
	FILE *file = fopen(path, "w");
	if (file == NULL) {
		return false;
	}
	pthread_mutex_lock(&fake.mutex);
	for (int i = 0; i < fake.trace_count; i++) {
		fprintf(file, "%s\n", fake.trace[i]);
	}
	pthread_mutex_unlock(&fake.mutex);
	fclose(file);
	return true;
}

static int fake_sysfs_pin(int bcm_pin) {
	return fake.gpio_base + bcm_pin;
}

static bool fake_pin_exported(int bcm_pin) {
	int pin = fake_sysfs_pin(bcm_pin);
	bool exported = false;
	pthread_mutex_lock(&fake.mutex);
	if (pin >= 0 && pin < FAKE_MAX_PINS) {
		exported = fake.pins[pin].exported;
	}
	pthread_mutex_unlock(&fake.mutex);
	return exported;
}

static int fake_pin_value(int bcm_pin) {
	int pin = fake_sysfs_pin(bcm_pin);
	int value = -1;
	pthread_mutex_lock(&fake.mutex);
	if (pin >= 0 && pin < FAKE_MAX_PINS) {
		value = fake.pins[pin].value;
	}
	pthread_mutex_unlock(&fake.mutex);
	return value;
}

static bool fake_pin_is_input(int bcm_pin) {
	int pin = fake_sysfs_pin(bcm_pin);
	bool is_input = false;
	pthread_mutex_lock(&fake.mutex);
	if (pin >= 0 && pin < FAKE_MAX_PINS) {
		is_input = fake.pins[pin].is_input;
	}
	pthread_mutex_unlock(&fake.mutex);
	return is_input;
}

static void fake_set_pin_value(int bcm_pin, int value) {
	int pin = fake_sysfs_pin(bcm_pin);
	pthread_mutex_lock(&fake.mutex);
	if (pin >= 0 && pin < FAKE_MAX_PINS) {
		fake.pins[pin].value = value;
	}
	pthread_mutex_unlock(&fake.mutex);
}

static int fake_exported_pin_count(void) {
	int count = 0;
	pthread_mutex_lock(&fake.mutex);
	for (int i = 0; i < FAKE_MAX_PINS; i++) {
		if (fake.pins[i].exported) {
			count++;
		}
	}
	pthread_mutex_unlock(&fake.mutex);
	return count;
}

static int fake_chip_index(int base) {
	for (int i = 0; i < fake.chip_count; i++) {
		if (fake.chips[i].base == base) {
			return i;
		}
	}
	return -1;
}

// sscanf() reports how many conversions succeeded, not whether the whole
// format matched, so "gpiochip571/ngpio" would satisfy a "gpiochip%d/label"
// format. Every indexed path is therefore matched exactly: literal prefix,
// number, literal suffix and nothing after it.
static bool fake_match(const char *path, const char *prefix, const char *suffix, int *value) {
	size_t length = strlen(prefix);
	if (strncmp(path, prefix, length)) {
		return false;
	}
	char *end = NULL;
	long parsed = strtol(path + length, &end, 10);
	if (end == path + length || strcmp(end, suffix)) {
		return false;
	}
	*value = (int)parsed;
	return true;
}

// A channel path carries two numbers, the chip and the channel, so the chip is
// tried explicitly rather than searched for in the string.
static bool fake_match_channel(const char *path, const char *suffix, int *channel) {
	char prefix[64];
	for (int chip = 0; chip < 8; chip++) {
		snprintf(prefix, sizeof(prefix), "/sys/class/pwm/pwmchip%d/pwm", chip);
		if (fake_match(path, prefix, suffix, channel)) {
			return true;
		}
	}
	return false;
}

static fake_node_kind fake_parse_path(const char *path, int *index) {
	int value = 0;
	*index = -1;
	if (fake_match(path, "/sys/class/gpio/gpiochip", "/label", &value)) {
		*index = fake_chip_index(value);
		return FAKE_NODE_CHIP_LABEL;
	}
	if (fake_match(path, "/sys/class/gpio/gpiochip", "/base", &value)) {
		*index = fake_chip_index(value);
		return FAKE_NODE_CHIP_BASE;
	}
	if (fake_match(path, "/sys/class/gpio/gpiochip", "/ngpio", &value)) {
		*index = fake_chip_index(value);
		return FAKE_NODE_CHIP_NGPIO;
	}
	if (fake_match(path, "/sys/class/pwm/pwmchip", "/npwm", &value)) {
		*index = value;
		return FAKE_NODE_PWM_NPWM;
	}
	if (!strcmp(path, "/sys/class/gpio/export")) {
		return FAKE_NODE_GPIO_EXPORT;
	}
	if (!strcmp(path, "/sys/class/gpio/unexport")) {
		return FAKE_NODE_GPIO_UNEXPORT;
	}
	if (fake_match(path, "/sys/class/gpio/gpio", "/direction", &value)) {
		*index = value;
		return FAKE_NODE_PIN_DIRECTION;
	}
	if (fake_match(path, "/sys/class/gpio/gpio", "/value", &value)) {
		*index = value;
		return FAKE_NODE_PIN_VALUE;
	}
	if (fake_match(path, "/sys/class/pwm/pwmchip", "/export", &value)) {
		return FAKE_NODE_PWM_EXPORT;
	}
	if (fake_match(path, "/sys/class/pwm/pwmchip", "/unexport", &value)) {
		return FAKE_NODE_PWM_UNEXPORT;
	}
	if (fake_match_channel(path, "/enable", &value)) {
		*index = value;
		return FAKE_NODE_PWM_ENABLE;
	}
	if (fake_match_channel(path, "/period", &value)) {
		*index = value;
		return FAKE_NODE_PWM_PERIOD;
	}
	if (fake_match_channel(path, "/duty_cycle", &value)) {
		*index = value;
		return FAKE_NODE_PWM_DUTY;
	}
	return FAKE_NODE_NONE;
}

static bool fake_node_exists(fake_node_kind kind, int index) {
	switch (kind) {
		case FAKE_NODE_GPIO_EXPORT:
		case FAKE_NODE_GPIO_UNEXPORT:
			return true;
		case FAKE_NODE_PIN_DIRECTION:
			if (index < 0 || index >= FAKE_MAX_PINS) {
				return false;
			}
			return fake.pins[index].exported && fake.pins[index].direction_present;
		case FAKE_NODE_PIN_VALUE:
			if (index < 0 || index >= FAKE_MAX_PINS) {
				return false;
			}
			return fake.pins[index].exported;
		case FAKE_NODE_PWM_EXPORT:
		case FAKE_NODE_PWM_UNEXPORT:
			return fake.pwm_chip_present;
		case FAKE_NODE_PWM_ENABLE:
		case FAKE_NODE_PWM_PERIOD:
		case FAKE_NODE_PWM_DUTY:
			if (!fake.pwm_chip_present || index < 0 || index >= FAKE_PWM_CHANNELS) {
				return false;
			}
			return fake.pwm[index].exported;
		case FAKE_NODE_CHIP_LABEL:
		case FAKE_NODE_CHIP_BASE:
		case FAKE_NODE_CHIP_NGPIO:
			return index >= 0 && index < fake.chip_count;
		case FAKE_NODE_PWM_NPWM:
			return fake.pwm_chip_present && index == 0;
		default:
			return false;
	}
}

int sysfs_test_open(const char *path, int flags, ...) {
	int index = 0;
	pthread_mutex_lock(&fake.mutex);
	fake_node_kind kind = fake_parse_path(path, &index);
	if (kind == FAKE_NODE_NONE || !fake_node_exists(kind, index)) {
		fake_trace("open-enoent %s", path);
		pthread_mutex_unlock(&fake.mutex);
		errno = ENOENT;
		return -1;
	}
	for (int i = 0; i < FAKE_MAX_FDS; i++) {
		if (!fake.descriptors[i].used) {
			fake.descriptors[i].used = true;
			fake.descriptors[i].kind = kind;
			fake.descriptors[i].index = index;
			fake.descriptors[i].flags = flags;
			fake.descriptors[i].read_offset = 0;
			pthread_mutex_unlock(&fake.mutex);
			return FAKE_FD_BASE + i;
		}
	}
	fake_trace("open-emfile %s", path);
	pthread_mutex_unlock(&fake.mutex);
	errno = EMFILE;
	return -1;
}

int sysfs_test_close(int fd) {
	int slot = fd - FAKE_FD_BASE;
	if (slot < 0 || slot >= FAKE_MAX_FDS) {
		errno = EBADF;
		return -1;
	}
	pthread_mutex_lock(&fake.mutex);
	fake.descriptors[slot].used = false;
	pthread_mutex_unlock(&fake.mutex);
	return 0;
}

static int fake_render(fake_descriptor *descriptor, char *buffer, int size) {
	switch (descriptor->kind) {
		case FAKE_NODE_PIN_DIRECTION:
			return snprintf(buffer, size, "%s\n", fake.pins[descriptor->index].is_input ? "in" : "out");
		case FAKE_NODE_PIN_VALUE:
			if (fake.value_read_empty) {
				return 0;
			}
			if (fake.value_read_unterminated) {
				return snprintf(buffer, size, "%d", fake.pins[descriptor->index].value);
			}
			return snprintf(buffer, size, "%d\n", fake.pins[descriptor->index].value);
		case FAKE_NODE_PWM_ENABLE:
			if (fake.pwm_read_fails) {
				return -1;
			}
			return snprintf(buffer, size, "%d\n", fake.pwm[descriptor->index].enable);
		case FAKE_NODE_PWM_PERIOD:
			if (fake.pwm_read_fails) {
				return -1;
			}
			return snprintf(buffer, size, "%d\n", fake.pwm_zero_period ? 0 : fake.pwm[descriptor->index].period);
		case FAKE_NODE_PWM_DUTY:
			if (fake.pwm_read_fails) {
				return -1;
			}
			return snprintf(buffer, size, "%d\n", fake.pwm[descriptor->index].duty_cycle);
		case FAKE_NODE_CHIP_LABEL:
			return snprintf(buffer, size, "%s\n", fake.chips[descriptor->index].label);
		case FAKE_NODE_CHIP_BASE:
			return snprintf(buffer, size, "%d\n", fake.chips[descriptor->index].base);
		case FAKE_NODE_CHIP_NGPIO:
			return snprintf(buffer, size, "%d\n", fake.chips[descriptor->index].lines);
		case FAKE_NODE_PWM_NPWM:
			return snprintf(buffer, size, "%d\n", FAKE_PWM_CHANNELS);
		default:
			return 0;
	}
}

ssize_t sysfs_test_read(int fd, void *buffer, size_t size) {
	int slot = fd - FAKE_FD_BASE;
	char rendered[64] = { 0 };
	if (slot < 0 || slot >= FAKE_MAX_FDS) {
		errno = EBADF;
		return -1;
	}
	pthread_mutex_lock(&fake.mutex);
	fake_descriptor *descriptor = fake.descriptors + slot;
	int length = fake_render(descriptor, rendered, sizeof(rendered));
	if (length < 0) {
		fake_trace("read-fail %d/%d", (int)descriptor->kind, descriptor->index);
		pthread_mutex_unlock(&fake.mutex);
		errno = EIO;
		return -1;
	}
	int remaining = length - descriptor->read_offset;
	if (remaining < 0) {
		remaining = 0;
	}
	int copied = remaining < (int)size ? remaining : (int)size;
	memcpy(buffer, rendered + descriptor->read_offset, copied);
	descriptor->read_offset += copied;
	switch (descriptor->kind) {
		case FAKE_NODE_PIN_DIRECTION:
			fake_trace("read direction %d -> %s", descriptor->index, fake.pins[descriptor->index].is_input ? "in" : "out");
			break;
		case FAKE_NODE_PIN_VALUE:
			fake_trace("read value %d -> %d", descriptor->index, fake.pins[descriptor->index].value);
			break;
		case FAKE_NODE_PWM_ENABLE:
			fake_trace("read pwm-enable %d -> %d", descriptor->index, fake.pwm[descriptor->index].enable);
			break;
		case FAKE_NODE_PWM_PERIOD:
			fake_trace("read pwm-period %d -> %d", descriptor->index, fake.pwm[descriptor->index].period);
			break;
		case FAKE_NODE_PWM_DUTY:
			fake_trace("read pwm-duty %d -> %d", descriptor->index, fake.pwm[descriptor->index].duty_cycle);
			break;
		case FAKE_NODE_CHIP_LABEL:
			fake_trace("read chip-label %d", descriptor->index);
			break;
		case FAKE_NODE_CHIP_BASE:
			fake_trace("read chip-base %d", descriptor->index);
			break;
		case FAKE_NODE_CHIP_NGPIO:
			fake_trace("read chip-ngpio %d", descriptor->index);
			break;
		default:
			break;
	}
	pthread_mutex_unlock(&fake.mutex);
	return copied;
}

ssize_t sysfs_test_write(int fd, const void *buffer, size_t size) {
	int slot = fd - FAKE_FD_BASE;
	char text[64] = { 0 };
	if (slot < 0 || slot >= FAKE_MAX_FDS) {
		errno = EBADF;
		return -1;
	}
	memcpy(text, buffer, size < sizeof(text) - 1 ? size : sizeof(text) - 1);
	pthread_mutex_lock(&fake.mutex);
	fake_descriptor *descriptor = fake.descriptors + slot;
	int index = descriptor->index;
	int value = atoi(text);
	switch (descriptor->kind) {
		case FAKE_NODE_GPIO_EXPORT:
			fake.export_writes++;
			if (fake.fail_export_after >= 0 && fake.export_writes > fake.fail_export_after) {
				fake_trace("export-fail %d", value);
				pthread_mutex_unlock(&fake.mutex);
				errno = EINVAL;
				return -1;
			}
			if (value < 0 || value >= FAKE_MAX_PINS || value < fake.gpio_base) {
				fake_trace("export-invalid %d", value);
				pthread_mutex_unlock(&fake.mutex);
				errno = EINVAL;
				return -1;
			}
			fake.pins[value].exported = true;
			fake.pins[value].direction_present = !fake.direction_appears_late;
			fake.pins[value].is_input = true;
			fake_trace("export %d", value);
			break;
		case FAKE_NODE_GPIO_UNEXPORT:
			if (value >= 0 && value < FAKE_MAX_PINS) {
				fake.pins[value].exported = false;
				fake.pins[value].direction_present = false;
			}
			fake_trace("unexport %d", value);
			break;
		case FAKE_NODE_PIN_DIRECTION:
			if (fake.fail_direction_write) {
				fake_trace("direction-fail %d", index);
				pthread_mutex_unlock(&fake.mutex);
				errno = EIO;
				return -1;
			}
			fake.pins[index].is_input = text[0] == 'i';
			fake_trace("direction %d %s", index, fake.pins[index].is_input ? "in" : "out");
			break;
		case FAKE_NODE_PIN_VALUE:
			if (fake.fail_value_write) {
				fake_trace("value-fail %d", index);
				pthread_mutex_unlock(&fake.mutex);
				errno = EIO;
				return -1;
			}
			fake.pins[index].value = text[0] == '1' ? 1 : 0;
			fake_trace("value %d %d", index, fake.pins[index].value);
			break;
		case FAKE_NODE_PWM_EXPORT:
			if (value >= 0 && value < FAKE_PWM_CHANNELS) {
				fake.pwm[value].exported = true;
			}
			fake_trace("pwm-export %d", value);
			break;
		case FAKE_NODE_PWM_UNEXPORT:
			if (value >= 0 && value < FAKE_PWM_CHANNELS) {
				fake.pwm[value].exported = false;
			}
			fake_trace("pwm-unexport %d", value);
			break;
		case FAKE_NODE_PWM_ENABLE:
			fake.pwm[index].enable = value ? 1 : 0;
			fake_trace("pwm-enable %d %d", index, fake.pwm[index].enable);
			break;
		case FAKE_NODE_PWM_PERIOD:
			fake.pwm[index].period = value;
			fake_trace("pwm-period %d %d", index, value);
			break;
		case FAKE_NODE_PWM_DUTY:
			fake.pwm[index].duty_cycle = value;
			fake_trace("pwm-duty %d %d", index, value);
			break;
		default:
			break;
	}
	pthread_mutex_unlock(&fake.mutex);
	return (ssize_t)size;
}

// Directory listing of the two sysfs classes the driver scans to resolve the
// header controller and the PWM chip.
typedef struct {
	bool used;
	bool pwm;
	int next;
	struct dirent entry;
} fake_directory;

static fake_directory fake_directories[4];

DIR *sysfs_test_opendir(const char *path) {
	bool pwm = !strcmp(path, "/sys/class/pwm");
	if (!pwm && strcmp(path, "/sys/class/gpio")) {
		errno = ENOENT;
		return NULL;
	}
	pthread_mutex_lock(&fake.mutex);
	if (pwm && !fake.pwm_chip_present) {
		fake_trace("opendir-enoent /sys/class/pwm");
		pthread_mutex_unlock(&fake.mutex);
		errno = ENOENT;
		return NULL;
	}
	for (int i = 0; i < (int)ARRAY_SIZE(fake_directories); i++) {
		if (!fake_directories[i].used) {
			fake_directories[i].used = true;
			fake_directories[i].pwm = pwm;
			fake_directories[i].next = 0;
			fake_trace("opendir %s", path);
			pthread_mutex_unlock(&fake.mutex);
			return (DIR *)(fake_directories + i);
		}
	}
	pthread_mutex_unlock(&fake.mutex);
	errno = EMFILE;
	return NULL;
}

struct dirent *sysfs_test_readdir(DIR *directory) {
	fake_directory *handle = (fake_directory *)directory;
	if (handle == NULL || !handle->used) {
		return NULL;
	}
	pthread_mutex_lock(&fake.mutex);
	int index = handle->next++;
	int count = handle->pwm ? 1 : fake.chip_count;
	if (index >= count) {
		pthread_mutex_unlock(&fake.mutex);
		return NULL;
	}
	if (handle->pwm) {
		snprintf(handle->entry.d_name, sizeof(handle->entry.d_name), "pwmchip0");
	} else {
		snprintf(handle->entry.d_name, sizeof(handle->entry.d_name), "gpiochip%d", fake.chips[index].base);
	}
	fake_trace("readdir %s", handle->entry.d_name);
	pthread_mutex_unlock(&fake.mutex);
	return &handle->entry;
}

int sysfs_test_closedir(DIR *directory) {
	fake_directory *handle = (fake_directory *)directory;
	if (handle == NULL) {
		return -1;
	}
	pthread_mutex_lock(&fake.mutex);
	handle->used = false;
	pthread_mutex_unlock(&fake.mutex);
	return 0;
}

int sysfs_test_stat(const char *path, struct stat *buffer) {
	int index = 0;
	int pin = 0;
	memset(buffer, 0, sizeof(struct stat));
	if (!strcmp(path, "/sys/class/pwm/pwmchip0")) {
		pthread_mutex_lock(&fake.mutex);
		bool present = fake.pwm_chip_present;
		fake_trace("stat pwmchip0 -> %s", present ? "present" : "absent");
		pthread_mutex_unlock(&fake.mutex);
		if (!present) {
			errno = ENOENT;
			return -1;
		}
		buffer->st_mode = S_IFDIR | 0755;
		return 0;
	}
	if (sscanf(path, "/sys/class/gpio/gpio%d", &pin) == 1 && strchr(path + strlen("/sys/class/gpio/gpio"), '/') == NULL) {
		pthread_mutex_lock(&fake.mutex);
		bool exported = pin >= 0 && pin < FAKE_MAX_PINS && fake.pins[pin].exported;
		fake_trace("stat gpio%d -> %s", pin, exported ? "present" : "absent");
		pthread_mutex_unlock(&fake.mutex);
		if (!exported) {
			errno = ENOENT;
			return -1;
		}
		buffer->st_mode = S_IFDIR | 0755;
		return 0;
	}
	(void)index;
	errno = ENOENT;
	return -1;
}

void sysfs_test_usleep(long delay) {
	pthread_mutex_lock(&fake.mutex);
	fake.slept_total += delay;
	fake.sleep_calls++;
	fake_trace("sleep %ld", delay);
	if (fake.direction_appears_late) {
		for (int i = 0; i < FAKE_MAX_PINS; i++) {
			if (fake.pins[i].exported) {
				fake.pins[i].direction_present = true;
			}
		}
	}
	pthread_mutex_unlock(&fake.mutex);
}


#endif /* sysfs_gpio_fake_h */
