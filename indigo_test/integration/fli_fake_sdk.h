// Copyright (c) 2026 INDIGO initiative
// All rights reserved.
//
// You may use this software under the terms of 'INDIGO Astronomy
// open-source license' (see LICENSE.md).
//
// THIS SOFTWARE IS PROVIDED BY THE AUTHORS 'AS IS' AND ANY EXPRESS
// OR IMPLIED WARRANTIES, INCLUDING, BUT NOT LIMITED TO, THE IMPLIED
// WARRANTIES OF MERCHANTABILITY AND FITNESS FOR A PARTICULAR PURPOSE
// ARE DISCLAIMED. IN NO EVENT SHALL THE AUTHOR BE LIABLE FOR ANY
// DIRECT, INDIRECT, INCIDENTAL, SPECIAL, EXEMPLARY, OR CONSEQUENTIAL
// DAMAGES (INCLUDING, BUT NOT LIMITED TO, PROCUREMENT OF SUBSTITUTE
// GOODS OR SERVICES; LOSS OF USE, DATA, OR PROFITS; OR BUSINESS
// INTERRUPTION) HOWEVER CAUSED AND ON ANY THEORY OF LIABILITY,
// WHETHER IN CONTRACT, STRICT LIABILITY, OR TORT (INCLUDING
// NEGLIGENCE OR OTHERWISE) ARISING IN ANY WAY OUT OF THE USE OF THIS
// SOFTWARE, EVEN IF ADVISED OF THE POSSIBILITY OF SUCH DAMAGE.

// Code is generated by AI

// Fake libfli shared by the ccd_fli, focuser_fli and wheel_fli driver tests.
// It models the parts of the SDK the three drivers use: the list based
// enumeration, open and close with handle accounting, identification, the
// filter wheel, the stepper focuser and the camera. Every entry point can be
// made to fail on demand, and every call is counted so a test can assert the
// order and the number of SDK interactions.

#ifndef FLI_FAKE_SDK_H
#define FLI_FAKE_SDK_H

#include <stdatomic.h>
#include <stdbool.h>
#include <stdio.h>
#include <stdlib.h>
#include <string.h>
#include <limits.h>
#include <pthread.h>

#include <libfli.h>

#define FLI_FAKE_DEVICES 4
#define FLI_FAKE_MODES   4

// The SDK returns 0 on success and a negative errno style code on failure.
#define FLI_FAKE_ERROR (-5)

typedef struct {
	bool present;
	flidomain_t domain;
	char file_name[PATH_MAX];
	char device_name[PATH_MAX];
	char model[64];
	char serial[64];
	long firmware_revision;
	long hardware_revision;
	// filter wheel
	long filter_count;
	long filter_position;
	// focuser
	long focuser_extent;
	long stepper_position;
	long steps_remaining;
	long device_status;
	bool homed;
	// When set, a step command leaves this many steps outstanding instead of
	// completing at once, so a test can observe motion and abort it.
	long step_hold;
	// The status reports the moving bit for this many polls after homing.
	int moving_polls;
	// camera
	long array_ul_x, array_ul_y, array_lr_x, array_lr_y;
	long visible_ul_x, visible_ul_y, visible_lr_x, visible_lr_y;
	double pixel_x, pixel_y;
	long hbin, vbin;
	long image_ul_x, image_ul_y, image_lr_x, image_lr_y;
	long exposure_time;
	fliframe_t frame_type;
	long exposure_left;
	// When set, an exposure reports this many milliseconds left until it is
	// cancelled, so a test can abort a running exposure.
	long exposure_hold;
	long nflushes;
	flimode_t camera_mode;
	int mode_count;
	bool rbi_flood_supported;
	double temperature;
	double set_point;
	double cooler_power;
	unsigned short pixel_seed;
} fli_fake_device;

typedef struct {
	atomic_int open_calls, close_calls, open_handles;
	atomic_int create_list_calls, delete_list_calls;
	atomic_int set_filter_calls, get_filter_calls;
	atomic_int step_motor_calls, home_calls;
	atomic_int expose_calls, cancel_calls, grab_row_calls;
	atomic_int set_temperature_calls, set_nflushes_calls, set_camera_mode_calls;
	atomic_long last_filter, last_steps, last_exposure_time, last_nflushes;
	atomic_long last_camera_mode, last_hbin, last_vbin;
	atomic_long last_image_ul_x, last_image_ul_y, last_image_lr_x, last_image_lr_y;
	atomic_int last_frame_type;
	atomic_int invalid_handle_uses;
	// fault injection, each counts down one failing call
	atomic_int fail_open, fail_close, fail_create_list, fail_list_first;
	atomic_int fail_model, fail_serial, fail_firmware, fail_filter_count;
	atomic_int fail_set_filter, fail_get_filter;
	atomic_int fail_home, fail_step, fail_stepper_position, fail_steps_remaining;
	atomic_int fail_focuser_extent, fail_device_status;
	atomic_int fail_array_area, fail_visible_area, fail_pixel_size;
	atomic_int fail_expose, fail_grab_row, fail_set_temperature, fail_get_temperature;
	atomic_int fail_nflushes, fail_camera_mode, fail_mode_string, fail_set_image_area;
} fli_fake_counters;

static fli_fake_device fli_fake_devices[FLI_FAKE_DEVICES];
static fli_fake_counters fli_fake;
static pthread_mutex_t fli_fake_mutex = PTHREAD_MUTEX_INITIALIZER;

// The list built by FLICreateList and walked by FLIListFirst/FLIListNext.
static int fli_fake_list[FLI_FAKE_DEVICES];
static int fli_fake_list_count;
static int fli_fake_list_index;
static bool fli_fake_list_open;

static bool fli_fake_take(atomic_int *counter) {
	int pending = atomic_load(counter);
	while (pending > 0) {
		if (atomic_compare_exchange_weak(counter, &pending, pending - 1)) {
			return true;
		}
	}
	return false;
}

static void fli_fake_reset_device(int index, flidomain_t device_class) {
	fli_fake_device *device = fli_fake_devices + index;
	memset(device, 0, sizeof(*device));
	device->domain = FLIDOMAIN_USB | device_class;
	snprintf(device->file_name, sizeof(device->file_name), "/dev/fliusb%d", index);
	snprintf(device->device_name, sizeof(device->device_name), "FLI Device %d", index);
	snprintf(device->serial, sizeof(device->serial), "SN%04d", 1000 + index);
	device->firmware_revision = 256 + index;
	device->hardware_revision = 16 + index;
	switch (device_class) {
		case FLIDEVICE_FILTERWHEEL:
			snprintf(device->model, sizeof(device->model), "CFW-%d-7", index + 1);
			snprintf(device->device_name, sizeof(device->device_name), "CFW-%d-7", index + 1);
			device->filter_count = 7;
			device->filter_position = 0;
			break;
		case FLIDEVICE_FOCUSER:
			snprintf(device->model, sizeof(device->model), "Atlas-%d", index + 1);
			snprintf(device->device_name, sizeof(device->device_name), "Atlas-%d", index + 1);
			device->focuser_extent = 7000;
			device->stepper_position = 100;
			device->device_status = FLI_FOCUSER_STATUS_HOME;
			device->homed = true;
			break;
		default:
			snprintf(device->model, sizeof(device->model), "ML%d-%d", 8300, index + 1);
			snprintf(device->device_name, sizeof(device->device_name), "ML%d-%d", 8300, index + 1);
			device->array_lr_x = 1024;
			device->array_lr_y = 512;
			device->visible_ul_x = 12;
			device->visible_ul_y = 4;
			device->visible_lr_x = 1012;
			device->visible_lr_y = 508;
			device->pixel_x = 5.4e-6;
			device->pixel_y = 5.4e-6;
			device->hbin = device->vbin = 1;
			device->image_lr_x = 1000;
			device->image_lr_y = 504;
			device->mode_count = FLI_FAKE_MODES;
			device->rbi_flood_supported = true;
			device->temperature = 12.5;
			device->set_point = 45;
			device->cooler_power = 0;
			device->nflushes = 1;
			break;
	}
}

// Prepares count devices of one class and clears every counter and fault.
static void fli_fake_reset(flidomain_t device_class, int count) {
	pthread_mutex_lock(&fli_fake_mutex);
	memset(&fli_fake, 0, sizeof(fli_fake));
	for (int i = 0; i < FLI_FAKE_DEVICES; i++) {
		fli_fake_reset_device(i, device_class);
		fli_fake_devices[i].present = i < count;
	}
	fli_fake_list_count = fli_fake_list_index = 0;
	fli_fake_list_open = false;
	pthread_mutex_unlock(&fli_fake_mutex);
}

static int fli_fake_index(flidev_t dev) {
	int index = (int)dev - 1;
	if (index < 0 || index >= FLI_FAKE_DEVICES || !fli_fake_devices[index].present) {
		atomic_fetch_add(&fli_fake.invalid_handle_uses, 1);
		return -1;
	}
	return index;
}

#define FLI_FAKE_DEVICE(dev) \
	int index = fli_fake_index(dev); \
	if (index < 0) { \
		return FLI_FAKE_ERROR; \
	} \
	fli_fake_device *device = fli_fake_devices + index

// ----------------------------------------------------------------- enumeration

LIBFLIAPI FLISetDebugLevel(char *host, flidebug_t level) {
	return 0;
}

LIBFLIAPI FLICreateList(flidomain_t domain) {
	atomic_fetch_add(&fli_fake.create_list_calls, 1);
	if (fli_fake_take(&fli_fake.fail_create_list)) {
		return FLI_FAKE_ERROR;
	}
	pthread_mutex_lock(&fli_fake_mutex);
	fli_fake_list_count = fli_fake_list_index = 0;
	for (int i = 0; i < FLI_FAKE_DEVICES; i++) {
		if (fli_fake_devices[i].present && fli_fake_devices[i].domain == domain) {
			fli_fake_list[fli_fake_list_count++] = i;
		}
	}
	fli_fake_list_open = true;
	pthread_mutex_unlock(&fli_fake_mutex);
	return 0;
}

LIBFLIAPI FLIDeleteList(void) {
	atomic_fetch_add(&fli_fake.delete_list_calls, 1);
	pthread_mutex_lock(&fli_fake_mutex);
	fli_fake_list_open = false;
	fli_fake_list_count = fli_fake_list_index = 0;
	pthread_mutex_unlock(&fli_fake_mutex);
	return 0;
}

static long fli_fake_list_entry(flidomain_t *domain, char *filename, size_t fnlen, char *name, size_t namelen) {
	pthread_mutex_lock(&fli_fake_mutex);
	if (!fli_fake_list_open || fli_fake_list_index >= fli_fake_list_count) {
		pthread_mutex_unlock(&fli_fake_mutex);
		return FLI_FAKE_ERROR;
	}
	fli_fake_device *device = fli_fake_devices + fli_fake_list[fli_fake_list_index++];
	*domain = device->domain;
	snprintf(filename, fnlen, "%s", device->file_name);
	snprintf(name, namelen, "%s", device->device_name);
	pthread_mutex_unlock(&fli_fake_mutex);
	return 0;
}

LIBFLIAPI FLIListFirst(flidomain_t *domain, char *filename, size_t fnlen, char *name, size_t namelen) {
	if (fli_fake_take(&fli_fake.fail_list_first)) {
		return FLI_FAKE_ERROR;
	}
	pthread_mutex_lock(&fli_fake_mutex);
	fli_fake_list_index = 0;
	pthread_mutex_unlock(&fli_fake_mutex);
	return fli_fake_list_entry(domain, filename, fnlen, name, namelen);
}

LIBFLIAPI FLIListNext(flidomain_t *domain, char *filename, size_t fnlen, char *name, size_t namelen) {
	return fli_fake_list_entry(domain, filename, fnlen, name, namelen);
}

// ----------------------------------------------------------------- lifecycle

LIBFLIAPI FLIOpen(flidev_t *dev, char *name, flidomain_t domain) {
	atomic_fetch_add(&fli_fake.open_calls, 1);
	if (fli_fake_take(&fli_fake.fail_open)) {
		return FLI_FAKE_ERROR;
	}
	pthread_mutex_lock(&fli_fake_mutex);
	for (int i = 0; i < FLI_FAKE_DEVICES; i++) {
		if (fli_fake_devices[i].present && !strcmp(fli_fake_devices[i].file_name, name) && fli_fake_devices[i].domain == domain) {
			*dev = i + 1;
			pthread_mutex_unlock(&fli_fake_mutex);
			atomic_fetch_add(&fli_fake.open_handles, 1);
			return 0;
		}
	}
	pthread_mutex_unlock(&fli_fake_mutex);
	return FLI_FAKE_ERROR;
}

LIBFLIAPI FLIClose(flidev_t dev) {
	atomic_fetch_add(&fli_fake.close_calls, 1);
	if (fli_fake_index(dev) < 0) {
		return FLI_FAKE_ERROR;
	}
	atomic_fetch_sub(&fli_fake.open_handles, 1);
	if (fli_fake_take(&fli_fake.fail_close)) {
		return FLI_FAKE_ERROR;
	}
	return 0;
}

// ----------------------------------------------------------------- identity

LIBFLIAPI FLIGetModel(flidev_t dev, char *model, size_t len) {
	FLI_FAKE_DEVICE(dev);
	if (fli_fake_take(&fli_fake.fail_model)) {
		return FLI_FAKE_ERROR;
	}
	snprintf(model, len, "%s", device->model);
	return 0;
}

LIBFLIAPI FLIGetSerialString(flidev_t dev, char *serial, size_t len) {
	FLI_FAKE_DEVICE(dev);
	if (fli_fake_take(&fli_fake.fail_serial)) {
		return FLI_FAKE_ERROR;
	}
	snprintf(serial, len, "%s", device->serial);
	return 0;
}

LIBFLIAPI FLIGetFWRevision(flidev_t dev, long *fwrev) {
	FLI_FAKE_DEVICE(dev);
	if (fli_fake_take(&fli_fake.fail_firmware)) {
		return FLI_FAKE_ERROR;
	}
	*fwrev = device->firmware_revision;
	return 0;
}

LIBFLIAPI FLIGetHWRevision(flidev_t dev, long *hwrev) {
	FLI_FAKE_DEVICE(dev);
	*hwrev = device->hardware_revision;
	return 0;
}

// ----------------------------------------------------------------- filter wheel

LIBFLIAPI FLIGetFilterCount(flidev_t dev, long *filter) {
	FLI_FAKE_DEVICE(dev);
	if (fli_fake_take(&fli_fake.fail_filter_count)) {
		return FLI_FAKE_ERROR;
	}
	*filter = device->filter_count;
	return 0;
}

LIBFLIAPI FLISetFilterPos(flidev_t dev, long filter) {
	atomic_fetch_add(&fli_fake.set_filter_calls, 1);
	atomic_store(&fli_fake.last_filter, filter);
	FLI_FAKE_DEVICE(dev);
	if (fli_fake_take(&fli_fake.fail_set_filter)) {
		return FLI_FAKE_ERROR;
	}
	if (filter < 0 || filter >= device->filter_count) {
		return FLI_FAKE_ERROR;
	}
	device->filter_position = filter;
	return 0;
}

LIBFLIAPI FLIGetFilterPos(flidev_t dev, long *filter) {
	atomic_fetch_add(&fli_fake.get_filter_calls, 1);
	FLI_FAKE_DEVICE(dev);
	if (fli_fake_take(&fli_fake.fail_get_filter)) {
		return FLI_FAKE_ERROR;
	}
	*filter = device->filter_position;
	return 0;
}

// ----------------------------------------------------------------- focuser

LIBFLIAPI FLIHomeDevice(flidev_t dev) {
	atomic_fetch_add(&fli_fake.home_calls, 1);
	FLI_FAKE_DEVICE(dev);
	if (fli_fake_take(&fli_fake.fail_home)) {
		return FLI_FAKE_ERROR;
	}
	device->stepper_position = 0;
	device->steps_remaining = 0;
	device->device_status = FLI_FOCUSER_STATUS_HOME;
	device->homed = true;
	return 0;
}

LIBFLIAPI FLIStepMotorAsync(flidev_t dev, long steps) {
	atomic_fetch_add(&fli_fake.step_motor_calls, 1);
	atomic_store(&fli_fake.last_steps, steps);
	FLI_FAKE_DEVICE(dev);
	if (fli_fake_take(&fli_fake.fail_step)) {
		return FLI_FAKE_ERROR;
	}
	if (steps == 0) {
		// A zero step command is how the SDK stops the motor.
		device->steps_remaining = 0;
		return 0;
	}
	if (device->step_hold > 0) {
		// The move starts, covers half the way and then stays outstanding.
		device->stepper_position += steps / 2;
		device->steps_remaining = device->step_hold;
		return 0;
	}
	device->stepper_position += steps;
	device->steps_remaining = 0;
	device->device_status = FLI_FOCUSER_STATUS_HOME;
	return 0;
}

LIBFLIAPI FLIGetStepperPosition(flidev_t dev, long *position) {
	FLI_FAKE_DEVICE(dev);
	if (fli_fake_take(&fli_fake.fail_stepper_position)) {
		return FLI_FAKE_ERROR;
	}
	*position = device->stepper_position;
	return 0;
}

LIBFLIAPI FLIGetStepsRemaining(flidev_t dev, long *steps) {
	FLI_FAKE_DEVICE(dev);
	if (fli_fake_take(&fli_fake.fail_steps_remaining)) {
		return FLI_FAKE_ERROR;
	}
	*steps = device->steps_remaining;
	return 0;
}

LIBFLIAPI FLIGetFocuserExtent(flidev_t dev, long *extent) {
	FLI_FAKE_DEVICE(dev);
	if (fli_fake_take(&fli_fake.fail_focuser_extent)) {
		return FLI_FAKE_ERROR;
	}
	*extent = device->focuser_extent;
	return 0;
}

LIBFLIAPI FLIGetDeviceStatus(flidev_t dev, long *status) {
	FLI_FAKE_DEVICE(dev);
	if (fli_fake_take(&fli_fake.fail_device_status)) {
		return FLI_FAKE_ERROR;
	}
	if (device->moving_polls > 0) {
		device->moving_polls--;
		*status = FLI_FOCUSER_STATUS_MOVING_MASK;
		return 0;
	}
	*status = device->device_status;
	return 0;
}

// ----------------------------------------------------------------- camera

LIBFLIAPI FLIGetArrayArea(flidev_t dev, long *ul_x, long *ul_y, long *lr_x, long *lr_y) {
	FLI_FAKE_DEVICE(dev);
	if (fli_fake_take(&fli_fake.fail_array_area)) {
		return FLI_FAKE_ERROR;
	}
	*ul_x = device->array_ul_x;
	*ul_y = device->array_ul_y;
	*lr_x = device->array_lr_x;
	*lr_y = device->array_lr_y;
	return 0;
}

LIBFLIAPI FLIGetVisibleArea(flidev_t dev, long *ul_x, long *ul_y, long *lr_x, long *lr_y) {
	FLI_FAKE_DEVICE(dev);
	if (fli_fake_take(&fli_fake.fail_visible_area)) {
		return FLI_FAKE_ERROR;
	}
	*ul_x = device->visible_ul_x;
	*ul_y = device->visible_ul_y;
	*lr_x = device->visible_lr_x;
	*lr_y = device->visible_lr_y;
	return 0;
}

LIBFLIAPI FLIGetPixelSize(flidev_t dev, double *pixel_x, double *pixel_y) {
	FLI_FAKE_DEVICE(dev);
	if (fli_fake_take(&fli_fake.fail_pixel_size)) {
		return FLI_FAKE_ERROR;
	}
	*pixel_x = device->pixel_x;
	*pixel_y = device->pixel_y;
	return 0;
}

LIBFLIAPI FLISetHBin(flidev_t dev, long hbin) {
	FLI_FAKE_DEVICE(dev);
	atomic_store(&fli_fake.last_hbin, hbin);
	device->hbin = hbin;
	return 0;
}

LIBFLIAPI FLISetVBin(flidev_t dev, long vbin) {
	FLI_FAKE_DEVICE(dev);
	atomic_store(&fli_fake.last_vbin, vbin);
	device->vbin = vbin;
	return 0;
}

LIBFLIAPI FLISetImageArea(flidev_t dev, long ul_x, long ul_y, long lr_x, long lr_y) {
	FLI_FAKE_DEVICE(dev);
	if (fli_fake_take(&fli_fake.fail_set_image_area)) {
		return FLI_FAKE_ERROR;
	}
	atomic_store(&fli_fake.last_image_ul_x, ul_x);
	atomic_store(&fli_fake.last_image_ul_y, ul_y);
	atomic_store(&fli_fake.last_image_lr_x, lr_x);
	atomic_store(&fli_fake.last_image_lr_y, lr_y);
	device->image_ul_x = ul_x;
	device->image_ul_y = ul_y;
	device->image_lr_x = lr_x;
	device->image_lr_y = lr_y;
	return 0;
}

LIBFLIAPI FLISetExposureTime(flidev_t dev, long exptime) {
	FLI_FAKE_DEVICE(dev);
	atomic_store(&fli_fake.last_exposure_time, exptime);
	device->exposure_time = exptime;
	return 0;
}

LIBFLIAPI FLISetFrameType(flidev_t dev, fliframe_t frametype) {
	FLI_FAKE_DEVICE(dev);
	if (frametype == FLI_FRAME_TYPE_RBI_FLUSH && !device->rbi_flood_supported) {
		return FLI_FAKE_ERROR;
	}
	atomic_store(&fli_fake.last_frame_type, (int)frametype);
	device->frame_type = frametype;
	return 0;
}

LIBFLIAPI FLIExposeFrame(flidev_t dev) {
	atomic_fetch_add(&fli_fake.expose_calls, 1);
	FLI_FAKE_DEVICE(dev);
	if (fli_fake_take(&fli_fake.fail_expose)) {
		return FLI_FAKE_ERROR;
	}
	// The frame is ready at once unless the test holds it, so the driver's
	// wait loop terminates on its first poll and the test does not depend on
	// wall clock timing.
	device->exposure_left = device->exposure_hold;
	device->device_status = device->exposure_hold > 0 ? FLI_CAMERA_STATUS_IDLE : FLI_CAMERA_DATA_READY;
	return 0;
}

LIBFLIAPI FLICancelExposure(flidev_t dev) {
	atomic_fetch_add(&fli_fake.cancel_calls, 1);
	FLI_FAKE_DEVICE(dev);
	device->exposure_left = 0;
	device->device_status = FLI_CAMERA_STATUS_IDLE;
	return 0;
}

LIBFLIAPI FLIGetExposureStatus(flidev_t dev, long *timeleft) {
	FLI_FAKE_DEVICE(dev);
	*timeleft = device->exposure_left;
	return 0;
}

LIBFLIAPI FLIGrabRow(flidev_t dev, void *buff, size_t width) {
	atomic_fetch_add(&fli_fake.grab_row_calls, 1);
	FLI_FAKE_DEVICE(dev);
	if (fli_fake_take(&fli_fake.fail_grab_row)) {
		return FLI_FAKE_ERROR;
	}
	unsigned short *pixels = (unsigned short *)buff;
	for (size_t i = 0; i < width; i++) {
		pixels[i] = (unsigned short)(device->pixel_seed + i);
	}
	device->pixel_seed++;
	return 0;
}

LIBFLIAPI FLISetNFlushes(flidev_t dev, long nflushes) {
	atomic_fetch_add(&fli_fake.set_nflushes_calls, 1);
	atomic_store(&fli_fake.last_nflushes, nflushes);
	FLI_FAKE_DEVICE(dev);
	if (fli_fake_take(&fli_fake.fail_nflushes)) {
		return FLI_FAKE_ERROR;
	}
	device->nflushes = nflushes;
	return 0;
}

LIBFLIAPI FLISetBitDepth(flidev_t dev, flibitdepth_t bitdepth) {
	FLI_FAKE_DEVICE(dev);
	return 0;
}

LIBFLIAPI FLIGetTemperature(flidev_t dev, double *temperature) {
	FLI_FAKE_DEVICE(dev);
	if (fli_fake_take(&fli_fake.fail_get_temperature)) {
		return FLI_FAKE_ERROR;
	}
	*temperature = device->temperature;
	return 0;
}

LIBFLIAPI FLISetTemperature(flidev_t dev, double temperature) {
	atomic_fetch_add(&fli_fake.set_temperature_calls, 1);
	FLI_FAKE_DEVICE(dev);
	if (fli_fake_take(&fli_fake.fail_set_temperature)) {
		return FLI_FAKE_ERROR;
	}
	device->set_point = temperature;
	// The fake cooler reaches its set point immediately and reports full power
	// while it is below ambient.
	device->temperature = temperature;
	device->cooler_power = temperature < 20 ? 90 : 0;
	return 0;
}

LIBFLIAPI FLIGetCoolerPower(flidev_t dev, double *power) {
	FLI_FAKE_DEVICE(dev);
	*power = device->cooler_power;
	return 0;
}

LIBFLIAPI FLIGetCameraMode(flidev_t dev, flimode_t *mode_index) {
	FLI_FAKE_DEVICE(dev);
	if (fli_fake_take(&fli_fake.fail_camera_mode)) {
		return FLI_FAKE_ERROR;
	}
	*mode_index = device->camera_mode;
	return 0;
}

LIBFLIAPI FLISetCameraMode(flidev_t dev, flimode_t mode_index) {
	atomic_fetch_add(&fli_fake.set_camera_mode_calls, 1);
	atomic_store(&fli_fake.last_camera_mode, (long)mode_index);
	FLI_FAKE_DEVICE(dev);
	if (fli_fake_take(&fli_fake.fail_camera_mode)) {
		return FLI_FAKE_ERROR;
	}
	if ((int)mode_index >= device->mode_count) {
		return FLI_FAKE_ERROR;
	}
	device->camera_mode = mode_index;
	return 0;
}

LIBFLIAPI FLIGetCameraModeString(flidev_t dev, flimode_t mode_index, char *mode_string, size_t siz) {
	FLI_FAKE_DEVICE(dev);
	if (fli_fake_take(&fli_fake.fail_mode_string)) {
		return FLI_FAKE_ERROR;
	}
	if ((int)mode_index >= device->mode_count) {
		return FLI_FAKE_ERROR;
	}
	snprintf(mode_string, siz, "MODE%d", (int)mode_index);
	return 0;
}

#endif /* FLI_FAKE_SDK_H */
