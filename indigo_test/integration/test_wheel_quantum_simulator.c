// Copyright (c) 2026 INDIGO initiative
// All rights reserved.
//
// You may use this software under the terms of 'INDIGO Astronomy
// open-source license' (see LICENSE.md).
//
// THIS SOFTWARE IS PROVIDED BY THE AUTHORS 'AS IS' AND ANY EXPRESS
// OR IMPLIED WARRANTIES, INCLUDING, BUT NOT LIMITED TO, THE IMPLIED
// WARRANTIES OF MERCHANTABILITY AND FITNESS FOR A PARTICULAR PURPOSE
// ARE DISCLAIMED. IN NO EVENT SHALL THE AUTHOR BE LIABLE FOR ANY
// DIRECT, INDIRECT, INCIDENTAL, SPECIAL, EXEMPLARY, OR CONSEQUENTIAL
// DAMAGES (INCLUDING, BUT NOT LIMITED TO, PROCUREMENT OF SUBSTITUTE
// GOODS OR SERVICES; LOSS OF USE, DATA, OR PROFITS; OR BUSINESS
// INTERRUPTION) HOWEVER CAUSED AND ON ANY THEORY OF LIABILITY,
// WHETHER IN CONTRACT, STRICT LIABILITY, OR TORT (INCLUDING
// NEGLIGENCE OR OTHERWISE) ARISING IN ANY WAY OUT OF THE USE OF THIS
// SOFTWARE, EVEN IF ADVISED OF THE POSSIBILITY OF SUCH DAMAGE.

// Code is generated by AI

// Wheel class coverage for indigo_wheel_quantum against the standalone Quantum simulator over a
// real PTY. The Quantum protocol is zero based on the wire (G<slot-1>) and one based in INDIGO, and
// the wheel streams a P<position> line per step until it arrives, so quantum_goto() consumes the
// whole move before returning. The driver homes to slot 1 on connect and advertises seven slots.

#include <indigo_drivers/wheel_quantum/indigo_wheel_quantum.h>

#include "serial_simulator_test_common.h"

#ifndef WHEEL_QUANTUM_SIMULATOR_EXECUTABLE
#define WHEEL_QUANTUM_SIMULATOR_EXECUTABLE "build/integration/wheel_quantum_simulator"
#endif

static const simulator_driver_case quantum_wheel = {
	"Quantum Filter Wheel",
	"indigo_wheel_quantum",
	"Quantum Filter Wheel",
	indigo_wheel_quantum,
	false,
	NULL, 0, NULL, 0, NULL, 0, NULL, 0
};

static const char *const slot_name_items[] = {
	WHEEL_SLOT_NAME_1_ITEM_NAME, WHEEL_SLOT_NAME_2_ITEM_NAME, WHEEL_SLOT_NAME_3_ITEM_NAME,
	WHEEL_SLOT_NAME_4_ITEM_NAME, WHEEL_SLOT_NAME_5_ITEM_NAME, WHEEL_SLOT_NAME_6_ITEM_NAME,
	WHEEL_SLOT_NAME_7_ITEM_NAME
};

static const char *const slot_offset_items[] = {
	WHEEL_SLOT_OFFSET_1_ITEM_NAME, WHEEL_SLOT_OFFSET_2_ITEM_NAME, WHEEL_SLOT_OFFSET_3_ITEM_NAME,
	WHEEL_SLOT_OFFSET_4_ITEM_NAME, WHEEL_SLOT_OFFSET_5_ITEM_NAME, WHEEL_SLOT_OFFSET_6_ITEM_NAME,
	WHEEL_SLOT_OFFSET_7_ITEM_NAME
};

static bool start_quantum(external_serial_simulator *simulator, const char **arguments) {
	if (arguments == NULL) {
		return start_external_serial_simulator(simulator, WHEEL_QUANTUM_SIMULATOR_EXECUTABLE);
	}
	return start_external_serial_simulator_with_args(simulator, WHEEL_QUANTUM_SIMULATOR_EXECUTABLE, arguments);
}

static bool request_slot(double slot) {
	return indigo_change_number_property_1(&simulator_test_client, quantum_wheel.device_name, WHEEL_SLOT_PROPERTY_NAME, WHEEL_SLOT_ITEM_NAME, slot) == INDIGO_OK;
}

static bool select_slot(double slot) {
	return request_slot(slot) && wait_for_property_state(WHEEL_SLOT_PROPERTY_NAME, INDIGO_OK_STATE) && wait_for_number_item_value(WHEEL_SLOT_PROPERTY_NAME, WHEEL_SLOT_ITEM_NAME, slot, 0.001);
}

static void assert_wheel_class_property_completeness(void) {
	static const char *properties[] = {
		WHEEL_SLOT_PROPERTY_NAME,
		WHEEL_SLOT_NAME_PROPERTY_NAME,
		WHEEL_SLOT_OFFSET_PROPERTY_NAME
	};
	assert_defined_properties(properties, ARRAY_SIZE(properties));
}

// -------------------------------------------------------------------------------- metadata

static void metadata_and_property_completeness(void) {
	external_serial_simulator simulator = { 0 };
	bool online = false;
	SERIAL_CHECK_TRUE(start_quantum(&simulator, NULL));
	SERIAL_CHECK_TRUE(start_serial_driver(&quantum_wheel, simulator.port));
	online = true;
	SERIAL_CHECK_TRUE(context.connected && context.last_connection_state == INDIGO_OK_STATE);
	assert_device_interface(INDIGO_INTERFACE_WHEEL);
	assert_wheel_class_property_completeness();
	assert_property_has_item(WHEEL_SLOT_PROPERTY_NAME, WHEEL_SLOT_ITEM_NAME);
	assert_property_has_items(WHEEL_SLOT_NAME_PROPERTY_NAME, slot_name_items, ARRAY_SIZE(slot_name_items));
	assert_property_has_items(WHEEL_SLOT_OFFSET_PROPERTY_NAME, slot_offset_items, ARRAY_SIZE(slot_offset_items));
	assert_number_item_in_range(WHEEL_SLOT_PROPERTY_NAME, WHEEL_SLOT_ITEM_NAME);
	indigo_property *slot = find_cached_property(WHEEL_SLOT_PROPERTY_NAME);
	SERIAL_CHECK_TRUE(slot != NULL);
	printf("Slot range %g..%g\n", slot->items[0].number.min, slot->items[0].number.max);
	SERIAL_CHECK_TRUE(fabs(slot->items[0].number.max - 7) < .001);
	// on_connect homes the wheel, so slot 1 is the documented post-connect position.
	SERIAL_CHECK_TRUE(wait_for_number_item_value(WHEEL_SLOT_PROPERTY_NAME, WHEEL_SLOT_ITEM_NAME, 1, 0.001));
cleanup:
	if (online) { stop_serial_driver(&quantum_wheel); }
	stop_external_serial_simulator(&simulator);
}

// -------------------------------------------------------------------------------- positioning

// Both rotation directions, covering the zero based wire index at the first and last slot.
static void moves_through_first_intermediate_and_last_slots(void) {
	external_serial_simulator simulator = { 0 };
	bool online = false;
	SERIAL_CHECK_TRUE(start_quantum(&simulator, NULL));
	SERIAL_CHECK_TRUE(start_serial_driver(&quantum_wheel, simulator.port));
	online = true;
	const double slots[] = { 4, 7, 1, 2 };
	for (int i = 0; i < ARRAY_SIZE(slots); i++) {
		SERIAL_CHECK_TRUE(select_slot(slots[i]));
	}
cleanup:
	if (online) { stop_serial_driver(&quantum_wheel); }
	stop_external_serial_simulator(&simulator);
}

static void reselecting_the_current_slot_completes(void) {
	external_serial_simulator simulator = { 0 };
	bool online = false;
	SERIAL_CHECK_TRUE(start_quantum(&simulator, NULL));
	SERIAL_CHECK_TRUE(start_serial_driver(&quantum_wheel, simulator.port));
	online = true;
	SERIAL_CHECK_TRUE(select_slot(5));
	SERIAL_CHECK_TRUE(select_slot(5));
cleanup:
	if (online) { stop_serial_driver(&quantum_wheel); }
	stop_external_serial_simulator(&simulator);
}

// The driver always advertises seven slots. On a five slot wheel the device ignores the request and
// reports nothing, so quantum_goto() must fail rather than hang, and the wheel must stay usable.
static void slot_beyond_the_device_capacity_is_refused(void) {
	external_serial_simulator simulator = { 0 };
	bool online = false;
	const char *arguments[] = { "--slots", "5", NULL };
	SERIAL_CHECK_TRUE(start_quantum(&simulator, arguments));
	SERIAL_CHECK_TRUE(start_serial_driver(&quantum_wheel, simulator.port));
	online = true;
	SERIAL_CHECK_TRUE(select_slot(5));
	SERIAL_CHECK_TRUE(request_slot(7));
	SERIAL_CHECK_TRUE(wait_for_property_state(WHEEL_SLOT_PROPERTY_NAME, INDIGO_ALERT_STATE));
	SERIAL_CHECK_TRUE(select_slot(3));
cleanup:
	if (online) { stop_serial_driver(&quantum_wheel); }
	stop_external_serial_simulator(&simulator);
}

// -------------------------------------------------------------------------------- lifecycle

static void reconnect_homes_the_wheel(void) {
	external_serial_simulator simulator = { 0 };
	bool online = false;
	SERIAL_CHECK_TRUE(start_quantum(&simulator, NULL));
	SERIAL_CHECK_TRUE(start_serial_driver(&quantum_wheel, simulator.port));
	online = true;
	SERIAL_CHECK_TRUE(select_slot(6));
	disconnect_serial_device(&quantum_wheel);
	SERIAL_CHECK_TRUE(!context.connected);
	SERIAL_CHECK_TRUE(connect_serial_device(&quantum_wheel, simulator.port));
	SERIAL_CHECK_TRUE(wait_for_number_item_value(WHEEL_SLOT_PROPERTY_NAME, WHEEL_SLOT_ITEM_NAME, 1, 0.001));
	SERIAL_CHECK_TRUE(select_slot(4));
cleanup:
	if (online) { stop_serial_driver(&quantum_wheel); }
	stop_external_serial_simulator(&simulator);
}

static void repeated_disconnect_is_tolerated(void) {
	external_serial_simulator simulator = { 0 };
	bool online = false;
	SERIAL_CHECK_TRUE(start_quantum(&simulator, NULL));
	SERIAL_CHECK_TRUE(start_serial_driver(&quantum_wheel, simulator.port));
	online = true;
	disconnect_serial_device(&quantum_wheel);
	SERIAL_CHECK_TRUE(!context.connected);
	disconnect_serial_device(&quantum_wheel);
	SERIAL_CHECK_TRUE(!context.connected);
	online = false;
	tear_down_serial_driver(&quantum_wheel);
cleanup:
	if (online) { stop_serial_driver(&quantum_wheel); }
	stop_external_serial_simulator(&simulator);
}

// quantum_open() only accepts a numeric SN reply, so a device answering something else is not a
// Quantum wheel and the connection has to roll back.
static void non_numeric_serial_is_refused(void) {
	external_serial_simulator simulator = { 0 };
	const char *arguments[] = { "--serial", "NOT-A-NUMBER", NULL };
	SERIAL_CHECK_TRUE(start_quantum(&simulator, arguments));
	SERIAL_CHECK_TRUE(bring_up_serial_driver(&quantum_wheel));
	SERIAL_CHECK_TRUE(!connect_serial_device(&quantum_wheel, simulator.port));
	SERIAL_CHECK_TRUE(!context.connected);
cleanup:
	tear_down_serial_driver(&quantum_wheel);
	stop_external_serial_simulator(&simulator);
}

static void silent_port_is_refused(void) {
	external_serial_simulator simulator = { 0 };
	SERIAL_CHECK_TRUE(start_quantum(&simulator, NULL));
	SERIAL_CHECK_TRUE(bring_up_serial_driver(&quantum_wheel));
	stop_external_serial_simulator(&simulator);
	SERIAL_CHECK_TRUE(!connect_serial_device(&quantum_wheel, simulator.port));
	SERIAL_CHECK_TRUE(!context.connected);
cleanup:
	tear_down_serial_driver(&quantum_wheel);
}

int main(void) {
	const indigo_test_case tests[] = {
		{ "metadata_and_property_completeness", metadata_and_property_completeness },
		{ "moves_through_first_intermediate_and_last_slots", moves_through_first_intermediate_and_last_slots },
		{ "reselecting_the_current_slot_completes", reselecting_the_current_slot_completes },
		{ "slot_beyond_the_device_capacity_is_refused", slot_beyond_the_device_capacity_is_refused },
		{ "reconnect_homes_the_wheel", reconnect_homes_the_wheel },
		{ "repeated_disconnect_is_tolerated", repeated_disconnect_is_tolerated },
		{ "non_numeric_serial_is_refused", non_numeric_serial_is_refused },
		{ "silent_port_is_refused", silent_port_is_refused }
	};
	return indigo_run_tests("Quantum wheel serial simulator integration tests", tests, ARRAY_SIZE(tests));
}
