// Copyright (c) 2026 INDIGO initiative
// All rights reserved.
//
// You may use this software under the terms of 'INDIGO Astronomy
// open-source license' (see LICENSE.md).
//
// THIS SOFTWARE IS PROVIDED BY THE AUTHORS 'AS IS' AND ANY EXPRESS
// OR IMPLIED WARRANTIES, INCLUDING, BUT NOT LIMITED TO, THE IMPLIED
// WARRANTIES OF MERCHANTABILITY AND FITNESS FOR A PARTICULAR PURPOSE
// ARE DISCLAIMED. IN NO EVENT SHALL THE AUTHOR BE LIABLE FOR ANY
// DIRECT, INDIRECT, INCIDENTAL, SPECIAL, EXEMPLARY, OR CONSEQUENTIAL
// DAMAGES (INCLUDING, BUT NOT LIMITED TO, PROCUREMENT OF SUBSTITUTE
// GOODS OR SERVICES; LOSS OF USE, DATA, OR PROFITS; OR BUSINESS
// INTERRUPTION) HOWEVER CAUSED AND ON ANY THEORY OF LIABILITY,
// WHETHER IN CONTRACT, STRICT LIABILITY, OR TORT (INCLUDING
// NEGLIGENCE OR OTHERWISE) ARISING IN ANY WAY OUT OF THE USE OF THIS
// SOFTWARE, EVEN IF ADVISED OF THE POSSIBILITY OF SUCH DAMAGE.

// Code is generated by AI

// Tests of the HTTP/1.1 client of the system_alpaca driver (indigo_system_alpaca_http.c) against a scripted
// HTTP server that runs on a thread of this process and listens on an ephemeral loopback port. Every case
// installs its own script, which decides the exact bytes and the timing of what the server sends.
// The suite opens loopback sockets, so it is an opt-in driver test and not part of test-integration.
//
// ALPACA_HTTP_TEST_TRACE=1 switches the INDIGO log to trace level.
// ALPACA_HTTP_TEST_BLACKHOLE=<address> names a host that silently drops TCP SYN packets (e.g. 192.0.2.1 on
// most networks) and enables the connect timeout case on systems where it cannot be produced on loopback.

#include <arpa/inet.h>
#include <locale.h>
#include <netinet/in.h>
#include <netinet/tcp.h>
#include <poll.h>
#include <pthread.h>
#include <signal.h>
#include <stdint.h>
#include <sys/socket.h>
#include <time.h>

#include <indigo/indigo_bus.h>
#include <indigo_drivers/system_alpaca/indigo_system_alpaca_http.h>

#include "../test_runner.h"

#define ARRAY_SIZE(array) ((int)(sizeof(array) / sizeof((array)[0])))

#define SERVER_MAX_CONNECTIONS	16
#define SERVER_MAX_REQUESTS			32
#define SERVER_HEAD_SIZE				2048
#define SERVER_BODY_SIZE				1024
#define SERVER_IO_TIMEOUT				5000
#define SERVER_WRITE_SIZE				2048
#define DEFAULT_MAX_BODY				(1024 * 1024)
#define LARGE_BODY_SIZE					(32 * 1024 * 1024)

typedef struct http_server http_server;

typedef void (*server_script)(http_server *server, int fd, int index);

typedef struct {
	char head[SERVER_HEAD_SIZE];
	char body[SERVER_BODY_SIZE];
	size_t body_size;
	int connection;
} recorded_request;

typedef struct {
	http_server *server;
	pthread_t thread;
	int fd;
	int index;
} server_worker;

struct http_server {
	int listener;
	int port;
	server_script script;
	void *context;
	pthread_t acceptor;
	pthread_mutex_t mutex;
	bool stopping;
	int connections;
	int finished;
	int request_count;
	server_worker workers[SERVER_MAX_CONNECTIONS];
	recorded_request requests[SERVER_MAX_REQUESTS];
};

typedef struct {
	http_server server;
	alpaca_http_connection *connection;
	alpaca_http_response response;
} fixture;

static double now_seconds(void) {
	struct timespec now;
	clock_gettime(CLOCK_MONOTONIC, &now);
	return now.tv_sec + now.tv_nsec / 1e9;
}

static void sleep_ms(int ms) {
	struct timespec delay = { ms / 1000, (ms % 1000) * 1000000L };
	nanosleep(&delay, NULL);
}

// ---- scripted loopback HTTP server ----

static bool server_wait_readable(int fd, int timeout) {
	struct pollfd descriptor = { fd, POLLIN, 0 };
	return poll(&descriptor, 1, timeout) > 0;
}

// Under memory pressure (several suites running in parallel) a blocking write() on a macOS loopback socket fails with ENOBUFS, and a large
// write fails that way after part of it was already sent, so it can be neither repeated nor continued. A write of one mbuf cluster either
// goes out completely or not at all, which makes the transient failure safe to retry. Measured: 256 KB writes duplicated data, 2 KB writes never did.
static bool server_send(int fd, const char *data, size_t size) {
	double deadline = now_seconds() + SERVER_IO_TIMEOUT / 1000.0;
	while (size > 0) {
		ssize_t count = write(fd, data, size < SERVER_WRITE_SIZE ? size : SERVER_WRITE_SIZE);
		if (count < 0 && (errno == ENOBUFS || errno == EAGAIN || errno == EINTR) && now_seconds() < deadline) {
			sleep_ms(1);
			continue;
		}
		if (count <= 0) {
			if (errno != EPIPE && errno != ECONNRESET) {
				fprintf(stderr, "test server: write failed (%s)\n", strerror(errno));
			}
			return false;
		}
		data += count;
		size -= (size_t)count;
	}
	return true;
}

static bool server_send_text(int fd, const char *text) {
	return server_send(fd, text, strlen(text));
}

// A complete response with Content-Length that leaves the connection open.
static bool server_reply(int fd, const char *status, const char *content_type, const char *body) {
	char head[512];
	snprintf(head, sizeof(head), "HTTP/1.1 %s\r\nContent-Type: %s\r\nContent-Length: %zu\r\n\r\n", status, content_type, strlen(body));
	return server_send_text(fd, head) && server_send_text(fd, body);
}

// Block until the client closes its end, which every client failure path does, bounded by SERVER_IO_TIMEOUT.
static void server_wait_for_close(int fd) {
	char scratch[256];
	double deadline = now_seconds() + SERVER_IO_TIMEOUT / 1000.0;
	while (now_seconds() < deadline) {
		if (server_wait_readable(fd, 100) && read(fd, scratch, sizeof(scratch)) <= 0) {
			break;
		}
	}
}

// Make the close that follows send a TCP reset instead of an orderly end of file.
static void server_reset_on_close(int fd) {
	struct linger linger = { 1, 0 };
	setsockopt(fd, SOL_SOCKET, SO_LINGER, &linger, sizeof(linger));
}

// Read one request (head and Content-Length body) and record it. False if the client closed the connection or sent nothing in time.
static bool server_read_request(http_server *server, int fd, int index, recorded_request *request) {
	char buffer[SERVER_HEAD_SIZE + SERVER_BODY_SIZE];
	size_t size = 0;
	char *end = NULL;
	memset(request, 0, sizeof(recorded_request));
	request->connection = index;
	while (end == NULL) {
		if (size >= sizeof(buffer) - 1 || !server_wait_readable(fd, SERVER_IO_TIMEOUT)) {
			return false;
		}
		ssize_t count = read(fd, buffer + size, sizeof(buffer) - 1 - size);
		if (count <= 0) {
			return false;
		}
		size += (size_t)count;
		buffer[size] = 0;
		end = strstr(buffer, "\r\n\r\n");
	}
	size_t head_size = (size_t)(end - buffer) + 4;
	if (head_size >= SERVER_HEAD_SIZE) {
		return false;
	}
	memcpy(request->head, buffer, head_size);
	const char *length = strstr(request->head, "Content-Length: ");
	size_t body_size = length != NULL ? strtoul(length + 16, NULL, 10) : 0;
	if (body_size >= SERVER_BODY_SIZE) {
		return false;
	}
	request->body_size = size - head_size;
	memcpy(request->body, buffer + head_size, request->body_size);
	while (request->body_size < body_size) {
		if (!server_wait_readable(fd, SERVER_IO_TIMEOUT)) {
			return false;
		}
		ssize_t count = read(fd, request->body + request->body_size, body_size - request->body_size);
		if (count <= 0) {
			return false;
		}
		request->body_size += (size_t)count;
	}
	pthread_mutex_lock(&server->mutex);
	if (server->request_count < SERVER_MAX_REQUESTS) {
		server->requests[server->request_count] = *request;
	}
	server->request_count++;
	pthread_mutex_unlock(&server->mutex);
	return true;
}

static void *server_worker_thread(void *data) {
	server_worker *worker = (server_worker *)data;
	http_server *server = worker->server;
	server->script(server, worker->fd, worker->index);
	pthread_mutex_lock(&server->mutex);
	close(worker->fd);
	worker->fd = -1;
	server->finished++;
	pthread_mutex_unlock(&server->mutex);
	return NULL;
}

static void *server_acceptor_thread(void *data) {
	http_server *server = (http_server *)data;
	while (true) {
		pthread_mutex_lock(&server->mutex);
		bool stop = server->stopping || server->connections == SERVER_MAX_CONNECTIONS;
		pthread_mutex_unlock(&server->mutex);
		if (stop) {
			break;
		}
		if (!server_wait_readable(server->listener, 20)) {
			continue;
		}
		int fd = accept(server->listener, NULL, NULL);
		if (fd < 0) {
			continue;
		}
		int enabled = 1;
		setsockopt(fd, IPPROTO_TCP, TCP_NODELAY, &enabled, sizeof(enabled));
		pthread_mutex_lock(&server->mutex);
		server_worker *worker = server->workers + server->connections;
		worker->server = server;
		worker->fd = fd;
		worker->index = server->connections;
		if (pthread_create(&worker->thread, NULL, server_worker_thread, worker) == 0) {
			server->connections++;
		} else {
			close(fd);
		}
		pthread_mutex_unlock(&server->mutex);
	}
	return NULL;
}

static int open_listener(int family, int backlog, int *port) {
	struct sockaddr_storage storage = { 0 };
	socklen_t length = family == AF_INET6 ? sizeof(struct sockaddr_in6) : sizeof(struct sockaddr_in);
	if (family == AF_INET6) {
		struct sockaddr_in6 *address = (struct sockaddr_in6 *)&storage;
		address->sin6_family = AF_INET6;
		address->sin6_addr = in6addr_loopback;
	} else {
		struct sockaddr_in *address = (struct sockaddr_in *)&storage;
		address->sin_family = AF_INET;
		address->sin_addr.s_addr = htonl(INADDR_LOOPBACK);
	}
	int fd = socket(family, SOCK_STREAM, 0);
	if (fd < 0 || bind(fd, (struct sockaddr *)&storage, length) < 0 || listen(fd, backlog) < 0 || getsockname(fd, (struct sockaddr *)&storage, &length) < 0) {
		if (fd >= 0) {
			close(fd);
		}
		return -1;
	}
	*port = ntohs(family == AF_INET6 ? ((struct sockaddr_in6 *)&storage)->sin6_port : ((struct sockaddr_in *)&storage)->sin_port);
	return fd;
}

static bool server_start(http_server *server, int family, server_script script, void *context) {
	memset(server, 0, sizeof(http_server));
	server->script = script;
	server->context = context;
	server->listener = open_listener(family, SERVER_MAX_CONNECTIONS, &server->port);
	if (server->listener < 0) {
		return false;
	}
	pthread_mutex_init(&server->mutex, NULL);
	if (pthread_create(&server->acceptor, NULL, server_acceptor_thread, server) != 0) {
		close(server->listener);
		pthread_mutex_destroy(&server->mutex);
		return false;
	}
	return true;
}

static void server_stop(http_server *server) {
	pthread_mutex_lock(&server->mutex);
	server->stopping = true;
	pthread_mutex_unlock(&server->mutex);
	pthread_join(server->acceptor, NULL);
	// wake up every script that is still blocked on its socket
	pthread_mutex_lock(&server->mutex);
	int connections = server->connections;
	for (int i = 0; i < connections; i++) {
		if (server->workers[i].fd >= 0) {
			shutdown(server->workers[i].fd, SHUT_RDWR);
		}
	}
	pthread_mutex_unlock(&server->mutex);
	for (int i = 0; i < connections; i++) {
		pthread_join(server->workers[i].thread, NULL);
	}
	close(server->listener);
	pthread_mutex_destroy(&server->mutex);
}

static int server_connections(http_server *server) {
	pthread_mutex_lock(&server->mutex);
	int result = server->connections;
	pthread_mutex_unlock(&server->mutex);
	return result;
}

static int server_request_count(http_server *server) {
	pthread_mutex_lock(&server->mutex);
	int result = server->request_count;
	pthread_mutex_unlock(&server->mutex);
	return result;
}

// A recorded request is written once, before the server answers it, so it is stable by the time the client call returned.
static const recorded_request *server_request(http_server *server, int index) {
	static const recorded_request none = { .connection = -1 };
	pthread_mutex_lock(&server->mutex);
	const recorded_request *result = index >= 0 && index < server->request_count && index < SERVER_MAX_REQUESTS ? server->requests + index : &none;
	pthread_mutex_unlock(&server->mutex);
	return result;
}

// Wait until the scripts of 'count' connections returned and their sockets are closed.
static bool server_wait_finished(http_server *server, int count) {
	double deadline = now_seconds() + 2;
	while (now_seconds() < deadline) {
		pthread_mutex_lock(&server->mutex);
		bool finished = server->finished >= count;
		pthread_mutex_unlock(&server->mutex);
		if (finished) {
			return true;
		}
		sleep_ms(1);
	}
	return false;
}

// ---- scripts ----

// Serve every request of every connection with a small JSON document and keep the connection open.
static void script_keep_alive(http_server *server, int fd, int index) {
	recorded_request request;
	while (server_read_request(server, fd, index, &request)) {
		if (!server_reply(fd, "200 OK", "application/json", "{\"Value\":1}")) {
			break;
		}
	}
}

// Answer with the request target, so a client can tell its own response from somebody else's.
static void script_echo(http_server *server, int fd, int index) {
	recorded_request request;
	while (server_read_request(server, fd, index, &request)) {
		char *target = strchr(request.head, ' ');
		char *end = target != NULL ? strchr(target + 1, ' ') : NULL;
		if (end == NULL) {
			break;
		}
		*end = 0;
		if (!server_reply(fd, "200 OK", "text/plain", target + 1)) {
			break;
		}
	}
}

// The context is an array of raw responses: the connection with index n reads one request, sends raw response n and closes.
static void script_raw(http_server *server, int fd, int index) {
	const char **replies = (const char **)server->context;
	recorded_request request;
	if (server_read_request(server, fd, index, &request)) {
		server_send_text(fd, replies[index]);
	}
}

// The context is one raw response that is sent one byte at a time for every request of the connection.
static void script_trickle(http_server *server, int fd, int index) {
	const char *reply = (const char *)server->context;
	recorded_request request;
	while (server_read_request(server, fd, index, &request)) {
		for (const char *byte = reply; *byte; byte++) {
			if (!server_send(fd, byte, 1)) {
				return;
			}
			usleep(300);
		}
	}
}

// The context is a raw prefix (possibly empty) that is sent before the server goes silent until the client gives up.
static void script_stall(http_server *server, int fd, int index) {
	recorded_request request;
	if (server_read_request(server, fd, index, &request)) {
		server_send_text(fd, (const char *)server->context);
		server_wait_for_close(fd);
	}
}

// A body that never stalls and never ends: one byte every 50 ms until the client gives up.
static void script_drip(http_server *server, int fd, int index) {
	recorded_request request;
	if (server_read_request(server, fd, index, &request)) {
		double deadline = now_seconds() + SERVER_IO_TIMEOUT / 1000.0;
		server_send_text(fd, "HTTP/1.1 200 OK\r\nContent-Length: 1000000\r\n\r\n");
		while (now_seconds() < deadline && server_send(fd, "x", 1) && !server_wait_readable(fd, 50)) {
		}
	}
}

// The context is a raw prefix (possibly empty) that is sent before the connection is reset.
static void script_reset(http_server *server, int fd, int index) {
	recorded_request request;
	if (server_read_request(server, fd, index, &request)) {
		server_send_text(fd, (const char *)server->context);
		server_reset_on_close(fd);
	}
}

typedef enum {
	STALE_CLOSE_IDLE,						// connection 0 is closed right after its first response
	STALE_CLOSE_ON_REQUEST,			// connection 0 reads the second request and closes without a response
	STALE_PARTIAL_ON_REQUEST,		// connection 0 answers the second request with half a header block and closes
	STALE_TWICE									// as STALE_CLOSE_ON_REQUEST, and connection 1 also closes without a response
} stale_mode;

// Connection 0 serves one request and then misbehaves as the mode says; later connections are well behaved.
static void script_stale(http_server *server, int fd, int index) {
	stale_mode mode = *(stale_mode *)server->context;
	recorded_request request;
	if (index > 0) {
		if (mode == STALE_TWICE) {
			server_read_request(server, fd, index, &request);
		} else {
			script_keep_alive(server, fd, index);
		}
		return;
	}
	if (!server_read_request(server, fd, index, &request) || !server_reply(fd, "200 OK", "application/json", "{\"Value\":1}") || mode == STALE_CLOSE_IDLE) {
		return;
	}
	if (server_read_request(server, fd, index, &request) && mode == STALE_PARTIAL_ON_REQUEST) {
		server_send_text(fd, "HTTP/1.1 200 OK\r\nContent-Le");
	}
}

typedef enum {
	LARGE_CONTENT_LENGTH,
	LARGE_CHUNKED,
	LARGE_TO_EOF
} large_mode;

typedef struct {
	const char *data;
	size_t size;
	large_mode mode;
} large_body;

static void script_large(http_server *server, int fd, int index) {
	large_body *large = (large_body *)server->context;
	recorded_request request;
	char head[256];
	if (!server_read_request(server, fd, index, &request)) {
		return;
	}
	if (large->mode == LARGE_CONTENT_LENGTH) {
		snprintf(head, sizeof(head), "HTTP/1.1 200 OK\r\nContent-Type: application/imagebytes\r\nContent-Length: %zu\r\n\r\n", large->size);
		if (server_send_text(fd, head) && server_send(fd, large->data, large->size)) {
			server_wait_for_close(fd);
		}
	} else if (large->mode == LARGE_CHUNKED) {
		bool ok = server_send_text(fd, "HTTP/1.1 200 OK\r\nContent-Type: application/imagebytes\r\nTransfer-Encoding: chunked\r\n\r\n");
		for (size_t offset = 0; ok && offset < large->size; offset += 65521) {
			size_t chunk = large->size - offset < 65521 ? large->size - offset : 65521;
			snprintf(head, sizeof(head), "%zx;offset=%zu\r\n", chunk, offset);
			ok = server_send_text(fd, head) && server_send(fd, large->data + offset, chunk) && server_send_text(fd, "\r\n");
		}
		if (ok && server_send_text(fd, "0\r\n\r\n")) {
			server_wait_for_close(fd);
		}
	} else {
		if (server_send_text(fd, "HTTP/1.1 200 OK\r\nContent-Type: application/imagebytes\r\nConnection: close\r\n\r\n")) {
			server_send(fd, large->data, large->size);
		}
	}
}

// ---- fixture ----

static bool fixture_start(fixture *f, int family, server_script script, void *context, size_t max_body) {
	memset(f, 0, sizeof(fixture));
	if (!server_start(&f->server, family, script, context)) {
		return false;
	}
	f->connection = alpaca_http_connection_create(family == AF_INET6 ? "::1" : "127.0.0.1", f->server.port);
	if (f->connection == NULL) {
		server_stop(&f->server);
		return false;
	}
	alpaca_http_response_init(&f->response, max_body);
	return true;
}

static void fixture_stop(fixture *f) {
	alpaca_http_connection_free(f->connection);
	alpaca_http_response_free(&f->response);
	server_stop(&f->server);
}

// A case with a server. The assertion macros return from the body, the wrapper always stops the server and releases the client.
#define HTTP_TEST(name, script, context, max_body) \
static void name##_body(fixture *f); \
static void name(void) { \
	static fixture f; \
	if (!fixture_start(&f, AF_INET, script, context, max_body)) { \
		fprintf(stderr, "%s: can't start the loopback server\n", #name); \
		indigo_test_failures++; \
		return; \
	} \
	name##_body(&f); \
	fixture_stop(&f); \
} \
static void name##_body(fixture *f)

// Timeouts that keep a broken case from hanging and are far above anything a loopback exchange needs.
static alpaca_http_options bounded_options(void) {
	alpaca_http_options options = { 0 };
	options.timeouts.connect = 2000;
	options.timeouts.first_byte = 3000;
	options.timeouts.inter_byte = 3000;
	options.timeouts.total = 10000;
	return options;
}

// ---- requests ----

HTTP_TEST(get_with_content_length, script_keep_alive, NULL, DEFAULT_MAX_BODY) {
	alpaca_http_options options = bounded_options();
	options.headers = "Accept: application/json\r\n";
	char expected[512];
	ASSERT_EQ_INT(ALPACA_HTTP_OK, alpaca_http_get(f->connection, "/api/v1/focuser/0/position", "ClientID=7&ClientTransactionID=1", &options, &f->response));
	ASSERT_EQ_INT(200, f->response.status);
	ASSERT_STREQ("{\"Value\":1}", f->response.body.data);
	ASSERT_EQ_INT(11, (int)f->response.body.size);
	ASSERT_STREQ("application/json", f->response.content_type);
	ASSERT_TRUE(alpaca_http_response_is(&f->response, "application/json"));
	ASSERT_FALSE(alpaca_http_response_is(&f->response, "application/imagebytes"));
	ASSERT_STREQ("", f->response.content_encoding);
	ASSERT_STREQ("", f->response.location);
	const recorded_request *request = server_request(&f->server, 0);
	snprintf(expected, sizeof(expected), "GET /api/v1/focuser/0/position?ClientID=7&ClientTransactionID=1 HTTP/1.1\r\nHost: 127.0.0.1:%d\r\nUser-Agent: indigo_system_alpaca\r\nConnection: keep-alive\r\nAccept: application/json\r\n\r\n", f->server.port);
	ASSERT_STREQ(expected, request->head);
	ASSERT_EQ_INT(0, (int)request->body_size);
}

HTTP_TEST(get_without_query_and_options, script_keep_alive, NULL, DEFAULT_MAX_BODY) {
	char expected[512];
	ASSERT_EQ_INT(ALPACA_HTTP_OK, alpaca_http_get(f->connection, "/management/apiversions", NULL, NULL, &f->response));
	ASSERT_EQ_INT(ALPACA_HTTP_OK, alpaca_http_get(f->connection, "/management/apiversions", "", NULL, &f->response));
	ASSERT_EQ_INT(200, f->response.status);
	snprintf(expected, sizeof(expected), "GET /management/apiversions HTTP/1.1\r\nHost: 127.0.0.1:%d\r\nUser-Agent: indigo_system_alpaca\r\nConnection: keep-alive\r\n\r\n", f->server.port);
	ASSERT_STREQ(expected, server_request(&f->server, 0)->head);
	ASSERT_STREQ(expected, server_request(&f->server, 1)->head);
}

HTTP_TEST(put_with_form_body, script_keep_alive, NULL, DEFAULT_MAX_BODY) {
	alpaca_http_options options = bounded_options();
	alpaca_http_buffer form;
	char expected[512];
	const char *body = "Position=1234&ClientID=7&ClientTransactionID=2&Name=M%2031%20%2B%20%C3%A9";
	alpaca_http_buffer_init(&form, 1024);
	ASSERT_TRUE(alpaca_http_form_add_int(&form, "Position", 1234));
	ASSERT_TRUE(alpaca_http_form_add_int(&form, "ClientID", 7));
	ASSERT_TRUE(alpaca_http_form_add_int(&form, "ClientTransactionID", 2));
	ASSERT_TRUE(alpaca_http_form_add_string(&form, "Name", "M 31 + \xC3\xA9"));
	alpaca_http_result result = alpaca_http_put(f->connection, "/api/v1/focuser/0/move", NULL, form.data, &options, &f->response);
	alpaca_http_buffer_free(&form);
	ASSERT_EQ_INT(ALPACA_HTTP_OK, result);
	ASSERT_EQ_INT(200, f->response.status);
	ASSERT_STREQ("{\"Value\":1}", f->response.body.data);
	const recorded_request *request = server_request(&f->server, 0);
	snprintf(expected, sizeof(expected), "PUT /api/v1/focuser/0/move HTTP/1.1\r\nHost: 127.0.0.1:%d\r\nUser-Agent: indigo_system_alpaca\r\nConnection: keep-alive\r\nContent-Type: application/x-www-form-urlencoded\r\nContent-Length: %zu\r\n\r\n", f->server.port, strlen(body));
	ASSERT_STREQ(expected, request->head);
	ASSERT_EQ_INT((int)strlen(body), (int)request->body_size);
	ASSERT_STREQ(body, request->body);
}

HTTP_TEST(put_without_form_sends_empty_body, script_keep_alive, NULL, DEFAULT_MAX_BODY) {
	alpaca_http_options options = bounded_options();
	char expected[512];
	ASSERT_EQ_INT(ALPACA_HTTP_OK, alpaca_http_put(f->connection, "/api/v1/telescope/0/abortslew", "ClientID=7", NULL, &options, &f->response));
	ASSERT_EQ_INT(200, f->response.status);
	const recorded_request *request = server_request(&f->server, 0);
	snprintf(expected, sizeof(expected), "PUT /api/v1/telescope/0/abortslew?ClientID=7 HTTP/1.1\r\nHost: 127.0.0.1:%d\r\nUser-Agent: indigo_system_alpaca\r\nConnection: keep-alive\r\nContent-Type: application/x-www-form-urlencoded\r\nContent-Length: 0\r\n\r\n", f->server.port);
	ASSERT_STREQ(expected, request->head);
	ASSERT_EQ_INT(0, (int)request->body_size);
}

HTTP_TEST(invalid_requests_are_rejected_before_sending, script_keep_alive, NULL, DEFAULT_MAX_BODY) {
	alpaca_http_options options = bounded_options();
	ASSERT_EQ_INT(ALPACA_HTTP_INVALID_REQUEST, alpaca_http_get(f->connection, "api/v1", NULL, &options, &f->response));
	ASSERT_EQ_INT(ALPACA_HTTP_INVALID_REQUEST, alpaca_http_get(f->connection, "/api v1", NULL, &options, &f->response));
	ASSERT_EQ_INT(ALPACA_HTTP_INVALID_REQUEST, alpaca_http_get(f->connection, "/api", "a=b HTTP/1.1\r\nX: y", &options, &f->response));
	ASSERT_EQ_INT(ALPACA_HTTP_INVALID_REQUEST, alpaca_http_get(f->connection, NULL, NULL, &options, &f->response));
	ASSERT_EQ_INT(ALPACA_HTTP_INVALID_REQUEST, alpaca_http_get(NULL, "/api", NULL, &options, &f->response));
	ASSERT_EQ_INT(ALPACA_HTTP_INVALID_REQUEST, alpaca_http_get(f->connection, "/api", NULL, &options, NULL));
	options.headers = "Accept: application/json";
	ASSERT_EQ_INT(ALPACA_HTTP_INVALID_REQUEST, alpaca_http_get(f->connection, "/api", NULL, &options, &f->response));
	options.headers = "Accept: application/json\r\n\r\nGET /other HTTP/1.1\r\n";
	ASSERT_EQ_INT(ALPACA_HTTP_INVALID_REQUEST, alpaca_http_get(f->connection, "/api", NULL, &options, &f->response));
	ASSERT_EQ_INT(0, f->response.status);
	ASSERT_STREQ("", f->response.body.data);
	ASSERT_EQ_INT(0, (int)alpaca_http_connection_connects(f->connection));
	ASSERT_EQ_INT(0, server_request_count(&f->server));
	ASSERT_TRUE(alpaca_http_connection_create(NULL, 80) == NULL);
	ASSERT_TRUE(alpaca_http_connection_create("", 80) == NULL);
	ASSERT_TRUE(alpaca_http_connection_create("host name", 80) == NULL);
	ASSERT_TRUE(alpaca_http_connection_create("127.0.0.1", 0) == NULL);
	ASSERT_TRUE(alpaca_http_connection_create("127.0.0.1", 65536) == NULL);
	alpaca_http_connection_free(NULL);
	alpaca_http_connection_close(NULL);
	ASSERT_FALSE(alpaca_http_connection_is_open(NULL));
}

// ---- keep-alive ----

HTTP_TEST(keep_alive_reuses_one_socket, script_keep_alive, NULL, DEFAULT_MAX_BODY) {
	alpaca_http_options options = bounded_options();
	ASSERT_FALSE(alpaca_http_connection_is_open(f->connection));
	for (int i = 0; i < 6; i++) {
		alpaca_http_result result = i % 2 ? alpaca_http_put(f->connection, "/api/v1/dome/0/slaved", NULL, "Slaved=True", &options, &f->response) : alpaca_http_get(f->connection, "/api/v1/dome/0/slaved", NULL, &options, &f->response);
		ASSERT_EQ_INT(ALPACA_HTTP_OK, result);
		ASSERT_EQ_INT(200, f->response.status);
		ASSERT_STREQ("{\"Value\":1}", f->response.body.data);
		ASSERT_TRUE(alpaca_http_connection_is_open(f->connection));
	}
	ASSERT_EQ_INT(1, (int)alpaca_http_connection_connects(f->connection));
	ASSERT_EQ_INT(1, server_connections(&f->server));
	ASSERT_EQ_INT(6, server_request_count(&f->server));
	for (int i = 0; i < 6; i++) {
		ASSERT_EQ_INT(0, server_request(&f->server, i)->connection);
	}
	alpaca_http_connection_close(f->connection);
	ASSERT_FALSE(alpaca_http_connection_is_open(f->connection));
	ASSERT_EQ_INT(ALPACA_HTTP_OK, alpaca_http_get(f->connection, "/api/v1/dome/0/slaved", NULL, &options, &f->response));
	ASSERT_EQ_INT(2, (int)alpaca_http_connection_connects(f->connection));
	ASSERT_EQ_INT(1, server_request(&f->server, 6)->connection);
}

static stale_mode stale_close_idle = STALE_CLOSE_IDLE;
static stale_mode stale_close_on_request = STALE_CLOSE_ON_REQUEST;
static stale_mode stale_partial_on_request = STALE_PARTIAL_ON_REQUEST;
static stale_mode stale_twice = STALE_TWICE;

// The server closed the idle socket. The next request notices before it writes anything, so even a PUT that must not be repeated goes out exactly once.
HTTP_TEST(stale_idle_socket_is_replaced_before_writing, script_stale, &stale_close_idle, DEFAULT_MAX_BODY) {
	alpaca_http_options options = bounded_options();
	ASSERT_EQ_INT(ALPACA_HTTP_OK, alpaca_http_get(f->connection, "/first", NULL, &options, &f->response));
	ASSERT_TRUE(server_wait_finished(&f->server, 1));
	sleep_ms(100);
	ASSERT_EQ_INT(ALPACA_HTTP_OK, alpaca_http_put(f->connection, "/second", NULL, "Position=10", &options, &f->response));
	ASSERT_EQ_INT(200, f->response.status);
	ASSERT_STREQ("{\"Value\":1}", f->response.body.data);
	ASSERT_EQ_INT(2, (int)alpaca_http_connection_connects(f->connection));
	ASSERT_EQ_INT(2, server_connections(&f->server));
	ASSERT_EQ_INT(2, server_request_count(&f->server));
	ASSERT_EQ_INT(1, server_request(&f->server, 1)->connection);
	ASSERT_STREQ("Position=10", server_request(&f->server, 1)->body);
}

HTTP_TEST(stale_idle_socket_is_reported_by_is_open, script_stale, &stale_close_idle, DEFAULT_MAX_BODY) {
	alpaca_http_options options = bounded_options();
	ASSERT_EQ_INT(ALPACA_HTTP_OK, alpaca_http_get(f->connection, "/first", NULL, &options, &f->response));
	ASSERT_TRUE(server_wait_finished(&f->server, 1));
	double deadline = now_seconds() + 2;
	bool open = true;
	while (open && now_seconds() < deadline) {
		open = alpaca_http_connection_is_open(f->connection);
		sleep_ms(1);
	}
	ASSERT_FALSE(open);
	ASSERT_EQ_INT(ALPACA_HTTP_OK, alpaca_http_put(f->connection, "/second", NULL, "Position=10", &options, &f->response));
	ASSERT_EQ_INT(2, (int)alpaca_http_connection_connects(f->connection));
	ASSERT_EQ_INT(2, server_request_count(&f->server));
}

// The reused socket dies after the request was written and before any response byte: a GET is sent once more over a new connection.
HTTP_TEST(stale_socket_get_is_retried_once, script_stale, &stale_close_on_request, DEFAULT_MAX_BODY) {
	alpaca_http_options options = bounded_options();
	ASSERT_EQ_INT(ALPACA_HTTP_OK, alpaca_http_get(f->connection, "/first", NULL, &options, &f->response));
	ASSERT_EQ_INT(ALPACA_HTTP_OK, alpaca_http_get(f->connection, "/second", NULL, &options, &f->response));
	ASSERT_EQ_INT(200, f->response.status);
	ASSERT_STREQ("{\"Value\":1}", f->response.body.data);
	ASSERT_EQ_INT(2, (int)alpaca_http_connection_connects(f->connection));
	ASSERT_EQ_INT(2, server_connections(&f->server));
	ASSERT_EQ_INT(3, server_request_count(&f->server));
	ASSERT_EQ_INT(0, server_request(&f->server, 1)->connection);
	ASSERT_EQ_INT(1, server_request(&f->server, 2)->connection);
	ASSERT_TRUE(strncmp(server_request(&f->server, 1)->head, "GET /second ", 12) == 0);
	ASSERT_TRUE(strncmp(server_request(&f->server, 2)->head, "GET /second ", 12) == 0);
	ASSERT_TRUE(alpaca_http_connection_is_open(f->connection));
}

// The same failure with a PUT that is not marked replayable: the server may have executed it, so it is reported and not repeated.
HTTP_TEST(stale_socket_put_is_not_repeated, script_stale, &stale_close_on_request, DEFAULT_MAX_BODY) {
	alpaca_http_options options = bounded_options();
	ASSERT_EQ_INT(ALPACA_HTTP_OK, alpaca_http_get(f->connection, "/first", NULL, &options, &f->response));
	ASSERT_EQ_INT(ALPACA_HTTP_RESET, alpaca_http_put(f->connection, "/api/v1/rotator/0/move", NULL, "Position=5", &options, &f->response));
	ASSERT_EQ_INT(0, f->response.status);
	ASSERT_STREQ("", f->response.body.data);
	ASSERT_FALSE(alpaca_http_connection_is_open(f->connection));
	ASSERT_EQ_INT(1, (int)alpaca_http_connection_connects(f->connection));
	ASSERT_TRUE(server_wait_finished(&f->server, 1));
	ASSERT_EQ_INT(1, server_connections(&f->server));
	ASSERT_EQ_INT(2, server_request_count(&f->server));
}

HTTP_TEST(stale_socket_replayable_put_is_retried_once, script_stale, &stale_close_on_request, DEFAULT_MAX_BODY) {
	alpaca_http_options options = bounded_options();
	options.replayable = true;
	ASSERT_EQ_INT(ALPACA_HTTP_OK, alpaca_http_get(f->connection, "/first", NULL, &options, &f->response));
	ASSERT_EQ_INT(ALPACA_HTTP_OK, alpaca_http_put(f->connection, "/api/v1/telescope/0/tracking", NULL, "Tracking=True", &options, &f->response));
	ASSERT_EQ_INT(200, f->response.status);
	ASSERT_EQ_INT(2, (int)alpaca_http_connection_connects(f->connection));
	ASSERT_EQ_INT(3, server_request_count(&f->server));
	ASSERT_STREQ("Tracking=True", server_request(&f->server, 1)->body);
	ASSERT_STREQ("Tracking=True", server_request(&f->server, 2)->body);
	ASSERT_EQ_INT(1, server_request(&f->server, 2)->connection);
}

// The retry runs over a new connection, so its failure is final: exactly two connections, never a third.
HTTP_TEST(stale_socket_retry_happens_only_once, script_stale, &stale_twice, DEFAULT_MAX_BODY) {
	alpaca_http_options options = bounded_options();
	ASSERT_EQ_INT(ALPACA_HTTP_OK, alpaca_http_get(f->connection, "/first", NULL, &options, &f->response));
	ASSERT_EQ_INT(ALPACA_HTTP_RESET, alpaca_http_get(f->connection, "/second", NULL, &options, &f->response));
	ASSERT_EQ_INT(2, (int)alpaca_http_connection_connects(f->connection));
	ASSERT_TRUE(server_wait_finished(&f->server, 2));
	ASSERT_EQ_INT(2, server_connections(&f->server));
	ASSERT_EQ_INT(3, server_request_count(&f->server));
}

// Once a byte of the response arrived the request was certainly processed, so nothing is repeated, not even a GET over a reused socket.
HTTP_TEST(no_retry_after_partial_response, script_stale, &stale_partial_on_request, DEFAULT_MAX_BODY) {
	alpaca_http_options options = bounded_options();
	ASSERT_EQ_INT(ALPACA_HTTP_OK, alpaca_http_get(f->connection, "/first", NULL, &options, &f->response));
	ASSERT_EQ_INT(ALPACA_HTTP_TRUNCATED, alpaca_http_get(f->connection, "/second", NULL, &options, &f->response));
	ASSERT_EQ_INT(0, f->response.status);
	ASSERT_FALSE(alpaca_http_connection_is_open(f->connection));
	ASSERT_EQ_INT(1, (int)alpaca_http_connection_connects(f->connection));
	ASSERT_TRUE(server_wait_finished(&f->server, 1));
	ASSERT_EQ_INT(1, server_connections(&f->server));
	ASSERT_EQ_INT(2, server_request_count(&f->server));
}

static const char *replies_garbage_after_body[] = {
	"HTTP/1.1 200 OK\r\nContent-Length: 2\r\n\r\nokHTTP/1.1 500 Unexpected\r\nContent-Length: 0\r\n\r\n",
	"HTTP/1.1 200 OK\r\nContent-Length: 6\r\n\r\nsecond"
};

// Bytes after the end of a response mean that the framing can't be trusted any more: the socket is not reused and the garbage never becomes the next response.
HTTP_TEST(data_after_the_response_prevents_reuse, script_raw, replies_garbage_after_body, DEFAULT_MAX_BODY) {
	alpaca_http_options options = bounded_options();
	ASSERT_EQ_INT(ALPACA_HTTP_OK, alpaca_http_get(f->connection, "/first", NULL, &options, &f->response));
	ASSERT_EQ_INT(200, f->response.status);
	ASSERT_STREQ("ok", f->response.body.data);
	ASSERT_EQ_INT(ALPACA_HTTP_OK, alpaca_http_get(f->connection, "/second", NULL, &options, &f->response));
	ASSERT_EQ_INT(200, f->response.status);
	ASSERT_STREQ("second", f->response.body.data);
	ASSERT_EQ_INT(2, (int)alpaca_http_connection_connects(f->connection));
}

// ---- body framing ----

static const char chunked_reply[] = "HTTP/1.1 200 OK\r\nContent-Type: application/json\r\nTransfer-Encoding: chunked\r\n\r\n8;name=value;flag\r\n{\"Value\"\r\n1\r\n:\r\n9 ; padded=\"x\"\r\n[1,2,3,4,\r\n00003\r\n5]}\r\n0;last\r\nExpires: never\r\nX-Checksum: 1234\r\n\r\n";

// Several chunks with extensions and a trailer block, every byte in its own TCP segment, and the connection stays usable afterwards.
HTTP_TEST(chunked_body_byte_by_byte, script_trickle, (void *)chunked_reply, DEFAULT_MAX_BODY) {
	alpaca_http_options options = bounded_options();
	for (int i = 0; i < 2; i++) {
		ASSERT_EQ_INT(ALPACA_HTTP_OK, alpaca_http_get(f->connection, "/api/v1/filterwheel/0/focusoffsets", NULL, &options, &f->response));
		ASSERT_EQ_INT(200, f->response.status);
		ASSERT_STREQ("{\"Value\":[1,2,3,4,5]}", f->response.body.data);
		ASSERT_EQ_INT(21, (int)f->response.body.size);
		ASSERT_TRUE(alpaca_http_response_is(&f->response, "application/json"));
	}
	ASSERT_EQ_INT(1, (int)alpaca_http_connection_connects(f->connection));
	ASSERT_EQ_INT(1, server_connections(&f->server));
}

static const char *replies_to_eof[] = {
	"HTTP/1.1 200 OK\r\nContent-Type: text/plain\r\nConnection: close\r\n\r\nbody up to the end of file",
	"HTTP/1.0 200 OK\r\nContent-Type: text/plain\r\n\r\nold server",
	"HTTP/1.1 200 OK\r\n\r\n",
	"HTTP/1.1 200 OK\r\nConnection: close\r\nContent-Length: 5\r\n\r\nexact"
};

// ESP8266/ESP32 style servers: no Content-Length, the body ends where the connection ends, and every request needs a new connection.
HTTP_TEST(connection_close_body_to_end_of_file, script_raw, replies_to_eof, DEFAULT_MAX_BODY) {
	alpaca_http_options options = bounded_options();
	ASSERT_EQ_INT(ALPACA_HTTP_OK, alpaca_http_get(f->connection, "/a", NULL, &options, &f->response));
	ASSERT_EQ_INT(200, f->response.status);
	ASSERT_STREQ("body up to the end of file", f->response.body.data);
	ASSERT_EQ_INT(26, (int)f->response.body.size);
	ASSERT_FALSE(alpaca_http_connection_is_open(f->connection));
	ASSERT_EQ_INT(ALPACA_HTTP_OK, alpaca_http_get(f->connection, "/b", NULL, &options, &f->response));
	ASSERT_STREQ("old server", f->response.body.data);
	ASSERT_FALSE(alpaca_http_connection_is_open(f->connection));
	ASSERT_EQ_INT(ALPACA_HTTP_OK, alpaca_http_get(f->connection, "/c", NULL, &options, &f->response));
	ASSERT_STREQ("", f->response.body.data);
	ASSERT_EQ_INT(0, (int)f->response.body.size);
	ASSERT_EQ_INT(ALPACA_HTTP_OK, alpaca_http_get(f->connection, "/d", NULL, &options, &f->response));
	ASSERT_STREQ("exact", f->response.body.data);
	ASSERT_FALSE(alpaca_http_connection_is_open(f->connection));
	ASSERT_EQ_INT(4, (int)alpaca_http_connection_connects(f->connection));
	ASSERT_EQ_INT(4, server_request_count(&f->server));
}

static const char *replies_truncated[] = {
	"HTTP/1.1 200 OK\r\nContent-Type: application/json\r\nContent-Length: 100\r\n\r\n{\"Value\":1",
	"HTTP/1.1 200 OK\r\nTransfer-Encoding: chunked\r\n\r\n5\r\nhello\r\n5\r\nwo",
	"HTTP/1.1 200 OK\r\nTransfer-Encoding: chunked\r\n\r\n5\r\nhello\r\n",
	"HTTP/1.1 200 OK\r\nTransfer-Encoding: chunked\r\n\r\n5\r\nhello\r\n0\r\nTrailer: cut",
	"HTTP/1.1 200 OK\r\nContent-Type: application/json\r\nContent-Len"
};

HTTP_TEST(truncated_bodies_are_reported, script_raw, replies_truncated, DEFAULT_MAX_BODY) {
	alpaca_http_options options = bounded_options();
	ASSERT_EQ_INT(ALPACA_HTTP_TRUNCATED, alpaca_http_get(f->connection, "/length", NULL, &options, &f->response));
	ASSERT_EQ_INT(200, f->response.status);
	ASSERT_STREQ("{\"Value\":1", f->response.body.data);
	ASSERT_EQ_INT(10, (int)f->response.body.size);
	ASSERT_FALSE(alpaca_http_connection_is_open(f->connection));
	ASSERT_EQ_INT(ALPACA_HTTP_TRUNCATED, alpaca_http_get(f->connection, "/chunk-data", NULL, &options, &f->response));
	ASSERT_STREQ("hellowo", f->response.body.data);
	ASSERT_EQ_INT(ALPACA_HTTP_TRUNCATED, alpaca_http_get(f->connection, "/chunk-size", NULL, &options, &f->response));
	ASSERT_STREQ("hello", f->response.body.data);
	ASSERT_EQ_INT(ALPACA_HTTP_TRUNCATED, alpaca_http_get(f->connection, "/trailer", NULL, &options, &f->response));
	ASSERT_STREQ("hello", f->response.body.data);
	ASSERT_EQ_INT(ALPACA_HTTP_TRUNCATED, alpaca_http_get(f->connection, "/header", NULL, &options, &f->response));
	ASSERT_EQ_INT(0, f->response.status);
	ASSERT_STREQ("", f->response.body.data);
	ASSERT_EQ_INT(5, server_request_count(&f->server));
}

// ---- timeouts, resets, connection failures ----

HTTP_TEST(timeout_before_first_byte, script_stall, "", DEFAULT_MAX_BODY) {
	alpaca_http_options options = bounded_options();
	options.timeouts.first_byte = 200;
	double start = now_seconds();
	alpaca_http_result result = alpaca_http_put(f->connection, "/api/v1/dome/0/park", NULL, "ClientID=7", &options, &f->response);
	double elapsed = now_seconds() - start;
	ASSERT_EQ_INT(ALPACA_HTTP_FIRST_BYTE_TIMEOUT, result);
	ASSERT_TRUE(elapsed >= 0.19 && elapsed < 1.5);
	ASSERT_EQ_INT(0, f->response.status);
	ASSERT_FALSE(alpaca_http_connection_is_open(f->connection));
	ASSERT_EQ_INT(1, (int)alpaca_http_connection_connects(f->connection));
	ASSERT_EQ_INT(1, server_request_count(&f->server));
}

HTTP_TEST(timeout_in_the_middle_of_the_body, script_stall, "HTTP/1.1 200 OK\r\nContent-Length: 100\r\n\r\n0123456789", DEFAULT_MAX_BODY) {
	alpaca_http_options options = bounded_options();
	options.timeouts.inter_byte = 200;
	double start = now_seconds();
	alpaca_http_result result = alpaca_http_get(f->connection, "/api/v1/camera/0/imagearray", NULL, &options, &f->response);
	double elapsed = now_seconds() - start;
	ASSERT_EQ_INT(ALPACA_HTTP_TRANSFER_TIMEOUT, result);
	ASSERT_TRUE(elapsed >= 0.19 && elapsed < 1.5);
	ASSERT_EQ_INT(200, f->response.status);
	ASSERT_STREQ("0123456789", f->response.body.data);
	ASSERT_FALSE(alpaca_http_connection_is_open(f->connection));
	ASSERT_EQ_INT(1, server_request_count(&f->server));
}

HTTP_TEST(timeout_in_the_middle_of_the_header, script_stall, "HTTP/1.1 200 OK\r\nContent-Le", DEFAULT_MAX_BODY) {
	alpaca_http_options options = bounded_options();
	options.timeouts.inter_byte = 200;
	double start = now_seconds();
	alpaca_http_result result = alpaca_http_get(f->connection, "/slow", NULL, &options, &f->response);
	double elapsed = now_seconds() - start;
	ASSERT_EQ_INT(ALPACA_HTTP_TRANSFER_TIMEOUT, result);
	ASSERT_TRUE(elapsed >= 0.19 && elapsed < 1.5);
	ASSERT_EQ_INT(0, f->response.status);
}

// The data keeps coming, so neither the first byte nor the inter byte timeout ever fires: only the total timeout ends it.
HTTP_TEST(total_timeout_bounds_a_response_that_never_ends, script_drip, NULL, DEFAULT_MAX_BODY) {
	alpaca_http_options options = bounded_options();
	options.timeouts.total = 400;
	double start = now_seconds();
	alpaca_http_result result = alpaca_http_get(f->connection, "/drip", NULL, &options, &f->response);
	double elapsed = now_seconds() - start;
	ASSERT_EQ_INT(ALPACA_HTTP_TRANSFER_TIMEOUT, result);
	ASSERT_TRUE(elapsed >= 0.39 && elapsed < 1.5);
	ASSERT_EQ_INT(200, f->response.status);
	ASSERT_TRUE(f->response.body.size >= 2 && f->response.body.size <= 20);
	ASSERT_EQ_INT(0, f->response.body.data[f->response.body.size]);
}

HTTP_TEST(reset_before_the_response, script_reset, "", DEFAULT_MAX_BODY) {
	alpaca_http_options options = bounded_options();
	ASSERT_EQ_INT(ALPACA_HTTP_RESET, alpaca_http_get(f->connection, "/reset", NULL, &options, &f->response));
	ASSERT_EQ_INT(0, f->response.status);
	ASSERT_FALSE(alpaca_http_connection_is_open(f->connection));
	ASSERT_EQ_INT(1, (int)alpaca_http_connection_connects(f->connection));
	ASSERT_TRUE(server_wait_finished(&f->server, 1));
	ASSERT_EQ_INT(1, server_connections(&f->server));
}

HTTP_TEST(reset_in_the_middle_of_the_body, script_reset, "HTTP/1.1 200 OK\r\nContent-Length: 100\r\n\r\n0123456789", DEFAULT_MAX_BODY) {
	alpaca_http_options options = bounded_options();
	ASSERT_EQ_INT(ALPACA_HTTP_RESET, alpaca_http_get(f->connection, "/reset", NULL, &options, &f->response));
	ASSERT_FALSE(alpaca_http_connection_is_open(f->connection));
	ASSERT_EQ_INT(1, (int)alpaca_http_connection_connects(f->connection));
	ASSERT_EQ_INT(0, f->response.body.data[f->response.body.size]);
}

static void connection_refused(void) {
	int port = 0;
	int listener = open_listener(AF_INET, 1, &port);
	ASSERT_TRUE(listener >= 0);
	close(listener);
	alpaca_http_connection *connection = alpaca_http_connection_create("127.0.0.1", port);
	alpaca_http_response response;
	alpaca_http_response_init(&response, DEFAULT_MAX_BODY);
	alpaca_http_options options = bounded_options();
	double start = now_seconds();
	alpaca_http_result result = alpaca_http_get(connection, "/management/apiversions", NULL, &options, &response);
	double elapsed = now_seconds() - start;
	int status = response.status;
	bool terminated = response.body.data != NULL && response.body.data[0] == 0;
	unsigned connects = alpaca_http_connection_connects(connection);
	alpaca_http_response_free(&response);
	alpaca_http_connection_free(connection);
	ASSERT_EQ_INT(ALPACA_HTTP_CONNECT_FAILED, result);
	ASSERT_TRUE(elapsed < 1.5);
	ASSERT_EQ_INT(0, status);
	ASSERT_TRUE(terminated);
	ASSERT_EQ_INT(0, (int)connects);
}

static alpaca_http_result timed_connect(const char *host, int port, int timeout, double *elapsed) {
	alpaca_http_connection *connection = alpaca_http_connection_create(host, port);
	alpaca_http_response response;
	alpaca_http_response_init(&response, DEFAULT_MAX_BODY);
	alpaca_http_options options = bounded_options();
	options.timeouts.connect = timeout;
	double start = now_seconds();
	alpaca_http_result result = alpaca_http_get(connection, "/management/apiversions", NULL, &options, &response);
	*elapsed = now_seconds() - start;
	alpaca_http_response_free(&response);
	alpaca_http_connection_free(connection);
	return result;
}

// Fill the accept queue of a loopback listener until a connection attempt hangs. Returns the listener (-1 on failure); fillers and
// *hangs tell what was opened and whether an attempt hangs, i.e. whether this system drops SYNs to a full accept queue.
static int fill_accept_queue(int *fillers, int max_fillers, int *filler_count, int *port, bool *hangs) {
	int listener = open_listener(AF_INET, 0, port);
	*filler_count = 0;
	*hangs = false;
	while (listener >= 0 && !*hangs && *filler_count < max_fillers) {
		struct sockaddr_in address = { 0 };
		address.sin_family = AF_INET;
		address.sin_port = htons((uint16_t)*port);
		address.sin_addr.s_addr = htonl(INADDR_LOOPBACK);
		int fd = socket(AF_INET, SOCK_STREAM, 0);
		if (fd < 0) {
			break;
		}
		fcntl(fd, F_SETFL, fcntl(fd, F_GETFL, 0) | O_NONBLOCK);
		connect(fd, (struct sockaddr *)&address, sizeof(address));
		struct pollfd descriptor = { fd, POLLOUT, 0 };
		*hangs = poll(&descriptor, 1, 200) == 0;
		fillers[(*filler_count)++] = fd;
	}
	return listener;
}

static void close_accept_queue(int listener, int *fillers, int filler_count) {
	for (int i = 0; i < filler_count; i++) {
		close(fillers[i]);
	}
	if (listener >= 0) {
		close(listener);
	}
}

// The case needs a peer that never completes the handshake. On Linux a listener whose accept queue is full drops further SYNs, which
// is hermetic. macOS completes or resets such connections, so there the case needs ALPACA_HTTP_TEST_BLACKHOLE (an address that drops
// SYNs); without it the case is not registered and is reported as skipped, it never counts as passed.
static bool connect_timeout_runnable(void) {
	const char *blackhole = getenv("ALPACA_HTTP_TEST_BLACKHOLE");
	int fillers[32];
	int filler_count = 0;
	int port = 0;
	bool hangs = false;
	if (blackhole != NULL && *blackhole) {
		return true;
	}
	int listener = fill_accept_queue(fillers, ARRAY_SIZE(fillers), &filler_count, &port, &hangs);
	close_accept_queue(listener, fillers, filler_count);
	return hangs;
}

static void connect_timeout(void) {
	const char *blackhole = getenv("ALPACA_HTTP_TEST_BLACKHOLE");
	int fillers[32];
	int filler_count = 0;
	int port = 0;
	bool hangs = false;
	int listener = fill_accept_queue(fillers, ARRAY_SIZE(fillers), &filler_count, &port, &hangs);
	ASSERT_TRUE(listener >= 0);
	double elapsed = 0;
	alpaca_http_result result = ALPACA_HTTP_CONNECT_TIMEOUT;
	if (hangs) {
		result = timed_connect("127.0.0.1", port, 300, &elapsed);
		printf("    connect timeout on a full loopback accept queue: %.3f s\n", elapsed);
	} else if (blackhole != NULL && *blackhole) {
		result = timed_connect(blackhole, 32323, 300, &elapsed);
		printf("    connect timeout against %s: %.3f s\n", blackhole, elapsed);
	} else {
		// connect_timeout_runnable() said otherwise when the case was registered
		printf("    connect_timeout can not run: no full accept queue that drops connections and no ALPACA_HTTP_TEST_BLACKHOLE\n");
		result = ALPACA_HTTP_OK;
	}
	close_accept_queue(listener, fillers, filler_count);
	ASSERT_EQ_INT(ALPACA_HTTP_CONNECT_TIMEOUT, result);
	ASSERT_TRUE(elapsed >= 0.29 && elapsed < 1.5);
}

// ---- status codes ----

static const char *replies_status[] = {
	"HTTP/1.1 100 Continue\r\n\r\nHTTP/1.1 102 Processing\r\nContent-Type: text/ignored\r\nContent-Length: 99\r\n\r\nHTTP/1.1 200 OK\r\nContent-Type: application/json\r\nConnection: close\r\nContent-Length: 2\r\n\r\nok",
	"HTTP/1.1 400 Bad Request\r\nContent-Type: text/plain; charset=utf-8\r\nContent-Length: 34\r\n\r\nParameter 'Position' is not valid.",
	"HTTP/1.1 500 Internal Server Error\r\nContent-Type: text/plain\r\nTransfer-Encoding: chunked\r\n\r\n10\r\nfatal device err\r\n2\r\nor\r\n0\r\n\r\n",
	"HTTP/1.1 302 Found\r\nLocation: http://127.0.0.1:1/elsewhere\r\nContent-Length: 5\r\n\r\nmoved",
	"HTTP/1.1 404\r\nContent-Length: 0\r\n\r\n",
	"HTTP/1.1 401 Unauthorized\r\nWWW-Authenticate: Basic realm=\"alpaca\"\r\nContent-Length: 0\r\n\r\n"
};

// The script closes every connection after one response. The response before the second PUT says so, because a PUT over a socket
// that the server is just closing is, correctly, not repeated; the GET requests after responses without that header are.
HTTP_TEST(status_codes_are_reported, script_raw, replies_status, DEFAULT_MAX_BODY) {
	alpaca_http_options options = bounded_options();
	ASSERT_EQ_INT(ALPACA_HTTP_OK, alpaca_http_put(f->connection, "/interim", NULL, "A=1", &options, &f->response));
	ASSERT_EQ_INT(200, f->response.status);
	ASSERT_STREQ("ok", f->response.body.data);
	ASSERT_STREQ("application/json", f->response.content_type);
	ASSERT_EQ_INT(ALPACA_HTTP_OK, alpaca_http_put(f->connection, "/bad", NULL, "Position=x", &options, &f->response));
	ASSERT_EQ_INT(400, f->response.status);
	ASSERT_STREQ("Parameter 'Position' is not valid.", f->response.body.data);
	ASSERT_STREQ("text/plain; charset=utf-8", f->response.content_type);
	ASSERT_TRUE(alpaca_http_response_is(&f->response, "text/plain"));
	ASSERT_FALSE(alpaca_http_response_is(&f->response, "text"));
	ASSERT_EQ_INT(ALPACA_HTTP_OK, alpaca_http_get(f->connection, "/fatal", NULL, &options, &f->response));
	ASSERT_EQ_INT(500, f->response.status);
	ASSERT_STREQ("fatal device error", f->response.body.data);
	ASSERT_EQ_INT(ALPACA_HTTP_OK, alpaca_http_get(f->connection, "/redirect", NULL, &options, &f->response));
	ASSERT_EQ_INT(302, f->response.status);
	ASSERT_STREQ("http://127.0.0.1:1/elsewhere", f->response.location);
	ASSERT_STREQ("moved", f->response.body.data);
	ASSERT_EQ_INT(4, server_request_count(&f->server));
	ASSERT_EQ_INT(ALPACA_HTTP_OK, alpaca_http_get(f->connection, "/no-reason", NULL, &options, &f->response));
	ASSERT_EQ_INT(404, f->response.status);
	ASSERT_STREQ("", f->response.location);
	ASSERT_STREQ("", f->response.content_type);
	ASSERT_EQ_INT(ALPACA_HTTP_OK, alpaca_http_get(f->connection, "/auth", NULL, &options, &f->response));
	ASSERT_EQ_INT(401, f->response.status);
	ASSERT_EQ_INT(6, server_request_count(&f->server));
}

// 204 and 304 never have a body, whatever their headers say; the connection must stay in step for the next request.
static void script_no_body(http_server *server, int fd, int index) {
	recorded_request request;
	const char *replies[] = { "HTTP/1.1 204 No Content\r\n\r\n", "HTTP/1.1 304 Not Modified\r\nContent-Length: 1234\r\nContent-Type: application/json\r\n\r\n", "HTTP/1.1 200 OK\r\nContent-Length: 4\r\n\r\nnext" };
	for (int i = 0; i < 3 && server_read_request(server, fd, index, &request); i++) {
		server_send_text(fd, replies[i]);
	}
	server_wait_for_close(fd);
}

HTTP_TEST(status_204_and_304_have_no_body, script_no_body, NULL, DEFAULT_MAX_BODY) {
	alpaca_http_options options = bounded_options();
	options.timeouts.first_byte = 1000;
	ASSERT_EQ_INT(ALPACA_HTTP_OK, alpaca_http_put(f->connection, "/no-content", NULL, "A=1", &options, &f->response));
	ASSERT_EQ_INT(204, f->response.status);
	ASSERT_EQ_INT(0, (int)f->response.body.size);
	ASSERT_STREQ("", f->response.body.data);
	ASSERT_EQ_INT(ALPACA_HTTP_OK, alpaca_http_get(f->connection, "/not-modified", NULL, &options, &f->response));
	ASSERT_EQ_INT(304, f->response.status);
	ASSERT_EQ_INT(0, (int)f->response.body.size);
	ASSERT_EQ_INT(ALPACA_HTTP_OK, alpaca_http_get(f->connection, "/next", NULL, &options, &f->response));
	ASSERT_EQ_INT(200, f->response.status);
	ASSERT_STREQ("next", f->response.body.data);
	ASSERT_EQ_INT(1, (int)alpaca_http_connection_connects(f->connection));
}

// ---- malformed and oversized responses ----

static const char *replies_malformed[] = {
	"HTP/1.1 200 OK\r\nContent-Length: 2\r\n\r\nok",
	"HTTP/1.1 20 OK\r\nContent-Length: 2\r\n\r\nok",
	"HTTP/1.1 2000 OK\r\nContent-Length: 2\r\n\r\nok",
	"HTTP/2 200\r\nContent-Length: 2\r\n\r\nok",
	"HTTP/1.1 099 Low\r\nContent-Length: 2\r\n\r\nok",
	"\r\nHTTP/1.1 200 OK\r\nContent-Length: 2\r\n\r\nok",
	"<html><body>this is not HTTP</body></html>\r\n",
	"HTTP/1.1 200 OK\r\nthis header has no colon\r\nContent-Length: 2\r\n\r\nok",
	"HTTP/1.1 200 OK\r\nContent-Length: two\r\n\r\nok",
	"HTTP/1.1 200 OK\r\nContent-Length: 2\r\nContent-Length: 3\r\n\r\nok",
	"HTTP/1.1 200 OK\r\nContent-Length: -2\r\n\r\nok",
	"HTTP/1.1 200 OK\r\nTransfer-Encoding: chunked\r\n\r\nxyz\r\nhello\r\n0\r\n\r\n",
	"HTTP/1.1 200 OK\r\nTransfer-Encoding: chunked\r\n\r\n5\r\nhelloXX\r\n0\r\n\r\n",
	"HTTP/1.1 100 Continue\r\n\r\nHTTP/1.1 100 Continue\r\n\r\nHTTP/1.1 100 Continue\r\n\r\nHTTP/1.1 100 Continue\r\n\r\nHTTP/1.1 100 Continue\r\n\r\nHTTP/1.1 100 Continue\r\n\r\nHTTP/1.1 100 Continue\r\n\r\nHTTP/1.1 100 Continue\r\n\r\nHTTP/1.1 100 Continue\r\n\r\nHTTP/1.1 100 Continue\r\n\r\nHTTP/1.1 200 OK\r\nContent-Length: 2\r\n\r\nok"
};

HTTP_TEST(malformed_responses_are_reported, script_raw, replies_malformed, DEFAULT_MAX_BODY) {
	alpaca_http_options options = bounded_options();
	for (int i = 0; i < ARRAY_SIZE(replies_malformed); i++) {
		alpaca_http_result result = alpaca_http_get(f->connection, "/malformed", NULL, &options, &f->response);
		if (result != ALPACA_HTTP_MALFORMED) {
			fprintf(stderr, "malformed reply %d: %s\n", i, alpaca_http_result_text(result));
		}
		ASSERT_EQ_INT(ALPACA_HTTP_MALFORMED, result);
		ASSERT_FALSE(alpaca_http_connection_is_open(f->connection));
	}
	ASSERT_EQ_INT(ARRAY_SIZE(replies_malformed), server_request_count(&f->server));
	ASSERT_EQ_INT(ARRAY_SIZE(replies_malformed), (int)alpaca_http_connection_connects(f->connection));
}

// A header block that never ends: 64 KB of header lines, far above ALPACA_HTTP_MAX_HEADER_SIZE.
static void script_oversized_header(http_server *server, int fd, int index) {
	recorded_request request;
	if (server_read_request(server, fd, index, &request)) {
		bool ok = server_send_text(fd, "HTTP/1.1 200 OK\r\n");
		for (int i = 0; ok && i < 1024; i++) {
			ok = server_send_text(fd, "X-Padding: 0123456789012345678901234567890123456789012345678\r\n");
		}
		if (ok && server_send_text(fd, "Content-Length: 2\r\n\r\nok")) {
			server_wait_for_close(fd);
		}
	}
}

HTTP_TEST(oversized_header_block_is_refused, script_oversized_header, NULL, DEFAULT_MAX_BODY) {
	alpaca_http_options options = bounded_options();
	ASSERT_EQ_INT(ALPACA_HTTP_TOO_LARGE, alpaca_http_get(f->connection, "/headers", NULL, &options, &f->response));
	ASSERT_EQ_INT(0, f->response.status);
	ASSERT_FALSE(alpaca_http_connection_is_open(f->connection));
}

// One header line without an end, sent until the client gives up.
static void script_endless_line(http_server *server, int fd, int index) {
	recorded_request request;
	if (server_read_request(server, fd, index, &request)) {
		bool ok = server_send_text(fd, "HTTP/1.1 200 OK\r\nX-Endless: ");
		for (int i = 0; ok && i < 4096; i++) {
			ok = server_send_text(fd, "0123456789012345678901234567890123456789012345678901234567890123");
		}
	}
}

HTTP_TEST(endless_header_line_is_refused, script_endless_line, NULL, DEFAULT_MAX_BODY) {
	alpaca_http_options options = bounded_options();
	ASSERT_EQ_INT(ALPACA_HTTP_TOO_LARGE, alpaca_http_get(f->connection, "/line", NULL, &options, &f->response));
	ASSERT_FALSE(alpaca_http_connection_is_open(f->connection));
}

static const char *replies_too_large[] = {
	"HTTP/1.1 200 OK\r\nContent-Length: 17\r\n\r\n01234567890123456",
	"HTTP/1.1 200 OK\r\nContent-Length: 16\r\n\r\n0123456789012345",
	"HTTP/1.1 200 OK\r\nContent-Length: 99999999999999999999999999999999\r\n\r\n0123456789",
	"HTTP/1.1 200 OK\r\nTransfer-Encoding: chunked\r\n\r\nA\r\n0123456789\r\n7\r\n0123456\r\n0\r\n\r\n",
	"HTTP/1.1 200 OK\r\nTransfer-Encoding: chunked\r\n\r\nA\r\n0123456789\r\n6\r\n012345\r\n0\r\n\r\n",
	"HTTP/1.1 200 OK\r\nTransfer-Encoding: chunked\r\n\r\nFFFFFFFFFFFFFFFFFFFFFFFFF\r\n0123456789",
	"HTTP/1.1 200 OK\r\nConnection: close\r\n\r\n01234567890123456",
	"HTTP/1.1 200 OK\r\nConnection: close\r\n\r\n0123456789012345"
};

// The response buffer of this case accepts 16 bytes: a body of 16 bytes fits, one of 17 bytes is refused in every framing.
HTTP_TEST(body_larger_than_the_maximum_is_refused, script_raw, replies_too_large, 16) {
	alpaca_http_options options = bounded_options();
	ASSERT_EQ_INT(ALPACA_HTTP_TOO_LARGE, alpaca_http_get(f->connection, "/length-17", NULL, &options, &f->response));
	ASSERT_EQ_INT(200, f->response.status);
	ASSERT_EQ_INT(0, (int)f->response.body.size);
	ASSERT_FALSE(alpaca_http_connection_is_open(f->connection));
	ASSERT_EQ_INT(ALPACA_HTTP_OK, alpaca_http_get(f->connection, "/length-16", NULL, &options, &f->response));
	ASSERT_STREQ("0123456789012345", f->response.body.data);
	ASSERT_EQ_INT(ALPACA_HTTP_TOO_LARGE, alpaca_http_get(f->connection, "/length-huge", NULL, &options, &f->response));
	ASSERT_EQ_INT(ALPACA_HTTP_TOO_LARGE, alpaca_http_get(f->connection, "/chunked-17", NULL, &options, &f->response));
	ASSERT_STREQ("0123456789", f->response.body.data);
	ASSERT_EQ_INT(ALPACA_HTTP_OK, alpaca_http_get(f->connection, "/chunked-16", NULL, &options, &f->response));
	ASSERT_STREQ("0123456789012345", f->response.body.data);
	ASSERT_EQ_INT(ALPACA_HTTP_TOO_LARGE, alpaca_http_get(f->connection, "/chunk-huge", NULL, &options, &f->response));
	ASSERT_EQ_INT(ALPACA_HTTP_TOO_LARGE, alpaca_http_get(f->connection, "/eof-17", NULL, &options, &f->response));
	ASSERT_TRUE(f->response.body.size <= 16);
	ASSERT_EQ_INT(0, f->response.body.data[f->response.body.size]);
	ASSERT_EQ_INT(ALPACA_HTTP_OK, alpaca_http_get(f->connection, "/eof-16", NULL, &options, &f->response));
	ASSERT_STREQ("0123456789012345", f->response.body.data);
	ASSERT_TRUE(f->response.body.capacity <= 17);
}

// ---- header parsing ----

static const char *replies_header_case[] = {
	"HTTP/1.1 200 OK\r\ncontent-length: 5\r\nCONTENT-TYPE: Application/ImageBytes\r\ncOnNeCtIoN: Close\r\nCONTENT-encoding:gzip\r\n\r\nhello",
	"HTTP/1.1 200 OK\r\nTRANSFER-ENCODING: Chunked\r\ncontent-type:\t application/json \t\r\n\r\n5\r\nhello\r\n0\r\n\r\n",
	"HTTP/1.1 200 OK\nContent-Length: 5\nContent-Type: text/plain\n\nhello",
	"HTTP/1.1 200 OK\r\nX-Folded: first\r\n second part\r\n\tthird part\r\nContent-Length : 5\r\nConnection: Upgrade, CLOSE\r\n\r\nhello",
	"HTTP/1.0 200 OK\r\nConnection: Keep-Alive\r\nContent-Length: 5\r\n\r\nhello",
	"HTTP/1.1 200 OK\r\nTransfer-Encoding: gzip, chunked\r\nContent-Length: 999\r\n\r\n5\r\nhello\r\n0\r\n\r\n",
	"HTTP/1.1 200 OK\r\nTransfer-Encoding: GZIP\r\nContent-Type: application/json\r\n\r\nhello",
	"HTTP/1.1 200 OK\r\nTransfer-Encoding: chunked\r\nTransfer-Encoding: deflate\r\n\r\n5\r\nhello\r\n0\r\n\r\n",
	"HTTP/1.1 200 OK\r\nTransfer-Encoding: , chunked ;ext=1\r\n\r\n5\r\nhello\r\n0\r\n\r\n"
};

HTTP_TEST(headers_are_case_insensitive, script_raw, replies_header_case, DEFAULT_MAX_BODY) {
	alpaca_http_options options = bounded_options();
	ASSERT_EQ_INT(ALPACA_HTTP_OK, alpaca_http_get(f->connection, "/upper", NULL, &options, &f->response));
	ASSERT_STREQ("hello", f->response.body.data);
	ASSERT_STREQ("Application/ImageBytes", f->response.content_type);
	ASSERT_TRUE(alpaca_http_response_is(&f->response, "application/imagebytes"));
	ASSERT_STREQ("gzip", f->response.content_encoding);
	ASSERT_FALSE(alpaca_http_connection_is_open(f->connection));
	ASSERT_EQ_INT(ALPACA_HTTP_OK, alpaca_http_get(f->connection, "/chunked", NULL, &options, &f->response));
	ASSERT_STREQ("hello", f->response.body.data);
	ASSERT_STREQ("application/json", f->response.content_type);
	ASSERT_STREQ("", f->response.content_encoding);
	ASSERT_EQ_INT(ALPACA_HTTP_OK, alpaca_http_get(f->connection, "/bare-lf", NULL, &options, &f->response));
	ASSERT_STREQ("hello", f->response.body.data);
	ASSERT_STREQ("text/plain", f->response.content_type);
	ASSERT_EQ_INT(ALPACA_HTTP_OK, alpaca_http_get(f->connection, "/folded", NULL, &options, &f->response));
	ASSERT_STREQ("hello", f->response.body.data);
	ASSERT_FALSE(alpaca_http_connection_is_open(f->connection));
	ASSERT_EQ_INT(ALPACA_HTTP_OK, alpaca_http_get(f->connection, "/http10-keep-alive", NULL, &options, &f->response));
	ASSERT_STREQ("hello", f->response.body.data);
	ASSERT_EQ_INT(5, (int)alpaca_http_connection_connects(f->connection));
	alpaca_http_connection_close(f->connection);
	// a transfer coding other than chunked is never asked for and never decoded: the coded body is not handed over as if it were plain
	ASSERT_EQ_INT(ALPACA_HTTP_MALFORMED, alpaca_http_get(f->connection, "/gzip-chunked", NULL, &options, &f->response));
	ASSERT_FALSE(alpaca_http_connection_is_open(f->connection));
	ASSERT_EQ_INT(ALPACA_HTTP_MALFORMED, alpaca_http_get(f->connection, "/gzip-to-eof", NULL, &options, &f->response));
	ASSERT_FALSE(alpaca_http_connection_is_open(f->connection));
	ASSERT_EQ_INT(ALPACA_HTTP_MALFORMED, alpaca_http_get(f->connection, "/two-codings", NULL, &options, &f->response));
	ASSERT_FALSE(alpaca_http_connection_is_open(f->connection));
	// an empty element of the list and a parameter of chunked are no other coding
	ASSERT_EQ_INT(ALPACA_HTTP_OK, alpaca_http_get(f->connection, "/chunked-parameter", NULL, &options, &f->response));
	ASSERT_STREQ("hello", f->response.body.data);
}

static void ipv6_literal_host(void) {
	static fixture f;
	char expected[512];
	if (!fixture_start(&f, AF_INET6, script_keep_alive, NULL, DEFAULT_MAX_BODY)) {
		printf("    SKIPPED ipv6_literal_host: no IPv6 loopback on this system\n");
		return;
	}
	alpaca_http_options options = bounded_options();
	alpaca_http_result result = alpaca_http_get(f.connection, "/management/apiversions", NULL, &options, &f.response);
	int status = f.response.status;
	recorded_request request = *server_request(&f.server, 0);
	snprintf(expected, sizeof(expected), "GET /management/apiversions HTTP/1.1\r\nHost: [::1]:%d\r\nUser-Agent: indigo_system_alpaca\r\nConnection: keep-alive\r\n\r\n", f.server.port);
	fixture_stop(&f);
	ASSERT_EQ_INT(ALPACA_HTTP_OK, result);
	ASSERT_EQ_INT(200, status);
	ASSERT_STREQ(expected, request.head);
}

// ---- large bodies ----

static uint64_t checksum(const char *data, size_t size) {
	uint64_t hash = 0xCBF29CE484222325ULL;
	for (size_t i = 0; i < size; i++) {
		hash = (hash ^ (unsigned char)data[i]) * 0x100000001B3ULL;
	}
	return hash;
}

static void large_binary_body(large_mode mode, const char *label) {
	static fixture f;
	large_body large = { NULL, LARGE_BODY_SIZE, mode };
	char *data = malloc(LARGE_BODY_SIZE);
	ASSERT_TRUE(data != NULL);
	uint64_t state = 0x9E3779B97F4A7C15ULL;
	for (size_t i = 0; i < LARGE_BODY_SIZE; i += 8) {
		state ^= state << 13;
		state ^= state >> 7;
		state ^= state << 17;
		memcpy(data + i, &state, 8);
	}
	large.data = data;
	uint64_t expected = checksum(data, LARGE_BODY_SIZE);
	if (!fixture_start(&f, AF_INET, script_large, &large, 2 * (size_t)LARGE_BODY_SIZE)) {
		free(data);
		ASSERT_TRUE(false);
	}
	alpaca_http_options options = bounded_options();
	options.headers = "Accept: application/imagebytes, application/json\r\n";
	options.timeouts.total = 60000;
	double start = now_seconds();
	alpaca_http_result result = alpaca_http_get(f.connection, "/api/v1/camera/0/imagearray", NULL, &options, &f.response);
	double elapsed = now_seconds() - start;
	size_t size = f.response.body.size;
	size_t capacity = f.response.body.capacity;
	bool terminated = f.response.body.data != NULL && f.response.body.data[size] == 0;
	bool imagebytes = alpaca_http_response_is(&f.response, "application/imagebytes");
	uint64_t actual = result == ALPACA_HTTP_OK ? checksum(f.response.body.data, size) : 0;
	fixture_stop(&f);
	free(data);
	printf("    %d MB %s body: %.3f s, %.0f MB/s, buffer capacity %.1f MB\n", LARGE_BODY_SIZE / (1024 * 1024), label, elapsed, LARGE_BODY_SIZE / (1024.0 * 1024.0) / elapsed, capacity / (1024.0 * 1024.0));
	ASSERT_EQ_INT(ALPACA_HTTP_OK, result);
	ASSERT_TRUE(size == LARGE_BODY_SIZE);
	ASSERT_TRUE(terminated);
	ASSERT_TRUE(imagebytes);
	ASSERT_TRUE(actual == expected);
	ASSERT_TRUE(capacity <= 2 * (size_t)LARGE_BODY_SIZE + 1);
	if (mode == LARGE_CONTENT_LENGTH) {
		ASSERT_TRUE(capacity == (size_t)LARGE_BODY_SIZE + 1);
	}
}

static void large_binary_body_with_content_length(void) {
	large_binary_body(LARGE_CONTENT_LENGTH, "Content-Length");
}

static void large_binary_body_chunked(void) {
	large_binary_body(LARGE_CHUNKED, "chunked");
}

static void large_binary_body_to_end_of_file(void) {
	large_binary_body(LARGE_TO_EOF, "end-of-file delimited");
}

// The response buffer is reused: a small response after a large one keeps the allocation and is terminated correctly.
static const char *replies_reuse[] = {
	"HTTP/1.1 200 OK\r\nConnection: close\r\nContent-Length: 40\r\n\r\n0123456789012345678901234567890123456789",
	"HTTP/1.1 200 OK\r\nConnection: close\r\nContent-Length: 2\r\n\r\nok",
	"HTTP/1.1 200 OK\r\nConnection: close\r\nContent-Length: 0\r\n\r\n"
};

HTTP_TEST(response_buffer_is_reused, script_raw, replies_reuse, DEFAULT_MAX_BODY) {
	alpaca_http_options options = bounded_options();
	ASSERT_EQ_INT(ALPACA_HTTP_OK, alpaca_http_get(f->connection, "/long", NULL, &options, &f->response));
	ASSERT_EQ_INT(40, (int)f->response.body.size);
	char *data = f->response.body.data;
	size_t capacity = f->response.body.capacity;
	ASSERT_EQ_INT(ALPACA_HTTP_OK, alpaca_http_get(f->connection, "/short", NULL, &options, &f->response));
	ASSERT_STREQ("ok", f->response.body.data);
	ASSERT_EQ_INT(2, (int)f->response.body.size);
	ASSERT_TRUE(f->response.body.data == data && f->response.body.capacity == capacity);
	ASSERT_EQ_INT(ALPACA_HTTP_OK, alpaca_http_get(f->connection, "/empty", NULL, &options, &f->response));
	ASSERT_STREQ("", f->response.body.data);
	ASSERT_EQ_INT(0, (int)f->response.body.size);
	ASSERT_TRUE(f->response.body.data == data && f->response.body.capacity == capacity);
}

// ---- concurrency ----

#define CLIENT_THREADS	4
#define CLIENT_REQUESTS	50

typedef struct {
	pthread_t thread;
	int port;
	int id;
	int failures;
	unsigned connects;
} client_thread;

static void *client_thread_main(void *data) {
	client_thread *client = (client_thread *)data;
	alpaca_http_connection *connection = alpaca_http_connection_create("127.0.0.1", client->port);
	alpaca_http_response response;
	alpaca_http_options options = bounded_options();
	alpaca_http_buffer query;
	char path[64];
	char expected[128];
	alpaca_http_response_init(&response, DEFAULT_MAX_BODY);
	alpaca_http_buffer_init(&query, 256);
	snprintf(path, sizeof(path), "/api/v1/telescope/%d/tracking", client->id);
	for (int i = 0; i < CLIENT_REQUESTS; i++) {
		alpaca_http_buffer_clear(&query);
		alpaca_http_form_add_int(&query, "ClientID", client->id);
		alpaca_http_form_add_int(&query, "ClientTransactionID", i + 1);
		snprintf(expected, sizeof(expected), "%s?ClientID=%d&ClientTransactionID=%d", path, client->id, i + 1);
		alpaca_http_result result = alpaca_http_get(connection, path, query.data, &options, &response);
		if (result != ALPACA_HTTP_OK || response.status != 200 || strcmp(response.body.data, expected) != 0) {
			client->failures++;
		}
	}
	client->connects = alpaca_http_connection_connects(connection);
	alpaca_http_buffer_free(&query);
	alpaca_http_response_free(&response);
	alpaca_http_connection_free(connection);
	return NULL;
}

// Several connection objects to the same server, each used by its own thread, never see each other's responses.
static void connections_are_independent_across_threads(void) {
	static http_server server;
	client_thread clients[CLIENT_THREADS] = { 0 };
	ASSERT_TRUE(server_start(&server, AF_INET, script_echo, NULL));
	int started = 0;
	for (int i = 0; i < CLIENT_THREADS; i++) {
		clients[i].port = server.port;
		clients[i].id = i;
		if (pthread_create(&clients[i].thread, NULL, client_thread_main, clients + i) != 0) {
			break;
		}
		started++;
	}
	for (int i = 0; i < started; i++) {
		pthread_join(clients[i].thread, NULL);
	}
	int connections = server_connections(&server);
	int requests = server_request_count(&server);
	server_stop(&server);
	ASSERT_EQ_INT(CLIENT_THREADS, started);
	for (int i = 0; i < CLIENT_THREADS; i++) {
		ASSERT_EQ_INT(0, clients[i].failures);
		ASSERT_EQ_INT(1, (int)clients[i].connects);
	}
	ASSERT_EQ_INT(CLIENT_THREADS, connections);
	ASSERT_EQ_INT(CLIENT_THREADS * CLIENT_REQUESTS, requests);
}

// ---- helpers without a server ----

static void percent_encoding(void) {
	alpaca_http_buffer buffer;
	alpaca_http_buffer_init(&buffer, 1024);
	ASSERT_TRUE(alpaca_http_buffer_append_encoded(&buffer, "AZaz09-._~"));
	ASSERT_STREQ("AZaz09-._~", buffer.data);
	alpaca_http_buffer_clear(&buffer);
	ASSERT_TRUE(alpaca_http_buffer_append_encoded(&buffer, "a b+c%d"));
	ASSERT_STREQ("a%20b%2Bc%25d", buffer.data);
	alpaca_http_buffer_clear(&buffer);
	ASSERT_TRUE(alpaca_http_buffer_append_encoded(&buffer, ":/?#[]@!$&'()*,;="));
	ASSERT_STREQ("%3A%2F%3F%23%5B%5D%40%21%24%26%27%28%29%2A%2C%3B%3D", buffer.data);
	alpaca_http_buffer_clear(&buffer);
	ASSERT_TRUE(alpaca_http_buffer_append_encoded(&buffer, "\"<>\\^`{|}\r\n\t\x7F"));
	ASSERT_STREQ("%22%3C%3E%5C%5E%60%7B%7C%7D%0D%0A%09%7F", buffer.data);
	alpaca_http_buffer_clear(&buffer);
	ASSERT_TRUE(alpaca_http_buffer_append_encoded(&buffer, "\xC5\xBDlt\xC3\xBD k\xC5\xAF\xC5\x88 \xE2\x98\x85 \xF0\x9F\x94\xAD"));
	ASSERT_STREQ("%C5%BDlt%C3%BD%20k%C5%AF%C5%88%20%E2%98%85%20%F0%9F%94%AD", buffer.data);
	ASSERT_EQ_INT((int)strlen(buffer.data), (int)buffer.size);
	alpaca_http_buffer_clear(&buffer);
	ASSERT_TRUE(alpaca_http_buffer_append_encoded(&buffer, ""));
	ASSERT_STREQ("", buffer.data);
	ASSERT_FALSE(alpaca_http_buffer_append_encoded(&buffer, NULL));
	alpaca_http_buffer_free(&buffer);
}

static void form_builder(void) {
	alpaca_http_buffer form;
	alpaca_http_buffer_init(&form, 1024);
	ASSERT_TRUE(form.data == NULL);
	ASSERT_TRUE(alpaca_http_form_add_int(&form, "Id", 3));
	ASSERT_STREQ("Id=3", form.data);
	ASSERT_TRUE(alpaca_http_form_add_bool(&form, "State", true));
	ASSERT_TRUE(alpaca_http_form_add_bool(&form, "Light", false));
	ASSERT_TRUE(alpaca_http_form_add_double(&form, "Duration", 1.5));
	ASSERT_TRUE(alpaca_http_form_add_string(&form, "Name", "Dew heater #2 & fan"));
	ASSERT_TRUE(alpaca_http_form_add_int(&form, "ClientID", 4294967295LL));
	ASSERT_TRUE(alpaca_http_form_add_int(&form, "Rate", -9223372036854775807LL - 1));
	ASSERT_TRUE(alpaca_http_form_add_string(&form, "Empty", ""));
	ASSERT_STREQ("Id=3&State=True&Light=False&Duration=1.5&Name=Dew%20heater%20%232%20%26%20fan&ClientID=4294967295&Rate=-9223372036854775808&Empty=", form.data);
	ASSERT_EQ_INT((int)strlen(form.data), (int)form.size);
	ASSERT_FALSE(alpaca_http_form_add_string(&form, "Name", NULL));
	ASSERT_FALSE(alpaca_http_form_add_string(&form, NULL, "x"));
	ASSERT_FALSE(alpaca_http_form_add_string(&form, "", "x"));
	ASSERT_FALSE(alpaca_http_form_add_double(&form, "Value", NAN));
	ASSERT_FALSE(alpaca_http_form_add_double(&form, "Value", INFINITY));
	ASSERT_STREQ("Id=3&State=True&Light=False&Duration=1.5&Name=Dew%20heater%20%232%20%26%20fan&ClientID=4294967295&Rate=-9223372036854775808&Empty=", form.data);
	alpaca_http_buffer_clear(&form);
	ASSERT_STREQ("", form.data);
	ASSERT_TRUE(alpaca_http_form_add_string(&form, "Sensor Name", "a=b"));
	ASSERT_STREQ("Sensor%20Name=a%3Db", form.data);
	alpaca_http_buffer_free(&form);
	ASSERT_TRUE(form.data == NULL && form.size == 0 && form.capacity == 0);
}

static void buffer_limits(void) {
	alpaca_http_buffer buffer;
	alpaca_http_buffer_init(&buffer, 10);
	ASSERT_TRUE(alpaca_http_buffer_append(&buffer, "01234", 5));
	ASSERT_FALSE(alpaca_http_buffer_append(&buffer, "567890", 6));
	ASSERT_STREQ("01234", buffer.data);
	ASSERT_TRUE(alpaca_http_buffer_append(&buffer, "56789", 5));
	ASSERT_STREQ("0123456789", buffer.data);
	ASSERT_EQ_INT(10, (int)buffer.size);
	ASSERT_EQ_INT(11, (int)buffer.capacity);
	ASSERT_FALSE(alpaca_http_buffer_append(&buffer, "x", 1));
	ASSERT_TRUE(alpaca_http_buffer_append(&buffer, "", 0));
	ASSERT_FALSE(alpaca_http_buffer_reserve(&buffer, 11));
	ASSERT_TRUE(alpaca_http_buffer_reserve(&buffer, 10));
	alpaca_http_buffer_clear(&buffer);
	ASSERT_TRUE(alpaca_http_form_add_string(&buffer, "A", "1"));
	ASSERT_FALSE(alpaca_http_form_add_string(&buffer, "Name", "too long"));
	ASSERT_STREQ("A=1", buffer.data);
	ASSERT_EQ_INT(3, (int)buffer.size);
	ASSERT_FALSE(alpaca_http_buffer_append_encoded(&buffer, "    "));
	ASSERT_STREQ("A=1", buffer.data);
	ASSERT_TRUE(alpaca_http_buffer_append_encoded(&buffer, "  x"));
	ASSERT_STREQ("A=1%20%20x", buffer.data);
	alpaca_http_buffer_free(&buffer);
	alpaca_http_buffer_init(&buffer, 0);
	ASSERT_FALSE(alpaca_http_buffer_append(&buffer, "x", 1));
	ASSERT_TRUE(alpaca_http_buffer_append(&buffer, "", 0));
	ASSERT_STREQ("", buffer.data);
	alpaca_http_buffer_free(&buffer);
	alpaca_http_buffer_init(&buffer, SIZE_MAX);
	ASSERT_TRUE(alpaca_http_buffer_append(&buffer, "x", 1));
	ASSERT_FALSE(alpaca_http_buffer_reserve(&buffer, SIZE_MAX));
	alpaca_http_buffer_free(&buffer);
	// growth is geometric: appending one byte at a time must not reallocate every time
	alpaca_http_buffer_init(&buffer, 1 << 20);
	int allocations = 0;
	size_t capacity = 0;
	for (int i = 0; i < (1 << 20); i++) {
		alpaca_http_buffer_append(&buffer, "x", 1);
		if (buffer.capacity != capacity) {
			capacity = buffer.capacity;
			allocations++;
		}
	}
	size_t size = buffer.size;
	alpaca_http_buffer_free(&buffer);
	ASSERT_EQ_INT(1 << 20, (int)size);
	ASSERT_TRUE(allocations <= 14);
}

static bool check_double(double value, const char *expected) {
	char text[ALPACA_HTTP_DOUBLE_SIZE];
	if (!alpaca_http_format_double(text, sizeof(text), value)) {
		fprintf(stderr, "%.17g was not formatted\n", value);
		return false;
	}
	if (expected != NULL && strcmp(text, expected) != 0) {
		fprintf(stderr, "%.17g: expected \"%s\", got \"%s\"\n", value, expected, text);
		return false;
	}
	if (strspn(text, "0123456789.-+e") != strlen(text)) {
		fprintf(stderr, "%.17g: unexpected characters in \"%s\"\n", value, text);
		return false;
	}
	// read it back without the locale: the text must be the exact value
	char *saved = setlocale(LC_NUMERIC, NULL);
	char locale[64];
	snprintf(locale, sizeof(locale), "%s", saved != NULL ? saved : "C");
	setlocale(LC_NUMERIC, "C");
	double parsed = strtod(text, NULL);
	setlocale(LC_NUMERIC, locale);
	if (parsed != value) {
		fprintf(stderr, "%.17g: \"%s\" reads back as %.17g\n", value, text, parsed);
		return false;
	}
	return true;
}

static bool check_doubles(void) {
	bool ok = check_double(1.5, "1.5") && check_double(0, "0") && check_double(-12.25, "-12.25") && check_double(0.1, "0.1") && check_double(100, "100") && check_double(1234567.875, "1234567.875");
	ok = ok && check_double(1e-5, "1e-05") && check_double(1e21, "1e+21") && check_double(15.041068640261905, "15.041068640261905") && check_double(0.1 + 0.2, "0.30000000000000004") && check_double(-0.0041780746, "-0.0041780746");
	ok = ok && check_double(1.0 / 3.0, NULL) && check_double(M_PI, NULL) && check_double(1.7976931348623157e308, NULL) && check_double(-1.7976931348623157e308, NULL) && check_double(2.2250738585072014e-308, NULL) && check_double(4.9406564584124654e-324, NULL) && check_double(123456789012345678.0, NULL);
	uint64_t state = 0x2545F4914F6CDD1DULL;
	for (int i = 0; ok && i < 20000; i++) {
		state ^= state << 13;
		state ^= state >> 7;
		state ^= state << 17;
		double value;
		memcpy(&value, &state, sizeof(value));
		if (isfinite(value)) {
			ok = check_double(value, NULL);
		}
	}
	return ok;
}

static void double_formatting(void) {
	char text[ALPACA_HTTP_DOUBLE_SIZE];
	ASSERT_TRUE(check_doubles());
	ASSERT_FALSE(alpaca_http_format_double(text, sizeof(text), NAN));
	ASSERT_FALSE(alpaca_http_format_double(text, sizeof(text), INFINITY));
	ASSERT_FALSE(alpaca_http_format_double(text, sizeof(text), -INFINITY));
	ASSERT_FALSE(alpaca_http_format_double(text, ALPACA_HTTP_DOUBLE_SIZE - 1, 1.5));
	ASSERT_FALSE(alpaca_http_format_double(NULL, ALPACA_HTTP_DOUBLE_SIZE, 1.5));
}

// The decimal separator of the process locale must never reach the wire: Alpaca numbers are invariant.
static void double_formatting_ignores_locale(void) {
	const char *locales[] = { "de_DE.UTF-8", "de_DE", "cs_CZ.UTF-8", "sk_SK.UTF-8", "fr_FR.UTF-8" };
	char printed[32];
	const char *selected = NULL;
	for (int i = 0; selected == NULL && i < ARRAY_SIZE(locales); i++) {
		if (setlocale(LC_NUMERIC, locales[i]) != NULL) {
			selected = locales[i];
		}
	}
	if (selected == NULL) {
		printf("    SKIPPED double_formatting_ignores_locale: no locale with a decimal comma is installed\n");
		return;
	}
	snprintf(printed, sizeof(printed), "%g", 1.5);
	alpaca_http_buffer form;
	alpaca_http_buffer_init(&form, 256);
	bool added = alpaca_http_form_add_double(&form, "Duration", 1.5) && alpaca_http_form_add_double(&form, "Rate", -0.0041780746) && alpaca_http_form_add_double(&form, "Value", 1234567.875);
	char text[128];
	snprintf(text, sizeof(text), "%s", form.data != NULL ? form.data : "");
	alpaca_http_buffer_free(&form);
	bool doubles = check_doubles();
	setlocale(LC_NUMERIC, "C");
	printf("    locale %s prints 1.5 as \"%s\"\n", selected, printed);
	ASSERT_STREQ("1,5", printed);
	ASSERT_TRUE(added);
	ASSERT_STREQ("Duration=1.5&Rate=-0.0041780746&Value=1234567.875", text);
	ASSERT_TRUE(doubles);
}

static void result_texts(void) {
	for (int result = ALPACA_HTTP_OK; result <= ALPACA_HTTP_TOO_LARGE; result++) {
		const char *text = alpaca_http_result_text((alpaca_http_result)result);
		ASSERT_TRUE(text != NULL && *text != 0 && strcmp(text, "unknown") != 0);
	}
	ASSERT_STREQ("OK", alpaca_http_result_text(ALPACA_HTTP_OK));
	ASSERT_STREQ("unknown", alpaca_http_result_text((alpaca_http_result)1000));
}

int main(void) {
	const indigo_test_case all_tests[] = {
		{ "get_with_content_length", get_with_content_length },
		{ "get_without_query_and_options", get_without_query_and_options },
		{ "put_with_form_body", put_with_form_body },
		{ "put_without_form_sends_empty_body", put_without_form_sends_empty_body },
		{ "invalid_requests_are_rejected_before_sending", invalid_requests_are_rejected_before_sending },
		{ "keep_alive_reuses_one_socket", keep_alive_reuses_one_socket },
		{ "stale_idle_socket_is_replaced_before_writing", stale_idle_socket_is_replaced_before_writing },
		{ "stale_idle_socket_is_reported_by_is_open", stale_idle_socket_is_reported_by_is_open },
		{ "stale_socket_get_is_retried_once", stale_socket_get_is_retried_once },
		{ "stale_socket_put_is_not_repeated", stale_socket_put_is_not_repeated },
		{ "stale_socket_replayable_put_is_retried_once", stale_socket_replayable_put_is_retried_once },
		{ "stale_socket_retry_happens_only_once", stale_socket_retry_happens_only_once },
		{ "no_retry_after_partial_response", no_retry_after_partial_response },
		{ "data_after_the_response_prevents_reuse", data_after_the_response_prevents_reuse },
		{ "chunked_body_byte_by_byte", chunked_body_byte_by_byte },
		{ "connection_close_body_to_end_of_file", connection_close_body_to_end_of_file },
		{ "truncated_bodies_are_reported", truncated_bodies_are_reported },
		{ "timeout_before_first_byte", timeout_before_first_byte },
		{ "timeout_in_the_middle_of_the_body", timeout_in_the_middle_of_the_body },
		{ "timeout_in_the_middle_of_the_header", timeout_in_the_middle_of_the_header },
		{ "total_timeout_bounds_a_response_that_never_ends", total_timeout_bounds_a_response_that_never_ends },
		{ "reset_before_the_response", reset_before_the_response },
		{ "reset_in_the_middle_of_the_body", reset_in_the_middle_of_the_body },
		{ "connection_refused", connection_refused },
		{ "connect_timeout", connect_timeout },
		{ "status_codes_are_reported", status_codes_are_reported },
		{ "status_204_and_304_have_no_body", status_204_and_304_have_no_body },
		{ "malformed_responses_are_reported", malformed_responses_are_reported },
		{ "oversized_header_block_is_refused", oversized_header_block_is_refused },
		{ "endless_header_line_is_refused", endless_header_line_is_refused },
		{ "body_larger_than_the_maximum_is_refused", body_larger_than_the_maximum_is_refused },
		{ "headers_are_case_insensitive", headers_are_case_insensitive },
		{ "ipv6_literal_host", ipv6_literal_host },
		{ "large_binary_body_with_content_length", large_binary_body_with_content_length },
		{ "large_binary_body_chunked", large_binary_body_chunked },
		{ "large_binary_body_to_end_of_file", large_binary_body_to_end_of_file },
		{ "response_buffer_is_reused", response_buffer_is_reused },
		{ "connections_are_independent_across_threads", connections_are_independent_across_threads },
		{ "percent_encoding", percent_encoding },
		{ "form_builder", form_builder },
		{ "buffer_limits", buffer_limits },
		{ "double_formatting", double_formatting },
		{ "double_formatting_ignores_locale", double_formatting_ignores_locale },
		{ "result_texts", result_texts }
	};
	indigo_test_case tests[ARRAY_SIZE(all_tests)];
	int count = 0;
	signal(SIGPIPE, SIG_IGN);
	const char *trace = getenv("ALPACA_HTTP_TEST_TRACE");
	if (trace != NULL && *trace == '1') {
		indigo_set_log_level(INDIGO_LOG_TRACE);
	}
	bool connect_timeout_runs = connect_timeout_runnable();
	for (int i = 0; i < ARRAY_SIZE(all_tests); i++) {
		if (all_tests[i].function == connect_timeout && !connect_timeout_runs) {
			printf("SKIPPED connect_timeout: this system does not drop connections to a full accept queue, set ALPACA_HTTP_TEST_BLACKHOLE to run it\n");
		} else {
			tests[count++] = all_tests[i];
		}
	}
	return indigo_run_tests("system_alpaca HTTP client tests", tests, count);
}
