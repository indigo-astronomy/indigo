// Copyright (c) 2026 INDIGO initiative
// All rights reserved.
//
// You may use this software under the terms of 'INDIGO Astronomy
// open-source license' (see LICENSE.md).
//
// THIS SOFTWARE IS PROVIDED BY THE AUTHORS 'AS IS' AND ANY EXPRESS
// OR IMPLIED WARRANTIES, INCLUDING, BUT NOT LIMITED TO, THE IMPLIED
// WARRANTIES OF MERCHANTABILITY AND FITNESS FOR A PARTICULAR PURPOSE
// ARE DISCLAIMED. IN NO EVENT SHALL THE AUTHOR BE LIABLE FOR ANY
// DIRECT, INDIRECT, INCIDENTAL, SPECIAL, EXEMPLARY, OR CONSEQUENTIAL
// DAMAGES (INCLUDING, BUT NOT LIMITED TO, PROCUREMENT OF SUBSTITUTE
// GOODS OR SERVICES; LOSS OF USE, DATA, OR PROFITS; OR BUSINESS
// INTERRUPTION) HOWEVER CAUSED AND ON ANY THEORY OF LIABILITY,
// WHETHER IN CONTRACT, STRICT LIABILITY, OR TORT (INCLUDING
// NEGLIGENCE OR OTHERWISE) ARISING IN ANY WAY OUT OF THE USE OF THIS
// SOFTWARE, EVEN IF ADVISED OF THE POSSIBILITY OF SUCH DAMAGE.

// Code is generated by AI

#include <stdarg.h>
#include <stdatomic.h>
#include <pthread.h>
#include <sys/stat.h>
#include <gps.h>
#include <indigo/indigo_gps_driver.h>
#include <indigo_drivers/gps_gpsd/indigo_gps_gpsd.h>

#include "serial_simulator_test_common.h"

#ifndef GPS_GPSD_SIMULATOR_EXECUTABLE
#define GPS_GPSD_SIMULATOR_EXECUTABLE "build/integration/gps_gpsd_simulator"
#endif

#ifndef GPSD_REFERENCE_TRACE_PATH
#define GPSD_REFERENCE_TRACE_PATH "fixtures/gps_gpsd/original_reference_trace.txt"
#endif

#define DEVICE_NAME "GPSD Client"
#define EXPECTED_API_GENERATION INDIGO_DRIVER_API_3
#define EXPECTED_LABEL "GPS Service Daemon (GPSD) Client"
#define PROPERTIES 48
#define WAIT_STEPS 500
#define TRACE_RECENT 32

#define CHECK(condition) do { \
	if (!(condition)) { \
		fprintf(stderr, "%s:%d: check failed: %s\n", __FILE__, __LINE__, #condition); \
		indigo_test_failures++; \
		goto cleanup; \
	} \
} while (0)

#define CHECK_EQ(expected, actual) do { \
	long long expected_value = (long long)(expected); \
	long long actual_value = (long long)(actual); \
	if (expected_value != actual_value) { \
		fprintf(stderr, "%s:%d: expected %lld, got %lld: %s\n", __FILE__, __LINE__, expected_value, actual_value, #actual); \
		indigo_test_failures++; \
		goto cleanup; \
	} \
} while (0)

#define CHECK_NEAR(expected, actual, tolerance) do { \
	double expected_value = (expected); \
	double actual_value = (actual); \
	if (!(fabs(expected_value - actual_value) <= (tolerance))) { \
		fprintf(stderr, "%s:%d: expected %g, got %g: %s\n", __FILE__, __LINE__, expected_value, actual_value, #actual); \
		indigo_test_failures++; \
		goto cleanup; \
	} \
} while (0)

#define CHECK_STR(expected, actual) do { \
	const char *expected_value = (expected); \
	const char *actual_value = (actual); \
	if (actual_value == NULL || strcmp(expected_value, actual_value)) { \
		fprintf(stderr, "%s:%d: expected \"%s\", got \"%s\": %s\n", __FILE__, __LINE__, expected_value, actual_value ? actual_value : "(null)", #actual); \
		indigo_test_failures++; \
		goto cleanup; \
	} \
} while (0)

#define EXPECT_EQ(expected, actual) do { \
	long long expected_value = (long long)(expected); \
	long long actual_value = (long long)(actual); \
	if (expected_value != actual_value) { \
		fprintf(stderr, "%s:%d: invariant expected %lld, got %lld: %s\n", __FILE__, __LINE__, expected_value, actual_value, #actual); \
		indigo_test_failures++; \
	} \
} while (0)

typedef struct {
	char name[INDIGO_NAME_SIZE];
	indigo_property *copy;
	bool defined;
	int revision, updates;
	char message[INDIGO_VALUE_SIZE];
} observed_property;

static observed_property observed[PROPERTIES];
static bool observed_connected;
static pthread_mutex_t observation_mutex = PTHREAD_MUTEX_INITIALIZER;
static pthread_mutex_t trace_mutex = PTHREAD_MUTEX_INITIALIZER;
static external_serial_simulator simulator;
static atomic_int open_calls, open_failures, close_calls, stream_enable_calls, stream_disable_calls, waiting_calls, read_calls, read_errors, messages;
static atomic_int active_io, reader_overlap, close_during_io, calls_after_close, late_updates, open_sessions;
static atomic_bool io_safety_invariants = true, trace_enabled;
static char last_host[INDIGO_VALUE_SIZE], last_port[INDIGO_VALUE_SIZE];
static char trace_text[65536];
static size_t trace_length;
static char trace_recent[TRACE_RECENT][512];
static int trace_recent_count;

static void trace_append(bool property, const char *line) {
	if (!atomic_load(&trace_enabled)) {
		return;
	}
	pthread_mutex_lock(&trace_mutex);
	if (property) {
		for (int i = 0; i < trace_recent_count; i++) {
			if (!strcmp(trace_recent[i], line)) {
				pthread_mutex_unlock(&trace_mutex);
				return;
			}
		}
		if (trace_recent_count < TRACE_RECENT) {
			snprintf(trace_recent[trace_recent_count++], sizeof(trace_recent[0]), "%s", line);
		}
	} else {
		trace_recent_count = 0;
	}
	int written = snprintf(trace_text + trace_length, sizeof(trace_text) - trace_length, "%s\n", line);
	if (written > 0 && trace_length + written < sizeof(trace_text)) {
		trace_length += written;
	}
	pthread_mutex_unlock(&trace_mutex);
}

static void trace_printf(bool property, const char *format, ...) {
	char line[512];
	va_list args;
	va_start(args, format);
	vsnprintf(line, sizeof(line), format, args);
	va_end(args);
	trace_append(property, line);
}

static void io_enter(void) {
	if (atomic_fetch_add(&active_io, 1) > 0) {
		atomic_fetch_add(&reader_overlap, 1);
	}
}

static void io_leave(void) {
	atomic_fetch_sub(&active_io, 1);
}

static const char *normalized_port(const char *port) {
	const char *simulator_port = strrchr(simulator.port, ':');
	return simulator_port && !strcmp(port, simulator_port + 1) ? "SIM" : port;
}

int gpsd_test_open(const char *host, const char *port, struct gps_data_t *data) {
	atomic_fetch_add(&open_calls, 1);
	snprintf(last_host, sizeof(last_host), "%s", host);
	snprintf(last_port, sizeof(last_port), "%s", port);
	int result = gps_open(host, port, data);
	if (result == 0) {
		atomic_fetch_add(&open_sessions, 1);
	} else {
		atomic_fetch_add(&open_failures, 1);
	}
	trace_printf(false, "gps_open %s %s -> %d", host, normalized_port(port), result == 0 ? 0 : -1);
	return result;
}

int gpsd_test_close(struct gps_data_t *data) {
	if (atomic_load(&active_io) > 0) {
		atomic_fetch_add(&close_during_io, 1);
	}
	atomic_fetch_add(&close_calls, 1);
	int result = gps_close(data);
	atomic_fetch_sub(&open_sessions, 1);
	trace_printf(false, "gps_close -> %d", result);
	return result;
}

int gpsd_test_stream(struct gps_data_t *data, unsigned int flags, void *device) {
	atomic_fetch_add((flags & WATCH_DISABLE) ? &stream_disable_calls : &stream_enable_calls, 1);
	int result = data->privdata == NULL ? -1 : gps_stream(data, flags, device);
	trace_printf(false, "gps_stream 0x%x -> %d", flags, result < 0 ? -1 : 0);
	return result;
}

bool gpsd_test_waiting(const struct gps_data_t *data, int timeout) {
	io_enter();
	atomic_fetch_add(&waiting_calls, 1);
	bool result = false;
	if (data->privdata == NULL) {
		atomic_fetch_add(&calls_after_close, 1);
		indigo_usleep(timeout > 0 ? timeout : 1000);
	} else {
		result = gps_waiting(data, timeout);
	}
	io_leave();
	return result;
}

int gpsd_test_read(struct gps_data_t *data, char *message, int length) {
	io_enter();
	atomic_fetch_add(&read_calls, 1);
	int result = -1;
	if (data->privdata == NULL) {
		atomic_fetch_add(&calls_after_close, 1);
	} else {
		result = gps_read(data, message, length);
	}
	if (result < 0) {
		atomic_fetch_add(&read_errors, 1);
		trace_printf(false, "gps_read -> -1");
	} else if (result > 0) {
		atomic_fetch_add(&messages, 1);
		gps_mask_t set = data->set;
		trace_printf(false, "gps_read%s%s%s%s%s%s%s%s%s", set & TIME_SET ? " TIME" : "", set & LATLON_SET ? " LATLON" : "", set & ALTITUDE_SET ? " ALTITUDE" : "", set & MODE_SET ? " MODE" : "", set & SATELLITE_SET ? " SATELLITE" : "", set & VERSION_SET ? " VERSION" : "", set & DEVICELIST_SET ? " DEVICES" : "", set & POLICY_SET ? " WATCH" : "", set & ERROR_SET ? " ERROR" : "");
	}
	io_leave();
	return result;
}

static observed_property *property_slot(const char *name, bool create) {
	for (int i = 0; i < PROPERTIES; i++) {
		if (!strcmp(observed[i].name, name)) {
			return observed + i;
		}
	}
	if (create) {
		for (int i = 0; i < PROPERTIES; i++) {
			if (!observed[i].name[0]) {
				snprintf(observed[i].name, INDIGO_NAME_SIZE, "%s", name);
				return observed + i;
			}
		}
	}
	return NULL;
}

static bool trace_selected(const char *name) {
	static const char *names[] = { CONNECTION_PROPERTY_NAME, GPS_STATUS_PROPERTY_NAME, GEOGRAPHIC_COORDINATES_PROPERTY_NAME, UTC_TIME_PROPERTY_NAME, GPS_ADVANCED_PROPERTY_NAME, GPS_ADVANCED_STATUS_PROPERTY_NAME };
	for (int i = 0; i < ARRAY_SIZE(names); i++) {
		if (!strcmp(names[i], name)) {
			return true;
		}
	}
	return false;
}

static void trace_property(indigo_property *property) {
	static const char *states[] = { "IDLE", "OK", "BUSY", "ALERT" };
	if (!atomic_load(&trace_enabled) || !trace_selected(property->name)) {
		return;
	}
	char line[512];
	int length = snprintf(line, sizeof(line), "prop %s %s", property->name, states[property->state & 3]);
	for (int i = 0; i < property->count && length < (int)sizeof(line); i++) {
		indigo_item *item = property->items + i;
		if (property->type == INDIGO_NUMBER_VECTOR) {
			length += snprintf(line + length, sizeof(line) - length, " %s=%.6g", item->name, item->number.value);
		} else if (property->type == INDIGO_SWITCH_VECTOR && item->sw.value) {
			length += snprintf(line + length, sizeof(line) - length, " %s", item->name);
		} else if (property->type == INDIGO_TEXT_VECTOR) {
			length += snprintf(line + length, sizeof(line) - length, " %s=\"%s\"", item->name, item->text.value);
		} else if (property->type == INDIGO_LIGHT_VECTOR) {
			length += snprintf(line + length, sizeof(line) - length, " %s=%s", item->name, states[item->light.value & 3]);
		}
	}
	trace_append(true, line);
}

static indigo_result observe_property(indigo_property *property, bool define) {
	if (strcmp(property->device, DEVICE_NAME)) {
		return INDIGO_OK;
	}
	pthread_mutex_lock(&observation_mutex);
	observed_property *slot = property_slot(property->name, true);
	if (slot != NULL) {
		bool connection = !strcmp(property->name, CONNECTION_PROPERTY_NAME);
		if (!define && !connection && !slot->defined && trace_selected(property->name)) {
			atomic_fetch_add(&late_updates, 1);
			fprintf(stderr, "late update of %s\n", property->name);
		}
		indigo_release_property(slot->copy);
		slot->copy = indigo_copy_property(NULL, property);
		if (define) {
			slot->defined = true;
		} else {
			slot->updates++;
		}
		slot->revision++;
		if (connection && property->state != INDIGO_BUSY_STATE) {
			observed_connected = property->items[0].sw.value;
		}
		if (!define) {
			trace_property(property);
		}
	}
	pthread_mutex_unlock(&observation_mutex);
	return INDIGO_OK;
}

static indigo_result client_define(indigo_client *client, indigo_device *device, indigo_property *property, const char *message) {
	return observe_property(property, true);
}

static indigo_result client_update(indigo_client *client, indigo_device *device, indigo_property *property, const char *message) {
	return observe_property(property, false);
}

static indigo_result client_delete(indigo_client *client, indigo_device *device, indigo_property *property, const char *message) {
	if (strcmp(property->device, DEVICE_NAME)) {
		return INDIGO_OK;
	}
	pthread_mutex_lock(&observation_mutex);
	for (int i = 0; i < PROPERTIES; i++) {
		if (observed[i].name[0] && (!property->name[0] || !strcmp(observed[i].name, property->name))) {
			observed[i].defined = false;
		}
	}
	pthread_mutex_unlock(&observation_mutex);
	return INDIGO_OK;
}

static indigo_result client_message(indigo_client *client, indigo_device *device, indigo_property *property, const char *message) {
	if (property == NULL || message == NULL || strcmp(property->device, DEVICE_NAME)) {
		return INDIGO_OK;
	}
	pthread_mutex_lock(&observation_mutex);
	observed_property *slot = property_slot(property->name, true);
	if (slot) {
		snprintf(slot->message, sizeof(slot->message), "%s", message);
	}
	pthread_mutex_unlock(&observation_mutex);
	return INDIGO_OK;
}

static indigo_client test_client = { .name = "gpsd simulator test", .version = INDIGO_VERSION_CURRENT, .define_property = client_define, .update_property = client_update, .delete_property = client_delete, .send_message = client_message, .force_property_updates = true };

static indigo_property *snapshot(const char *name) {
	pthread_mutex_lock(&observation_mutex);
	observed_property *slot = property_slot(name, false);
	indigo_property *copy = slot && slot->copy ? indigo_copy_property(NULL, slot->copy) : NULL;
	pthread_mutex_unlock(&observation_mutex);
	return copy;
}

static bool is_defined(const char *name) {
	pthread_mutex_lock(&observation_mutex);
	observed_property *slot = property_slot(name, false);
	bool defined = slot && slot->defined;
	pthread_mutex_unlock(&observation_mutex);
	return defined;
}

static int revision(const char *name) {
	pthread_mutex_lock(&observation_mutex);
	observed_property *slot = property_slot(name, false);
	int value = slot ? slot->revision : 0;
	pthread_mutex_unlock(&observation_mutex);
	return value;
}

static int update_count(const char *name) {
	pthread_mutex_lock(&observation_mutex);
	observed_property *slot = property_slot(name, false);
	int value = slot ? slot->updates : 0;
	pthread_mutex_unlock(&observation_mutex);
	return value;
}

static int state(const char *name) {
	indigo_property *property = snapshot(name);
	int value = property ? (int)property->state : -1;
	indigo_release_property(property);
	return value;
}

static void message(const char *name, char *buffer) {
	pthread_mutex_lock(&observation_mutex);
	observed_property *slot = property_slot(name, false);
	snprintf(buffer, INDIGO_VALUE_SIZE, "%s", slot ? slot->message : "");
	pthread_mutex_unlock(&observation_mutex);
}

static indigo_item *find_item(indigo_property *property, const char *item) {
	for (int i = 0; property && i < property->count; i++) {
		if (!strcmp(property->items[i].name, item)) {
			return property->items + i;
		}
	}
	return NULL;
}

static double number(const char *name, const char *item_name) {
	indigo_property *property = snapshot(name);
	indigo_item *item = find_item(property, item_name);
	double value = item ? item->number.value : -99999;
	indigo_release_property(property);
	return value;
}

static int light(const char *item_name) {
	indigo_property *property = snapshot(GPS_STATUS_PROPERTY_NAME);
	indigo_item *item = find_item(property, item_name);
	int value = item ? (int)item->light.value : -1;
	indigo_release_property(property);
	return value;
}

static void text(const char *name, const char *item_name, char *buffer) {
	indigo_property *property = snapshot(name);
	indigo_item *item = find_item(property, item_name);
	snprintf(buffer, INDIGO_VALUE_SIZE, "%s", item ? item->text.value : "");
	indigo_release_property(property);
}

static bool wait_state_after(const char *name, int after, int expected) {
	for (int i = 0; i < WAIT_STEPS; i++) {
		if (revision(name) > after && state(name) == expected) {
			return true;
		}
		indigo_usleep(10000);
	}
	fprintf(stderr, "%s expected state %d after revision %d, got %d revision %d\n", name, expected, after, state(name), revision(name));
	return false;
}

static bool wait_count(atomic_int *counter, int expected) {
	for (int i = 0; i < WAIT_STEPS; i++) {
		if (atomic_load(counter) >= expected) {
			return true;
		}
		indigo_usleep(10000);
	}
	fprintf(stderr, "counter expected >= %d, got %d\n", expected, atomic_load(counter));
	return false;
}

static bool wait_updates(const char *name, int expected) {
	for (int i = 0; i < WAIT_STEPS; i++) {
		if (update_count(name) >= expected) {
			return true;
		}
		indigo_usleep(10000);
	}
	fprintf(stderr, "%s expected %d updates, got %d\n", name, expected, update_count(name));
	return false;
}

static bool advanced_enabled(void) {
	indigo_property *property = snapshot(GPS_ADVANCED_PROPERTY_NAME);
	indigo_item *item = find_item(property, GPS_ADVANCED_ENABLED_ITEM_NAME);
	bool value = item && item->sw.value;
	indigo_release_property(property);
	return value;
}

static bool wait_processed(int utc_before, int advanced_before, int count) {
	if (!wait_updates(UTC_TIME_PROPERTY_NAME, utc_before + count)) {
		return false;
	}
	return !advanced_enabled() || wait_updates(GPS_ADVANCED_STATUS_PROPERTY_NAME, advanced_before + count);
}

static bool change_switch(const char *property, const char *item) {
	return indigo_change_switch_property_1(&test_client, DEVICE_NAME, property, item, true) == INDIGO_OK;
}

static bool set_port(const char *port) {
	int before = revision(DEVICE_PORT_PROPERTY_NAME);
	return indigo_change_text_property_1_raw(&test_client, DEVICE_NAME, DEVICE_PORT_PROPERTY_NAME, DEVICE_PORT_ITEM_NAME, port) == INDIGO_OK && wait_state_after(DEVICE_PORT_PROPERTY_NAME, before, INDIGO_OK_STATE);
}

static int connect_gpsd(bool connect) {
	int before = revision(CONNECTION_PROPERTY_NAME);
	if (!change_switch(CONNECTION_PROPERTY_NAME, connect ? CONNECTION_CONNECTED_ITEM_NAME : CONNECTION_DISCONNECTED_ITEM_NAME)) {
		return -1;
	}
	for (int i = 0; i < WAIT_STEPS; i++) {
		int current = state(CONNECTION_PROPERTY_NAME);
		if (revision(CONNECTION_PROPERTY_NAME) > before && current != INDIGO_BUSY_STATE) {
			return current;
		}
		indigo_usleep(10000);
	}
	fprintf(stderr, "connection %d timed out\n", connect);
	return -1;
}

static bool sim_control(const char *line) {
	char path[PATH_MAX], tmp[PATH_MAX];
	struct stat info;
	snprintf(path, sizeof(path), "%s.control", simulator.ready_file);
	snprintf(tmp, sizeof(tmp), "%s.tmp", path);
	for (int i = 0; i < WAIT_STEPS && stat(path, &info) == 0; i++) {
		indigo_usleep(10000);
	}
	FILE *file = fopen(tmp, "w");
	if (file == NULL) {
		return false;
	}
	fprintf(file, "%s\n", line);
	fclose(file);
	if (rename(tmp, path) != 0) {
		return false;
	}
	for (int i = 0; i < WAIT_STEPS; i++) {
		if (stat(path, &info) != 0) {
			return true;
		}
		indigo_usleep(10000);
	}
	fprintf(stderr, "simulator did not consume control '%s'\n", line);
	return false;
}

static int sim_events(const char *text) {
	char path[PATH_MAX], line[4096];
	snprintf(path, sizeof(path), "%s.events", simulator.ready_file);
	FILE *file = fopen(path, "r");
	int count = 0;
	if (file == NULL) {
		return 0;
	}
	while (fgets(line, sizeof(line), file) != NULL) {
		char *event = strchr(line, '\t');
		if (event != NULL && !strncmp(event + 1, text, strlen(text))) {
			count++;
		}
	}
	fclose(file);
	return count;
}

static bool wait_sim_events(const char *text, int expected) {
	for (int i = 0; i < WAIT_STEPS; i++) {
		if (sim_events(text) >= expected) {
			return true;
		}
		indigo_usleep(10000);
	}
	fprintf(stderr, "simulator event '%s' expected >= %d, got %d\n", text, expected, sim_events(text));
	return false;
}

static bool emit_and_wait(const char *command, int count) {
	int utc = update_count(UTC_TIME_PROPERTY_NAME), advanced = update_count(GPS_ADVANCED_STATUS_PROPERTY_NAME);
	return sim_control(command) && wait_processed(utc, advanced, count);
}

static bool connect_and_sync(void) {
	int utc = update_count(UTC_TIME_PROPERTY_NAME), advanced = update_count(GPS_ADVANCED_STATUS_PROPERTY_NAME), watches = sim_events("WATCH ENABLE");
	return connect_gpsd(true) == INDIGO_OK_STATE && wait_sim_events("WATCH ENABLE", watches + 1) && wait_processed(utc, advanced, 3);
}

static void reset_state(void) {
	pthread_mutex_lock(&observation_mutex);
	for (int i = 0; i < PROPERTIES; i++) {
		indigo_release_property(observed[i].copy);
	}
	memset(observed, 0, sizeof(observed));
	observed_connected = false;
	pthread_mutex_unlock(&observation_mutex);
	pthread_mutex_lock(&trace_mutex);
	trace_length = 0;
	trace_text[0] = 0;
	trace_recent_count = 0;
	pthread_mutex_unlock(&trace_mutex);
	atomic_store(&trace_enabled, false);
	atomic_store(&open_calls, 0);
	atomic_store(&open_failures, 0);
	atomic_store(&close_calls, 0);
	atomic_store(&stream_enable_calls, 0);
	atomic_store(&stream_disable_calls, 0);
	atomic_store(&waiting_calls, 0);
	atomic_store(&read_calls, 0);
	atomic_store(&read_errors, 0);
	atomic_store(&messages, 0);
	atomic_store(&reader_overlap, 0);
	atomic_store(&close_during_io, 0);
	atomic_store(&calls_after_close, 0);
	atomic_store(&late_updates, 0);
	atomic_store(&open_sessions, 0);
	last_host[0] = last_port[0] = 0;
}

static bool start_test(bool manual) {
	reset_state();
	if (!start_external_serial_simulator(&simulator, GPS_GPSD_SIMULATOR_EXECUTABLE)) {
		return false;
	}
	if (manual && !sim_control("period 0")) {
		return false;
	}
	if (indigo_gps_gpsd(INDIGO_DRIVER_INIT, NULL) != INDIGO_OK) {
		return false;
	}
	return is_defined(CONNECTION_PROPERTY_NAME) && set_port(simulator.port);
}

static void finish_test(void) {
	atomic_store(&trace_enabled, false);
	pthread_mutex_lock(&observation_mutex);
	bool connected = observed_connected;
	pthread_mutex_unlock(&observation_mutex);
	if (connected && connect_gpsd(false) != INDIGO_OK_STATE) {
		fprintf(stderr, "cleanup failed to disconnect\n");
		indigo_test_failures++;
	}
	indigo_usleep(300000);
	if (indigo_gps_gpsd(INDIGO_DRIVER_SHUTDOWN, NULL) != INDIGO_OK) {
		fprintf(stderr, "cleanup shutdown failed\n");
		indigo_test_failures++;
	}
	stop_external_serial_simulator(&simulator);
	EXPECT_EQ(0, atomic_load(&open_sessions));
	EXPECT_EQ(0, atomic_load(&calls_after_close));
	EXPECT_EQ(0, atomic_load(&late_updates));
	if (atomic_load(&io_safety_invariants)) {
		EXPECT_EQ(0, atomic_load(&reader_overlap));
		EXPECT_EQ(0, atomic_load(&close_during_io));
		EXPECT_EQ(0, atomic_load(&active_io));
	}
}

// Preservation tests

static void metadata_and_properties(void) {
	indigo_driver_info info = { 0 };
	indigo_property *property = NULL;
	char buffer[INDIGO_VALUE_SIZE];
	CHECK_EQ(INDIGO_OK, indigo_gps_gpsd(INDIGO_DRIVER_INFO, &info));
	CHECK_STR("indigo_gps_gpsd", info.name);
	CHECK_STR(EXPECTED_LABEL, info.description);
	CHECK_EQ(EXPECTED_API_GENERATION, INDIGO_DRIVER_API_GENERATION(info.version));
	CHECK(!info.multi_device_support);
	reset_state();
	CHECK(start_external_serial_simulator(&simulator, GPS_GPSD_SIMULATOR_EXECUTABLE));
	CHECK(sim_control("period 0"));
	CHECK_EQ(INDIGO_OK, indigo_gps_gpsd(INDIGO_DRIVER_INIT, NULL));
	const char *visible[] = { INFO_PROPERTY_NAME, CONFIG_PROPERTY_NAME, PROFILE_PROPERTY_NAME, PROFILE_NAME_PROPERTY_NAME, CONNECTION_PROPERTY_NAME, DEVICE_PORT_PROPERTY_NAME };
	const char *hidden[] = { SIMULATION_PROPERTY_NAME, DEVICE_PORTS_PROPERTY_NAME, DEVICE_BAUDRATE_PROPERTY_NAME, AUTHENTICATION_PROPERTY_NAME, ADDITIONAL_INSTANCES_PROPERTY_NAME, GEOGRAPHIC_COORDINATES_PROPERTY_NAME, GPS_STATUS_PROPERTY_NAME, UTC_TIME_PROPERTY_NAME, GPS_ADVANCED_PROPERTY_NAME, GPS_ADVANCED_STATUS_PROPERTY_NAME };
	for (int i = 0; i < ARRAY_SIZE(visible); i++) {
		CHECK(is_defined(visible[i]));
	}
	for (int i = 0; i < ARRAY_SIZE(hidden); i++) {
		CHECK(!is_defined(hidden[i]));
	}
	property = snapshot(INFO_PROPERTY_NAME);
	snprintf(buffer, sizeof(buffer), "%d", INDIGO_INTERFACE_GPS);
	CHECK_STR(buffer, find_item(property, INFO_DEVICE_INTERFACE_ITEM_NAME)->text.value);
	indigo_release_property(property);
	property = snapshot(DEVICE_PORT_PROPERTY_NAME);
	CHECK_STR("GPS daemon host", property->label);
	CHECK_STR("Hostname (host:port)", property->items[0].label);
	CHECK_STR("gpsd://localhost:2947", property->items[0].text.value);
	CHECK_EQ(INDIGO_OK_STATE, property->state);
	indigo_release_property(property);
	property = NULL;
	CHECK(set_port(simulator.port));
	CHECK(connect_and_sync());
	CHECK(is_defined(GEOGRAPHIC_COORDINATES_PROPERTY_NAME) && is_defined(GPS_STATUS_PROPERTY_NAME) && is_defined(UTC_TIME_PROPERTY_NAME) && is_defined(GPS_ADVANCED_PROPERTY_NAME));
	CHECK(!is_defined(GPS_ADVANCED_STATUS_PROPERTY_NAME));
	property = snapshot(GEOGRAPHIC_COORDINATES_PROPERTY_NAME);
	CHECK_EQ(3, property->count);
	indigo_release_property(property);
	property = snapshot(UTC_TIME_PROPERTY_NAME);
	CHECK_EQ(1, property->count);
	indigo_release_property(property);
	property = snapshot(GPS_STATUS_PROPERTY_NAME);
	CHECK_EQ(3, property->count);
	indigo_release_property(property);
	property = NULL;
	CHECK_EQ(true, advanced_enabled() == false);
	int before = revision(GPS_ADVANCED_PROPERTY_NAME);
	CHECK(change_switch(GPS_ADVANCED_PROPERTY_NAME, GPS_ADVANCED_ENABLED_ITEM_NAME));
	CHECK(wait_state_after(GPS_ADVANCED_PROPERTY_NAME, before, INDIGO_OK_STATE));
	CHECK(is_defined(GPS_ADVANCED_STATUS_PROPERTY_NAME));
	before = revision(GPS_ADVANCED_PROPERTY_NAME);
	CHECK(change_switch(GPS_ADVANCED_PROPERTY_NAME, GPS_ADVANCED_DISABLED_ITEM_NAME));
	CHECK(wait_state_after(GPS_ADVANCED_PROPERTY_NAME, before, INDIGO_OK_STATE));
	CHECK(!is_defined(GPS_ADVANCED_STATUS_PROPERTY_NAME));
	CHECK_EQ(INDIGO_OK_STATE, connect_gpsd(false));
	CHECK(!is_defined(GEOGRAPHIC_COORDINATES_PROPERTY_NAME) && !is_defined(GPS_STATUS_PROPERTY_NAME) && !is_defined(UTC_TIME_PROPERTY_NAME));
cleanup:
	indigo_release_property(property);
	finish_test();
}

static void port_parsing_and_open_failures(void) {
	char port[INDIGO_VALUE_SIZE], long_host[200];
	const char *number = strrchr(simulator.port, ':');
	CHECK(start_test(true));
	number = strrchr(simulator.port, ':') + 1;
	snprintf(port, sizeof(port), "127.0.0.1:%s", number);
	CHECK(set_port(port));
	CHECK(connect_and_sync());
	CHECK_STR("127.0.0.1", last_host);
	CHECK_STR(number, last_port);
	CHECK_EQ(1, atomic_load(&stream_enable_calls));
	CHECK_EQ(INDIGO_OK_STATE, connect_gpsd(false));
	CHECK(wait_sim_events("WATCH DISABLE", 1));
	CHECK(wait_sim_events("CLOSE peer", 1));
	CHECK_EQ(1, atomic_load(&stream_disable_calls));
	CHECK_EQ(1, atomic_load(&close_calls));
	CHECK(set_port("gpsd://127.0.0.1"));
	CHECK_EQ(INDIGO_ALERT_STATE, connect_gpsd(true));
	CHECK_STR("2947", last_port);
	CHECK(!observed_connected);
	memset(long_host, 'h', sizeof(long_host) - 1);
	long_host[sizeof(long_host) - 1] = 0;
	int opens = atomic_load(&open_calls);
	CHECK(set_port(long_host));
	CHECK_EQ(INDIGO_ALERT_STATE, connect_gpsd(true));
	CHECK_EQ(opens, atomic_load(&open_calls));
	CHECK(set_port("gpsd://127.0.0.1:1234567890123456"));
	CHECK_EQ(INDIGO_ALERT_STATE, connect_gpsd(true));
	CHECK_EQ(opens, atomic_load(&open_calls));
	CHECK(set_port(simulator.port));
	CHECK(connect_and_sync());
	CHECK_STR("127.0.0.1", last_host);
cleanup:
	finish_test();
}

static void connection_refused_and_recovery(void) {
	external_serial_simulator stopped = { 0 };
	CHECK(start_test(true));
	CHECK(start_external_serial_simulator(&stopped, GPS_GPSD_SIMULATOR_EXECUTABLE));
	char unused[PATH_MAX];
	snprintf(unused, sizeof(unused), "%s", stopped.port);
	stop_external_serial_simulator(&stopped);
	CHECK(set_port(unused));
	CHECK_EQ(INDIGO_ALERT_STATE, connect_gpsd(true));
	CHECK_EQ(1, atomic_load(&open_failures));
	CHECK_EQ(0, atomic_load(&close_calls));
	CHECK(!is_defined(GPS_STATUS_PROPERTY_NAME));
	CHECK(set_port(simulator.port));
	CHECK(connect_and_sync());
	CHECK(emit_and_wait("emit tpv", 1));
	CHECK_EQ(INDIGO_OK_STATE, state(GEOGRAPHIC_COORDINATES_PROPERTY_NAME));
cleanup:
	finish_test();
}

static void fix_lifecycle_and_mapping(void) {
	char buffer[INDIGO_VALUE_SIZE];
	CHECK(start_test(true));
	CHECK(connect_and_sync());
	CHECK_EQ(INDIGO_BUSY_STATE, state(GEOGRAPHIC_COORDINATES_PROPERTY_NAME));
	CHECK_EQ(INDIGO_BUSY_STATE, state(UTC_TIME_PROPERTY_NAME));
	CHECK_EQ(INDIGO_BUSY_STATE, state(GPS_STATUS_PROPERTY_NAME));
	CHECK_NEAR(0, number(GEOGRAPHIC_COORDINATES_PROPERTY_NAME, GEOGRAPHIC_COORDINATES_LATITUDE_ITEM_NAME), 0);
	text(UTC_TIME_PROPERTY_NAME, UTC_TIME_ITEM_NAME, buffer);
	CHECK_STR("0000-00-00T00:00:00.00", buffer);
	CHECK(sim_control("alt_style legacy"));
	CHECK(emit_and_wait("emit tpv", 1));
	CHECK_EQ(INDIGO_OK_STATE, state(GEOGRAPHIC_COORDINATES_PROPERTY_NAME));
	CHECK_NEAR(48.1486, number(GEOGRAPHIC_COORDINATES_PROPERTY_NAME, GEOGRAPHIC_COORDINATES_LATITUDE_ITEM_NAME), 1e-9);
	CHECK_NEAR(17.1077, number(GEOGRAPHIC_COORDINATES_PROPERTY_NAME, GEOGRAPHIC_COORDINATES_LONGITUDE_ITEM_NAME), 1e-9);
	CHECK_NEAR(180.5, number(GEOGRAPHIC_COORDINATES_PROPERTY_NAME, GEOGRAPHIC_COORDINATES_ELEVATION_ITEM_NAME), 1e-9);
	CHECK_EQ(INDIGO_OK_STATE, state(UTC_TIME_PROPERTY_NAME));
	text(UTC_TIME_PROPERTY_NAME, UTC_TIME_ITEM_NAME, buffer);
	CHECK_STR("2026-01-02T03:04:05", buffer);
	CHECK_EQ(INDIGO_OK_STATE, state(GPS_STATUS_PROPERTY_NAME));
	CHECK_EQ(INDIGO_OK_STATE, light(GPS_STATUS_3D_FIX_ITEM_NAME));
	CHECK_EQ(INDIGO_IDLE_STATE, light(GPS_STATUS_2D_FIX_ITEM_NAME));
	CHECK_EQ(INDIGO_IDLE_STATE, light(GPS_STATUS_NO_FIX_ITEM_NAME));
	CHECK(sim_control("alt_style both"));
	CHECK(sim_control("position -33.8568 151.2153"));
	CHECK(sim_control("altitude 58 22"));
	CHECK(sim_control("time 2026-12-31T23:59:59.900Z"));
	CHECK(emit_and_wait("emit tpv", 1));
	CHECK_NEAR(-33.8568, number(GEOGRAPHIC_COORDINATES_PROPERTY_NAME, GEOGRAPHIC_COORDINATES_LATITUDE_ITEM_NAME), 1e-9);
	CHECK_NEAR(151.2153, number(GEOGRAPHIC_COORDINATES_PROPERTY_NAME, GEOGRAPHIC_COORDINATES_LONGITUDE_ITEM_NAME), 1e-9);
	CHECK_NEAR(58, number(GEOGRAPHIC_COORDINATES_PROPERTY_NAME, GEOGRAPHIC_COORDINATES_ELEVATION_ITEM_NAME), 1e-9);
	text(UTC_TIME_PROPERTY_NAME, UTC_TIME_ITEM_NAME, buffer);
	CHECK_STR("2026-12-31T23:59:59", buffer);
	CHECK(sim_control("mode 2"));
	CHECK(sim_control("position 10.5 -20.25"));
	CHECK(emit_and_wait("emit tpv", 1));
	CHECK_EQ(INDIGO_OK_STATE, state(GEOGRAPHIC_COORDINATES_PROPERTY_NAME));
	CHECK_NEAR(10.5, number(GEOGRAPHIC_COORDINATES_PROPERTY_NAME, GEOGRAPHIC_COORDINATES_LATITUDE_ITEM_NAME), 1e-9);
	CHECK_NEAR(58, number(GEOGRAPHIC_COORDINATES_PROPERTY_NAME, GEOGRAPHIC_COORDINATES_ELEVATION_ITEM_NAME), 1e-9);
	CHECK_EQ(INDIGO_BUSY_STATE, light(GPS_STATUS_2D_FIX_ITEM_NAME));
	CHECK_EQ(INDIGO_IDLE_STATE, light(GPS_STATUS_3D_FIX_ITEM_NAME));
	CHECK_EQ(INDIGO_OK_STATE, state(GPS_STATUS_PROPERTY_NAME));
	CHECK(sim_control("mode 1"));
	CHECK(emit_and_wait("emit tpv", 1));
	CHECK_EQ(INDIGO_BUSY_STATE, state(GEOGRAPHIC_COORDINATES_PROPERTY_NAME));
	CHECK_NEAR(10.5, number(GEOGRAPHIC_COORDINATES_PROPERTY_NAME, GEOGRAPHIC_COORDINATES_LATITUDE_ITEM_NAME), 1e-9);
	CHECK_EQ(INDIGO_OK_STATE, state(UTC_TIME_PROPERTY_NAME));
	CHECK_EQ(INDIGO_ALERT_STATE, light(GPS_STATUS_NO_FIX_ITEM_NAME));
	CHECK_EQ(INDIGO_OK_STATE, state(GPS_STATUS_PROPERTY_NAME));
	CHECK(sim_control("time none"));
	CHECK(sim_control("mode 0"));
	CHECK(emit_and_wait("emit tpv", 1));
	CHECK_EQ(INDIGO_BUSY_STATE, state(UTC_TIME_PROPERTY_NAME));
	CHECK_EQ(INDIGO_BUSY_STATE, state(GPS_STATUS_PROPERTY_NAME));
	CHECK_EQ(INDIGO_IDLE_STATE, light(GPS_STATUS_NO_FIX_ITEM_NAME));
	CHECK(sim_control("mode 3"));
	CHECK(sim_control("time 2027-02-03T04:05:06.000Z"));
	CHECK(emit_and_wait("emit tpv", 1));
	CHECK_EQ(INDIGO_OK_STATE, state(GEOGRAPHIC_COORDINATES_PROPERTY_NAME));
	CHECK_EQ(INDIGO_OK_STATE, light(GPS_STATUS_3D_FIX_ITEM_NAME));
	text(UTC_TIME_PROPERTY_NAME, UTC_TIME_ITEM_NAME, buffer);
	CHECK_STR("2027-02-03T04:05:06", buffer);
	CHECK(emit_and_wait("emit sky", 1));
	CHECK_EQ(INDIGO_OK_STATE, state(GEOGRAPHIC_COORDINATES_PROPERTY_NAME));
	CHECK_EQ(INDIGO_OK_STATE, state(UTC_TIME_PROPERTY_NAME));
cleanup:
	finish_test();
}

static void advanced_satellites_and_dop(void) {
	CHECK(start_test(true));
	CHECK(connect_and_sync());
	int before = update_count(GPS_ADVANCED_STATUS_PROPERTY_NAME);
	CHECK(emit_and_wait("emit sky", 1));
	CHECK_EQ(before, update_count(GPS_ADVANCED_STATUS_PROPERTY_NAME));
	before = revision(GPS_ADVANCED_PROPERTY_NAME);
	CHECK(change_switch(GPS_ADVANCED_PROPERTY_NAME, GPS_ADVANCED_ENABLED_ITEM_NAME));
	CHECK(wait_state_after(GPS_ADVANCED_PROPERTY_NAME, before, INDIGO_OK_STATE));
	CHECK(emit_and_wait("emit sky", 1));
	CHECK_EQ(INDIGO_OK_STATE, state(GPS_ADVANCED_STATUS_PROPERTY_NAME));
	CHECK_NEAR(7, number(GPS_ADVANCED_STATUS_PROPERTY_NAME, GPS_ADVANCED_STATUS_SVS_IN_USE_ITEM_NAME), 0);
	CHECK_NEAR(9, number(GPS_ADVANCED_STATUS_PROPERTY_NAME, GPS_ADVANCED_STATUS_SVS_IN_VIEW_ITEM_NAME), 0);
	CHECK_NEAR(1.8, number(GPS_ADVANCED_STATUS_PROPERTY_NAME, GPS_ADVANCED_STATUS_PDOP_ITEM_NAME), 1e-9);
	CHECK_NEAR(0.9, number(GPS_ADVANCED_STATUS_PROPERTY_NAME, GPS_ADVANCED_STATUS_HDOP_ITEM_NAME), 1e-9);
	CHECK_NEAR(1.5, number(GPS_ADVANCED_STATUS_PROPERTY_NAME, GPS_ADVANCED_STATUS_VDOP_ITEM_NAME), 1e-9);
	CHECK(sim_control("satellites 12 4"));
	CHECK(sim_control("dop none"));
	CHECK(emit_and_wait("emit sky", 1));
	CHECK_NEAR(4, number(GPS_ADVANCED_STATUS_PROPERTY_NAME, GPS_ADVANCED_STATUS_SVS_IN_USE_ITEM_NAME), 0);
	CHECK_NEAR(12, number(GPS_ADVANCED_STATUS_PROPERTY_NAME, GPS_ADVANCED_STATUS_SVS_IN_VIEW_ITEM_NAME), 0);
	CHECK_NEAR(1.8, number(GPS_ADVANCED_STATUS_PROPERTY_NAME, GPS_ADVANCED_STATUS_PDOP_ITEM_NAME), 1e-9);
	CHECK(sim_control("dop 2.5 1.25 2"));
	CHECK(sim_control("satellites 5 3"));
	CHECK(sim_control("sky_style modern"));
	CHECK(emit_and_wait("emit sky", 1));
	CHECK_NEAR(2.5, number(GPS_ADVANCED_STATUS_PROPERTY_NAME, GPS_ADVANCED_STATUS_PDOP_ITEM_NAME), 1e-9);
	CHECK_NEAR(1.25, number(GPS_ADVANCED_STATUS_PROPERTY_NAME, GPS_ADVANCED_STATUS_HDOP_ITEM_NAME), 1e-9);
	CHECK_NEAR(4, number(GPS_ADVANCED_STATUS_PROPERTY_NAME, GPS_ADVANCED_STATUS_SVS_IN_USE_ITEM_NAME), 0);
	CHECK_NEAR(12, number(GPS_ADVANCED_STATUS_PROPERTY_NAME, GPS_ADVANCED_STATUS_SVS_IN_VIEW_ITEM_NAME), 0);
	before = revision(GPS_ADVANCED_PROPERTY_NAME);
	CHECK(change_switch(GPS_ADVANCED_PROPERTY_NAME, GPS_ADVANCED_DISABLED_ITEM_NAME));
	CHECK(wait_state_after(GPS_ADVANCED_PROPERTY_NAME, before, INDIGO_OK_STATE));
	before = update_count(GPS_ADVANCED_STATUS_PROPERTY_NAME);
	CHECK(emit_and_wait("emit sky", 1));
	CHECK_EQ(before, update_count(GPS_ADVANCED_STATUS_PROPERTY_NAME));
cleanup:
	finish_test();
}

static void message_framing_and_malformed_input(void) {
	CHECK(start_test(true));
	CHECK(connect_and_sync());
	CHECK(emit_and_wait("emit tpv", 1));
	int read_before = atomic_load(&messages);
	CHECK(sim_control("mode 2"));
	CHECK(sim_control("position 1.25 2.5"));
	CHECK(sim_control("split {\"class\":\"TPV\",\"device\":\"/dev/ttyACM0\",\"mode\":3,\"time\":\"2026-03-04T05:06:07.000Z\",\"lat\":-1.5,\"lon\":-2.75,\"alt\":12.5}"));
	CHECK(wait_count(&messages, read_before + 1));
	indigo_usleep(200000);
	CHECK_NEAR(-1.5, number(GEOGRAPHIC_COORDINATES_PROPERTY_NAME, GEOGRAPHIC_COORDINATES_LATITUDE_ITEM_NAME), 1e-9);
	CHECK_NEAR(-2.75, number(GEOGRAPHIC_COORDINATES_PROPERTY_NAME, GEOGRAPHIC_COORDINATES_LONGITUDE_ITEM_NAME), 1e-9);
	CHECK_NEAR(12.5, number(GEOGRAPHIC_COORDINATES_PROPERTY_NAME, GEOGRAPHIC_COORDINATES_ELEVATION_ITEM_NAME), 1e-9);
	CHECK_EQ(INDIGO_OK_STATE, state(GEOGRAPHIC_COORDINATES_PROPERTY_NAME));
	CHECK(emit_and_wait("raw {\"class\":\"ERROR\",\"message\":\"Unrecognized request\"}", 1));
	CHECK(emit_and_wait("raw {\"class\":\"TPV\",\"lat\":\"bogus\",", 1));
	CHECK(emit_and_wait("raw this is not json", 1));
	CHECK(emit_and_wait("raw {\"class\":\"UNKNOWN\",\"x\":1}", 1));
	CHECK(observed_connected);
	CHECK_EQ(0, atomic_load(&read_errors));
	CHECK(emit_and_wait("emit all", 2));
	CHECK_NEAR(1.25, number(GEOGRAPHIC_COORDINATES_PROPERTY_NAME, GEOGRAPHIC_COORDINATES_LATITUDE_ITEM_NAME), 1e-9);
	CHECK_EQ(INDIGO_BUSY_STATE, light(GPS_STATUS_2D_FIX_ITEM_NAME));
	read_before = atomic_load(&messages);
	CHECK(sim_control("emit all"));
	CHECK(sim_control("emit all"));
	CHECK(sim_control("emit all"));
	CHECK(wait_count(&messages, read_before + 6));
cleanup:
	finish_test();
}

static void periodic_stream(void) {
	CHECK(start_test(false));
	CHECK(sim_control("period 100"));
	CHECK(connect_gpsd(true) == INDIGO_OK_STATE);
	int before = update_count(GEOGRAPHIC_COORDINATES_PROPERTY_NAME);
	CHECK(wait_updates(GEOGRAPHIC_COORDINATES_PROPERTY_NAME, before + 20));
	CHECK_EQ(INDIGO_OK_STATE, state(GEOGRAPHIC_COORDINATES_PROPERTY_NAME));
	CHECK_EQ(INDIGO_OK_STATE, state(UTC_TIME_PROPERTY_NAME));
	CHECK_EQ(INDIGO_OK_STATE, state(GPS_STATUS_PROPERTY_NAME));
	CHECK(sim_control("period 0"));
	indigo_usleep(300000);
cleanup:
	finish_test();
}

static void disconnect_reconnect_fresh_data(void) {
	CHECK(start_test(true));
	CHECK(connect_and_sync());
	CHECK(emit_and_wait("emit tpv", 1));
	CHECK_NEAR(48.1486, number(GEOGRAPHIC_COORDINATES_PROPERTY_NAME, GEOGRAPHIC_COORDINATES_LATITUDE_ITEM_NAME), 1e-9);
	indigo_usleep(300000);
	CHECK_EQ(INDIGO_OK_STATE, connect_gpsd(false));
	CHECK(wait_sim_events("WATCH DISABLE", 1));
	CHECK(wait_sim_events("CLOSE peer", 1));
	indigo_usleep(400000);
	CHECK(sim_control("position 1 2"));
	CHECK(connect_and_sync());
	CHECK_NEAR(0, number(GEOGRAPHIC_COORDINATES_PROPERTY_NAME, GEOGRAPHIC_COORDINATES_LATITUDE_ITEM_NAME), 0);
	CHECK_EQ(INDIGO_BUSY_STATE, state(GEOGRAPHIC_COORDINATES_PROPERTY_NAME));
	CHECK(emit_and_wait("emit tpv", 1));
	CHECK_NEAR(1, number(GEOGRAPHIC_COORDINATES_PROPERTY_NAME, GEOGRAPHIC_COORDINATES_LATITUDE_ITEM_NAME), 0);
	CHECK_EQ(2, sim_events("CONNECT"));
	CHECK_EQ(2, atomic_load(&stream_enable_calls));
cleanup:
	finish_test();
}

static void shutdown_while_connected(void) {
	CHECK(start_test(true));
	CHECK(connect_and_sync());
	CHECK_EQ(INDIGO_BUSY, indigo_gps_gpsd(INDIGO_DRIVER_SHUTDOWN, NULL));
	CHECK(observed_connected);
	CHECK(emit_and_wait("emit tpv", 1));
	indigo_usleep(300000);
	CHECK_EQ(INDIGO_OK_STATE, connect_gpsd(false));
	indigo_usleep(400000);
	CHECK_EQ(INDIGO_OK, indigo_gps_gpsd(INDIGO_DRIVER_SHUTDOWN, NULL));
	CHECK_EQ(INDIGO_OK, indigo_gps_gpsd(INDIGO_DRIVER_SHUTDOWN, NULL));
	CHECK_EQ(INDIGO_OK, indigo_gps_gpsd(INDIGO_DRIVER_INIT, NULL));
	CHECK_EQ(INDIGO_OK, indigo_gps_gpsd(INDIGO_DRIVER_INIT, NULL));
	CHECK(is_defined(CONNECTION_PROPERTY_NAME));
	CHECK(set_port(simulator.port));
	CHECK(connect_and_sync());
cleanup:
	finish_test();
}

static void reconnect_single_reader(void) {
	CHECK(start_test(true));
	CHECK(connect_and_sync());
	CHECK_EQ(INDIGO_OK_STATE, connect_gpsd(false));
	CHECK(connect_gpsd(true) == INDIGO_OK_STATE);
	indigo_usleep(600000);
	CHECK_EQ(0, atomic_load(&reader_overlap));
	CHECK(emit_and_wait("emit tpv", 1));
	CHECK_EQ(0, atomic_load(&reader_overlap));
cleanup:
	finish_test();
}

static void shutdown_after_disconnect_stops_reader(void) {
	CHECK(start_test(true));
	CHECK(connect_and_sync());
	indigo_usleep(300000);
	CHECK_EQ(INDIGO_OK_STATE, connect_gpsd(false));
	CHECK_EQ(INDIGO_OK, indigo_gps_gpsd(INDIGO_DRIVER_SHUTDOWN, NULL));
	CHECK_EQ(0, atomic_load(&active_io));
	int calls = atomic_load(&waiting_calls) + atomic_load(&read_calls);
	indigo_usleep(500000);
	CHECK_EQ(calls, atomic_load(&waiting_calls) + atomic_load(&read_calls));
	CHECK_EQ(INDIGO_OK, indigo_gps_gpsd(INDIGO_DRIVER_INIT, NULL));
cleanup:
	finish_test();
}

static void reference_trace(void) {
	char expected[65536];
	FILE *file = NULL;
	CHECK(start_test(true));
	atomic_store(&trace_enabled, true);
	trace_printf(false, "step connect");
	CHECK(connect_and_sync());
	trace_printf(false, "step tpv-legacy-3d");
	CHECK(sim_control("alt_style legacy"));
	CHECK(emit_and_wait("emit tpv", 1));
	trace_printf(false, "step sky");
	CHECK(emit_and_wait("emit sky", 1));
	trace_printf(false, "step advanced");
	int before = revision(GPS_ADVANCED_PROPERTY_NAME);
	CHECK(change_switch(GPS_ADVANCED_PROPERTY_NAME, GPS_ADVANCED_ENABLED_ITEM_NAME));
	CHECK(wait_state_after(GPS_ADVANCED_PROPERTY_NAME, before, INDIGO_OK_STATE));
	CHECK(emit_and_wait("emit sky", 1));
	trace_printf(false, "step no-fix");
	CHECK(sim_control("mode 1"));
	CHECK(emit_and_wait("emit tpv", 1));
	trace_printf(false, "step 2d");
	CHECK(sim_control("mode 2"));
	CHECK(emit_and_wait("emit tpv", 1));
	trace_printf(false, "step mode-0-no-time");
	CHECK(sim_control("mode 0"));
	CHECK(sim_control("time none"));
	CHECK(emit_and_wait("emit tpv", 1));
	trace_printf(false, "step 3d-both");
	CHECK(sim_control("mode 3"));
	CHECK(sim_control("time 2026-05-06T07:08:09.000Z"));
	CHECK(sim_control("alt_style both"));
	CHECK(emit_and_wait("emit tpv", 1));
	trace_printf(false, "step error");
	CHECK(emit_and_wait("raw {\"class\":\"ERROR\",\"message\":\"trace\"}", 1));
	trace_printf(false, "step disconnect");
	indigo_usleep(300000);
	CHECK_EQ(INDIGO_OK_STATE, connect_gpsd(false));
	CHECK(wait_sim_events("CLOSE peer", 1));
	indigo_usleep(300000);
	trace_printf(false, "step end");
	atomic_store(&trace_enabled, false);
	const char *write_path = getenv("GPSD_WRITE_TRACE");
	if (write_path) {
		file = fopen(write_path, "w");
		CHECK(file != NULL);
		fputs(trace_text, file);
		fclose(file);
		file = NULL;
	}
	file = fopen(GPSD_REFERENCE_TRACE_PATH, "r");
	CHECK(file != NULL);
	size_t length = fread(expected, 1, sizeof(expected) - 1, file);
	expected[length] = 0;
	if (strcmp(expected, trace_text)) {
		fprintf(stderr, "reference trace mismatch, actual trace:\n%s\n", trace_text);
		CHECK(false);
	}
cleanup:
	if (file) {
		fclose(file);
	}
	finish_test();
}

// Regression tests for defects reproduced against the original driver

static void defect_disconnect_closes_idle_session(void) {
	CHECK(start_test(true));
	CHECK(connect_and_sync());
	indigo_usleep(300000);
	CHECK_EQ(INDIGO_OK_STATE, connect_gpsd(false));
	CHECK_EQ(0, atomic_load(&close_during_io));
	indigo_usleep(400000);
	CHECK_EQ(0, atomic_load(&calls_after_close));
cleanup:
	finish_test();
}

static void defect_gpsd_loss_reported(void) {
	char buffer[INDIGO_VALUE_SIZE];
	CHECK(start_test(true));
	CHECK(connect_and_sync());
	int before = revision(CONNECTION_PROPERTY_NAME);
	CHECK(sim_control("close"));
	CHECK(wait_state_after(CONNECTION_PROPERTY_NAME, before, INDIGO_ALERT_STATE));
	CHECK(!observed_connected);
	message(CONNECTION_PROPERTY_NAME, buffer);
	CHECK(strstr(buffer, "lost") != NULL);
	CHECK_EQ(1, atomic_load(&close_calls));
	CHECK(!is_defined(GPS_STATUS_PROPERTY_NAME));
	CHECK(connect_and_sync());
	CHECK(emit_and_wait("emit tpv", 1));
	CHECK_EQ(INDIGO_OK_STATE, state(GEOGRAPHIC_COORDINATES_PROPERTY_NAME));
cleanup:
	finish_test();
}

static void defect_modern_altitude_elevation(void) {
	CHECK(start_test(true));
	CHECK(connect_and_sync());
	CHECK(sim_control("alt_style modern"));
	CHECK(emit_and_wait("emit tpv", 1));
	CHECK_EQ(INDIGO_OK_STATE, state(GEOGRAPHIC_COORDINATES_PROPERTY_NAME));
	CHECK_NEAR(136.25, number(GEOGRAPHIC_COORDINATES_PROPERTY_NAME, GEOGRAPHIC_COORDINATES_ELEVATION_ITEM_NAME), 1e-9);
	CHECK(sim_control("alt_style both"));
	CHECK(emit_and_wait("emit tpv", 1));
	CHECK_NEAR(180.5, number(GEOGRAPHIC_COORDINATES_PROPERTY_NAME, GEOGRAPHIC_COORDINATES_ELEVATION_ITEM_NAME), 1e-9);
cleanup:
	finish_test();
}

static void defect_reconnect_resets_advanced_status(void) {
	CHECK(start_test(true));
	CHECK(connect_and_sync());
	int before = revision(GPS_ADVANCED_PROPERTY_NAME);
	CHECK(change_switch(GPS_ADVANCED_PROPERTY_NAME, GPS_ADVANCED_ENABLED_ITEM_NAME));
	CHECK(wait_state_after(GPS_ADVANCED_PROPERTY_NAME, before, INDIGO_OK_STATE));
	CHECK(emit_and_wait("emit sky", 1));
	CHECK_NEAR(7, number(GPS_ADVANCED_STATUS_PROPERTY_NAME, GPS_ADVANCED_STATUS_SVS_IN_USE_ITEM_NAME), 0);
	indigo_usleep(300000);
	CHECK_EQ(INDIGO_OK_STATE, connect_gpsd(false));
	indigo_usleep(400000);
	CHECK(connect_and_sync());
	CHECK_NEAR(0, number(GPS_ADVANCED_STATUS_PROPERTY_NAME, GPS_ADVANCED_STATUS_SVS_IN_USE_ITEM_NAME), 0);
	CHECK_NEAR(0, number(GPS_ADVANCED_STATUS_PROPERTY_NAME, GPS_ADVANCED_STATUS_SVS_IN_VIEW_ITEM_NAME), 0);
	CHECK_NEAR(0, number(GPS_ADVANCED_STATUS_PROPERTY_NAME, GPS_ADVANCED_STATUS_PDOP_ITEM_NAME), 0);
cleanup:
	finish_test();
}

static void defect_partial_line_does_not_spin(void) {
	CHECK(start_test(true));
	CHECK(connect_and_sync());
	CHECK(emit_and_wait("emit tpv", 1));
	int updates = update_count(UTC_TIME_PROPERTY_NAME), reads = atomic_load(&messages);
	CHECK(sim_control("split {\"class\":\"TPV\",\"device\":\"/dev/ttyACM0\",\"mode\":3,\"time\":\"2026-03-04T05:06:07.000Z\",\"lat\":-1.5,\"lon\":-2.75,\"alt\":12.5}"));
	CHECK(wait_count(&messages, reads + 1));
	indigo_usleep(300000);
	CHECK_NEAR(-1.5, number(GEOGRAPHIC_COORDINATES_PROPERTY_NAME, GEOGRAPHIC_COORDINATES_LATITUDE_ITEM_NAME), 1e-9);
	int published = update_count(UTC_TIME_PROPERTY_NAME) - updates;
	if (published > 2) {
		fprintf(stderr, "UTC_TIME published %d times for one split message\n", published);
	}
	CHECK(published <= 2);
cleanup:
	finish_test();
}

static int run_cases(const char *suite, const indigo_test_case *cases, int count) {
	indigo_set_log_level(INDIGO_LOG_ERROR);
	indigo_start();
	indigo_attach_client(&test_client);
	int result = indigo_run_tests(suite, cases, count);
	indigo_detach_client(&test_client);
	indigo_stop();
	return result;
}

int main(int argc, char **argv) {
	const indigo_test_case tests[] = {
		{ "metadata_and_properties", metadata_and_properties },
		{ "port_parsing_and_open_failures", port_parsing_and_open_failures },
		{ "connection_refused_and_recovery", connection_refused_and_recovery },
		{ "fix_lifecycle_and_mapping", fix_lifecycle_and_mapping },
		{ "advanced_satellites_and_dop", advanced_satellites_and_dop },
		{ "message_framing_and_malformed_input", message_framing_and_malformed_input },
		{ "periodic_stream", periodic_stream },
		{ "disconnect_reconnect_fresh_data", disconnect_reconnect_fresh_data },
		{ "shutdown_while_connected", shutdown_while_connected },
		{ "reconnect_single_reader", reconnect_single_reader },
		{ "shutdown_after_disconnect_stops_reader", shutdown_after_disconnect_stops_reader },
		{ "reference_trace", reference_trace },
		{ "GPSD-02 disconnect_closes_idle_session", defect_disconnect_closes_idle_session },
		{ "GPSD-04 gpsd_loss_reported", defect_gpsd_loss_reported },
		{ "GPSD-05 modern_altitude_elevation", defect_modern_altitude_elevation },
		{ "GPSD-06 reconnect_resets_advanced_status", defect_reconnect_resets_advanced_status },
		{ "GPSD-07 partial_line_does_not_spin", defect_partial_line_does_not_spin }
	};
	if (argc > 1) {
		indigo_test_case selected[ARRAY_SIZE(tests)];
		int count = 0;
		for (int i = 0; i < ARRAY_SIZE(tests); i++) {
			if (strstr(tests[i].name, argv[1])) {
				selected[count++] = tests[i];
			}
		}
		return run_cases("gpsd simulator integration tests", selected, count);
	}
	return run_cases("gpsd simulator integration tests", tests, ARRAY_SIZE(tests));
}
