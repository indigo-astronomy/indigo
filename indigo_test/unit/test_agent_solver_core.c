// Copyright (c) 2026 INDIGO initiative
// All rights reserved.
//
// You may use this software under the terms of 'INDIGO Astronomy
// open-source license' (see LICENSE.md).
//
// THIS SOFTWARE IS PROVIDED BY THE AUTHORS 'AS IS' AND ANY EXPRESS
// OR IMPLIED WARRANTIES, INCLUDING, BUT NOT LIMITED TO, THE IMPLIED
// WARRANTIES OF MERCHANTABILITY AND FITNESS FOR A PARTICULAR PURPOSE
// ARE DISCLAIMED. IN NO EVENT SHALL THE AUTHOR BE LIABLE FOR ANY
// DIRECT, INDIRECT, INCIDENTAL, SPECIAL, EXEMPLARY, OR CONSEQUENTIAL
// DAMAGES (INCLUDING, BUT NOT LIMITED TO, PROCUREMENT OF SUBSTITUTE
// GOODS OR SERVICES; LOSS OF USE, DATA, OR PROFITS; OR BUSINESS
// INTERRUPTION) HOWEVER CAUSED AND ON ANY THEORY OF LIABILITY,
// WHETHER IN CONTRACT, STRICT LIABILITY, OR TORT (INCLUDING
// NEGLIGENCE OR OTHERWISE) ARISING IN ANY WAY OUT OF THE USE OF THIS
// SOFTWARE, EVEN IF ADVISED OF THE POSSIBILITY OF SUCH DAMAGE.

// Code is generated by AI

/** Unit tests of the quad based plate solver core used by indigo_agent_solver:
 tangent plane projection, quad code invariance, index file format, image loading and binning and a synthetic
 end-to-end solve.
 \file test_agent_solver_core.c
 */

#include <stdio.h>
#include <stdlib.h>
#include <string.h>
#include <unistd.h>
#include <math.h>

#include <indigo/indigo_bus.h>
#include <indigo/indigo_timer.h>

#include "indigo_drivers/agent_solver/indigo_solver.h"
#include "../test_runner.h"

// deterministic pseudo random numbers, the tests never depend on the platform rand()
static uint32_t rng_state = 20261027;

static float frand(void) {
	rng_state = rng_state * 1664525u + 1013904223u;
	return (rng_state >> 8) / (float)(1u << 24);
}

// --------------------------------------------------------------------------------

static void test_tangent_plane_roundtrip(void) {
	float ra0 = 97.9 * DEG_TO_RAD, dec0 = 5.1 * DEG_TO_RAD;
	for (int i = 0; i < 100; i++) {
		float ra = ra0 + (frand() - 0.5) * 6 * DEG_TO_RAD;
		float dec = dec0 + (frand() - 0.5) * 6 * DEG_TO_RAD;
		float xi, eta, ra_back, dec_back;
		ASSERT_TRUE(indigo_radec_to_tangent(ra0, dec0, ra, dec, &xi, &eta));
		indigo_tangent_to_radec(ra0, dec0, xi, eta, &ra_back, &dec_back);
		ASSERT_TRUE(fabs(ra_back - ra) < 1e-6);
		ASSERT_TRUE(fabs(dec_back - dec) < 1e-6);
	}
	// a point on the far hemisphere has no projection
	float xi, eta;
	ASSERT_FALSE(indigo_radec_to_tangent(ra0, dec0, ra0 + M_PI, -dec0, &xi, &eta));
	// RA wraps around 0/360
	ASSERT_TRUE(indigo_radec_to_tangent(0.5 * DEG_TO_RAD, 0, 359.5 * DEG_TO_RAD, 0, &xi, &eta));
	ASSERT_TRUE(fabs(xi + 1.0 * DEG_TO_RAD) < 1e-5);
}

static void test_hash_components_roundtrip(void) {
	uint64_t hash = indigo_solver_quad_hash(123, 456, 789, -321);
	int x3, y3, x4, y4;
	indigo_solver_quad_hash_components(hash, &x3, &y3, &x4, &y4);
	ASSERT_EQ_INT(123, x3);
	ASSERT_EQ_INT(456, y3);
	ASSERT_EQ_INT(789, x4);
	ASSERT_EQ_INT(-321, y4);
	// out of range components are clamped, so the (x3, y3) bucket key stays valid
	indigo_solver_quad_hash_components(indigo_solver_quad_hash(-5, 2000, 1001, -2000), &x3, &y3, &x4, &y4);
	ASSERT_EQ_INT(0, x3);
	ASSERT_EQ_INT(INDIGO_SOLVER_CODE_QUANTUM, y3);
	ASSERT_EQ_INT(INDIGO_SOLVER_CODE_QUANTUM, x4);
	ASSERT_EQ_INT(-INDIGO_SOLVER_CODE_QUANTUM, y4);
}

// the code of a quad must not change under translation, rotation, scaling and mirroring of the image
static void test_quad_code_invariance(void) {
	int exact = 0;
	for (int n = 0; n < 300; n++) {
		indigo_solver_star a[4], b[4];
		float angle = frand() * 2 * M_PI, scale = 0.3 + 2 * frand(), tx = frand() * 1000, ty = frand() * 1000;
		bool mirror = frand() < 0.5;
		for (int i = 0; i < 4; i++) {
			memset(a + i, 0, sizeof(indigo_solver_star));
			a[i].x = frand() * 500;
			a[i].y = frand() * 500;
			float x = mirror ? -a[i].x : a[i].x;
			b[i] = a[i];
			b[i].x = tx + scale * (x * cos(angle) - a[i].y * sin(angle));
			b[i].y = ty + scale * (x * sin(angle) + a[i].y * cos(angle));
		}
		indigo_solver_quad qa, qb;
		indigo_solver_make_quad(&qa, a, a + 1, a + 2, a + 3);
		indigo_solver_make_quad(&qb, b, b + 1, b + 2, b + 3);
		int ax3, ay3, ax4, ay4, bx3, by3, bx4, by4;
		indigo_solver_quad_hash_components(qa.hash, &ax3, &ay3, &ax4, &ay4);
		indigo_solver_quad_hash_components(qb.hash, &bx3, &by3, &bx4, &by4);
		// rounding at a quantisation boundary or an ambiguous ordering may move the code by one quantum,
		// which the matching tolerance covers; the variants of the ambiguous codes must contain the other one
		bool close = abs(ax3 - bx3) <= 1 && abs(ay3 - by3) <= 1 && abs(ax4 - bx4) <= 1 && abs(ay4 - by4) <= 1;
		if (!close) {
			indigo_solver_quad variants[INDIGO_SOLVER_MAX_QUAD_VARIANTS];
			int count = indigo_solver_make_quad_variants(variants, INDIGO_SOLVER_MAX_QUAD_VARIANTS, a, a + 1, a + 2, a + 3);
			for (int i = 0; i < count && !close; i++) {
				int vx3, vy3, vx4, vy4;
				indigo_solver_quad_hash_components(variants[i].hash, &vx3, &vy3, &vx4, &vy4);
				close = abs(vx3 - bx3) <= 1 && abs(vy3 - by3) <= 1 && abs(vx4 - bx4) <= 1 && abs(vy4 - by4) <= 1;
			}
		}
		ASSERT_TRUE(close);
		ASSERT_TRUE(fabs(qb.baseline / qa.baseline - scale) < 1e-3 * scale);
		if (qa.hash == qb.hash) {
			exact++;
		}
	}
	ASSERT_TRUE(exact > 150);
}

static void test_quad_variants_canonical_first(void) {
	for (int n = 0; n < 200; n++) {
		indigo_solver_star s[4];
		for (int i = 0; i < 4; i++) {
			memset(s + i, 0, sizeof(indigo_solver_star));
			s[i].x = frand() * 500;
			s[i].y = frand() * 500;
		}
		indigo_solver_quad canonical, variants[INDIGO_SOLVER_MAX_QUAD_VARIANTS];
		indigo_solver_make_quad(&canonical, s, s + 1, s + 2, s + 3);
		int count = indigo_solver_make_quad_variants(variants, INDIGO_SOLVER_MAX_QUAD_VARIANTS, s, s + 1, s + 2, s + 3);
		ASSERT_TRUE(count >= 1 && count <= INDIGO_SOLVER_MAX_QUAD_VARIANTS);
		ASSERT_TRUE(variants[0].hash == canonical.hash);
		for (int i = 1; i < count; i++) {
			ASSERT_TRUE(variants[i].hash != variants[0].hash);
		}
		// the code lies in the lens between P1 = (0, 0) and P2 = (1, 0), mirrored to y3 >= 0
		ASSERT_TRUE(canonical.x3 >= -1e-5 && canonical.x3 <= 1 + 1e-5);
		ASSERT_TRUE(canonical.x4 >= -1e-5 && canonical.x4 <= 1 + 1e-5);
		ASSERT_TRUE(canonical.y3 >= -1e-5);
	}
}

static bool write_bytes(const char *path, const void *data, size_t size) {
	FILE *file = fopen(path, "wb");
	if (file == NULL) {
		return false;
	}
	bool ok = fwrite(data, 1, size, file) == size;
	return fclose(file) == 0 && ok;
}

static void test_index_file_roundtrip(void) {
	char path[] = "/tmp/indigo_test_solver_index_XXXXXX";
	int fd = mkstemp(path);
	ASSERT_TRUE(fd >= 0);
	close(fd);
	indigo_solver_star stars[3] = { { 0 } };
	stars[0].ra = 0.1f;
	stars[0].dec = -0.2f;
	stars[1].ra = 1.5f;
	stars[1].dec = 0.7f;
	stars[2].ra = 6.2f;
	stars[2].dec = -1.4f;
	indigo_solver_quad quads[2] = { { 0 } };
	quads[0].hash = 0x03E8000003E8FC18ull;
	quads[0].baseline = 0.25f;
	quads[0].stars[0] = stars + 2;
	quads[0].stars[1] = stars + 1;
	quads[0].stars[2] = stars;
	quads[0].stars[3] = stars + 1;
	quads[1].hash = 0x0001000200030004ull;
	quads[1].baseline = 123.5f;
	quads[1].stars[0] = stars;
	quads[1].stars[1] = stars + 1;
	quads[1].stars[2] = stars + 2;
	quads[1].stars[3] = stars;
	// a quad referencing a star outside of the catalog is refused
	indigo_solver_star outside = { 0 };
	quads[1].stars[3] = &outside;
	indigo_solver_catalog built;
	ASSERT_FALSE(indigo_solver_catalog_build(stars, 3, quads, 2, 5, &built));
	ASSERT_TRUE(built.stars == NULL && built.hashes == NULL);
	quads[1].stars[3] = stars;
	ASSERT_TRUE(indigo_solver_catalog_build(stars, 3, quads, 2, 5, &built));
	ASSERT_TRUE(indigo_solver_write_index(path, &built));
	indigo_solver_free_catalog(&built);
	FILE *file = fopen(path, "rb");
	ASSERT_TRUE(file != NULL);
	fseek(file, 0, SEEK_END);
	// header, stars, bucket table, hashes, baselines and quad stars, all on multiples of 8 here
	ASSERT_EQ_INT(INDIGO_SOLVER_INDEX_HEADER_SIZE + 3 * 8 + (INDIGO_SOLVER_BUCKET_COUNT + 1) * 4 + 2 * 8 + 2 * 4 + 2 * 16, (int)ftell(file));
	size_t size = (size_t)ftell(file);
	fseek(file, 0, SEEK_SET);
	uint8_t *original = malloc(size);
	ASSERT_TRUE(fread(original, 1, size, file) == size);
	fseek(file, 0, SEEK_SET);
	indigo_solve_index_header header;
	ASSERT_TRUE(indigo_solver_index_read_header(file, &header));
	ASSERT_TRUE(header.version == INDIGO_SOLVER_INDEX_VERSION && header.fov == 5 && header.star_count == 3 && header.quad_count == 2);
	fclose(file);
	indigo_solver_catalog loaded;
	ASSERT_TRUE(indigo_solver_load_index(path, &loaded));
	ASSERT_EQ_INT(3, loaded.star_count);
	ASSERT_EQ_INT(2, loaded.quad_count);
	ASSERT_TRUE(loaded.fov == 5 && loaded.mapping != NULL);
	ASSERT_TRUE(loaded.stars[1].ra == 1.5f && loaded.stars[2].dec == -1.4f);
	// the unsorted quads are sorted by hash, the baselines and stars follow their quads
	ASSERT_TRUE(loaded.hashes[0] < loaded.hashes[1]);
	ASSERT_TRUE(loaded.hashes[0] == quads[1].hash && loaded.baselines[0] == quads[1].baseline);
	ASSERT_TRUE(loaded.quad_stars[0] == 0 && loaded.quad_stars[1] == 1 && loaded.quad_stars[4] == 2);
	ASSERT_TRUE(loaded.buckets[0] == 0 && loaded.buckets[INDIGO_SOLVER_BUCKET_COUNT] == 2);
	indigo_solver_free_catalog(&loaded);
	ASSERT_TRUE(loaded.stars == NULL && loaded.quad_count == 0 && loaded.mapping == NULL);
	indigo_solver_free_catalog(&loaded);
	// version 1, another version or a wrong magic is rejected
	uint32_t versions[2] = { 1, 99 };
	for (int i = 0; i < 2; i++) {
		memcpy(original + 4, versions + i, 4);
		ASSERT_TRUE(write_bytes(path, original, size));
		file = fopen(path, "rb");
		ASSERT_FALSE(indigo_solver_index_read_header(file, &header));
		fclose(file);
		ASSERT_FALSE(indigo_solver_load_index(path, &loaded));
		ASSERT_TRUE(loaded.stars == NULL && loaded.mapping == NULL);
	}
	uint32_t version = INDIGO_SOLVER_INDEX_VERSION;
	memcpy(original + 4, &version, 4);
	memcpy(original, "FITS", 4);
	ASSERT_TRUE(write_bytes(path, original, size));
	ASSERT_FALSE(indigo_solver_load_index(path, &loaded));
	free(original);
	unlink(path);
}

static void test_index_selection(void) {
	char dir[] = "/tmp/indigo_test_solver_dir_XXXXXX";
	ASSERT_TRUE(mkdtemp(dir) != NULL);
	char path[PATH_MAX], selected[PATH_MAX];
	float fov;
	// no files: nothing to select
	ASSERT_FALSE(indigo_solver_select_index(dir, indigo_solver_index_fovs, INDIGO_SOLVER_INDEX_FOV_COUNT, 3 * DEG_TO_RAD, 2 * DEG_TO_RAD, selected, sizeof(selected), &fov));
	float present[] = { 2, 5, 20 };
	for (int i = 0; i < 3; i++) {
		indigo_solver_index_path(path, sizeof(path), dir, present[i]);
		FILE *file = fopen(path, "wb");
		ASSERT_TRUE(file != NULL);
		fclose(file);
	}
	// 3.75 x 2.8 degrees: 0.7 x geometric mean is 2.27, the nearest present index is 2
	ASSERT_TRUE(indigo_solver_select_index(dir, present, 3, 3.75 * DEG_TO_RAD, 2.8 * DEG_TO_RAD, selected, sizeof(selected), &fov));
	ASSERT_TRUE(fov == 2);
	indigo_solver_index_path(path, sizeof(path), dir, 2);
	ASSERT_TRUE(strcmp(path, selected) == 0);
	// a 10 x 8 degree field selects 5 (6.3), a 30 x 20 degree field 20 (17.1), a tiny field the smallest present one
	ASSERT_TRUE(indigo_solver_select_index(dir, present, 3, 10 * DEG_TO_RAD, 8 * DEG_TO_RAD, selected, sizeof(selected), &fov) && fov == 5);
	ASSERT_TRUE(indigo_solver_select_index(dir, present, 3, 30 * DEG_TO_RAD, 20 * DEG_TO_RAD, selected, sizeof(selected), &fov) && fov == 20);
	ASSERT_TRUE(indigo_solver_select_index(dir, present, 3, 0.5 * DEG_TO_RAD, 0.3 * DEG_TO_RAD, selected, sizeof(selected), &fov) && fov == 2);
	// only the given FOVs are considered
	float only_20[] = { 20 };
	ASSERT_TRUE(indigo_solver_select_index(dir, only_20, 1, 3.75 * DEG_TO_RAD, 2.8 * DEG_TO_RAD, selected, sizeof(selected), &fov) && fov == 20);
	for (int i = 0; i < 3; i++) {
		indigo_solver_index_path(path, sizeof(path), dir, present[i]);
		unlink(path);
	}
	// the 0.5 degree scale (a Gaia index): the index nearest to 0.7 x the geometric mean of the field is selected, 0.5
	// for 0.3 x 0.25, 0.6 x 0.45 and 1 x 0.75 degrees (0.61, on frames of 1.03 x 0.69 degrees the 1 degree index does
	// not solve) as well as 0.71 x 0.71 degrees, 1 for 1.9 x 1.27 degrees (1.09, the 2 degree index does not solve it)
	float narrow[] = { 0.5, 1 };
	for (int i = 0; i < 2; i++) {
		indigo_solver_index_path(path, sizeof(path), dir, narrow[i]);
		FILE *file = fopen(path, "wb");
		ASSERT_TRUE(file != NULL);
		fclose(file);
	}
	ASSERT_TRUE(strstr(path, "index-01deg-tyc2.isix") != NULL);
	indigo_solver_index_path(path, sizeof(path), dir, 0.5);
	ASSERT_TRUE(strstr(path, "index-00.5deg-gaia.isix") != NULL);
	ASSERT_TRUE(strcmp(indigo_solver_index_catalog(0.5), "gaia") == 0 && strcmp(indigo_solver_index_catalog(1), "tyc2") == 0);
	ASSERT_TRUE(indigo_solver_select_index(dir, narrow, 2, 0.3 * DEG_TO_RAD, 0.25 * DEG_TO_RAD, selected, sizeof(selected), &fov) && fov == 0.5);
	ASSERT_TRUE(indigo_solver_select_index(dir, narrow, 2, 0.6 * DEG_TO_RAD, 0.45 * DEG_TO_RAD, selected, sizeof(selected), &fov) && fov == 0.5);
	ASSERT_TRUE(indigo_solver_select_index(dir, narrow, 2, 1 * DEG_TO_RAD, 0.75 * DEG_TO_RAD, selected, sizeof(selected), &fov) && fov == 0.5);
	ASSERT_TRUE(indigo_solver_select_index(dir, narrow, 2, 0.71 * DEG_TO_RAD, 0.71 * DEG_TO_RAD, selected, sizeof(selected), &fov) && fov == 0.5);
	ASSERT_TRUE(indigo_solver_select_index(dir, narrow, 2, 1.9 * DEG_TO_RAD, 1.27 * DEG_TO_RAD, selected, sizeof(selected), &fov) && fov == 1);
	ASSERT_TRUE(indigo_solver_index_fovs[0] == 0.2f && indigo_solver_index_fovs[1] == 0.5 && INDIGO_SOLVER_INDEX_FOV_COUNT == 7);
	for (int i = 0; i < 2; i++) {
		indigo_solver_index_path(path, sizeof(path), dir, narrow[i]);
		unlink(path);
	}
	// the 0.2 degree Gaia index: 0.2 for 0.3 x 0.25 and 0.4 x 0.4 degrees, 0.5 for 0.5 x 0.45 degrees (the boundary is
	// 0.45 degrees, 0.7 x 0.45 being the geometric mean of 0.2 and 0.5)
	float gaia[] = { 0.2, 0.5 };
	for (int i = 0; i < 2; i++) {
		indigo_solver_index_path(path, sizeof(path), dir, gaia[i]);
		FILE *file = fopen(path, "wb");
		ASSERT_TRUE(file != NULL);
		fclose(file);
	}
	indigo_solver_index_path(path, sizeof(path), dir, 0.2);
	ASSERT_TRUE(strstr(path, "index-00.2deg-gaia.isix") != NULL && strcmp(indigo_solver_index_catalog(0.2), "gaia") == 0);
	ASSERT_TRUE(indigo_solver_select_index(dir, gaia, 2, 0.3 * DEG_TO_RAD, 0.25 * DEG_TO_RAD, selected, sizeof(selected), &fov) && fov == 0.2f);
	ASSERT_TRUE(indigo_solver_select_index(dir, gaia, 2, 0.4 * DEG_TO_RAD, 0.4 * DEG_TO_RAD, selected, sizeof(selected), &fov) && fov == 0.2f);
	ASSERT_TRUE(indigo_solver_select_index(dir, gaia, 2, 0.5 * DEG_TO_RAD, 0.45 * DEG_TO_RAD, selected, sizeof(selected), &fov) && fov == 0.5);
	char label[64];
	indigo_solver_index_label(0.2, label, sizeof(label));
	ASSERT_TRUE(strcmp(label, "0.2° Gaia DR3 (FOV 0.2° - 0.45°)") == 0);
	for (int i = 0; i < 2; i++) {
		indigo_solver_index_path(path, sizeof(path), dir, gaia[i]);
		unlink(path);
	}
	rmdir(dir);
}

// --------------------------------------------------------------------------------

#define CATALOG_STAR_COUNT	28
#define IMAGE_WIDTH					1600
#define IMAGE_HEIGHT				1200
#define CATALOG_SCALE				(16 * ARCSEC_TO_RAD)

typedef struct {
	float ra0, dec0;
	indigo_solver_star catalog[CATALOG_STAR_COUNT];
	indigo_solver_quad *quads;
	int quad_count;
	indigo_solver_catalog index;
} synthetic_catalog;

// Random stars around the field centre, quads built the way the indexer does: projected around a tangent point
// near the field, every four of them with all variants, sorted by hash
static void build_synthetic_catalog(synthetic_catalog *c) {
	c->ra0 = 97.9 * DEG_TO_RAD;
	c->dec0 = 5.1 * DEG_TO_RAD;
	for (int i = 0; i < CATALOG_STAR_COUNT; i++) {
		memset(c->catalog + i, 0, sizeof(indigo_solver_star));
		c->catalog[i].id = i;
		c->catalog[i].ra = c->ra0 + (frand() - 0.5) * 3.2 * DEG_TO_RAD;
		c->catalog[i].dec = c->dec0 + (frand() - 0.5) * 2.4 * DEG_TO_RAD;
		ASSERT_TRUE(indigo_radec_to_xy(c->ra0, c->dec0 + 0.4 * DEG_TO_RAD, 0, CATALOG_SCALE, 1000, 1000, -1, c->catalog[i].ra, c->catalog[i].dec, &c->catalog[i].x, &c->catalog[i].y));
	}
	int capacity = 40000;
	c->quads = malloc(capacity * sizeof(indigo_solver_quad));
	c->quad_count = 0;
	for (int i = 0; i < CATALOG_STAR_COUNT; i++) {
		for (int j = i + 1; j < CATALOG_STAR_COUNT; j++) {
			for (int k = j + 1; k < CATALOG_STAR_COUNT; k++) {
				for (int l = k + 1; l < CATALOG_STAR_COUNT; l++) {
					if (c->quad_count + INDIGO_SOLVER_MAX_QUAD_VARIANTS > capacity) {
						capacity *= 2;
						c->quads = realloc(c->quads, capacity * sizeof(indigo_solver_quad));
					}
					c->quad_count += indigo_solver_make_quad_variants(c->quads + c->quad_count, INDIGO_SOLVER_MAX_QUAD_VARIANTS, c->catalog + i, c->catalog + j, c->catalog + k, c->catalog + l);
				}
			}
		}
	}
	ASSERT_TRUE(indigo_solver_catalog_build(c->catalog, CATALOG_STAR_COUNT, c->quads, c->quad_count, 5, &c->index));
}

static void free_synthetic_catalog(synthetic_catalog *c) {
	indigo_solver_free_catalog(&c->index);
	free(c->quads);
	free(c);
}

// Solves a synthetic image of the catalog and checks the solution reproduces the star positions
// Renders the catalog with the given WCS angle and parity (astrometry.net convention) and expects them back
static void solve_synthetic_image(synthetic_catalog *c, float ra_center, float dec_center, float angle, float scale, int parity_in) {
	indigo_solver_star image_stars[CATALOG_STAR_COUNT];
	int star_count = 0;
	for (int i = 0; i < CATALOG_STAR_COUNT; i++) {
		float x, y;
		if (indigo_radec_to_xy(ra_center, dec_center, angle, scale, IMAGE_WIDTH, IMAGE_HEIGHT, parity_in, c->catalog[i].ra, c->catalog[i].dec, &x, &y) && x >= 0 && x < IMAGE_WIDTH && y >= 0 && y < IMAGE_HEIGHT) {
			memset(image_stars + star_count, 0, sizeof(indigo_solver_star));
			image_stars[star_count].x = x + (frand() - 0.5) * 0.4;
			image_stars[star_count].y = y + (frand() - 0.5) * 0.4;
			image_stars[star_count].magnitude = frand();
			star_count++;
		}
	}
	ASSERT_TRUE(star_count >= 10);
	int max_quads = 200000;
	indigo_solver_quad *image_quads = malloc(max_quads * sizeof(indigo_solver_quad));
	int used = 0;
	int quad_count = indigo_solver_build_image_quads(image_stars, star_count, IMAGE_WIDTH, IMAGE_HEIGHT, IMAGE_WIDTH / 10, &used, image_quads, max_quads);
	ASSERT_TRUE(quad_count > 0);
	int max_matches = 200000;
	indigo_solver_quad_match *quad_matches = malloc(max_matches * sizeof(indigo_solver_quad_match));
	int quad_match_count = indigo_solver_match_quads(image_quads, quad_count, &c->index, quad_matches, max_matches, NULL);
	ASSERT_TRUE(quad_match_count > 0);
	indigo_solver_star_match star_matches[1000];
	int star_match_count = indigo_solver_match_stars(quad_matches, quad_match_count, star_matches, 1000, NULL);
	ASSERT_TRUE(star_match_count >= 4);
	float ra, dec, rotation, pixel;
	int parity;
	int matched = 0;
	float rms = 0;
	ASSERT_TRUE(indigo_solver_compute_center(star_matches, star_match_count, IMAGE_WIDTH, IMAGE_HEIGHT, &ra, &dec, &rotation, &pixel, &parity, &matched, &rms));
	ASSERT_TRUE(matched >= 6);
	ASSERT_TRUE(rms < 3 * pixel);
	ASSERT_TRUE(indigo_angular_distance(ra, dec, ra_center, dec_center) < 5 * ARCSEC_TO_RAD);
	ASSERT_TRUE(fabs(pixel / scale - 1) < 0.002);
	ASSERT_EQ_INT(parity_in, parity);
	ASSERT_TRUE(fabs(remainder(rotation - angle, 2 * M_PI)) < 0.2 * DEG_TO_RAD);
	// the solution maps the catalog back onto the detected stars
	int reprojected = 0;
	for (int i = 0; i < star_match_count; i++) {
		float x, y;
		ASSERT_TRUE(indigo_radec_to_xy(ra, dec, rotation, pixel, IMAGE_WIDTH, IMAGE_HEIGHT, parity, star_matches[i].catalog_star->ra, star_matches[i].catalog_star->dec, &x, &y));
		if (hypot(x - star_matches[i].image_star->x, y - star_matches[i].image_star->y) < 1.5) {
			reprojected++;
		}
	}
	ASSERT_TRUE(reprojected >= 8);
	free(quad_matches);
	free(image_quads);
}

static void test_solve_synthetic_field(void) {
	synthetic_catalog *c = malloc(sizeof(synthetic_catalog));
	build_synthetic_catalog(c);
	ASSERT_TRUE(c->quad_count > 1000);
	solve_synthetic_image(c, c->ra0 + 0.15 * DEG_TO_RAD, c->dec0 - 0.1 * DEG_TO_RAD, 33 * DEG_TO_RAD, 8 * ARCSEC_TO_RAD, -1);
	free_synthetic_catalog(c);
}

static void test_solve_synthetic_mirrored_field(void) {
	synthetic_catalog *c = malloc(sizeof(synthetic_catalog));
	build_synthetic_catalog(c);
	solve_synthetic_image(c, c->ra0 - 0.2 * DEG_TO_RAD, c->dec0 + 0.25 * DEG_TO_RAD, 197 * DEG_TO_RAD, 7 * ARCSEC_TO_RAD, 1);
	free_synthetic_catalog(c);
}

static bool same_catalog(const indigo_solver_catalog *a, const indigo_solver_catalog *b) {
	return a->fov == b->fov && a->star_count == b->star_count && a->quad_count == b->quad_count && memcmp(a->stars, b->stars, a->star_count * sizeof(indigo_solver_index_star)) == 0 && memcmp(a->buckets, b->buckets, (INDIGO_SOLVER_BUCKET_COUNT + 1) * sizeof(uint32_t)) == 0 && memcmp(a->hashes, b->hashes, a->quad_count * sizeof(uint64_t)) == 0 && memcmp(a->baselines, b->baselines, a->quad_count * sizeof(float)) == 0 && memcmp(a->quad_stars, b->quad_stars, a->quad_count * 4 * sizeof(uint32_t)) == 0;
}

// A catalog written as an index is mapped with the same contents, aligned sections and no copies, and solves the
// field like the catalog in memory
static void test_mapped_index_roundtrip(void) {
	synthetic_catalog *c = malloc(sizeof(synthetic_catalog));
	build_synthetic_catalog(c);
	char path[] = "/tmp/indigo_test_solver_mapped_XXXXXX";
	int fd = mkstemp(path);
	ASSERT_TRUE(fd >= 0);
	close(fd);
	ASSERT_TRUE(indigo_solver_write_index(path, &c->index));
	FILE *file = fopen(path, "rb");
	ASSERT_TRUE(file != NULL);
	indigo_solve_index_header header;
	ASSERT_TRUE(indigo_solver_index_read_header(file, &header));
	fclose(file);
	ASSERT_TRUE(header.version == INDIGO_SOLVER_INDEX_VERSION && header.fov == 5 && header.star_count == c->index.star_count && header.quad_count == c->index.quad_count);
	indigo_solver_catalog mapped;
	ASSERT_TRUE(indigo_solver_load_index(path, &mapped));
	ASSERT_TRUE(mapped.mapping != NULL && mapped.mapping_size > 0);
	for (int i = 0; i < 6; i++) {
		ASSERT_TRUE(mapped.allocated[i] == NULL);
	}
	ASSERT_TRUE(same_catalog(&mapped, &c->index));
	ASSERT_TRUE((uintptr_t)mapped.hashes % 8 == 0 && (uintptr_t)mapped.stars % 4 == 0 && (uintptr_t)mapped.buckets % 4 == 0 && (uintptr_t)mapped.baselines % 4 == 0 && (uintptr_t)mapped.quad_stars % 4 == 0);
	indigo_solver_catalog built = c->index;
	c->index = mapped;
	solve_synthetic_image(c, c->ra0 + 0.15 * DEG_TO_RAD, c->dec0 - 0.1 * DEG_TO_RAD, 33 * DEG_TO_RAD, 8 * ARCSEC_TO_RAD, -1);
	c->index = built;
	indigo_solver_free_catalog(&mapped);
	ASSERT_TRUE(mapped.mapping == NULL && mapped.quad_count == 0);
	unlink(path);
	free_synthetic_catalog(c);
}

// A damaged index is refused when it is mapped: truncated, another bucket side, a section outside of the
// file or misaligned, a bucket table not ending at the quad count; quads whose star indices lie outside of the
// catalog are loaded but never matched nor kept by the cone
static void test_mapped_index_rejects_damage(void) {
	synthetic_catalog *c = malloc(sizeof(synthetic_catalog));
	build_synthetic_catalog(c);
	char path[] = "/tmp/indigo_test_solver_damaged_XXXXXX";
	int fd = mkstemp(path);
	ASSERT_TRUE(fd >= 0);
	close(fd);
	ASSERT_TRUE(indigo_solver_write_index(path, &c->index));
	FILE *file = fopen(path, "rb");
	ASSERT_TRUE(file != NULL);
	fseek(file, 0, SEEK_END);
	size_t size = (size_t)ftell(file);
	fseek(file, 0, SEEK_SET);
	uint8_t *original = malloc(size), *damaged = malloc(size);
	ASSERT_TRUE(fread(original, 1, size, file) == size);
	fclose(file);
	uint64_t buckets_offset, quad_stars_offset;
	memcpy(&buckets_offset, original + 32, 8);
	memcpy(&quad_stars_offset, original + 56, 8);
	indigo_solver_catalog catalog;
	// truncated in the quad stars and in the header
	ASSERT_TRUE(write_bytes(path, original, size - 4));
	ASSERT_FALSE(indigo_solver_load_index(path, &catalog));
	ASSERT_TRUE(catalog.mapping == NULL && catalog.hashes == NULL);
	ASSERT_TRUE(write_bytes(path, original, 40));
	ASSERT_FALSE(indigo_solver_load_index(path, &catalog));
	// another bucket side
	memcpy(damaged, original, size);
	uint32_t side = INDIGO_SOLVER_BUCKET_SIDE - 1;
	memcpy(damaged + 20, &side, 4);
	ASSERT_TRUE(write_bytes(path, damaged, size));
	ASSERT_FALSE(indigo_solver_load_index(path, &catalog));
	// the stars beyond the end of the file, the hashes misaligned
	memcpy(damaged, original, size);
	uint64_t offset = size;
	memcpy(damaged + 24, &offset, 8);
	ASSERT_TRUE(write_bytes(path, damaged, size));
	ASSERT_FALSE(indigo_solver_load_index(path, &catalog));
	memcpy(damaged, original, size);
	memcpy(&offset, original + 40, 8);
	offset += 4;
	memcpy(damaged + 40, &offset, 8);
	ASSERT_TRUE(write_bytes(path, damaged, size));
	ASSERT_FALSE(indigo_solver_load_index(path, &catalog));
	// the bucket table not ending at the quad count
	memcpy(damaged, original, size);
	uint32_t end = c->index.quad_count + 1;
	memcpy(damaged + buckets_offset + 4 * INDIGO_SOLVER_BUCKET_COUNT, &end, 4);
	ASSERT_TRUE(write_bytes(path, damaged, size));
	ASSERT_FALSE(indigo_solver_load_index(path, &catalog));
	// every quad references a star outside of the catalog: loaded, but no match and an empty cone
	memcpy(damaged, original, size);
	uint32_t outside = c->index.star_count;
	for (uint32_t i = 0; i < 4 * c->index.quad_count; i++) {
		memcpy(damaged + quad_stars_offset + 4 * (size_t)i, &outside, 4);
	}
	ASSERT_TRUE(write_bytes(path, damaged, size));
	ASSERT_TRUE(indigo_solver_load_index(path, &catalog));
	indigo_solver_quad image_quads[8];
	for (int i = 0; i < 8; i++) {
		image_quads[i] = c->quads[i * 13];
	}
	indigo_solver_quad_match matches[64];
	ASSERT_EQ_INT(0, indigo_solver_match_quads(image_quads, 8, &catalog, matches, 64, NULL));
	// the intact catalog matches the same quads
	ASSERT_TRUE(indigo_solver_match_quads(image_quads, 8, &c->index, matches, 64, NULL) > 0);
	indigo_solver_catalog cone;
	ASSERT_TRUE(indigo_solver_cone_catalog(&catalog, c->ra0, c->dec0, 10 * DEG_TO_RAD, &cone) > 0);
	ASSERT_EQ_INT(0, indigo_solver_match_quads(image_quads, 8, &cone, matches, 64, NULL));
	indigo_solver_free_catalog(&cone);
	indigo_solver_free_catalog(&catalog);
	free(original);
	free(damaged);
	unlink(path);
	free_synthetic_catalog(c);
}

// The orientation astrometry.net derives from a CD matrix, written out independently of the solver: tan_get_orientation()
// in util/sip-utils.c of astrometry.net, in degrees from -180 to 180
static double astrometry_net_orientation(double cd00, double cd01, double cd10, double cd11) {
	double det = cd00 * cd11 - cd01 * cd10;
	double parity = det >= 0 ? 1 : -1;
	return -atan2(parity * cd10 - cd01, parity * cd00 + cd11) * RAD_TO_DEG;
}

// Matches generated from a known CD matrix (pixel offsets from the image centre to the tangent plane, a rotation by
// phi, mirrored or not) are solved with the angle astrometry.net reports for that matrix and the parity it reports:
// positive for a negative determinant, so the Solver and the Astrometry agents agree on every frame
static void test_compute_center_uses_astrometry_net_orientation(void) {
	const double phis[] = { -170, -98.19, -8.41, 0, 26.85, 90, 179.14 };
	const double scale = 2 * ARCSEC_TO_RAD;
	const float ra0 = 1.2f, dec0 = 0.5f;
	indigo_solver_star image[16];
	indigo_solver_index_star catalog[16];
	indigo_solver_star_match matches[16];
	for (unsigned p = 0; p < sizeof(phis) / sizeof(phis[0]); p++) {
		for (int mirror = 0; mirror < 2; mirror++) {
			double c = cos(phis[p] * DEG_TO_RAD), s = sin(phis[p] * DEG_TO_RAD), m = mirror ? -1 : 1;
			double cd00 = scale * c * m, cd01 = -scale * s, cd10 = scale * s * m, cd11 = scale * c;
			for (int i = 0; i < 16; i++) {
				memset(image + i, 0, sizeof(indigo_solver_star));
				memset(catalog + i, 0, sizeof(indigo_solver_index_star));
				image[i].x = 100 + frand() * (IMAGE_WIDTH - 200);
				image[i].y = 100 + frand() * (IMAGE_HEIGHT - 200);
				double dx = image[i].x - IMAGE_WIDTH / 2.0, dy = image[i].y - IMAGE_HEIGHT / 2.0;
				indigo_tangent_to_radec(ra0, dec0, cd00 * dx + cd01 * dy, cd10 * dx + cd11 * dy, &catalog[i].ra, &catalog[i].dec);
				matches[i].image_star = image + i;
				matches[i].catalog_star = catalog + i;
				matches[i].votes = 10;
			}
			float ra, dec, rotation, pixel;
			int parity;
			ASSERT_TRUE(indigo_solver_compute_center(matches, 16, IMAGE_WIDTH, IMAGE_HEIGHT, &ra, &dec, &rotation, &pixel, &parity, NULL, NULL));
			double expected = astrometry_net_orientation(cd00, cd01, cd10, cd11);
			if (fabs(remainder(rotation * RAD_TO_DEG - expected, 360)) >= 0.01) {
				fprintf(stderr, "phi %g mirrored %d: angle %.3f, astrometry.net %.3f\n", phis[p], mirror, rotation * RAD_TO_DEG, expected);
			}
			ASSERT_TRUE(fabs(remainder(rotation * RAD_TO_DEG - expected, 360)) < 0.01);
			ASSERT_TRUE(rotation >= 0 && rotation < 2 * M_PI);
			ASSERT_EQ_INT(cd00 * cd11 - cd01 * cd10 < 0 ? 1 : -1, parity);
			ASSERT_TRUE(fabs(pixel / scale - 1) < 1e-4);
			ASSERT_TRUE(indigo_angular_distance(ra, dec, ra0, dec0) < 0.1 * ARCSEC_TO_RAD);
		}
	}
}

static void test_solve_rejects_unrelated_field(void) {
	synthetic_catalog *c = malloc(sizeof(synthetic_catalog));
	build_synthetic_catalog(c);
	// stars that are not in the catalog must not produce a solution
	indigo_solver_star image_stars[20];
	for (int i = 0; i < 20; i++) {
		memset(image_stars + i, 0, sizeof(indigo_solver_star));
		image_stars[i].x = frand() * IMAGE_WIDTH;
		image_stars[i].y = frand() * IMAGE_HEIGHT;
		image_stars[i].magnitude = frand();
	}
	int max_quads = 200000;
	indigo_solver_quad *image_quads = malloc(max_quads * sizeof(indigo_solver_quad));
	int used = 0;
	int quad_count = indigo_solver_build_image_quads(image_stars, 20, IMAGE_WIDTH, IMAGE_HEIGHT, IMAGE_WIDTH / 10, &used, image_quads, max_quads);
	indigo_solver_quad_match *quad_matches = malloc(max_quads * sizeof(indigo_solver_quad_match));
	int quad_match_count = indigo_solver_match_quads(image_quads, quad_count, &c->index, quad_matches, max_quads, NULL);
	indigo_solver_star_match star_matches[1000];
	int star_match_count = indigo_solver_match_stars(quad_matches, quad_match_count, star_matches, 1000, NULL);
	float ra, dec, rotation, pixel;
	int parity;
	bool solved = indigo_solver_compute_center(star_matches, star_match_count, IMAGE_WIDTH, IMAGE_HEIGHT, &ra, &dec, &rotation, &pixel, &parity, NULL, NULL);
	if (solved) {
		// a chance fit of a few random matches is possible, it must not reproduce the catalog
		int reprojected = 0;
		for (int i = 0; i < star_match_count; i++) {
			float x, y;
			if (indigo_radec_to_xy(ra, dec, rotation, pixel, IMAGE_WIDTH, IMAGE_HEIGHT, parity, star_matches[i].catalog_star->ra, star_matches[i].catalog_star->dec, &x, &y) && hypot(x - star_matches[i].image_star->x, y - star_matches[i].image_star->y) < 1.5) {
				reprojected++;
			}
		}
		ASSERT_TRUE(reprojected < 8);
	}
	free(quad_matches);
	free(image_quads);
	free_synthetic_catalog(c);
}

// A deadline in the past and an abort flag stop the matching loops at once with the limit named; the cone filter
// keeps the quads around the field and none far away
static void test_match_respects_limits_and_cone(void) {
	synthetic_catalog *c = malloc(sizeof(synthetic_catalog));
	build_synthetic_catalog(c);
	indigo_solver_star image_stars[CATALOG_STAR_COUNT];
	int star_count = 0;
	for (int i = 0; i < CATALOG_STAR_COUNT; i++) {
		float x, y;
		if (indigo_radec_to_xy(c->ra0, c->dec0, 0.3f, 8 * ARCSEC_TO_RAD, IMAGE_WIDTH, IMAGE_HEIGHT, -1, c->catalog[i].ra, c->catalog[i].dec, &x, &y) && x >= 0 && x < IMAGE_WIDTH && y >= 0 && y < IMAGE_HEIGHT) {
			memset(image_stars + star_count, 0, sizeof(indigo_solver_star));
			image_stars[star_count].x = x;
			image_stars[star_count].y = y;
			image_stars[star_count].magnitude = frand();
			star_count++;
		}
	}
	int max_quads = 200000;
	indigo_solver_quad *image_quads = malloc(max_quads * sizeof(indigo_solver_quad));
	int used = 0;
	int quad_count = indigo_solver_build_image_quads(image_stars, star_count, IMAGE_WIDTH, IMAGE_HEIGHT, IMAGE_WIDTH / 10, &used, image_quads, max_quads);
	indigo_solver_quad_match *quad_matches = malloc(max_quads * sizeof(indigo_solver_quad_match));
	indigo_solver_limits limits = { 0 };
	limits.deadline = indigo_monotonic_time() - 1;
	ASSERT_EQ_INT(0, indigo_solver_match_quads(image_quads, quad_count, &c->index, quad_matches, max_quads, &limits));
	ASSERT_TRUE(limits.exceeded);
	ASSERT_TRUE(strcmp(limits.reason, "CPU time limit exceeded") == 0);
	volatile bool abort = true;
	memset(&limits, 0, sizeof(limits));
	limits.abort = &abort;
	ASSERT_EQ_INT(0, indigo_solver_match_quads(image_quads, quad_count, &c->index, quad_matches, max_quads, &limits));
	ASSERT_TRUE(limits.exceeded);
	ASSERT_TRUE(strcmp(limits.reason, "Aborted") == 0);
	indigo_solver_star_match star_matches[1000];
	ASSERT_EQ_INT(0, indigo_solver_match_stars(quad_matches, 1, star_matches, 1000, &limits));
	// a far deadline and a clear flag let the field solve
	memset(&limits, 0, sizeof(limits));
	limits.deadline = indigo_monotonic_time() + 60;
	abort = false;
	limits.abort = &abort;
	int quad_match_count = indigo_solver_match_quads(image_quads, quad_count, &c->index, quad_matches, max_quads, &limits);
	ASSERT_TRUE(quad_match_count > 0);
	ASSERT_FALSE(limits.exceeded);
	int star_match_count = indigo_solver_match_stars(quad_matches, quad_match_count, star_matches, 1000, &limits);
	ASSERT_TRUE(star_match_count >= 6);
	// the cone around the field marks its stars and shares the arrays of the catalog, a cone 30 degrees away marks none
	indigo_solver_catalog cone;
	int cone_count = indigo_solver_cone_catalog(&c->index, c->ra0, c->dec0, 3 * DEG_TO_RAD, &cone);
	ASSERT_TRUE(cone_count > 0 && cone_count <= (int)c->index.star_count);
	ASSERT_TRUE(cone.stars == c->index.stars && cone.hashes == c->index.hashes && cone.quad_stars == c->index.quad_stars && cone.quad_count == c->index.quad_count && cone.star_mask != NULL);
	int marked = 0;
	for (uint32_t i = 0; i < cone.star_count; i++) {
		bool inside = indigo_angular_distance(c->ra0, c->dec0, cone.stars[i].ra, cone.stars[i].dec) <= 3 * DEG_TO_RAD;
		ASSERT_TRUE((cone.star_mask[i] != 0) == inside);
		marked += inside;
	}
	ASSERT_EQ_INT(marked, cone_count);
	// the cone solves the field like the whole catalog, every matched catalog star is within the cone
	int cone_match_count = indigo_solver_match_quads(image_quads, quad_count, &cone, quad_matches, max_quads, NULL);
	ASSERT_TRUE(cone_match_count > 0);
	for (int i = 0; i < cone_match_count; i++) {
		for (int k = 0; k < 4; k++) {
			ASSERT_TRUE(cone.star_mask[quad_matches[i].catalog_stars[k] - cone.stars]);
		}
	}
	indigo_solver_free_catalog(&cone);
	// freeing the cone leaves the catalog intact
	ASSERT_TRUE(indigo_solver_match_quads(image_quads, quad_count, &c->index, quad_matches, max_quads, NULL) > 0);
	ASSERT_EQ_INT(0, indigo_solver_cone_catalog(&c->index, c->ra0 + 30 * DEG_TO_RAD, c->dec0, 3 * DEG_TO_RAD, &cone));
	ASSERT_EQ_INT(0, indigo_solver_match_quads(image_quads, quad_count, &cone, quad_matches, max_quads, NULL));
	indigo_solver_free_catalog(&cone);
	free(quad_matches);
	free(image_quads);
	free_synthetic_catalog(c);
}

// A noisy frame with faint gaussian stars, hot pixels, a hot column and a hot row: every star is detected at
// its position within 1.5 px (half the inlier limit of the fit), none of the defects is, and the frame is left as it was
#define NOISY_WIDTH 400
#define NOISY_HEIGHT 300
#define NOISY_STAR_COUNT 30
#define NOISY_HOT_COUNT 20

static void test_image_stars_noisy_frame(void) {
	size_t size = (size_t)NOISY_WIDTH * NOISY_HEIGHT;
	indigo_raw_header *image = indigo_safe_malloc(sizeof(indigo_raw_header) + size * sizeof(uint16_t));
	uint16_t *data = (uint16_t *)(image + 1);
	image->signature = INDIGO_RAW_MONO16;
	image->width = NOISY_WIDTH;
	image->height = NOISY_HEIGHT;
	// background 1000 with uniform noise over 250 ADU (sigma 72), stars of sigma 1.4 px peaking at 200 to 500 ADU
	// like the magnitude 8 to 9 stars of the CCD Guider Simulator at IMAGE_NOISE_VAR 250
	for (size_t i = 0; i < size; i++) {
		data[i] = 1000 + (uint16_t)(frand() * 250);
	}
	float star_x[NOISY_STAR_COUNT], star_y[NOISY_STAR_COUNT];
	for (int i = 0; i < NOISY_STAR_COUNT; i++) {
		bool clear;
		do {
			star_x[i] = 30 + frand() * (NOISY_WIDTH - 60);
			star_y[i] = 30 + frand() * (NOISY_HEIGHT - 60);
			clear = true;
			for (int j = 0; j < i; j++) {
				clear = clear && hypotf(star_x[i] - star_x[j], star_y[i] - star_y[j]) > 25;
			}
		} while (!clear);
		float peak = 200 + frand() * 300;
		for (int y = (int)star_y[i] - 8; y <= (int)star_y[i] + 8; y++) {
			for (int x = (int)star_x[i] - 8; x <= (int)star_x[i] + 8; x++) {
				float dx = x - star_x[i], dy = y - star_y[i];
				data[y * NOISY_WIDTH + x] += (uint16_t)(peak * expf(-(dx * dx + dy * dy) / 4));
			}
		}
	}
	int hot_x[NOISY_HOT_COUNT], hot_y[NOISY_HOT_COUNT];
	for (int i = 0; i < NOISY_HOT_COUNT; i++) {
		hot_x[i] = 20 + (int)(frand() * (NOISY_WIDTH - 40));
		hot_y[i] = 20 + (int)(frand() * (NOISY_HEIGHT - 40));
		data[hot_y[i] * NOISY_WIDTH + hot_x[i]] = 65535;
	}
	const int hot_column = 150, hot_row = 100;
	for (int y = 0; y < 200; y++) {
		data[y * NOISY_WIDTH + hot_column] = 65535;
	}
	for (int x = 0; x < 300; x++) {
		data[hot_row * NOISY_WIDTH + x] = 65535;
	}
	uint16_t *original = indigo_safe_malloc(size * sizeof(uint16_t));
	memcpy(original, data, size * sizeof(uint16_t));
	indigo_solver_star stars[100];
	int count = indigo_solver_image_stars(image, stars, 100);
	ASSERT_TRUE(memcmp(original, data, size * sizeof(uint16_t)) == 0);
	for (int i = 0; i < NOISY_STAR_COUNT; i++) {
		bool found = false;
		float nearest = 1e9;
		for (int j = 0; j < count; j++) {
			float d = hypotf(stars[j].x - star_x[i], stars[j].y - star_y[i]);
			found = found || d < 1.5;
			nearest = d < nearest ? d : nearest;
		}
		if (!found) {
			printf("  star %d at %.1f, %.1f not found, nearest detection %.2f px away, %d detections\n", i, star_x[i], star_y[i], nearest, count);
		}
		ASSERT_TRUE(found);
	}
	for (int j = 0; j < count; j++) {
		bool star = false;
		for (int i = 0; i < NOISY_STAR_COUNT; i++) {
			star = star || hypotf(stars[j].x - star_x[i], stars[j].y - star_y[i]) < 1.5;
		}
		ASSERT_TRUE(star);
	}
	indigo_safe_free(original);
	indigo_safe_free(image);
}

// Loading: the image comes back binned with the factor used and the size before binning; single plane FITS and RAW
// MONO16 images, binned while they are read, have the values of converting the image at full size and binning it

static void fits_card(char *card, const char *keyword, const char *value) {
	char text[81];
	snprintf(text, sizeof(text), "%-8s= %20s", keyword, value);
	memcpy(card, text, strlen(text));
}

// A FITS file in memory with the given cards and big endian pixels of bytes_per_pixel bytes, padded to whole records
static char *fits_file(const char *const *keywords, const char *const *values, int card_count, const uint8_t *pixels, size_t pixel_bytes, long *size) {
	size_t header = (((size_t)card_count + 1) * 80 + 2879) / 2880 * 2880;
	size_t data = (pixel_bytes + 2879) / 2880 * 2880;
	char *fits = indigo_safe_malloc(header + data);
	memset(fits, ' ', header);
	for (int i = 0; i < card_count; i++) {
		fits_card(fits + 80 * i, keywords[i], values[i]);
	}
	memcpy(fits + 80 * card_count, "END", 3);
	memcpy(fits + header, pixels, pixel_bytes);
	*size = (long)(header + data);
	return fits;
}

static char *fits_16bit(int width, int height, const uint16_t *values, bool bayer, long *size) {
	char naxis1[16], naxis2[16];
	snprintf(naxis1, sizeof(naxis1), "%d", width);
	snprintf(naxis2, sizeof(naxis2), "%d", height);
	const char *keywords[] = { "SIMPLE", "BITPIX", "NAXIS", "NAXIS1", "NAXIS2", "BZERO", "BSCALE", "BAYERPAT" };
	const char *card_values[] = { "T", "16", "2", naxis1, naxis2, "32768", "1", "'RGGB'" };
	uint8_t *pixels = indigo_safe_malloc((size_t)width * height * 2);
	for (int i = 0; i < width * height; i++) {
		int16_t stored = (int16_t)(values[i] - 32768);
		pixels[2 * i] = (uint8_t)((uint16_t)stored >> 8);
		pixels[2 * i + 1] = (uint8_t)((uint16_t)stored & 0xFF);
	}
	char *fits = fits_file(keywords, card_values, bayer ? 8 : 7, pixels, (size_t)width * height * 2, size);
	indigo_safe_free(pixels);
	return fits;
}

// the expected binned value: the mean of the bin x bin full size values, truncated
static uint16_t binned_value(const uint16_t *values, int width, int x, int y, int bin) {
	uint32_t sum = 0;
	for (int by = 0; by < bin; by++) {
		for (int bx = 0; bx < bin; bx++) {
			sum += values[(y * bin + by) * width + x * bin + bx];
		}
	}
	return (uint16_t)(sum / (bin * bin));
}

static void test_load_fits_16bit_binned_odd_size(void) {
	const int width = 7, height = 5;
	uint16_t values[7 * 5];
	for (int i = 0; i < width * height; i++) {
		values[i] = (uint16_t)(1000 + 1777 * i % 60000);
	}
	values[0] = 65535;
	values[1] = 0;
	long size;
	char *fits = fits_16bit(width, height, values, false, &size);
	for (int downsample = 1; downsample <= 3; downsample++) {
		int bin = 0, full_width = 0, full_height = 0;
		bool bayered = true;
		const char *message = NULL;
		indigo_raw_header *image = indigo_solver_load_image(fits, size, downsample, &bin, &full_width, &full_height, &bayered, &message);
		ASSERT_TRUE(image != NULL);
		ASSERT_FALSE(bayered);
		ASSERT_EQ_INT(downsample, bin);
		ASSERT_EQ_INT(width, full_width);
		ASSERT_EQ_INT(height, full_height);
		ASSERT_EQ_INT(width / bin, (int)image->width);
		ASSERT_EQ_INT(height / bin, (int)image->height);
		const uint16_t *pixels = (const uint16_t *)(image + 1);
		for (int y = 0; y < height / bin; y++) {
			for (int x = 0; x < width / bin; x++) {
				ASSERT_EQ_INT(binned_value(values, width, x, y, bin), pixels[y * (width / bin) + x]);
			}
		}
		indigo_safe_free(image);
	}
	indigo_safe_free(fits);
}

static void test_load_fits_scaled_binned_matches_full_size(void) {
	// BITPIX -32 with values outside 16 bits is mapped onto them, the binned image is the full size one binned
	const int width = 9, height = 7;
	const char *keywords[] = { "SIMPLE", "BITPIX", "NAXIS", "NAXIS1", "NAXIS2" };
	const char *card_values[] = { "T", "-32", "2", "9", "7" };
	uint8_t pixels[9 * 7 * 4];
	for (int i = 0; i < width * height; i++) {
		float value = -500.25f + 1637.5f * i;
		uint32_t bits;
		memcpy(&bits, &value, sizeof(bits));
		for (int k = 0; k < 4; k++) {
			pixels[4 * i + k] = (uint8_t)(bits >> (24 - 8 * k));
		}
	}
	long size;
	char *fits = fits_file(keywords, card_values, 5, pixels, sizeof(pixels), &size);
	int bin, full_width, full_height;
	bool bayered;
	const char *message = NULL;
	indigo_raw_header *full = indigo_solver_load_image(fits, size, 1, &bin, &full_width, &full_height, &bayered, &message);
	ASSERT_TRUE(full != NULL);
	ASSERT_EQ_INT(1, bin);
	const uint16_t *full_pixels = (const uint16_t *)(full + 1);
	ASSERT_EQ_INT(0, full_pixels[0]);
	ASSERT_EQ_INT(65535, full_pixels[width * height - 1]);
	indigo_raw_header *binned = indigo_solver_load_image(fits, size, 3, &bin, &full_width, &full_height, &bayered, &message);
	ASSERT_TRUE(binned != NULL);
	ASSERT_EQ_INT(3, bin);
	ASSERT_EQ_INT(width, full_width);
	ASSERT_EQ_INT(height, full_height);
	ASSERT_EQ_INT(3, (int)binned->width);
	ASSERT_EQ_INT(2, (int)binned->height);
	const uint16_t *binned_pixels = (const uint16_t *)(binned + 1);
	for (int y = 0; y < 2; y++) {
		for (int x = 0; x < 3; x++) {
			ASSERT_EQ_INT(binned_value(full_pixels, width, x, y, 3), binned_pixels[y * 3 + x]);
		}
	}
	indigo_safe_free(full);
	indigo_safe_free(binned);
	indigo_safe_free(fits);
}

static void test_load_bayer_binning(void) {
	// a Bayer mosaic is binned at least 2 x 2 and by an even factor, other images as requested and at least 1 x 1
	uint16_t values[8 * 8];
	for (int i = 0; i < 64; i++) {
		values[i] = (uint16_t)(100 * i);
	}
	const int requested[] = { 0, 1, 2, 3, 4 };
	const int mosaic[] = { 2, 2, 2, 4, 4 };
	const int mono[] = { 1, 1, 2, 3, 4 };
	for (int bayer = 0; bayer <= 1; bayer++) {
		long size;
		char *fits = fits_16bit(8, 8, values, bayer, &size);
		for (int i = 0; i < 5; i++) {
			int bin, full_width, full_height;
			bool bayered;
			const char *message = NULL;
			indigo_raw_header *image = indigo_solver_load_image(fits, size, requested[i], &bin, &full_width, &full_height, &bayered, &message);
			ASSERT_TRUE(image != NULL);
			ASSERT_EQ_INT(bayer, bayered);
			ASSERT_EQ_INT(bayer ? mosaic[i] : mono[i], bin);
			ASSERT_EQ_INT(8 / bin, (int)image->width);
			indigo_safe_free(image);
		}
		indigo_safe_free(fits);
	}
}

static void test_load_raw_mono16_binned(void) {
	const int width = 5, height = 5;
	size_t size = sizeof(indigo_raw_header) + width * height * sizeof(uint16_t);
	indigo_raw_header *raw = indigo_safe_malloc(size);
	raw->signature = INDIGO_RAW_MONO16;
	raw->width = width;
	raw->height = height;
	uint16_t *values = (uint16_t *)(raw + 1);
	for (int i = 0; i < width * height; i++) {
		values[i] = (uint16_t)(65535 - 2621 * i);
	}
	int bin, full_width, full_height;
	bool bayered;
	const char *message = NULL;
	indigo_raw_header *image = indigo_solver_load_image(raw, (long)size, 2, &bin, &full_width, &full_height, &bayered, &message);
	ASSERT_TRUE(image != NULL);
	ASSERT_EQ_INT(2, bin);
	ASSERT_EQ_INT(width, full_width);
	ASSERT_EQ_INT(height, full_height);
	ASSERT_EQ_INT(2, (int)image->width);
	ASSERT_EQ_INT(2, (int)image->height);
	const uint16_t *pixels = (const uint16_t *)(image + 1);
	for (int y = 0; y < 2; y++) {
		for (int x = 0; x < 2; x++) {
			ASSERT_EQ_INT(binned_value(values, width, x, y, 2), pixels[y * 2 + x]);
		}
	}
	indigo_safe_free(image);
	indigo_safe_free(raw);
}

// --------------------------------------------------------------------------------

int main(void) {
	indigo_test_case cases[] = {
		{ "tangent_plane_roundtrip", test_tangent_plane_roundtrip },
		{ "hash_components_roundtrip", test_hash_components_roundtrip },
		{ "quad_code_invariance", test_quad_code_invariance },
		{ "quad_variants_canonical_first", test_quad_variants_canonical_first },
		{ "index_file_roundtrip", test_index_file_roundtrip },
		{ "index_selection", test_index_selection },
		{ "solve_synthetic_field", test_solve_synthetic_field },
		{ "solve_synthetic_mirrored_field", test_solve_synthetic_mirrored_field },
		{ "mapped_index_roundtrip", test_mapped_index_roundtrip },
		{ "mapped_index_rejects_damage", test_mapped_index_rejects_damage },
		{ "compute_center_uses_astrometry_net_orientation", test_compute_center_uses_astrometry_net_orientation },
		{ "solve_rejects_unrelated_field", test_solve_rejects_unrelated_field },
		{ "image_stars_noisy_frame", test_image_stars_noisy_frame },
		{ "match_respects_limits_and_cone", test_match_respects_limits_and_cone },
		{ "load_fits_16bit_binned_odd_size", test_load_fits_16bit_binned_odd_size },
		{ "load_fits_scaled_binned_matches_full_size", test_load_fits_scaled_binned_matches_full_size },
		{ "load_bayer_binning", test_load_bayer_binning },
		{ "load_raw_mono16_binned", test_load_raw_mono16_binned },
	};
	return indigo_run_tests("test_agent_solver_core", cases, sizeof(cases) / sizeof(cases[0]));
}
