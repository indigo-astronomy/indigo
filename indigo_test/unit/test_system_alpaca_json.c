// Copyright (c) 2026 INDIGO initiative
// All rights reserved.
//
// You may use this software under the terms of 'INDIGO Astronomy
// open-source license' (see LICENSE.md).
//
// THIS SOFTWARE IS PROVIDED BY THE AUTHORS 'AS IS' AND ANY EXPRESS
// OR IMPLIED WARRANTIES, INCLUDING, BUT NOT LIMITED TO, THE IMPLIED
// WARRANTIES OF MERCHANTABILITY AND FITNESS FOR A PARTICULAR PURPOSE
// ARE DISCLAIMED. IN NO EVENT SHALL THE AUTHOR BE LIABLE FOR ANY
// DIRECT, INDIRECT, INCIDENTAL, SPECIAL, EXEMPLARY, OR CONSEQUENTIAL
// DAMAGES (INCLUDING, BUT NOT LIMITED TO, PROCUREMENT OF SUBSTITUTE
// GOODS OR SERVICES; LOSS OF USE, DATA, OR PROFITS; OR BUSINESS
// INTERRUPTION) HOWEVER CAUSED AND ON ANY THEORY OF LIABILITY,
// WHETHER IN CONTRACT, STRICT LIABILITY, OR TORT (INCLUDING
// NEGLIGENCE OR OTHERWISE) ARISING IN ANY WAY OUT OF THE USE OF THIS
// SOFTWARE, EVEN IF ADVISED OF THE POSSIBILITY OF SUCH DAMAGE.

// Code is generated by AI

// Unit tests of the JSON parser of the system_alpaca driver: the DOM parser, its accessors and the
// DOM-less scanner of the imagearray reply. The alpaca_*.json fixtures are written by hand from the
// ASCOM Alpaca API reference, they are not captured from a real server.

#include <float.h>
#include <locale.h>
#include <stdint.h>
#include <stdio.h>
#include <stdlib.h>
#include <string.h>
#include <time.h>

#include <indigo_drivers/system_alpaca/indigo_system_alpaca_json.h>

#include "../test_runner.h"

#ifndef ARRAY_SIZE
#define ARRAY_SIZE(array) ((int)(sizeof(array) / sizeof((array)[0])))
#endif

#define ASSERT_EQ_INT64(expected, actual) ASSERT_TRUE((int64_t)(expected) == (int64_t)(actual))

static char error[256];

// Every text is parsed from a heap copy of exactly its length, without a terminating NUL, which is released
// before the result is used: the sanitizer build then reports any read past the end of the text and any
// reference from the DOM back into it.
static char *exact_copy(const char *text, size_t length) {
	char *copy = malloc(length > 0 ? length : 1);
	if (copy != NULL && length > 0) {
		memcpy(copy, text, length);
	}
	return copy;
}

static alpaca_json_value *parse_bytes(const char *text, size_t length) {
	char *copy = exact_copy(text, length);
	alpaca_json_value *root = alpaca_json_parse(copy, length, error, sizeof(error));
	free(copy);
	return root;
}

static alpaca_json_value *parse_text(const char *text) {
	return parse_bytes(text, strlen(text));
}

static bool rejects_bytes(const char *text, size_t length) {
	alpaca_json_value *root = parse_bytes(text, length);
	if (root != NULL) {
		fprintf(stderr, "Unexpectedly accepted: %.*s\n", (int)length, text);
		alpaca_json_free(root);
		return false;
	}
	if (strstr(error, " at offset ") == NULL) {
		fprintf(stderr, "No error reported for: %.*s\n", (int)length, text);
		return false;
	}
	return true;
}

static bool rejects(const char *text) {
	return rejects_bytes(text, strlen(text));
}

static bool rejects_all(const char *const *texts, int count) {
	bool result = true;
	for (int i = 0; i < count; i++) {
		if (!rejects(texts[i])) {
			result = false;
		}
	}
	return result;
}

static long error_offset(void) {
	const char *offset = strstr(error, " at offset ");
	return offset != NULL ? atol(offset + 11) : -1;
}

static bool parses_double(const char *text, double expected) {
	double value = 0;
	alpaca_json_value *root = parse_text(text);
	bool result = alpaca_json_get_type(root) == ALPACA_JSON_NUMBER && alpaca_json_get_double(root, &value) && value == expected;
	if (!result) {
		fprintf(stderr, "%s: expected %.17g, got %.17g (%s)\n", text, expected, value, error);
	}
	alpaca_json_free(root);
	return result;
}

static bool parses_int(const char *text, int64_t expected) {
	int64_t value = 0;
	alpaca_json_value *root = parse_text(text);
	bool result = alpaca_json_get_type(root) == ALPACA_JSON_NUMBER && alpaca_json_get_int(root, &value) && value == expected;
	if (!result) {
		fprintf(stderr, "%s: expected %lld, got %lld (%s)\n", text, (long long)expected, (long long)value, error);
	}
	alpaca_json_free(root);
	return result;
}

static bool is_number_but_not_int(const char *text) {
	int64_t value = 12345;
	alpaca_json_value *root = parse_text(text);
	bool result = alpaca_json_get_type(root) == ALPACA_JSON_NUMBER && alpaca_json_get_double(root, NULL) && !alpaca_json_get_int(root, &value) && value == 12345;
	if (!result) {
		fprintf(stderr, "%s: expected a number without an integer value (%s)\n", text, error);
	}
	alpaca_json_free(root);
	return result;
}

static bool parses_string(const char *text, const char *expected, size_t expected_length) {
	const char *value = NULL;
	alpaca_json_value *root = parse_text(text);
	bool result = alpaca_json_get_type(root) == ALPACA_JSON_STRING && alpaca_json_get_string(root, &value) && alpaca_json_get_string_length(root) == expected_length && memcmp(value, expected, expected_length + 1) == 0;
	if (!result) {
		fprintf(stderr, "%s: expected \"%s\", got \"%s\" (%s)\n", text, expected, value != NULL ? value : "(null)", error);
	}
	alpaca_json_free(root);
	return result;
}

static char *read_fixture(const char *path, size_t *length) {
	FILE *file = fopen(path, "rb");
	if (file == NULL) {
		perror(path);
		return NULL;
	}
	fseek(file, 0, SEEK_END);
	long size = ftell(file);
	fseek(file, 0, SEEK_SET);
	char *buffer = malloc(size > 0 ? (size_t)size : 1);
	*length = fread(buffer, 1, (size_t)size, file);
	fclose(file);
	return buffer;
}

static alpaca_json_value *parse_fixture(const char *path) {
	size_t length = 0;
	char *text = read_fixture(path, &length);
	if (text == NULL) {
		return NULL;
	}
	alpaca_json_value *root = alpaca_json_parse(text, length, error, sizeof(error));
	if (root == NULL) {
		fprintf(stderr, "%s: %s\n", path, error);
	}
	free(text);
	return root;
}

static bool member_int_equals(const alpaca_json_value *object, const char *name, int64_t expected) {
	int64_t value = 0;
	return alpaca_json_get_int(alpaca_json_get(object, name), &value) && value == expected;
}

static bool member_string_equals(const alpaca_json_value *object, const char *name, const char *expected) {
	const char *value = NULL;
	return alpaca_json_get_string(alpaca_json_get(object, name), &value) && strcmp(value, expected) == 0;
}

static double seconds(void) {
	struct timespec now = { 0 };
	clock_gettime(CLOCK_MONOTONIC, &now);
	return (double)now.tv_sec + (double)now.tv_nsec / 1e9;
}

static void parses_scalar_documents_of_every_type(void) {
	bool boolean = false;
	alpaca_json_value *root = parse_text("null");
	ASSERT_TRUE(root != NULL);
	ASSERT_EQ_INT(ALPACA_JSON_NULL, alpaca_json_get_type(root));
	ASSERT_TRUE(alpaca_json_is_null(root));
	alpaca_json_free(root);
	root = parse_text("true");
	ASSERT_EQ_INT(ALPACA_JSON_BOOL, alpaca_json_get_type(root));
	ASSERT_TRUE(alpaca_json_get_bool(root, &boolean) && boolean);
	ASSERT_FALSE(alpaca_json_is_null(root));
	alpaca_json_free(root);
	root = parse_text("false");
	ASSERT_EQ_INT(ALPACA_JSON_BOOL, alpaca_json_get_type(root));
	ASSERT_TRUE(alpaca_json_get_bool(root, &boolean) && !boolean);
	alpaca_json_free(root);
	ASSERT_TRUE(parses_int("42", 42));
	ASSERT_TRUE(parses_double("-2.5", -2.5));
	ASSERT_TRUE(parses_string("\"text\"", "text", 4));
	root = parse_text("[]");
	ASSERT_EQ_INT(ALPACA_JSON_ARRAY, alpaca_json_get_type(root));
	alpaca_json_free(root);
	root = parse_text("{}");
	ASSERT_EQ_INT(ALPACA_JSON_OBJECT, alpaca_json_get_type(root));
	alpaca_json_free(root);
}

static void parses_nested_containers(void) {
	alpaca_json_value *root = parse_text("{\"a\":[1,[2,3,{\"b\":null}],\"x\"],\"c\":{\"d\":{\"e\":[true,false]}},\"f\":-7}");
	ASSERT_TRUE(root != NULL);
	ASSERT_EQ_INT(3, alpaca_json_size(root));
	const alpaca_json_value *a = alpaca_json_get(root, "a");
	ASSERT_EQ_INT(ALPACA_JSON_ARRAY, alpaca_json_get_type(a));
	ASSERT_EQ_INT(3, alpaca_json_size(a));
	ASSERT_TRUE(member_int_equals(root, "f", -7));
	int64_t integer = 0;
	ASSERT_TRUE(alpaca_json_get_int(alpaca_json_array_get(a, 0), &integer) && integer == 1);
	const alpaca_json_value *inner = alpaca_json_array_get(a, 1);
	ASSERT_EQ_INT(3, alpaca_json_size(inner));
	ASSERT_TRUE(alpaca_json_get_int(alpaca_json_array_get(inner, 1), &integer) && integer == 3);
	ASSERT_TRUE(alpaca_json_is_null(alpaca_json_get(alpaca_json_array_get(inner, 2), "b")));
	const char *string = NULL;
	ASSERT_TRUE(alpaca_json_get_string(alpaca_json_array_get(a, 2), &string));
	ASSERT_STREQ("x", string);
	const alpaca_json_value *e = alpaca_json_get(alpaca_json_get(alpaca_json_get(root, "c"), "d"), "e");
	bool boolean = false;
	ASSERT_EQ_INT(2, alpaca_json_size(e));
	ASSERT_TRUE(alpaca_json_get_bool(alpaca_json_array_get(e, 0), &boolean) && boolean);
	ASSERT_TRUE(alpaca_json_get_bool(alpaca_json_array_get(e, 1), &boolean) && !boolean);
	alpaca_json_free(root);
}

static void parses_empty_containers(void) {
	alpaca_json_value *root = parse_text("{\"a\":[],\"b\":{},\"c\":[[],{},[{}]],\"d\":\"\"}");
	ASSERT_TRUE(root != NULL);
	ASSERT_EQ_INT(4, alpaca_json_size(root));
	ASSERT_EQ_INT(ALPACA_JSON_ARRAY, alpaca_json_get_type(alpaca_json_get(root, "a")));
	ASSERT_EQ_INT(0, alpaca_json_size(alpaca_json_get(root, "a")));
	ASSERT_TRUE(alpaca_json_first(alpaca_json_get(root, "a")) == NULL);
	ASSERT_EQ_INT(ALPACA_JSON_OBJECT, alpaca_json_get_type(alpaca_json_get(root, "b")));
	ASSERT_EQ_INT(0, alpaca_json_size(alpaca_json_get(root, "b")));
	const alpaca_json_value *c = alpaca_json_get(root, "c");
	ASSERT_EQ_INT(3, alpaca_json_size(c));
	ASSERT_EQ_INT(ALPACA_JSON_ARRAY, alpaca_json_get_type(alpaca_json_array_get(c, 0)));
	ASSERT_EQ_INT(ALPACA_JSON_OBJECT, alpaca_json_get_type(alpaca_json_array_get(c, 1)));
	ASSERT_EQ_INT(1, alpaca_json_size(alpaca_json_array_get(c, 2)));
	ASSERT_EQ_INT(ALPACA_JSON_OBJECT, alpaca_json_get_type(alpaca_json_array_get(alpaca_json_array_get(c, 2), 0)));
	ASSERT_TRUE(parses_string("\"\"", "", 0));
	alpaca_json_free(root);
}

static void tolerates_whitespace_around_every_token(void) {
	alpaca_json_value *root = parse_text(" \t\r\n{ \n\t\"a\" \r\n: \t[ 1 ,\n2 \t, 3 ] ,\r\n \"b\" : { } , \"c\" :\ttrue\n}\n \t\r");
	ASSERT_TRUE(root != NULL);
	ASSERT_EQ_INT(3, alpaca_json_size(root));
	ASSERT_EQ_INT(3, alpaca_json_size(alpaca_json_get(root, "a")));
	ASSERT_TRUE(alpaca_json_get_bool(alpaca_json_get(root, "c"), NULL));
	alpaca_json_free(root);
	ASSERT_TRUE(parses_int("  17\n", 17));
	ASSERT_TRUE(rejects("\v1"));
	ASSERT_TRUE(rejects("\f1"));
	ASSERT_TRUE(rejects("1\v"));
}

static void parses_integers(void) {
	ASSERT_TRUE(parses_int("0", 0));
	ASSERT_TRUE(parses_int("-0", 0));
	ASSERT_TRUE(parses_int("7", 7));
	ASSERT_TRUE(parses_int("-1", -1));
	ASSERT_TRUE(parses_int("65535", 65535));
	ASSERT_TRUE(parses_int("2147483647", INT32_MAX));
	ASSERT_TRUE(parses_int("-2147483648", INT32_MIN));
	ASSERT_TRUE(parses_int("4294967295", UINT32_MAX));
	ASSERT_TRUE(parses_int("9007199254740993", 9007199254740993LL));
	ASSERT_TRUE(parses_int("9223372036854775807", INT64_MAX));
	ASSERT_TRUE(parses_int("-9223372036854775808", INT64_MIN));
	ASSERT_TRUE(parses_double("9223372036854775807", 9223372036854775807.0));
	ASSERT_TRUE(parses_double("42", 42.0));
}

static void get_int_accepts_integral_doubles_only(void) {
	ASSERT_TRUE(parses_int("123.0", 123));
	ASSERT_TRUE(parses_int("-123.000", -123));
	ASSERT_TRUE(parses_int("1e3", 1000));
	ASSERT_TRUE(parses_int("1.5e1", 15));
	ASSERT_TRUE(is_number_but_not_int("25e-1"));
	ASSERT_TRUE(parses_int("9007199254740992.0", 9007199254740992LL));
	ASSERT_TRUE(is_number_but_not_int("1.5"));
	ASSERT_TRUE(is_number_but_not_int("-0.25"));
	ASSERT_TRUE(is_number_but_not_int("1e-1"));
	ASSERT_TRUE(is_number_but_not_int("9223372036854775808"));
	ASSERT_TRUE(is_number_but_not_int("-9223372036854775809"));
	ASSERT_TRUE(is_number_but_not_int("18446744073709551616"));
	ASSERT_TRUE(is_number_but_not_int("1e19"));
	ASSERT_TRUE(is_number_but_not_int("9007199254740994.0"));
	ASSERT_TRUE(is_number_but_not_int("123456789012345678901234567890"));
}

static void parses_doubles(void) {
	ASSERT_TRUE(parses_double("0.0", 0.0));
	ASSERT_TRUE(parses_double("0.1", 0.1));
	ASSERT_TRUE(parses_double("-0.1", -0.1));
	ASSERT_TRUE(parses_double("3.141592653589793", 3.141592653589793));
	ASSERT_TRUE(parses_double("12.3456789", 12.3456789));
	ASSERT_TRUE(parses_double("1e0", 1.0));
	ASSERT_TRUE(parses_double("1E2", 100.0));
	ASSERT_TRUE(parses_double("1e+2", 100.0));
	ASSERT_TRUE(parses_double("1e-2", 0.01));
	ASSERT_TRUE(parses_double("-2.5E-3", -0.0025));
	ASSERT_TRUE(parses_double("1e22", 1e22));
	ASSERT_TRUE(parses_double("1e23", 1e23));
	ASSERT_TRUE(parses_double("1e-22", 1e-22));
	ASSERT_TRUE(parses_double("1e-23", 1e-23));
	ASSERT_TRUE(parses_double("6.02214076e23", 6.02214076e23));
	ASSERT_TRUE(parses_double("0.000001", 0.000001));
	ASSERT_TRUE(parses_double("123456789012345678", 123456789012345678.0));
	ASSERT_TRUE(parses_double("123456789012345678901234567890", 123456789012345678901234567890.0));
	ASSERT_TRUE(parses_double("0.123456789012345678901234567890", 0.123456789012345678901234567890));
	ASSERT_TRUE(parses_double("1.7976931348623157e308", DBL_MAX));
	ASSERT_TRUE(parses_double("-1.7976931348623157e308", -DBL_MAX));
	ASSERT_TRUE(parses_double("2.2250738585072014e-308", DBL_MIN));
	ASSERT_TRUE(parses_double("5e-324", 5e-324));
	ASSERT_TRUE(parses_double("1e-400", 0.0));
	ASSERT_TRUE(parses_double("0e999999999999", 0.0));
	ASSERT_TRUE(parses_double("0.00000000000000000000000000000000000000000000000001e50", 1.0));
	ASSERT_TRUE(parses_double("10000000000000000000000000000000000000000000000000e-48", 10.0));
	double value = 1;
	alpaca_json_value *root = parse_text("-0.0");
	ASSERT_TRUE(alpaca_json_get_double(root, &value) && value == 0 && signbit(value));
	alpaca_json_free(root);
}

static void rejects_malformed_numbers(void) {
	const char *texts[] = { "01", "-01", "00", "-", "+1", "1.", ".5", "-.5", "1e", "1e+", "1e-", "1E", "1.e3", "0x10", "1e400", "-1e400", "1.7976931348623159e308", "NaN", "Infinity", "-Infinity", "1,5", "1 2", "--1", "1e1.5", "1_000", "١" };
	ASSERT_TRUE(rejects_all(texts, ARRAY_SIZE(texts)));
}

static void parses_very_long_number_tokens(void) {
	size_t length = 3000;
	char *text = malloc(length + 16);
	ASSERT_TRUE(text != NULL);
	memset(text, '0', length);
	text[1] = '.';
	text[length - 1] = '1';
	strcpy(text + length, "e2998");
	ASSERT_TRUE(parses_double(text, 1.0));
	memset(text, '9', length);
	text[length] = 0;
	ASSERT_TRUE(rejects(text));
	strcpy(text + length, "e-2990");
	ASSERT_TRUE(parses_double(text, 1e10));
	free(text);
}

static void unescapes_strings(void) {
	ASSERT_TRUE(parses_string("\"\\\"\\\\\\/\\b\\f\\n\\r\\t\"", "\"\\/\b\f\n\r\t", 8));
	ASSERT_TRUE(parses_string("\"a\\u0041\\u007a\"", "aAz", 3));
	ASSERT_TRUE(parses_string("\"\\u00e9\\u00E9\"", "\xC3\xA9\xC3\xA9", 4));
	ASSERT_TRUE(parses_string("\"\\u20AC\"", "\xE2\x82\xAC", 3));
	ASSERT_TRUE(parses_string("\"\\uFFFF\"", "\xEF\xBF\xBF", 3));
	ASSERT_TRUE(parses_string("\"\\ud83d\\ude00\"", "\xF0\x9F\x98\x80", 4));
	ASSERT_TRUE(parses_string("\"\\uD800\\uDC00\"", "\xF0\x90\x80\x80", 4));
	ASSERT_TRUE(parses_string("\"\\uDBFF\\uDFFF\"", "\xF4\x8F\xBF\xBF", 4));
	ASSERT_TRUE(parses_string("\"x\\ud83d\\ude00y\\u00e9\"", "x\xF0\x9F\x98\x80y\xC3\xA9", 8));
	ASSERT_TRUE(parses_string("\"a\\u0000b\"", "a\0b", 3));
	ASSERT_TRUE(parses_string("\"\\u007f\\u0080\\u07ff\\u0800\"", "\x7F\xC2\x80\xDF\xBF\xE0\xA0\x80", 8));
	ASSERT_TRUE(parses_string("\"a/b 'c' {d} [e], f:g\"", "a/b 'c' {d} [e], f:g", 20));
}

static void keeps_valid_utf8_and_replaces_invalid_bytes(void) {
	ASSERT_TRUE(parses_string("\"\xC3\xA9\xE2\x82\xAC\xF0\x9F\x98\x80\"", "\xC3\xA9\xE2\x82\xAC\xF0\x9F\x98\x80", 9));
	ASSERT_TRUE(parses_string("\"\xC4\x8C\x65\xC5\xA1ky\"", "\xC4\x8C\x65\xC5\xA1ky", 7));
	ASSERT_TRUE(parses_string("\"Cam\xE9ra\"", "Cam?ra", 6));
	ASSERT_TRUE(parses_string("\"\x80\"", "?", 1));
	ASSERT_TRUE(parses_string("\"\xC0\xAF\"", "??", 2));
	ASSERT_TRUE(parses_string("\"\xC3\"", "?", 1));
	ASSERT_TRUE(parses_string("\"\xE2\x82\"", "??", 2));
	ASSERT_TRUE(parses_string("\"\xED\xA0\x80\"", "???", 3));
	ASSERT_TRUE(parses_string("\"\xF4\x90\x80\x80\"", "????", 4));
	ASSERT_TRUE(parses_string("\"\xF8\x88\x80\x80\x80\"", "?????", 5));
	ASSERT_TRUE(parses_string("\"a\xFFz\"", "a?z", 3));
}

static void rejects_malformed_strings(void) {
	const char *texts[] = { "\"", "\"abc", "\"abc\\\"", "\"\\", "\"\\x41\"", "\"\\a\"", "\"\\'\"", "\"\\0\"", "\"\\U0041\"", "\"\\u\"", "\"\\u12\"", "\"\\u123\"", "\"\\u12G4\"", "\"\\u 123\"", "\"\\u+123\"", "\"a\tb\"", "\"a\nb\"", "\"a\x01z\"", "\"a\x1Fz\"", "'abc'", "abc" };
	ASSERT_TRUE(rejects_all(texts, ARRAY_SIZE(texts)));
	ASSERT_TRUE(rejects_bytes("\"a\0b\"", 5));
}

static void rejects_invalid_surrogates(void) {
	const char *texts[] = { "\"\\ud83d\"", "\"\\ud83dx\"", "\"\\ud83d\\n\"", "\"\\ud83d\\u0041\"", "\"\\ud83d\\ud83d\"", "\"\\ude00\"", "\"\\ude00\\ud83d\"", "\"\\udfff\"", "\"\\ud83d\\u\"", "\"\\ud83d\\ude0\"", "\"\\ud83d\\", "\"\\ud83d\\ude00" };
	ASSERT_TRUE(rejects_all(texts, ARRAY_SIZE(texts)));
}

static void tolerates_leading_byte_order_mark_only(void) {
	alpaca_json_value *root = parse_text("\xEF\xBB\xBF{\"Value\":1}");
	ASSERT_TRUE(root != NULL);
	ASSERT_TRUE(member_int_equals(root, "Value", 1));
	alpaca_json_free(root);
	ASSERT_TRUE(parses_int("\xEF\xBB\xBF 5 ", 5));
	ASSERT_TRUE(rejects("\xEF\xBB\xBF"));
	ASSERT_TRUE(rejects("\xEF\xBB\xBF\xEF\xBB\xBF" "1"));
	ASSERT_TRUE(rejects(" \xEF\xBB\xBF" "1"));
	ASSERT_TRUE(rejects("1\xEF\xBB\xBF"));
	ASSERT_TRUE(rejects("\xEF\xBB" "1"));
	ASSERT_TRUE(rejects("\xFF\xFE" "1"));
}

static void rejects_malformed_documents(void) {
	const char *texts[] = { "", " ", "\n\t", "[1,]", "[,1]", "[,]", "[1,,2]", "[1 2]", "{\"a\":1,}", "{,\"a\":1}", "{\"a\":1,,\"b\":2}", "{\"a\" 1}", "{\"a\":}", "{\"a\"}", "{a:1}", "{1:2}", "{\"a\":1 \"b\":2}", "{null:1}", "[1}", "{\"a\":1]", "[", "]", "{", "}", "[[]", "{\"a\":{}", ",", ":", "tru", "True", "TRUE", "fals", "nul", "nulll", "truefalse", "undefined", "[1]]", "{}}", "{} {}", "[] 1", "1 1", "null null", "\"a\" \"b\"", "{\"a\":1}x", "{\"a\":1},", "[1] // comment", "/* comment */ 1", "[1,2,3", "{\"a\":[1,2,{\"b\":", "[\"a\",\"b" };
	ASSERT_TRUE(rejects_all(texts, ARRAY_SIZE(texts)));
	ASSERT_TRUE(rejects_bytes("1\0", 2));
	ASSERT_TRUE(rejects_bytes("\0", 1));
	ASSERT_TRUE(rejects_bytes("[1,\0" "2]", 6));
	ASSERT_TRUE(alpaca_json_parse(NULL, 0, error, sizeof(error)) == NULL);
	ASSERT_TRUE(alpaca_json_parse(NULL, 10, error, sizeof(error)) == NULL);
	ASSERT_TRUE(alpaca_json_parse("[1,", 3, NULL, 0) == NULL);
}

static void reports_error_message_and_offset(void) {
	ASSERT_TRUE(rejects("{\"a\":1,}"));
	ASSERT_EQ_INT(7, (int)error_offset());
	ASSERT_STREQ("Expected member name at offset 7", error);
	ASSERT_TRUE(rejects("[1,2] x"));
	ASSERT_STREQ("Unexpected text after value at offset 6", error);
	ASSERT_TRUE(rejects("[1,2"));
	ASSERT_STREQ("Unexpected end of text at offset 4", error);
	ASSERT_TRUE(rejects("\"a\\qb\""));
	ASSERT_STREQ("Invalid escape at offset 3", error);
	ASSERT_TRUE(rejects("[01]"));
	ASSERT_STREQ("Leading zero in number at offset 2", error);
	char small[8] = { 0 };
	memset(small, 'x', sizeof(small));
	ASSERT_TRUE(alpaca_json_parse("[1,", 3, small, sizeof(small)) == NULL);
	ASSERT_STREQ("Unexpec", small);
	alpaca_json_value *root = alpaca_json_parse("[1]", 3, error, sizeof(error));
	ASSERT_TRUE(root != NULL);
	ASSERT_STREQ("", error);
	alpaca_json_free(root);
}

static void every_truncated_prefix_fails_cleanly(void) {
	const char *text = "{\"Value\":[{\"Name\":\"Alt\\u00e9\\ud83d\\ude00\",\"Value\":-45.5e+1},[true,false,null],{}],\"ErrorNumber\":0,\"ErrorMessage\":\"\"}";
	size_t length = strlen(text);
	alpaca_json_value *root = parse_bytes(text, length);
	ASSERT_TRUE(root != NULL);
	alpaca_json_free(root);
	for (size_t prefix = 0; prefix < length; prefix++) {
		if (!rejects_bytes(text, prefix)) {
			fprintf(stderr, "Prefix of %d bytes was accepted\n", (int)prefix);
			ASSERT_TRUE(false);
		}
		long offset = error_offset();
		ASSERT_TRUE(offset >= 0 && (size_t)offset <= prefix);
	}
}

static char *nested_text(int depth, char open, char close, const char *core) {
	size_t core_length = strlen(core);
	char *text = malloc((size_t)depth * 2 + core_length + 1);
	memset(text, open, (size_t)depth);
	memcpy(text + depth, core, core_length);
	memset(text + depth + core_length, close, (size_t)depth);
	text[(size_t)depth * 2 + core_length] = 0;
	return text;
}

static void enforces_depth_limit(void) {
	char *text = nested_text(ALPACA_JSON_MAX_DEPTH, '[', ']', "1");
	alpaca_json_value *root = parse_text(text);
	ASSERT_TRUE(root != NULL);
	const alpaca_json_value *value = root;
	for (int i = 0; i < ALPACA_JSON_MAX_DEPTH; i++) {
		ASSERT_EQ_INT(ALPACA_JSON_ARRAY, alpaca_json_get_type(value));
		value = alpaca_json_array_get(value, 0);
	}
	ASSERT_TRUE(alpaca_json_get_int(value, NULL));
	alpaca_json_free(root);
	free(text);
	text = nested_text(ALPACA_JSON_MAX_DEPTH, '[', ']', "");
	root = parse_text(text);
	ASSERT_TRUE(root != NULL);
	alpaca_json_free(root);
	free(text);
	text = nested_text(ALPACA_JSON_MAX_DEPTH + 1, '[', ']', "1");
	ASSERT_TRUE(rejects(text));
	ASSERT_TRUE(strstr(error, "Nesting too deep") != NULL);
	ASSERT_EQ_INT(ALPACA_JSON_MAX_DEPTH, (int)error_offset());
	free(text);
	text = nested_text(ALPACA_JSON_MAX_DEPTH + 1, '[', ']', "");
	ASSERT_TRUE(rejects(text));
	free(text);
}

static void survives_hostile_nesting(void) {
	int depth = 1000000;
	char *text = nested_text(depth, '[', ']', "");
	ASSERT_TRUE(rejects_bytes(text, (size_t)depth * 2));
	ASSERT_TRUE(strstr(error, "Nesting too deep") != NULL);
	ASSERT_TRUE(rejects_bytes(text, (size_t)depth));
	free(text);
	depth = 500000;
	size_t length = (size_t)depth * 5;
	text = malloc(length);
	for (int i = 0; i < depth; i++) {
		memcpy(text + (size_t)i * 5, "{\"a\":", 5);
	}
	ASSERT_TRUE(rejects_bytes(text, length));
	ASSERT_TRUE(strstr(error, "Nesting too deep") != NULL);
	free(text);
}

static void enforces_size_limit(void) {
	size_t length = (size_t)ALPACA_JSON_MAX_SIZE + 1;
	char *text = malloc(length);
	ASSERT_TRUE(text != NULL);
	memset(text, ' ', length);
	text[0] = '1';
	alpaca_json_value *root = alpaca_json_parse(text, length - 1, error, sizeof(error));
	ASSERT_TRUE(root != NULL);
	ASSERT_TRUE(alpaca_json_get_int(root, NULL));
	alpaca_json_free(root);
	ASSERT_TRUE(alpaca_json_parse(text, length, error, sizeof(error)) == NULL);
	ASSERT_STREQ("Text too long at offset 0", error);
	free(text);
}

static void parses_largest_document_made_of_shortest_values(void) {
	size_t length = (size_t)ALPACA_JSON_MAX_SIZE;
	char *text = malloc(length);
	ASSERT_TRUE(text != NULL);
	for (size_t i = 0; i < length; i += 2) {
		text[i] = ',';
		text[i + 1] = '7';
	}
	text[0] = '[';
	text[length - 1] = ']';
	text[length - 2] = ' ';
	alpaca_json_value *root = alpaca_json_parse(text, length, error, sizeof(error));
	free(text);
	ASSERT_TRUE(root != NULL);
	int count = 0;
	for (const alpaca_json_value *element = alpaca_json_first(root); element != NULL; element = alpaca_json_next(element)) {
		count++;
	}
	ASSERT_EQ_INT((int)(length / 2 - 1), count);
	ASSERT_EQ_INT(count, alpaca_json_size(root));
	alpaca_json_free(root);
}

static void parses_numbers_independently_of_locale(void) {
	char probe[16] = { 0 };
	if (setlocale(LC_NUMERIC, "de_DE.UTF-8") == NULL && setlocale(LC_NUMERIC, "de_DE") == NULL) {
		printf("  SKIP parses_numbers_independently_of_locale: locale de_DE is not available\n");
		return;
	}
	snprintf(probe, sizeof(probe), "%.1f", 1.5);
	bool comma = strcmp(probe, "1,5") == 0;
	bool exact = parses_double("1.5", 1.5) && parses_double("-12.3456789", -12.3456789) && parses_double("1.25e2", 125.0);
	bool rounded = parses_double("1.7976931348623157e308", DBL_MAX) && parses_double("0.123456789012345678901234567890", 0.123456789012345678901234567890) && parses_double("6.02214076e23", 6.02214076e23) && parses_double("1e23", 1e23);
	bool strict = rejects("1,5") && rejects("[1,5e]");
	int32_t pixels[4] = { 0 };
	void *buffer = pixels;
	size_t capacity = 4;
	alpaca_json_image image = { 0 };
	const char *text = "{\"Value\":[[1.0,2.5],[1.5e1,123456789.123456789e-6]]}";
	bool fast = alpaca_json_parse_image(text, strlen(text), ALPACA_JSON_IMAGE_INT32, &buffer, &capacity, false, &image, error, sizeof(error));
	setlocale(LC_NUMERIC, "C");
	ASSERT_TRUE(comma);
	ASSERT_TRUE(exact);
	ASSERT_TRUE(rounded);
	ASSERT_TRUE(strict);
	ASSERT_TRUE(fast);
	ASSERT_EQ_INT(1, pixels[0]);
	ASSERT_EQ_INT(3, pixels[1]);
	ASSERT_EQ_INT(15, pixels[2]);
	ASSERT_EQ_INT(123, pixels[3]);
}

static void looks_up_members_with_and_without_case(void) {
	alpaca_json_value *root = parse_text("{\"Value\":1,\"value\":2,\"ErrorNumber\":3,\"\":4,\"\\u00c9\":5,\"Val\":6}");
	ASSERT_TRUE(root != NULL);
	ASSERT_TRUE(member_int_equals(root, "Value", 1));
	ASSERT_TRUE(member_int_equals(root, "VALUE", 1));
	ASSERT_TRUE(member_int_equals(root, "value", 1));
	ASSERT_TRUE(member_int_equals(root, "errornumber", 3));
	ASSERT_TRUE(member_int_equals(root, "ERRORNUMBER", 3));
	ASSERT_TRUE(member_int_equals(root, "", 4));
	ASSERT_TRUE(member_int_equals(root, "\xC3\x89", 5));
	ASSERT_TRUE(member_int_equals(root, "val", 6));
	ASSERT_TRUE(alpaca_json_get(root, "\xC3\xA9") == NULL);
	ASSERT_TRUE(alpaca_json_get(root, "Valu") == NULL);
	ASSERT_TRUE(alpaca_json_get(root, "Values") == NULL);
	ASSERT_TRUE(alpaca_json_get(root, NULL) == NULL);
	int64_t integer = 0;
	ASSERT_TRUE(alpaca_json_get_int(alpaca_json_get_exact(root, "Value"), &integer) && integer == 1);
	ASSERT_TRUE(alpaca_json_get_int(alpaca_json_get_exact(root, "value"), &integer) && integer == 2);
	ASSERT_TRUE(alpaca_json_get_int(alpaca_json_get_exact(root, "ErrorNumber"), &integer) && integer == 3);
	ASSERT_TRUE(alpaca_json_get_exact(root, "VALUE") == NULL);
	ASSERT_TRUE(alpaca_json_get_exact(root, "errornumber") == NULL);
	ASSERT_TRUE(alpaca_json_get_exact(root, NULL) == NULL);
	ASSERT_TRUE(alpaca_json_get(alpaca_json_get(root, "Value"), "x") == NULL);
	alpaca_json_free(root);
	root = parse_text("[{\"a\":1}]");
	ASSERT_TRUE(alpaca_json_get(root, "a") == NULL);
	ASSERT_TRUE(alpaca_json_get_exact(root, "a") == NULL);
	alpaca_json_free(root);
}

static void getters_do_not_coerce_types(void) {
	alpaca_json_value *root = parse_text("{\"n\":null,\"t\":true,\"i\":1,\"z\":0,\"d\":1.5,\"s\":\"1\",\"e\":\"\",\"b\":\"true\",\"a\":[1],\"o\":{\"x\":1}}");
	ASSERT_TRUE(root != NULL);
	const char *names[] = { "n", "t", "i", "z", "d", "s", "e", "b", "a", "o", "missing" };
	const bool is_bool[] = { false, true, false, false, false, false, false, false, false, false, false };
	const bool is_int[] = { false, false, true, true, false, false, false, false, false, false, false };
	const bool is_double[] = { false, false, true, true, true, false, false, false, false, false, false };
	const bool is_string[] = { false, false, false, false, false, true, true, true, false, false, false };
	for (int i = 0; i < ARRAY_SIZE(names); i++) {
		const alpaca_json_value *value = alpaca_json_get(root, names[i]);
		bool boolean = true;
		int64_t integer = 77;
		double number = 77;
		const char *string = "untouched";
		ASSERT_EQ_INT(is_bool[i], alpaca_json_get_bool(value, &boolean));
		ASSERT_EQ_INT(is_int[i], alpaca_json_get_int(value, &integer));
		ASSERT_EQ_INT(is_double[i], alpaca_json_get_double(value, &number));
		ASSERT_EQ_INT(is_string[i], alpaca_json_get_string(value, &string));
		ASSERT_EQ_INT(is_bool[i], alpaca_json_get_bool(value, NULL));
		ASSERT_EQ_INT(is_int[i], alpaca_json_get_int(value, NULL));
		ASSERT_EQ_INT(is_double[i], alpaca_json_get_double(value, NULL));
		ASSERT_EQ_INT(is_string[i], alpaca_json_get_string(value, NULL));
		ASSERT_TRUE(is_int[i] || integer == 77);
		ASSERT_TRUE(is_double[i] || number == 77);
		ASSERT_TRUE(is_string[i] || strcmp(string, "untouched") == 0);
		ASSERT_EQ_INT(i == 0, alpaca_json_is_null(value));
	}
	ASSERT_EQ_INT(ALPACA_JSON_NONE, alpaca_json_get_type(alpaca_json_get(root, "missing")));
	ASSERT_EQ_INT(ALPACA_JSON_NULL, alpaca_json_get_type(alpaca_json_get(root, "n")));
	ASSERT_EQ_INT(0, alpaca_json_size(alpaca_json_get(root, "s")));
	ASSERT_EQ_INT(0, (int)alpaca_json_get_string_length(alpaca_json_get(root, "i")));
	ASSERT_EQ_INT(1, (int)alpaca_json_get_string_length(alpaca_json_get(root, "s")));
	alpaca_json_free(root);
}

static void accessors_tolerate_null_values(void) {
	ASSERT_EQ_INT(ALPACA_JSON_NONE, alpaca_json_get_type(NULL));
	ASSERT_FALSE(alpaca_json_is_null(NULL));
	ASSERT_EQ_INT(0, alpaca_json_size(NULL));
	ASSERT_TRUE(alpaca_json_get(NULL, "a") == NULL);
	ASSERT_TRUE(alpaca_json_get_exact(NULL, "a") == NULL);
	ASSERT_TRUE(alpaca_json_array_get(NULL, 0) == NULL);
	ASSERT_TRUE(alpaca_json_first(NULL) == NULL);
	ASSERT_TRUE(alpaca_json_next(NULL) == NULL);
	ASSERT_TRUE(alpaca_json_get_name(NULL) == NULL);
	ASSERT_FALSE(alpaca_json_get_bool(NULL, NULL));
	ASSERT_FALSE(alpaca_json_get_int(NULL, NULL));
	ASSERT_FALSE(alpaca_json_get_double(NULL, NULL));
	ASSERT_FALSE(alpaca_json_get_string(NULL, NULL));
	ASSERT_EQ_INT(0, (int)alpaca_json_get_string_length(NULL));
	alpaca_json_free(NULL);
}

static void iterates_arrays_and_objects(void) {
	alpaca_json_value *root = parse_text("{\"first\":[10,20,30],\"second\":{\"x\":1},\"third\":null}");
	ASSERT_TRUE(root != NULL);
	const char *names[] = { "first", "second", "third" };
	int count = 0;
	ASSERT_TRUE(alpaca_json_get_name(root) == NULL);
	for (const alpaca_json_value *member = alpaca_json_first(root); member != NULL; member = alpaca_json_next(member)) {
		ASSERT_TRUE(count < 3);
		ASSERT_STREQ(names[count], alpaca_json_get_name(member));
		ASSERT_TRUE(member == alpaca_json_array_get(root, count));
		count++;
	}
	ASSERT_EQ_INT(3, count);
	const alpaca_json_value *array = alpaca_json_get(root, "first");
	int64_t sum = 0;
	for (const alpaca_json_value *element = alpaca_json_first(array); element != NULL; element = alpaca_json_next(element)) {
		int64_t integer = 0;
		ASSERT_TRUE(alpaca_json_get_name(element) == NULL);
		ASSERT_TRUE(alpaca_json_get_int(element, &integer));
		sum += integer;
	}
	ASSERT_EQ_INT64(60, sum);
	ASSERT_TRUE(alpaca_json_array_get(array, -1) == NULL);
	ASSERT_TRUE(alpaca_json_array_get(array, 3) == NULL);
	ASSERT_TRUE(alpaca_json_array_get(array, INT_MAX) == NULL);
	ASSERT_TRUE(alpaca_json_array_get(alpaca_json_get(root, "third"), 0) == NULL);
	ASSERT_TRUE(alpaca_json_first(alpaca_json_get(root, "third")) == NULL);
	ASSERT_TRUE(alpaca_json_next(alpaca_json_array_get(array, 2)) == NULL);
	alpaca_json_free(root);
}

static void parses_apiversions_fixture(void) {
	alpaca_json_value *root = parse_fixture("fixtures/protocol/alpaca_apiversions.json");
	ASSERT_TRUE(root != NULL);
	const alpaca_json_value *value = alpaca_json_get(root, "Value");
	int64_t version = 0;
	ASSERT_EQ_INT(1, alpaca_json_size(value));
	ASSERT_TRUE(alpaca_json_get_int(alpaca_json_array_get(value, 0), &version));
	ASSERT_EQ_INT64(1, version);
	ASSERT_TRUE(member_int_equals(root, "ClientTransactionID", 1));
	ASSERT_TRUE(member_int_equals(root, "ServerTransactionID", 1));
	ASSERT_TRUE(alpaca_json_get(root, "ErrorNumber") == NULL);
	alpaca_json_free(root);
}

static void parses_description_fixture(void) {
	alpaca_json_value *root = parse_fixture("fixtures/protocol/alpaca_description.json");
	ASSERT_TRUE(root != NULL);
	const alpaca_json_value *value = alpaca_json_get(root, "Value");
	ASSERT_EQ_INT(ALPACA_JSON_OBJECT, alpaca_json_get_type(value));
	ASSERT_TRUE(member_string_equals(value, "ServerName", "Test Alpaca Server"));
	ASSERT_TRUE(member_string_equals(value, "Manufacturer", "Test Manufacturer"));
	ASSERT_TRUE(member_string_equals(value, "ManufacturerVersion", "1.2.3"));
	ASSERT_TRUE(member_string_equals(value, "Location", "Bratislava, Slovakia"));
	ASSERT_TRUE(member_int_equals(root, "ClientTransactionID", 2));
	alpaca_json_free(root);
}

static void parses_configureddevices_fixture(void) {
	alpaca_json_value *root = parse_fixture("fixtures/protocol/alpaca_configureddevices.json");
	ASSERT_TRUE(root != NULL);
	const alpaca_json_value *value = alpaca_json_get(root, "Value");
	const char *names[] = { "Test Camera", "Test Telescope", "Test Cover & Calibrator" };
	const char *types[] = { "Camera", "Telescope", "CoverCalibrator" };
	const int numbers[] = { 0, 0, 3 };
	int index = 0;
	ASSERT_EQ_INT(3, alpaca_json_size(value));
	for (const alpaca_json_value *device = alpaca_json_first(value); device != NULL; device = alpaca_json_next(device)) {
		ASSERT_TRUE(member_string_equals(device, "DeviceName", names[index]));
		ASSERT_TRUE(member_string_equals(device, "DeviceType", types[index]));
		ASSERT_TRUE(member_int_equals(device, "DeviceNumber", numbers[index]));
		ASSERT_EQ_INT(36, (int)alpaca_json_get_string_length(alpaca_json_get(device, "UniqueID")));
		index++;
	}
	ASSERT_EQ_INT(3, index);
	ASSERT_TRUE(member_string_equals(alpaca_json_array_get(value, 2), "uniqueid", "0A1B2C3D-0000-4000-8000-000000000003"));
	ASSERT_TRUE(member_int_equals(root, "ServerTransactionID", 3));
	alpaca_json_free(root);
}

static void parses_value_envelope_fixture(void) {
	alpaca_json_value *root = parse_fixture("fixtures/protocol/alpaca_value.json");
	ASSERT_TRUE(root != NULL);
	double value = 0;
	ASSERT_TRUE(member_int_equals(root, "ErrorNumber", 0));
	ASSERT_TRUE(member_string_equals(root, "ErrorMessage", ""));
	ASSERT_TRUE(alpaca_json_get_double(alpaca_json_get(root, "Value"), &value));
	ASSERT_TRUE(value == 12.3456789);
	ASSERT_FALSE(alpaca_json_get_int(alpaca_json_get(root, "Value"), NULL));
	ASSERT_TRUE(member_int_equals(root, "ClientTransactionID", 4));
	ASSERT_TRUE(member_int_equals(root, "ServerTransactionID", 104));
	alpaca_json_free(root);
}

static void parses_error_envelope_fixture(void) {
	alpaca_json_value *root = parse_fixture("fixtures/protocol/alpaca_error.json");
	ASSERT_TRUE(root != NULL);
	ASSERT_TRUE(member_int_equals(root, "ErrorNumber", 0x407));
	ASSERT_TRUE(member_string_equals(root, "ErrorMessage", "Telescope is not connected"));
	ASSERT_TRUE(alpaca_json_get(root, "Value") == NULL);
	ASSERT_EQ_INT(ALPACA_JSON_NONE, alpaca_json_get_type(alpaca_json_get(root, "Value")));
	ASSERT_FALSE(alpaca_json_get_double(alpaca_json_get(root, "Value"), NULL));
	ASSERT_TRUE(member_int_equals(root, "ClientTransactionID", 5));
	alpaca_json_free(root);
}

static void parses_devicestate_fixture(void) {
	alpaca_json_value *root = parse_fixture("fixtures/protocol/alpaca_devicestate.json");
	ASSERT_TRUE(root != NULL);
	const alpaca_json_value *value = alpaca_json_get(root, "Value");
	double altitude = 0;
	double declination = 0;
	int64_t side_of_pier = 0;
	bool slewing = false;
	bool at_park = true;
	const char *utc = NULL;
	int count = 0;
	ASSERT_EQ_INT(13, alpaca_json_size(value));
	for (const alpaca_json_value *state = alpaca_json_first(value); state != NULL; state = alpaca_json_next(state)) {
		const char *name = NULL;
		const alpaca_json_value *item = alpaca_json_get(state, "Value");
		ASSERT_TRUE(alpaca_json_get_string(alpaca_json_get(state, "Name"), &name));
		ASSERT_TRUE(item != NULL);
		if (strcmp(name, "Altitude") == 0) {
			ASSERT_TRUE(alpaca_json_get_double(item, &altitude));
		} else if (strcmp(name, "Declination") == 0) {
			ASSERT_TRUE(alpaca_json_get_double(item, &declination));
		} else if (strcmp(name, "SideOfPier") == 0) {
			ASSERT_TRUE(alpaca_json_get_int(item, &side_of_pier));
		} else if (strcmp(name, "Slewing") == 0) {
			ASSERT_TRUE(alpaca_json_get_bool(item, &slewing));
		} else if (strcmp(name, "AtPark") == 0) {
			ASSERT_TRUE(alpaca_json_get_bool(item, &at_park));
		} else if (strcmp(name, "UTCDate") == 0) {
			ASSERT_TRUE(alpaca_json_get_string(item, &utc));
		}
		count++;
	}
	ASSERT_EQ_INT(13, count);
	ASSERT_TRUE(altitude == 45.5);
	ASSERT_TRUE(declination == -12.75);
	ASSERT_EQ_INT64(-1, side_of_pier);
	ASSERT_TRUE(slewing);
	ASSERT_FALSE(at_park);
	ASSERT_STREQ("2026-10-01T10:00:00.000Z", utc);
	ASSERT_TRUE(member_int_equals(root, "ErrorNumber", 0));
	alpaca_json_free(root);
}

static void parses_imagearray_fixtures_into_dom(void) {
	alpaca_json_value *root = parse_fixture("fixtures/protocol/alpaca_imagearray_rank2.json");
	ASSERT_TRUE(root != NULL);
	const alpaca_json_value *value = alpaca_json_get(root, "Value");
	int64_t pixel = 0;
	ASSERT_TRUE(member_int_equals(root, "Type", 2));
	ASSERT_TRUE(member_int_equals(root, "Rank", 2));
	ASSERT_EQ_INT(4, alpaca_json_size(value));
	ASSERT_EQ_INT(3, alpaca_json_size(alpaca_json_array_get(value, 0)));
	ASSERT_TRUE(alpaca_json_get_int(alpaca_json_array_get(alpaca_json_array_get(value, 3), 2), &pixel));
	ASSERT_EQ_INT64(70000, pixel);
	alpaca_json_free(root);
	root = parse_fixture("fixtures/protocol/alpaca_imagearray_rank3.json");
	ASSERT_TRUE(root != NULL);
	value = alpaca_json_get(root, "Value");
	ASSERT_TRUE(member_int_equals(root, "Rank", 3));
	ASSERT_EQ_INT(4, alpaca_json_size(value));
	ASSERT_EQ_INT(2, alpaca_json_size(alpaca_json_array_get(value, 0)));
	ASSERT_EQ_INT(3, alpaca_json_size(alpaca_json_array_get(alpaca_json_array_get(value, 0), 0)));
	ASSERT_TRUE(alpaca_json_get_int(alpaca_json_array_get(alpaca_json_array_get(alpaca_json_array_get(value, 3), 1), 2), &pixel));
	ASSERT_EQ_INT64(24, pixel);
	alpaca_json_free(root);
}

static void fixtures_fail_cleanly_at_every_prefix(void) {
	const char *paths[] = { "fixtures/protocol/alpaca_apiversions.json", "fixtures/protocol/alpaca_description.json", "fixtures/protocol/alpaca_configureddevices.json", "fixtures/protocol/alpaca_value.json", "fixtures/protocol/alpaca_error.json", "fixtures/protocol/alpaca_devicestate.json", "fixtures/protocol/alpaca_imagearray_rank2.json", "fixtures/protocol/alpaca_imagearray_rank3.json" };
	for (int i = 0; i < ARRAY_SIZE(paths); i++) {
		size_t length = 0;
		char *text = read_fixture(paths[i], &length);
		ASSERT_TRUE(text != NULL);
		while (length > 0 && (text[length - 1] == '\n' || text[length - 1] == '\r')) {
			length--;
		}
		alpaca_json_value *root = parse_bytes(text, length);
		ASSERT_TRUE(root != NULL);
		alpaca_json_free(root);
		for (size_t prefix = 0; prefix < length; prefix++) {
			if (!rejects_bytes(text, prefix)) {
				fprintf(stderr, "%s: prefix of %d bytes was accepted\n", paths[i], (int)prefix);
				ASSERT_TRUE(false);
			}
		}
		free(text);
	}
}

// The image scanner is exercised the same way as the DOM parser: from an exact heap copy of the text.
static bool scan_image_bytes(const char *text, size_t length, alpaca_json_image_format format, void **buffer, size_t *capacity, bool growable, alpaca_json_image *image) {
	char *copy = exact_copy(text, length);
	bool result = alpaca_json_parse_image(copy, length, format, buffer, capacity, growable, image, error, sizeof(error));
	free(copy);
	return result;
}

static bool scan_image(const char *text, int32_t **pixels, alpaca_json_image *image) {
	void *buffer = NULL;
	size_t capacity = 0;
	bool result = scan_image_bytes(text, strlen(text), ALPACA_JSON_IMAGE_INT32, &buffer, &capacity, true, image);
	*pixels = buffer;
	return result;
}

static bool image_rejects_bytes(const char *text, size_t length) {
	void *buffer = NULL;
	size_t capacity = 0;
	alpaca_json_image image = { 0 };
	bool result = scan_image_bytes(text, length, ALPACA_JSON_IMAGE_INT32, &buffer, &capacity, true, &image);
	free(buffer);
	if (result) {
		fprintf(stderr, "Image unexpectedly accepted: %.*s\n", (int)length, text);
		return false;
	}
	if (strstr(error, " at offset ") == NULL) {
		fprintf(stderr, "No error reported for image: %.*s\n", (int)length, text);
		return false;
	}
	return true;
}

static bool image_rejects(const char *text, const char *message) {
	if (!image_rejects_bytes(text, strlen(text))) {
		return false;
	}
	if (strstr(error, message) == NULL) {
		fprintf(stderr, "%s: expected error \"%s\", got \"%s\"\n", text, message, error);
		return false;
	}
	return true;
}

static void image_scans_rank2_fixture(void) {
	const int32_t expected[] = { 0, 1, 2, 100, 101, 102, 200, 201, 202, 65535, -1, 70000 };
	size_t length = 0;
	char *text = read_fixture("fixtures/protocol/alpaca_imagearray_rank2.json", &length);
	ASSERT_TRUE(text != NULL);
	void *buffer = NULL;
	size_t capacity = 0;
	alpaca_json_image image = { 0 };
	bool result = alpaca_json_parse_image(text, length, ALPACA_JSON_IMAGE_INT32, &buffer, &capacity, true, &image, error, sizeof(error));
	free(text);
	if (!result) {
		fprintf(stderr, "%s\n", error);
	}
	ASSERT_TRUE(result);
	ASSERT_TRUE(image.has_value);
	ASSERT_EQ_INT(2, image.type);
	ASSERT_EQ_INT(2, image.rank);
	ASSERT_EQ_INT(4, image.dimensions[0]);
	ASSERT_EQ_INT(3, image.dimensions[1]);
	ASSERT_EQ_INT(0, image.dimensions[2]);
	ASSERT_EQ_INT(12, (int)image.count);
	ASSERT_TRUE(capacity >= image.count);
	ASSERT_TRUE(memcmp(buffer, expected, sizeof(expected)) == 0);
	ASSERT_TRUE(image.minimum == -1 && image.maximum == 70000);
	ASSERT_EQ_INT(0, (int)image.rounded);
	ASSERT_TRUE(image.has_error_number && image.error_number == 0);
	ASSERT_STREQ("", image.error_message);
	ASSERT_TRUE(image.has_client_transaction_id && image.client_transaction_id == 7);
	ASSERT_TRUE(image.has_server_transaction_id && image.server_transaction_id == 107);
	free(buffer);
}

static void image_scans_rank3_fixture(void) {
	size_t length = 0;
	char *text = read_fixture("fixtures/protocol/alpaca_imagearray_rank3.json", &length);
	ASSERT_TRUE(text != NULL);
	void *buffer = NULL;
	size_t capacity = 0;
	alpaca_json_image image = { 0 };
	bool result = alpaca_json_parse_image(text, length, ALPACA_JSON_IMAGE_INT32, &buffer, &capacity, true, &image, error, sizeof(error));
	free(text);
	if (!result) {
		fprintf(stderr, "%s\n", error);
	}
	ASSERT_TRUE(result);
	ASSERT_TRUE(image.has_value);
	ASSERT_EQ_INT(2, image.type);
	ASSERT_EQ_INT(3, image.rank);
	ASSERT_EQ_INT(4, image.dimensions[0]);
	ASSERT_EQ_INT(2, image.dimensions[1]);
	ASSERT_EQ_INT(3, image.dimensions[2]);
	ASSERT_EQ_INT(24, (int)image.count);
	const int32_t *pixels = buffer;
	for (int x = 0; x < 4; x++) {
		for (int y = 0; y < 2; y++) {
			for (int plane = 0; plane < 3; plane++) {
				ASSERT_EQ_INT((x * 2 + y) * 3 + plane + 1, pixels[(x * image.dimensions[1] + y) * image.dimensions[2] + plane]);
			}
		}
	}
	ASSERT_TRUE(image.minimum == 1 && image.maximum == 24);
	ASSERT_TRUE(image.has_client_transaction_id && image.client_transaction_id == 8);
	ASSERT_TRUE(image.has_server_transaction_id && image.server_transaction_id == 108);
	free(buffer);
}

static void image_accepts_members_in_any_order(void) {
	const char *texts[] = {
		"{\"Type\":2,\"Rank\":2,\"Value\":[[1,2],[3,4],[5,6]],\"ErrorNumber\":0,\"ErrorMessage\":\"\",\"ClientTransactionID\":11,\"ServerTransactionID\":22}",
		"{\"Value\":[[1,2],[3,4],[5,6]],\"Type\":2,\"Rank\":2,\"ErrorNumber\":0,\"ErrorMessage\":\"\",\"ClientTransactionID\":11,\"ServerTransactionID\":22}",
		"{\"ClientTransactionID\":11,\"ServerTransactionID\":22,\"ErrorNumber\":0,\"ErrorMessage\":\"\",\"Rank\":2,\"Type\":2,\"Value\":[[1,2],[3,4],[5,6]]}",
		"{\"ErrorMessage\":\"\",\"ServerTransactionID\":22,\"Value\":[[1,2],[3,4],[5,6]],\"ClientTransactionID\":11,\"Rank\":2,\"ErrorNumber\":0,\"Type\":2}",
		"{\"errormessage\":\"\",\"SERVERTRANSACTIONID\":22,\"value\":[[1,2],[3,4],[5,6]],\"clienttransactionid\":11,\"RANK\":2,\"errorNumber\":0,\"type\":2}",
		" {\n\t\"Type\" : 2 ,\n\t\"Rank\" : 2 ,\n\t\"Value\" : [ [ 1 , 2 ] ,\r\n [ 3 , 4 ] , [ 5 , 6 ] ] ,\n\t\"ErrorNumber\" : 0 , \"ErrorMessage\" : \"\" , \"ClientTransactionID\" : 11 , \"ServerTransactionID\" : 22\n}\n",
		"\xEF\xBB\xBF{\"Extra\":{\"Value\":[[9]],\"a\":[1,{\"b\":\"]}\"}]},\"Type\":2.0,\"Rank\":2e0,\"Value\":[[1,2],[3,4],[5,6]],\"Other\":[null,true,\"x\"],\"ErrorNumber\":0,\"ErrorMessage\":\"\",\"ClientTransactionID\":11,\"ServerTransactionID\":22,\"More\":-1.5e3}"
	};
	for (int i = 0; i < ARRAY_SIZE(texts); i++) {
		int32_t *pixels = NULL;
		alpaca_json_image image = { 0 };
		bool result = scan_image(texts[i], &pixels, &image);
		if (!result) {
			fprintf(stderr, "Variant %d: %s\n", i, error);
		}
		ASSERT_TRUE(result);
		ASSERT_TRUE(image.has_value);
		ASSERT_EQ_INT(2, image.type);
		ASSERT_EQ_INT(2, image.rank);
		ASSERT_EQ_INT(3, image.dimensions[0]);
		ASSERT_EQ_INT(2, image.dimensions[1]);
		ASSERT_EQ_INT(0, image.dimensions[2]);
		ASSERT_EQ_INT(6, (int)image.count);
		for (int j = 0; j < 6; j++) {
			ASSERT_EQ_INT(j + 1, pixels[j]);
		}
		ASSERT_TRUE(image.has_error_number && image.error_number == 0);
		ASSERT_TRUE(image.has_client_transaction_id && image.client_transaction_id == 11);
		ASSERT_TRUE(image.has_server_transaction_id && image.server_transaction_id == 22);
		free(pixels);
	}
}

static void image_handles_missing_and_mistyped_members(void) {
	int32_t *pixels = NULL;
	alpaca_json_image image = { 0 };
	ASSERT_TRUE(scan_image("{\"Value\":[[1,2,3]]}", &pixels, &image));
	ASSERT_TRUE(image.has_value);
	ASSERT_EQ_INT(0, image.type);
	ASSERT_EQ_INT(2, image.rank);
	ASSERT_EQ_INT(1, image.dimensions[0]);
	ASSERT_EQ_INT(3, image.dimensions[1]);
	ASSERT_FALSE(image.has_error_number);
	ASSERT_FALSE(image.has_client_transaction_id);
	ASSERT_FALSE(image.has_server_transaction_id);
	free(pixels);
	ASSERT_TRUE(scan_image("{\"Type\":null,\"Rank\":\"2\",\"ErrorNumber\":null,\"ErrorMessage\":null,\"ClientTransactionID\":-1,\"ServerTransactionID\":4294967296,\"Value\":[[[7]]]}", &pixels, &image));
	ASSERT_TRUE(image.has_value);
	ASSERT_EQ_INT(0, image.type);
	ASSERT_EQ_INT(3, image.rank);
	ASSERT_EQ_INT(1, image.dimensions[2]);
	ASSERT_FALSE(image.has_error_number);
	ASSERT_STREQ("", image.error_message);
	ASSERT_FALSE(image.has_client_transaction_id);
	ASSERT_FALSE(image.has_server_transaction_id);
	ASSERT_EQ_INT(7, pixels[0]);
	free(pixels);
	ASSERT_TRUE(scan_image("{\"ClientTransactionID\":4294967295,\"ServerTransactionID\":0,\"ErrorNumber\":-2147220480,\"Type\":1.5,\"Value\":[[1]]}", &pixels, &image));
	ASSERT_TRUE(image.has_client_transaction_id && image.client_transaction_id == UINT32_MAX);
	ASSERT_TRUE(image.has_server_transaction_id && image.server_transaction_id == 0);
	ASSERT_TRUE(image.has_error_number && image.error_number == -2147220480LL);
	ASSERT_EQ_INT(0, image.type);
	free(pixels);
	ASSERT_TRUE(scan_image("{}", &pixels, &image));
	ASSERT_FALSE(image.has_value);
	ASSERT_EQ_INT(0, (int)image.count);
	ASSERT_TRUE(pixels == NULL);
	ASSERT_TRUE(scan_image(" { } ", &pixels, &image));
	ASSERT_FALSE(image.has_value);
}

static void image_reports_error_envelope_without_value(void) {
	size_t length = 0;
	char *text = read_fixture("fixtures/protocol/alpaca_error.json", &length);
	ASSERT_TRUE(text != NULL);
	void *buffer = NULL;
	size_t capacity = 0;
	alpaca_json_image image = { 0 };
	bool result = alpaca_json_parse_image(text, length, ALPACA_JSON_IMAGE_INT32, &buffer, &capacity, true, &image, error, sizeof(error));
	free(text);
	ASSERT_TRUE(result);
	ASSERT_FALSE(image.has_value);
	ASSERT_TRUE(buffer == NULL);
	ASSERT_EQ_INT(0, (int)image.count);
	ASSERT_EQ_INT(0, image.rank);
	ASSERT_TRUE(image.has_error_number && image.error_number == 0x407);
	ASSERT_STREQ("Telescope is not connected", image.error_message);
	ASSERT_TRUE(image.has_client_transaction_id && image.client_transaction_id == 5);
	ASSERT_TRUE(image.has_server_transaction_id && image.server_transaction_id == 105);
	int32_t *pixels = NULL;
	ASSERT_TRUE(scan_image("{\"Type\":2,\"Rank\":2,\"Value\":null,\"ErrorNumber\":1035,\"ErrorMessage\":\"No image \\u00e9 \\\"ready\\\"\"}", &pixels, &image));
	ASSERT_FALSE(image.has_value);
	ASSERT_TRUE(pixels == NULL);
	ASSERT_EQ_INT(2, image.rank);
	ASSERT_TRUE(image.error_number == 0x40B);
	ASSERT_STREQ("No image \xC3\xA9 \"ready\"", image.error_message);
	ASSERT_TRUE(scan_image("{\"Value\":\"\",\"ErrorNumber\":1024,\"ErrorMessage\":\"x\"}", &pixels, &image));
	ASSERT_FALSE(image.has_value);
	ASSERT_TRUE(image.error_number == 0x400);
}

static void image_truncates_long_error_message_at_character_boundary(void) {
	char text[1024] = { 0 };
	char expected[ALPACA_JSON_ERROR_MESSAGE_SIZE] = { 0 };
	int32_t *pixels = NULL;
	alpaca_json_image image = { 0 };
	strcpy(text, "{\"ErrorNumber\":1279,\"ErrorMessage\":\"");
	size_t used = strlen(text);
	memset(text + used, 'a', ALPACA_JSON_ERROR_MESSAGE_SIZE - 2);
	used += ALPACA_JSON_ERROR_MESSAGE_SIZE - 2;
	strcpy(text + used, "\xC3\xA9 and much more text follows\"}");
	memset(expected, 'a', ALPACA_JSON_ERROR_MESSAGE_SIZE - 2);
	ASSERT_TRUE(scan_image(text, &pixels, &image));
	ASSERT_TRUE(image.error_number == 0x4FF);
	ASSERT_STREQ(expected, image.error_message);
	ASSERT_TRUE(pixels == NULL);
}

static void image_converts_doubles(void) {
	int32_t *pixels = NULL;
	alpaca_json_image image = { 0 };
	ASSERT_TRUE(scan_image("{\"Type\":3,\"Rank\":2,\"Value\":[[123.0,-5.000,1e3],[1.2e2,65535.0,0.0]]}", &pixels, &image));
	ASSERT_EQ_INT(3, image.type);
	ASSERT_EQ_INT(0, (int)image.rounded);
	ASSERT_EQ_INT(123, pixels[0]);
	ASSERT_EQ_INT(-5, pixels[1]);
	ASSERT_EQ_INT(1000, pixels[2]);
	ASSERT_EQ_INT(120, pixels[3]);
	ASSERT_EQ_INT(65535, pixels[4]);
	ASSERT_EQ_INT(0, pixels[5]);
	ASSERT_TRUE(image.minimum == -5 && image.maximum == 65535);
	free(pixels);
	ASSERT_TRUE(scan_image("{\"Type\":3,\"Rank\":2,\"Value\":[[0.4,0.5,1.5],[-0.5,-2.6,7]]}", &pixels, &image));
	ASSERT_EQ_INT(5, (int)image.rounded);
	ASSERT_EQ_INT(0, pixels[0]);
	ASSERT_EQ_INT(1, pixels[1]);
	ASSERT_EQ_INT(2, pixels[2]);
	ASSERT_EQ_INT(-1, pixels[3]);
	ASSERT_EQ_INT(-3, pixels[4]);
	ASSERT_EQ_INT(7, pixels[5]);
	ASSERT_TRUE(image.minimum == -3 && image.maximum == 7);
	free(pixels);
	void *buffer = NULL;
	size_t capacity = 0;
	const char *text = "{\"Type\":3,\"Rank\":2,\"Value\":[[0.25,-1.5e-3],[4294967296,7]]}";
	ASSERT_TRUE(scan_image_bytes(text, strlen(text), ALPACA_JSON_IMAGE_DOUBLE, &buffer, &capacity, true, &image));
	const double *values = buffer;
	ASSERT_EQ_INT(4, (int)image.count);
	ASSERT_EQ_INT(0, (int)image.rounded);
	ASSERT_TRUE(values[0] == 0.25 && values[1] == -1.5e-3 && values[2] == 4294967296.0 && values[3] == 7.0);
	ASSERT_TRUE(image.minimum == -1.5e-3 && image.maximum == 4294967296.0);
	free(buffer);
}

static void image_checks_int32_range(void) {
	int32_t *pixels = NULL;
	alpaca_json_image image = { 0 };
	ASSERT_TRUE(scan_image("{\"Value\":[[2147483647,-2147483648,2147483647.0,-2147483648.0,2147483647.4,-0]]}", &pixels, &image));
	ASSERT_EQ_INT(INT32_MAX, pixels[0]);
	ASSERT_EQ_INT(INT32_MIN, pixels[1]);
	ASSERT_EQ_INT(INT32_MAX, pixels[2]);
	ASSERT_EQ_INT(INT32_MIN, pixels[3]);
	ASSERT_EQ_INT(INT32_MAX, pixels[4]);
	ASSERT_EQ_INT(0, pixels[5]);
	ASSERT_EQ_INT(1, (int)image.rounded);
	free(pixels);
	ASSERT_TRUE(image_rejects("{\"Value\":[[2147483648]]}", "Image value out of range"));
	ASSERT_TRUE(image_rejects("{\"Value\":[[-2147483649]]}", "Image value out of range"));
	ASSERT_TRUE(image_rejects("{\"Value\":[[2147483647.5]]}", "Image value out of range"));
	ASSERT_TRUE(image_rejects("{\"Value\":[[99999999999]]}", "Image value out of range"));
	ASSERT_TRUE(image_rejects("{\"Value\":[[123456789012345678901234567890]]}", "Image value out of range"));
	ASSERT_TRUE(image_rejects("{\"Value\":[[1e300]]}", "Image value out of range"));
	ASSERT_TRUE(image_rejects("{\"Value\":[[1e999]]}", "Number out of range"));
}

static void image_rejects_ragged_arrays(void) {
	ASSERT_TRUE(image_rejects("{\"Value\":[[1,2,3],[4,5]]}", "Ragged image array"));
	ASSERT_TRUE(image_rejects("{\"Value\":[[1,2],[3,4,5]]}", "Ragged image array"));
	ASSERT_TRUE(image_rejects("{\"Value\":[[1,2],[3,4],[5]]}", "Ragged image array"));
	ASSERT_TRUE(image_rejects("{\"Value\":[[[1,2,3],[4,5,6]],[[7,8,9]]]}", "Ragged image array"));
	ASSERT_TRUE(image_rejects("{\"Value\":[[[1,2,3],[4,5]]]}", "Ragged image array"));
	ASSERT_TRUE(image_rejects("{\"Value\":[[[1,2],[4,5,6]]]}", "Ragged image array"));
	ASSERT_TRUE(image_rejects("{\"Value\":[[1,2],[]]}", "Invalid number"));
	ASSERT_TRUE(image_rejects("{\"Value\":[[],[1,2]]}", "Invalid number"));
}

static void image_rejects_wrong_rank(void) {
	ASSERT_TRUE(image_rejects("{\"Value\":[]}", "Image array is not of rank 2 or 3"));
	ASSERT_TRUE(image_rejects("{\"Value\":[1,2,3]}", "Image array is not of rank 2 or 3"));
	ASSERT_TRUE(image_rejects("{\"Value\":[[1,2],3]}", "Image array is not of rank 2 or 3"));
	ASSERT_TRUE(image_rejects("{\"Value\":[[]]}", "Invalid number"));
	ASSERT_TRUE(image_rejects("{\"Value\":[[[]]]}", "Invalid number"));
	ASSERT_TRUE(image_rejects("{\"Value\":[[[[1]]]]}", "Invalid number"));
	ASSERT_TRUE(image_rejects("{\"Value\":[[1,[2]]]}", "Mixed nesting in image array"));
	ASSERT_TRUE(image_rejects("{\"Value\":[[[1],2]]}", "Mixed nesting in image array"));
	ASSERT_TRUE(image_rejects("{\"Value\":[[1,2]],\"Rank\":3}", "Rank does not match Value"));
	ASSERT_TRUE(image_rejects("{\"Rank\":2,\"Value\":[[[1,2]]]}", "Rank does not match Value"));
	ASSERT_TRUE(image_rejects("{\"Rank\":1,\"Value\":[[1,2]]}", "Rank does not match Value"));
	ASSERT_TRUE(image_rejects("{\"Value\":[[1]],\"value\":[[2]]}", "Duplicate Value"));
}

static void image_rejects_malformed_envelopes(void) {
	const char *texts[] = { "", " ", "[]", "[[1,2]]", "null", "1", "\"Value\"", "{", "{\"Value\"", "{\"Value\":", "{\"Value\":[", "{\"Value\":[[", "{\"Value\":[[1", "{\"Value\":[[1,", "{\"Value\":[[1]", "{\"Value\":[[1]]", "{\"Value\":[[1]],", "{\"Value\":[[1]],}", "{\"Value\":[[1,]]}", "{\"Value\":[[1],]}", "{\"Value\":[[,1]]}", "{\"Value\":[[1 2]]}", "{\"Value\":[[1][2]]}", "{\"Value\":[[1]]}}", "{\"Value\":[[1]]} x", "{\"Value\":[[1]]}{}", "{\"Value\":[[01]]}", "{\"Value\":[[1.]]}", "{\"Value\":[[-]]}", "{\"Value\":[[+1]]}", "{\"Value\":[[1e]]}", "{\"Value\":[[0x10]]}", "{\"Value\":[[null]]}", "{\"Value\":[[true]]}", "{\"Value\":[[\"1\"]]}", "{\"Value\":[[{}]]}", "{\"Value\":[[1]}", "{\"Value\":[[1]]]}", "{Value:[[1]]}", "{\"Value\" [[1]]}", "{\"Type\":2 \"Value\":[[1]]}", "{\"Type\":,\"Value\":[[1]]}", "{\"Type\":01,\"Value\":[[1]]}", "{\"Other\":[1,},\"Value\":[[1]]}", "{\"Other\":tru,\"Value\":[[1]]}", "{\"ErrorMessage\":\"\\q\",\"Value\":[[1]]}", "{\"ErrorMessage\":\"abc,\"Value\":[[1]]}", "{\"Val\\ue\":[[1]]}", "{\"Value\":[[1]],\"x\"}" };
	for (int i = 0; i < ARRAY_SIZE(texts); i++) {
		ASSERT_TRUE(image_rejects_bytes(texts[i], strlen(texts[i])));
	}
	ASSERT_TRUE(image_rejects_bytes("{\"Value\":[[1,\0]]}", 16));
	char *text = nested_text(100000, '[', ']', "");
	char *nested = malloc(200100);
	snprintf(nested, 200100, "{\"Other\":%s,\"Value\":[[1]]}", text);
	ASSERT_TRUE(image_rejects(nested, "Nesting too deep"));
	snprintf(nested, 200100, "{\"Value\":%s}", text);
	ASSERT_TRUE(image_rejects(nested, "Invalid number"));
	free(nested);
	free(text);
	void *buffer = NULL;
	size_t capacity = 0;
	alpaca_json_image image = { 0 };
	ASSERT_FALSE(alpaca_json_parse_image(NULL, 0, ALPACA_JSON_IMAGE_INT32, &buffer, &capacity, true, &image, error, sizeof(error)));
	ASSERT_FALSE(alpaca_json_parse_image("{}", 2, ALPACA_JSON_IMAGE_INT32, NULL, &capacity, true, &image, error, sizeof(error)));
	ASSERT_FALSE(alpaca_json_parse_image("{}", 2, ALPACA_JSON_IMAGE_INT32, &buffer, NULL, true, &image, error, sizeof(error)));
	ASSERT_FALSE(alpaca_json_parse_image("{}", 2, ALPACA_JSON_IMAGE_INT32, &buffer, &capacity, true, NULL, error, sizeof(error)));
	ASSERT_FALSE(alpaca_json_parse_image("{}", 2, (alpaca_json_image_format)7, &buffer, &capacity, true, &image, error, sizeof(error)));
	ASSERT_FALSE(alpaca_json_parse_image("{", 1, ALPACA_JSON_IMAGE_INT32, &buffer, &capacity, true, &image, NULL, 0));
}

static void image_fails_cleanly_at_every_prefix(void) {
	const char *paths[] = { "fixtures/protocol/alpaca_imagearray_rank2.json", "fixtures/protocol/alpaca_imagearray_rank3.json", "fixtures/protocol/alpaca_error.json" };
	for (int i = 0; i < ARRAY_SIZE(paths); i++) {
		size_t length = 0;
		char *text = read_fixture(paths[i], &length);
		ASSERT_TRUE(text != NULL);
		while (length > 0 && (text[length - 1] == '\n' || text[length - 1] == '\r')) {
			length--;
		}
		for (size_t prefix = 0; prefix < length; prefix++) {
			if (!image_rejects_bytes(text, prefix)) {
				fprintf(stderr, "%s: prefix of %d bytes was accepted\n", paths[i], (int)prefix);
				ASSERT_TRUE(false);
			}
			ASSERT_TRUE(error_offset() >= 0 && (size_t)error_offset() <= prefix);
		}
		free(text);
	}
	const char *text = "{\"Type\":3,\"Extra\":{\"a\":[1,\"\\u00e9\"]},\"Value\":[[1.5e0,-2],[3,4.0]],\"ErrorMessage\":\"\\ud83d\\ude00\"}";
	for (size_t prefix = 0; prefix < strlen(text); prefix++) {
		ASSERT_TRUE(image_rejects_bytes(text, prefix));
	}
	int32_t *pixels = NULL;
	alpaca_json_image image = { 0 };
	ASSERT_TRUE(scan_image(text, &pixels, &image));
	ASSERT_EQ_INT(4, (int)image.count);
	ASSERT_STREQ("\xF0\x9F\x98\x80", image.error_message);
	free(pixels);
}

static void image_respects_caller_buffer(void) {
	const char *text = "{\"Value\":[[1,2,3],[4,5,6]]}";
	int32_t pixels[8] = { 0 };
	void *buffer = pixels;
	size_t capacity = 6;
	alpaca_json_image image = { 0 };
	pixels[6] = 777;
	ASSERT_TRUE(scan_image_bytes(text, strlen(text), ALPACA_JSON_IMAGE_INT32, &buffer, &capacity, false, &image));
	ASSERT_TRUE(buffer == pixels);
	ASSERT_EQ_INT(6, (int)capacity);
	ASSERT_EQ_INT(6, (int)image.count);
	ASSERT_EQ_INT(6, pixels[5]);
	ASSERT_EQ_INT(777, pixels[6]);
	capacity = 5;
	ASSERT_FALSE(scan_image_bytes(text, strlen(text), ALPACA_JSON_IMAGE_INT32, &buffer, &capacity, false, &image));
	ASSERT_TRUE(strstr(error, "Image buffer too small") != NULL);
	ASSERT_TRUE(buffer == pixels);
	ASSERT_EQ_INT(5, (int)capacity);
	ASSERT_EQ_INT(777, pixels[6]);
	buffer = NULL;
	capacity = 100;
	ASSERT_FALSE(scan_image_bytes(text, strlen(text), ALPACA_JSON_IMAGE_INT32, &buffer, &capacity, false, &image));
	ASSERT_TRUE(buffer == NULL);
	capacity = 2;
	buffer = malloc(capacity * sizeof(int32_t));
	ASSERT_TRUE(scan_image_bytes(text, strlen(text), ALPACA_JSON_IMAGE_INT32, &buffer, &capacity, true, &image));
	ASSERT_TRUE(capacity >= 6);
	ASSERT_EQ_INT(6, (int)image.count);
	ASSERT_EQ_INT(1, ((int32_t *)buffer)[0]);
	ASSERT_EQ_INT(6, ((int32_t *)buffer)[5]);
	const char *second = "{\"Value\":[[9,8]]}";
	size_t before = capacity;
	void *same = buffer;
	ASSERT_TRUE(scan_image_bytes(second, strlen(second), ALPACA_JSON_IMAGE_INT32, &buffer, &capacity, true, &image));
	ASSERT_TRUE(buffer == same && capacity == before);
	ASSERT_EQ_INT(2, (int)image.count);
	ASSERT_EQ_INT(9, ((int32_t *)buffer)[0]);
	ASSERT_EQ_INT(8, ((int32_t *)buffer)[1]);
	free(buffer);
}

// Not a benchmark: one generated 2000 x 1500 16-bit frame is scanned and verified, the printed time only
// shows the order of magnitude of the JSON fallback.
static void image_scans_large_generated_array(void) {
	const int width = 2000;
	const int height = 1500;
	size_t size = (size_t)width * (size_t)height * 6 + (size_t)width * 2 + 256;
	char *text = malloc(size);
	ASSERT_TRUE(text != NULL);
	size_t used = (size_t)snprintf(text, size, "{\"Type\":2,\"Rank\":2,\"Value\":[");
	for (int x = 0; x < width; x++) {
		text[used++] = '[';
		for (int y = 0; y < height; y++) {
			unsigned value = ((unsigned)x * 31U + (unsigned)y * 17U) & 0xFFFFU;
			char digits[8] = { 0 };
			int count = 0;
			do {
				digits[count++] = (char)('0' + value % 10);
				value /= 10;
			} while (value > 0);
			while (count > 0) {
				text[used++] = digits[--count];
			}
			text[used++] = y + 1 < height ? ',' : ']';
		}
		text[used++] = x + 1 < width ? ',' : ']';
	}
	used += (size_t)snprintf(text + used, size - used, ",\"ErrorNumber\":0,\"ErrorMessage\":\"\",\"ClientTransactionID\":1,\"ServerTransactionID\":2}");
	ASSERT_TRUE(used < size);
	void *buffer = NULL;
	size_t capacity = 0;
	alpaca_json_image image = { 0 };
	double start = seconds();
	bool result = alpaca_json_parse_image(text, used, ALPACA_JSON_IMAGE_INT32, &buffer, &capacity, true, &image, error, sizeof(error));
	double elapsed = seconds() - start;
	if (!result) {
		fprintf(stderr, "%s\n", error);
	}
	ASSERT_TRUE(result);
	printf("  INFO image_scans_large_generated_array: %d x %d, %.1f MB of JSON scanned in %.3f s (%.0f MB/s)\n", width, height, (double)used / 1e6, elapsed, (double)used / 1e6 / elapsed);
	ASSERT_TRUE(image.has_value);
	ASSERT_EQ_INT(2, image.rank);
	ASSERT_EQ_INT(width, image.dimensions[0]);
	ASSERT_EQ_INT(height, image.dimensions[1]);
	ASSERT_TRUE(image.count == (size_t)width * (size_t)height);
	ASSERT_TRUE(capacity >= image.count && capacity <= image.count * 2 + 65536);
	const int32_t *pixels = buffer;
	bool equal = true;
	for (int x = 0; x < width && equal; x++) {
		for (int y = 0; y < height && equal; y++) {
			equal = pixels[(size_t)x * (size_t)height + (size_t)y] == (int32_t)(((unsigned)x * 31U + (unsigned)y * 17U) & 0xFFFFU);
		}
	}
	ASSERT_TRUE(equal);
	ASSERT_TRUE(image.minimum == 0 && image.maximum == 65535);
	ASSERT_TRUE(image.has_client_transaction_id && image.client_transaction_id == 1);
	ASSERT_TRUE(image.has_server_transaction_id && image.server_transaction_id == 2);
	size_t fixed = image.count;
	ASSERT_TRUE(alpaca_json_parse_image(text, used, ALPACA_JSON_IMAGE_INT32, &buffer, &fixed, false, &image, error, sizeof(error)));
	ASSERT_FALSE(alpaca_json_parse_image(text, used - 1, ALPACA_JSON_IMAGE_INT32, &buffer, &capacity, true, &image, error, sizeof(error)));
	ASSERT_FALSE(alpaca_json_parse_image(text, used / 2, ALPACA_JSON_IMAGE_INT32, &buffer, &capacity, true, &image, error, sizeof(error)));
	ASSERT_TRUE(alpaca_json_parse(text, used, error, sizeof(error)) == NULL);
	ASSERT_STREQ("Text too long at offset 0", error);
	free(buffer);
	free(text);
}

int main(void) {
	const indigo_test_case tests[] = {
		{ "parses_scalar_documents_of_every_type", parses_scalar_documents_of_every_type },
		{ "parses_nested_containers", parses_nested_containers },
		{ "parses_empty_containers", parses_empty_containers },
		{ "tolerates_whitespace_around_every_token", tolerates_whitespace_around_every_token },
		{ "parses_integers", parses_integers },
		{ "get_int_accepts_integral_doubles_only", get_int_accepts_integral_doubles_only },
		{ "parses_doubles", parses_doubles },
		{ "rejects_malformed_numbers", rejects_malformed_numbers },
		{ "parses_very_long_number_tokens", parses_very_long_number_tokens },
		{ "unescapes_strings", unescapes_strings },
		{ "keeps_valid_utf8_and_replaces_invalid_bytes", keeps_valid_utf8_and_replaces_invalid_bytes },
		{ "rejects_malformed_strings", rejects_malformed_strings },
		{ "rejects_invalid_surrogates", rejects_invalid_surrogates },
		{ "tolerates_leading_byte_order_mark_only", tolerates_leading_byte_order_mark_only },
		{ "rejects_malformed_documents", rejects_malformed_documents },
		{ "reports_error_message_and_offset", reports_error_message_and_offset },
		{ "every_truncated_prefix_fails_cleanly", every_truncated_prefix_fails_cleanly },
		{ "enforces_depth_limit", enforces_depth_limit },
		{ "survives_hostile_nesting", survives_hostile_nesting },
		{ "enforces_size_limit", enforces_size_limit },
		{ "parses_largest_document_made_of_shortest_values", parses_largest_document_made_of_shortest_values },
		{ "parses_numbers_independently_of_locale", parses_numbers_independently_of_locale },
		{ "looks_up_members_with_and_without_case", looks_up_members_with_and_without_case },
		{ "getters_do_not_coerce_types", getters_do_not_coerce_types },
		{ "accessors_tolerate_null_values", accessors_tolerate_null_values },
		{ "iterates_arrays_and_objects", iterates_arrays_and_objects },
		{ "parses_apiversions_fixture", parses_apiversions_fixture },
		{ "parses_description_fixture", parses_description_fixture },
		{ "parses_configureddevices_fixture", parses_configureddevices_fixture },
		{ "parses_value_envelope_fixture", parses_value_envelope_fixture },
		{ "parses_error_envelope_fixture", parses_error_envelope_fixture },
		{ "parses_devicestate_fixture", parses_devicestate_fixture },
		{ "parses_imagearray_fixtures_into_dom", parses_imagearray_fixtures_into_dom },
		{ "fixtures_fail_cleanly_at_every_prefix", fixtures_fail_cleanly_at_every_prefix },
		{ "image_scans_rank2_fixture", image_scans_rank2_fixture },
		{ "image_scans_rank3_fixture", image_scans_rank3_fixture },
		{ "image_accepts_members_in_any_order", image_accepts_members_in_any_order },
		{ "image_handles_missing_and_mistyped_members", image_handles_missing_and_mistyped_members },
		{ "image_reports_error_envelope_without_value", image_reports_error_envelope_without_value },
		{ "image_truncates_long_error_message_at_character_boundary", image_truncates_long_error_message_at_character_boundary },
		{ "image_converts_doubles", image_converts_doubles },
		{ "image_checks_int32_range", image_checks_int32_range },
		{ "image_rejects_ragged_arrays", image_rejects_ragged_arrays },
		{ "image_rejects_wrong_rank", image_rejects_wrong_rank },
		{ "image_rejects_malformed_envelopes", image_rejects_malformed_envelopes },
		{ "image_fails_cleanly_at_every_prefix", image_fails_cleanly_at_every_prefix },
		{ "image_respects_caller_buffer", image_respects_caller_buffer },
		{ "image_scans_large_generated_array", image_scans_large_generated_array }
	};
	return indigo_run_tests("system_alpaca JSON parser unit tests", tests, ARRAY_SIZE(tests));
}
