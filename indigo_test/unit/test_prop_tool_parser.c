// Copyright (c) 2026 INDIGO initiative
// All rights reserved.
//
// You may use this software under the terms of 'INDIGO Astronomy
// open-source license' (see LICENSE.md).
//
// THIS SOFTWARE IS PROVIDED BY THE AUTHORS 'AS IS' AND ANY EXPRESS
// OR IMPLIED WARRANTIES, INCLUDING, BUT NOT LIMITED TO, THE IMPLIED
// WARRANTIES OF MERCHANTABILITY AND FITNESS FOR A PARTICULAR PURPOSE
// ARE DISCLAIMED. IN NO EVENT SHALL THE AUTHOR BE LIABLE FOR ANY
// DIRECT, INDIRECT, INCIDENTAL, SPECIAL, EXEMPLARY, OR CONSEQUENTIAL
// DAMAGES (INCLUDING, BUT NOT LIMITED TO, PROCUREMENT OF SUBSTITUTE
// GOODS OR SERVICES; LOSS OF USE, DATA, OR PROFITS; OR BUSINESS
// INTERRUPTION) HOWEVER CAUSED AND ON ANY THEORY OF LIABILITY,
// WHETHER IN CONTRACT, STRICT LIABILITY, OR TORT (INCLUDING
// NEGLIGENCE OR OTHERWISE) ARISING IN ANY WAY OUT OF THE USE OF THIS
// SOFTWARE, EVEN IF ADVISED OF THE POSSIBILITY OF SUCH DAMAGE.

// Code is generated by AI

#include <indigo/indigo_bus.h>
#include "../test_runner.h"

#define MAX_ITEMS 128
#define ARRAY_SIZE(array) (sizeof(array) / sizeof((array)[0]))

typedef struct {
	int item_count;
	char device_name[INDIGO_NAME_SIZE];
	char property_name[INDIGO_NAME_SIZE];
	char item_name[MAX_ITEMS][INDIGO_NAME_SIZE];
	char value_string[MAX_ITEMS][INDIGO_VALUE_SIZE];
} property_change_request;

typedef struct {
	int item_count;
	char device_name[INDIGO_NAME_SIZE];
	char property_name[INDIGO_NAME_SIZE];
	char item_name[MAX_ITEMS][INDIGO_NAME_SIZE];
} property_get_request;

typedef struct {
	char device_name[INDIGO_NAME_SIZE];
	char property_name[INDIGO_NAME_SIZE];
} property_list_request;

extern int parse_list_property_string(const char *, property_list_request *);
extern int parse_get_property_string(const char *, property_get_request *);
extern int parse_set_property_string(const char *, property_change_request *);
extern int indigo_prop_tool_main(int, const char *[]);

static property_change_request set_result;
static property_get_request get_result;

static void ordinary_requests(void) {
	property_list_request list_result;
	ASSERT_EQ_INT(0, parse_list_property_string(NULL, &list_result));
	ASSERT_EQ_INT(1, parse_list_property_string("My Device", &list_result));
	ASSERT_STREQ("My Device", list_result.device_name);
	ASSERT_EQ_INT(2, parse_list_property_string("My Device. PROP  ", &list_result));
	ASSERT_STREQ("PROP", list_result.property_name);
	ASSERT_EQ_INT(2, parse_get_property_string("My Device.PROP. A ;B;", &get_result));
	ASSERT_STREQ("A", get_result.item_name[0]);
	ASSERT_STREQ("B", get_result.item_name[1]);
	ASSERT_EQ_INT(2, parse_set_property_string("My Device.PROP. A = \"hello world\" ; B=\"say \\\"yes\\\"\";", &set_result));
	ASSERT_STREQ("A", set_result.item_name[0]);
	ASSERT_STREQ("hello world", set_result.value_string[0]);
	ASSERT_STREQ("say \"yes\"", set_result.value_string[1]);
}

static void field_boundaries(void) {
	char name[INDIGO_NAME_SIZE + 1], value[INDIGO_VALUE_SIZE + 1];
	char request[INDIGO_VALUE_SIZE + INDIGO_NAME_SIZE * 3 + 16];
	property_list_request list_result;
	memset(name, 'N', sizeof(name));
	name[INDIGO_NAME_SIZE - 1] = '\0';
	ASSERT_EQ_INT(1, parse_list_property_string(name, &list_result));
	snprintf(request, sizeof(request), "%s.%s.%s=1", name, name, name);
	ASSERT_EQ_INT(1, parse_set_property_string(request, &set_result));
	snprintf(request, sizeof(request), "%s.%s.%s", name, name, name);
	ASSERT_EQ_INT(1, parse_get_property_string(request, &get_result));
	memset(value, 'V', sizeof(value));
	value[INDIGO_VALUE_SIZE - 1] = '\0';
	snprintf(request, sizeof(request), "D.P.I=%s", value);
	ASSERT_EQ_INT(1, parse_set_property_string(request, &set_result));
	value[INDIGO_VALUE_SIZE - 1] = 'V';
	value[INDIGO_VALUE_SIZE] = '\0';
	snprintf(request, sizeof(request), "D.P.I=%s", value);
	ASSERT_TRUE(parse_set_property_string(request, &set_result) < 0);
	name[INDIGO_NAME_SIZE - 1] = 'N';
	name[INDIGO_NAME_SIZE] = '\0';
	ASSERT_TRUE(parse_list_property_string(name, &list_result) < 0);
	snprintf(request, sizeof(request), "D.%s", name);
	ASSERT_TRUE(parse_list_property_string(request, &list_result) < 0);
	for (int position = 0; position < 3; position++) {
		snprintf(request, sizeof(request), "%s.%s.%s", position == 0 ? name : "D", position == 1 ? name : "P", position == 2 ? name : "I");
		ASSERT_TRUE(parse_get_property_string(request, &get_result) < 0);
		strcat(request, "=1");
		ASSERT_TRUE(parse_set_property_string(request, &set_result) < 0);
	}
}

static void item_count_boundaries(void) {
	char request[MAX_ITEMS * 8 + 32] = "D.P.";
	for (int i = 0; i < MAX_ITEMS; i++) {
		strcat(request, "I;");
	}
	ASSERT_EQ_INT(MAX_ITEMS, parse_get_property_string(request, &get_result));
	strcat(request, "I");
	ASSERT_TRUE(parse_get_property_string(request, &get_result) < 0);
	strcpy(request, "D.P.");
	for (int i = 0; i < MAX_ITEMS; i++) {
		strcat(request, "I=1;");
	}
	ASSERT_EQ_INT(MAX_ITEMS, parse_set_property_string(request, &set_result));
	strcat(request, "I=1");
	ASSERT_TRUE(parse_set_property_string(request, &set_result) < 0);
}

static void malformed_requests(void) {
	property_list_request list_result;
	const char *invalid_get[] = { "D", "D.P", "D.P.", ".P.I", "D..I", "D.P. ", "D.P.I;;J", "D.P.I\nJ" };
	for (size_t i = 0; i < ARRAY_SIZE(invalid_get); i++) {
		ASSERT_TRUE(parse_get_property_string(invalid_get[i], &get_result) < 0);
	}
	const char *invalid_set[] = { "D.P.I", "D.P.=V", "D.P.I=", "D.P.I=  ", "D.P.I=V;;J=W", "D.P.I=V\nW" };
	for (size_t i = 0; i < ARRAY_SIZE(invalid_set); i++) {
		ASSERT_TRUE(parse_set_property_string(invalid_set[i], &set_result) < 0);
	}
	ASSERT_TRUE(parse_list_property_string(".P", &list_result) < 0);
	ASSERT_TRUE(parse_list_property_string("D.", &list_result) < 0);
}

static void remote_endpoints(void) {
	char endpoint[256];
	const char *arguments[] = { "indigo_prop_tool", "set", "-r", endpoint, "--help" };
	memset(endpoint, 'h', 255);
	endpoint[255] = '\0';
	ASSERT_EQ_INT(1, indigo_prop_tool_main(5, arguments));
	endpoint[254] = '\0';
	const char *valid[] = { "example.invalid", "example.invalid:1", "example.invalid:65535", endpoint };
	// --help returns before the bus or network starts, after endpoint validation.
	for (size_t i = 0; i < ARRAY_SIZE(valid); i++) {
		arguments[3] = valid[i];
		ASSERT_EQ_INT(0, indigo_prop_tool_main(5, arguments));
	}
	const char *invalid[] = { "", ":123", "host:", "host:0", "host:-1", "host:65536", "host:999999999999999999999999", "host:1x", "host:1:2", "host\nname:1" };
	for (size_t i = 0; i < ARRAY_SIZE(invalid); i++) {
		arguments[3] = invalid[i];
		ASSERT_EQ_INT(1, indigo_prop_tool_main(5, arguments));
	}
}

int main(void) {
	const indigo_test_case tests[] = {
		{ "ordinary_requests", ordinary_requests },
		{ "field_boundaries", field_boundaries },
		{ "item_count_boundaries", item_count_boundaries },
		{ "malformed_requests", malformed_requests },
		{ "remote_endpoints", remote_endpoints }
	};
	return indigo_run_tests("Property tool input safety", tests, ARRAY_SIZE(tests));
}
