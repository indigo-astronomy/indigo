// Copyright (c) 2026 INDIGO initiative
// All rights reserved.
//
// You may use this software under the terms of 'INDIGO Astronomy
// open-source license' (see LICENSE.md).
//
// THIS SOFTWARE IS PROVIDED BY THE AUTHORS 'AS IS' AND ANY EXPRESS
// OR IMPLIED WARRANTIES, INCLUDING, BUT NOT LIMITED TO, THE IMPLIED
// WARRANTIES OF MERCHANTABILITY AND FITNESS FOR A PARTICULAR PURPOSE
// ARE DISCLAIMED. IN NO EVENT SHALL THE AUTHOR BE LIABLE FOR ANY
// DIRECT, INDIRECT, INCIDENTAL, SPECIAL, EXEMPLARY, OR CONSEQUENTIAL
// DAMAGES (INCLUDING, BUT NOT LIMITED TO, PROCUREMENT OF SUBSTITUTE
// GOODS OR SERVICES; LOSS OF USE, DATA, OR PROFITS; OR BUSINESS
// INTERRUPTION) HOWEVER CAUSED AND ON ANY THEORY OF LIABILITY,
// WHETHER IN CONTRACT, STRICT LIABILITY, OR TORT (INCLUDING
// NEGLIGENCE OR OTHERWISE) ARISING IN ANY WAY OUT OF THE USE OF THIS
// SOFTWARE, EVEN IF ADVISED OF THE POSSIBILITY OF SUCH DAMAGE.

// Code is generated by AI

#include <string.h>
#include <indigo/indigo_bus.h>
#include <indigo/indigo_client.h>
#include <indigo/indigo_client_xml.h>
#include <indigo/indigo_agent.h>
#include <indigo/indigo_filter.h>
#include "../test_runner.h"

#define CHECK(condition) do { if (!(condition)) { fprintf(stderr, "%s:%d: %s\n", __FILE__, __LINE__, #condition); indigo_test_failures++; goto cleanup; } } while (0)
#define CHECK_EQ_INT(expected, actual) CHECK((expected) == (actual))
#define CHECK_STREQ(expected, actual) CHECK(strcmp((expected), (actual)) == 0)

static char captured[4][INDIGO_VALUE_SIZE];
static int changes;

static indigo_result capture_change(indigo_device *device, indigo_client *client, indigo_property *property) {
	changes++;
	for (int i = 0; i < property->count && i < 4; i++) {
		INDIGO_COPY_VALUE(captured[i], indigo_get_text_item_value(property->items + i));
	}
	return INDIGO_OK;
}

static void service_and_adapter_names_reserve_capacity(void) {
	char host[INDIGO_NAME_SIZE], name[INDIGO_NAME_SIZE];
	memset(host, 'h', sizeof(host) - 1);
	host[sizeof(host) - 1] = 0;
	indigo_service_name(host, 12345, name);
	ASSERT_EQ_INT(INDIGO_NAME_SIZE - 1, strlen(name));
	ASSERT_STREQ(":12345", name + strlen(name) - 6);
	indigo_service_name("example.local", 7624, name);
	ASSERT_STREQ("example", name);
	indigo_uni_handle input = { 0 };
	indigo_device *adapter = indigo_xml_client_adapter(host, "", &input, &input);
	ASSERT_TRUE(adapter != NULL);
	ASSERT_EQ_INT(INDIGO_NAME_SIZE - 1, strlen(adapter->name));
	ASSERT_TRUE(!strncmp(adapter->name, "@ ", 2));
	indigo_release_xml_client_adapter(adapter);
}

static void formatted_text_and_snoop_values_are_literal(void) {
	indigo_device device = INDIGO_DEVICE_INITIALIZER("Text Bounds", NULL, NULL, capture_change, NULL, NULL);
	indigo_device snoop = INDIGO_DEVICE_INITIALIZER(SNOOP_AGENT_NAME, NULL, NULL, capture_change, NULL, NULL);
	bool started = false, attached = false, snoop_attached = false;
	indigo_property *target = NULL;
	CHECK_EQ_INT(INDIGO_OK, indigo_start());
	started = true;
	CHECK_EQ_INT(INDIGO_OK, indigo_attach_device(&device));
	attached = true;
	CHECK_EQ_INT(INDIGO_OK, indigo_attach_device(&snoop));
	snoop_attached = true;
	changes = 0;
	CHECK_EQ_INT(INDIGO_OK, indigo_change_text_property_1(NULL, device.name, "VALUE", "ITEM", "%s %d%%", "progress", 50));
	CHECK_EQ_INT(1, changes);
	CHECK_STREQ("progress 50%", captured[0]);
	CHECK_EQ_INT(INDIGO_OK, indigo_change_text_property_1_with_token(NULL, device.name, 0, "VALUE", "ITEM", "%s", "literal %% marker"));
	CHECK_STREQ("literal %% marker", captured[0]);
	target = indigo_init_text_property(NULL, "Target 50%", "Target %%", "", "", INDIGO_OK_STATE, INDIGO_RW_PERM, 0);
	CHECK_EQ_INT(INDIGO_OK, indigo_add_snoop_rule(target, "Source 50%", "Source %%"));
	CHECK_STREQ("Source 50%", captured[0]);
	CHECK_STREQ("Source %%", captured[1]);
	CHECK_STREQ("Target 50%", captured[2]);
	CHECK_STREQ("Target %%", captured[3]);
	CHECK_EQ_INT(INDIGO_OK, indigo_remove_snoop_rule(target, "Source 50%", "Source %%"));
	CHECK_STREQ("Source 50%", captured[0]);
	CHECK_STREQ("Target %%", captured[3]);
cleanup:
	indigo_release_property(target);
	if (snoop_attached && indigo_detach_device(&snoop) != INDIGO_OK) {
		indigo_test_failures++;
	}
	if (attached && indigo_detach_device(&device) != INDIGO_OK) {
		indigo_test_failures++;
	}
	if (started && indigo_stop() != INDIGO_OK) {
		indigo_test_failures++;
	}
}

static void unique_names_reject_unrepresentable_suffixes(void) {
	indigo_device device = INDIGO_DEVICE_INITIALIZER("Unique", NULL, NULL, NULL, NULL, NULL);
	bool started = false, attached = false;
	CHECK_EQ_INT(INDIGO_OK, indigo_start());
	started = true;
	CHECK_EQ_INT(INDIGO_OK, indigo_attach_device(&device));
	attached = true;
	char name[INDIGO_NAME_SIZE] = "Unique";
	CHECK(indigo_make_name_unique(name, NULL));
	CHECK_STREQ("Unique #1", name);
	memset(device.name, 'u', sizeof(device.name) - 1);
	device.name[sizeof(device.name) - 1] = 0;
	strcpy(name, device.name);
	CHECK(!indigo_make_name_unique(name, NULL));
	CHECK_STREQ(device.name, name);
	CHECK(!indigo_make_name_unique(name, "%s", "suffix"));
	CHECK_STREQ(device.name, name);
cleanup:
	if (attached && indigo_detach_device(&device) != INDIGO_OK) {
		indigo_test_failures++;
	}
	if (started && indigo_stop() != INDIGO_OK) {
		indigo_test_failures++;
	}
}

static void filter_proxy_identifiers_are_bounded(void) {
	indigo_device agent = INDIGO_DEVICE_INITIALIZER("Proxy Agent", NULL, NULL, NULL, NULL, NULL);
	indigo_device remote = INDIGO_DEVICE_INITIALIZER("Remote Wheel", NULL, NULL, NULL, NULL, NULL);
	indigo_filter_context *context = calloc(1, sizeof(*context));
	indigo_client client = { 0 };
	indigo_property *property = NULL;
	bool passed = false;
	if (!context) {
		goto cleanup;
	}
	context->device = &agent;
	client.client_context = context;
	INDIGO_COPY_NAME(context->device_name[INDIGO_FILTER_WHEEL_INDEX], remote.name);
	char name[INDIGO_NAME_SIZE], group[INDIGO_VALUE_SIZE];
	memset(name, 'n', sizeof(name) - 1);
	name[sizeof(name) - 1] = 0;
	memset(group, 'g', sizeof(group) - 1);
	group[sizeof(group) - 1] = 0;
	property = indigo_init_text_property(NULL, remote.name, name, group, "", INDIGO_OK_STATE, INDIGO_RW_PERM, 0);
	if (indigo_filter_define_property(&client, &remote, property, NULL) != INDIGO_OK || context->device_property_cache[0] || context->agent_property_cache[0]) {
		goto cleanup;
	}
	strcpy(property->name, "CUSTOM");
	if (indigo_filter_define_property(&client, &remote, property, NULL) != INDIGO_OK || !context->device_property_cache[0] || !context->agent_property_cache[0]) {
		goto cleanup;
	}
	indigo_property *proxy = context->agent_property_cache[0];
	passed = !strcmp(proxy->name, "WHEEL_CUSTOM") && strlen(proxy->group) == sizeof(proxy->group) - 1 && !strncmp(proxy->group, "Filter Wheel ", strlen("Filter Wheel "));
cleanup:
	indigo_release_property(property);
	if (context) {
		for (int i = 0; i < INDIGO_FILTER_MAX_CACHED_PROPERTIES; i++) {
			indigo_release_property(context->device_property_cache[i]);
			indigo_release_property(context->agent_property_cache[i]);
		}
		free(context);
	}
	ASSERT_TRUE(passed);
}

int main(void) {
	if (!indigo_test_use_private_home()) {
		return 1;
	}
	const indigo_test_case tests[] = {
		{ "service_and_adapter_names_reserve_capacity", service_and_adapter_names_reserve_capacity },
		{ "formatted_text_and_snoop_values_are_literal", formatted_text_and_snoop_values_are_literal },
		{ "unique_names_reject_unrepresentable_suffixes", unique_names_reject_unrepresentable_suffixes },
		{ "filter_proxy_identifiers_are_bounded", filter_proxy_identifiers_are_bounded }
	};
	int result = indigo_run_tests("Core text bounds", tests, sizeof(tests) / sizeof(tests[0]));
	indigo_test_remove_private_home();
	return result;
}
