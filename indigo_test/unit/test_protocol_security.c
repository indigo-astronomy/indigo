// Copyright (c) 2026 INDIGO initiative
// All rights reserved.
//
// You may use this software under the terms of 'INDIGO Astronomy
// open-source license' (see LICENSE.md).
//
// THIS SOFTWARE IS PROVIDED BY THE AUTHORS 'AS IS' AND ANY EXPRESS
// OR IMPLIED WARRANTIES, INCLUDING, BUT NOT LIMITED TO, THE IMPLIED
// WARRANTIES OF MERCHANTABILITY AND FITNESS FOR A PARTICULAR PURPOSE
// ARE DISCLAIMED. IN NO EVENT SHALL THE AUTHOR BE LIABLE FOR ANY
// DIRECT, INDIRECT, INCIDENTAL, SPECIAL, EXEMPLARY, OR CONSEQUENTIAL
// DAMAGES (INCLUDING, BUT NOT LIMITED TO, PROCUREMENT OF SUBSTITUTE
// GOODS OR SERVICES; LOSS OF USE, DATA, OR PROFITS; OR BUSINESS
// INTERRUPTION) HOWEVER CAUSED AND ON ANY THEORY OF LIABILITY,
// WHETHER IN CONTRACT, STRICT LIABILITY, OR TORT (INCLUDING
// NEGLIGENCE OR OTHERWISE) ARISING IN ANY WAY OUT OF THE USE OF THIS
// SOFTWARE, EVEN IF ADVISED OF THE POSSIBILITY OF SUCH DAMAGE.

// Code is generated by AI

#include <stdio.h>
#include <string.h>
#include <unistd.h>
#include <indigo/indigo_bus.h>
#include <indigo/indigo_xml.h>
#include <indigo/indigo_json.h>
#include <indigo/indigo_client_xml.h>
#include <indigo/indigo_driver_xml.h>
#include <indigo/indigo_driver_json.h>
#include "../test_runner.h"

#define ARRAY_SIZE(a) (sizeof(a) / sizeof((a)[0]))

static int changes, updates, messages;
static char last_message[INDIGO_VALUE_SIZE];
static bool large_blob_valid;
static size_t text_length;
static unsigned char blobs[2][32];
static long sizes[2];

static indigo_result change(indigo_device *device, indigo_client *client, indigo_property *property) {
	changes++;
	if (property->type == INDIGO_TEXT_VECTOR && property->count) {
		text_length = strlen(indigo_get_text_item_value(property->items));
	}
	return INDIGO_OK;
}

static indigo_result update(indigo_client *client, indigo_device *device, indigo_property *property, const char *message) {
	if (property->type == INDIGO_BLOB_VECTOR) {
		updates++;
		for (int i = 0; i < property->count && i < 2; i++) {
			sizes[i] = property->items[i].blob.size;
			if (sizes[i] == 450000 && property->items[i].blob.value) {
				large_blob_valid = true;
				for (long j = 0; j < sizes[i]; j++) {
					if (((unsigned char *)property->items[i].blob.value)[j] != 'a') {
						large_blob_valid = false;
						break;
					}
				}
			}
			if (sizes[i] && sizes[i] <= sizeof(blobs[i]) && property->items[i].blob.value) {
				memcpy(blobs[i], property->items[i].blob.value, sizes[i]);
			}
		}
	}
	return INDIGO_OK;
}

static indigo_result property_event(indigo_client *client, indigo_device *device, indigo_property *property, const char *message) {
	return INDIGO_OK;
}

static indigo_result message_event(indigo_client *client, indigo_device *device, indigo_property *property, const char *message) {
	messages++;
	INDIGO_COPY_VALUE(last_message, message);
	return INDIGO_OK;
}

static indigo_device device = INDIGO_DEVICE_INITIALIZER("Security", NULL, NULL, change, NULL, NULL);
static indigo_client observer = { .name = "Security observer", .version = INDIGO_VERSION_CURRENT, .define_property = property_event, .update_property = update, .delete_property = property_event, .send_message = message_event };

static void parse(const void *data, size_t length, int protocol, bool remote, indigo_version version) {
	FILE *file = tmpfile();
	ASSERT_TRUE(file != NULL);
	ASSERT_EQ_INT(length, fwrite(data, 1, length, file));
	if (protocol == 1) {
		fputc('\n', file);
	}
	fflush(file);
	rewind(file);
	indigo_uni_handle *input = indigo_uni_create_file_handle(dup(fileno(file)), INDIGO_LOG_NONE);
	ASSERT_TRUE(input != NULL);
	if (remote) {
		indigo_device *adapter = indigo_xml_client_adapter("Test", "", input, input);
		adapter->version = version;
		indigo_xml_parse(adapter, NULL);
		indigo_release_xml_client_adapter(adapter);
	} else if (protocol) {
		indigo_client *adapter = indigo_json_device_adapter(input, input, protocol == 2);
		indigo_json_parse(NULL, adapter);
		indigo_release_json_device_adapter(adapter);
	} else {
		indigo_client *adapter = indigo_xml_device_adapter(input, input);
		indigo_xml_parse(NULL, adapter);
		indigo_release_xml_device_adapter(adapter);
	}
	indigo_uni_close(&input);
	fclose(file);
}

static void xml(const char *data) {
	parse(data, strlen(data), 0, false, INDIGO_VERSION_CURRENT);
}

static const char *xml_change = "<newTextVector device='Security' name='T'><oneText name='V'>ok</oneText></newTextVector>";
static const char *json_change = "{\"newTextVector\":{\"device\":\"Security\",\"name\":\"T\",\"items\":[{\"name\":\"V\",\"value\":\"ok\"}]}}";

static void xml_attribute_boundaries(void) {
	for (int quote = 0; quote < 2; quote++) {
		for (size_t length = 524287; length <= 524289; length++) {
			char *request = malloc(length + 256);
			int prefix = snprintf(request, length + 256, "<newTextVector device='Security' name='T' unknown=%c", quote ? '\"' : '\'');
			memset(request + prefix, 'a', length);
			snprintf(request + prefix + length, 256 - prefix, "%c><oneText name='V'>ok</oneText></newTextVector>", quote ? '\"' : '\'');
			changes = 0;
			xml(request);
			free(request);
			ASSERT_EQ_INT(length <= 524288, changes);
		}
	}
}

static void xml_name_boundaries(void) {
	char request[512];
	for (size_t length = 127; length <= 129; length++) {
		strcpy(request, "<newTextVector ");
		memset(request + 15, 'a', length);
		snprintf(request + 15 + length, sizeof(request) - 15 - length, "='x' device='Security' name='T'/>");
		changes = 0;
		xml(request);
		ASSERT_EQ_INT(length == 127, changes);
	}
	for (size_t length = 127; length <= 129; length++) {
		request[0] = '<';
		memset(request + 1, 'a', length);
		snprintf(request + 1 + length, sizeof(request) - 1 - length, "/>%s", xml_change);
		changes = 0;
		xml(request);
		ASSERT_EQ_INT(0, changes);
	}
}

static void xml_entity_boundaries(void) {
	char request[512];
	const char *entities[] = { "&amp;&lt;&gt;&quot;&apos;", "&aaaaaaaa;", "&aaaaaaa;", "&aaaaaaaaa;", "&amp", "&&amp;" };
	for (size_t i = 0; i < ARRAY_SIZE(entities); i++) {
		snprintf(request, sizeof(request), "<newTextVector device='Security' name='T'><oneText name='V'>%s</oneText></newTextVector>", entities[i]);
		changes = 0;
		xml(request);
		ASSERT_EQ_INT(i == 0, changes);
	}
}

static void xml_wrong_direction(void) {
	const char *responses[] = { "switchProtocol", "defTextVector", "defNumberVector", "defSwitchVector", "defLightVector", "defBLOBVector", "setTextVector", "setNumberVector", "setSwitchVector", "setLightVector", "setBLOBVector", "delProperty", "message" };
	char request[512];
	for (size_t i = 0; i < ARRAY_SIZE(responses); i++) {
		snprintf(request, sizeof(request), "<%s version='2.0' device='Security' name='T'/>%s", responses[i], xml_change);
		changes = 0;
		xml(request);
		ASSERT_EQ_INT(0, changes);
	}
	const char *requests[] = { "getProperties", "enableBLOB", "newTextVector", "newNumberVector", "newSwitchVector", "newBLOBVector" };
	for (size_t i = 0; i < ARRAY_SIZE(requests); i++) {
		snprintf(request, sizeof(request), "<%s device='Security' name='T'/>", requests[i]);
		changes = 0;
		parse(request, strlen(request), 0, true, INDIGO_VERSION_CURRENT);
		ASSERT_EQ_INT(0, changes);
	}
}

static void remote_blob(const char *size1, const char *body1, const char *size2, const char *body2, bool complete, indigo_version version) {
	char request[2048];
	snprintf(request, sizeof(request), "<defBLOBVector device='Security' name='B' state='Ok' perm='ro'><defBLOB name='A'/><defBLOB name='B'/></defBLOBVector><setBLOBVector device='Security' name='B' state='Ok'><oneBLOB name='A' size='%s'>%s</oneBLOB><oneBLOB name='B' size='%s'>%s%s", size1, body1, size2, body2, complete ? "</oneBLOB></setBLOBVector>" : "");
	updates = 0;
	memset(blobs, 0, sizeof(blobs));
	memset(sizes, 0, sizeof(sizes));
	parse(request, strlen(request), 0, true, version);
}

static void xml_blob_owned_items_and_padding(void) {
	indigo_version versions[] = { INDIGO_VERSION_LEGACY, INDIGO_VERSION_CURRENT };
	for (size_t i = 0; i < ARRAY_SIZE(versions); i++) {
		remote_blob("6", "YWJjZGVm", "1", "eg==", true, versions[i]);
		ASSERT_EQ_INT(1, updates);
		ASSERT_EQ_INT(6, sizes[0]);
		ASSERT_TRUE(!memcmp(blobs[0], "abcdef", 6));
		ASSERT_TRUE(!memcmp(blobs[1], "z", 1));
		remote_blob("1", "YQ==", "6", "eHl6eHl6", true, versions[i]);
		ASSERT_EQ_INT(1, updates);
		ASSERT_TRUE(!memcmp(blobs[0], "a", 1));
		ASSERT_TRUE(!memcmp(blobs[1], "xyzxyz", 6));
		remote_blob("2", "Y W\r\nI=", "0", "", true, versions[i]);
		ASSERT_EQ_INT(1, updates);
		ASSERT_TRUE(!memcmp(blobs[0], "ab", 2));
	}
}

static void xml_blob_empty_after_nonempty(void) {
	const char *request = "<defBLOBVector device='Security' name='B' state='Ok' perm='ro'><defBLOB name='A'/></defBLOBVector><setBLOBVector device='Security' name='B' state='Ok'><oneBLOB name='A' size='1'>YQ==</oneBLOB></setBLOBVector><setBLOBVector device='Security' name='B' state='Ok'><oneBLOB name='A' size='0'></oneBLOB></setBLOBVector>";
	updates = 0;
	parse(request, strlen(request), 0, true, INDIGO_VERSION_CURRENT);
	ASSERT_EQ_INT(2, updates);
	ASSERT_EQ_INT(0, sizes[0]);
}

static void xml_blob_rejects_mismatch_and_malformed(void) {
	const char *invalid[][2] = { { "1", "YWJjZGVm" }, { "4", "YWJj" }, { "1", "YQ=" }, { "1", "Y!==" }, { "1", "YQ==YQ==" }, { "1", "YR==" }, { "0", "YQ==" }, { "-1", "" }, { "999999999999999999999", "" }, { "268435457", "" }, { "1junk", "" } };
	for (size_t i = 0; i < ARRAY_SIZE(invalid); i++) {
		for (int legacy = 0; legacy < 2; legacy++) {
			remote_blob(invalid[i][0], invalid[i][1], "1", "eg==", true, legacy ? INDIGO_VERSION_CURRENT : INDIGO_VERSION_LEGACY);
			ASSERT_EQ_INT(0, updates);
		}
	}
	remote_blob("3", "YWJj", "4", "ZGVm", false, INDIGO_VERSION_CURRENT);
	ASSERT_EQ_INT(0, updates);
}

static void xml_blob_crosses_input_buffers(void) {
	char *request = malloc(601024);
	for (int legacy = 0; legacy < 2; legacy++) {
		int prefix = snprintf(request, 1024, "<defBLOBVector device='Security' name='B' state='Ok' perm='ro'><defBLOB name='A'/><defBLOB name='B'/></defBLOBVector><setBLOBVector device='Security' name='B' state='Ok'><oneBLOB name='A' size='450000'>");
		for (size_t i = 0; i < 600000; i += 4) {
			memcpy(request + prefix + i, "YWFh", 4);
		}
		snprintf(request + prefix + 600000, 1024 - prefix, "</oneBLOB><oneBLOB name='B' size='1'>eg==</oneBLOB></setBLOBVector>");
		updates = 0;
		large_blob_valid = false;
		parse(request, strlen(request), 0, true, legacy ? INDIGO_VERSION_CURRENT : INDIGO_VERSION_LEGACY);
		ASSERT_EQ_INT(1, updates);
		ASSERT_TRUE(large_blob_valid);
		ASSERT_TRUE(blobs[1][0] == 'z');
	}
	free(request);
}

static void xml_messages_are_literal(void) {
	const char *events[] = {
		"<defTextVector device='Security' name='T' state='Ok' perm='ro' message='%s %n %%'><defText name='V'>ok</defText></defTextVector>",
		"<setTextVector device='Security' name='T' state='Ok' message='%s %n %%'><oneText name='V'>ok</oneText></setTextVector>",
		"<message device='Security' name='T' message='%s %n %%'/>",
		"<delProperty device='Security' name='T' message='%s %n %%'/>"
	};
	char request[2048] = { 0 };
	for (size_t i = 0; i < ARRAY_SIZE(events); i++) {
		strcat(request, events[i]);
		messages = 0;
		parse(request, strlen(request), 0, true, INDIGO_VERSION_CURRENT);
		ASSERT_EQ_INT(i + 1, messages);
		ASSERT_STREQ("%s %n %%", last_message);
	}
}

static void json_token_boundaries(void) {
	for (size_t length = 262143; length <= 262145; length++) {
		char *request = malloc(length + 256);
		int prefix = snprintf(request, length + 256, "{\"newTextVector\":{\"device\":\"Security\",\"name\":\"T\",\"items\":[{\"name\":\"V\",\"value\":\"");
		memset(request + prefix, 'a', length);
		strcpy(request + prefix + length, "\"}]}}");
		changes = 0;
		parse(request, strlen(request), 1, false, 0);
		free(request);
		ASSERT_EQ_INT(length <= 262144, changes);
		if (changes) {
			ASSERT_EQ_INT(length, text_length);
		}
	}
	for (size_t length = 127; length <= 129; length++) {
		char request[512];
		strcpy(request, "{\"newTextVector\":{\"");
		size_t prefix = strlen(request);
		memset(request + prefix, 'a', length);
		snprintf(request + prefix + length, sizeof(request) - prefix - length, "\":\"x\",\"device\":\"Security\",\"name\":\"T\",\"items\":[{\"name\":\"V\",\"value\":\"ok\"}]}}");
		changes = 0;
		parse(request, strlen(request), 1, false, 0);
		ASSERT_EQ_INT(length == 127, changes);
	}
}

static void json_number_and_logical_boundaries(void) {
	for (int logical = 0; logical < 2; logical++) {
		for (size_t length = 262143; length <= 262145; length++) {
			char *request = malloc(length + 256);
			int prefix = snprintf(request, length + 256, "{\"newTextVector\":{\"unused\":");
			memset(request + prefix, logical ? 'a' : '1', length);
			snprintf(request + prefix + length, 256 - prefix, ",\"device\":\"Security\",\"name\":\"T\",\"items\":[{\"name\":\"V\",\"value\":\"ok\"}]}}");
			changes = 0;
			parse(request, strlen(request), 1, false, 0);
			free(request);
			ASSERT_EQ_INT(!logical && length <= 262144, changes);
		}
	}
}

static size_t frame(unsigned char *output, unsigned opcode, const char *payload, size_t length) {
	size_t offset = 0;
	output[offset++] = opcode;
	if (length < 126) {
		output[offset++] = 0x80 | length;
	} else if (length < 65536) {
		output[offset++] = 0xfe;
		output[offset++] = length >> 8;
		output[offset++] = length;
	} else {
		output[offset++] = 0xff;
		for (int shift = 56; shift >= 0; shift -= 8) {
			output[offset++] = (uint64_t)length >> shift;
		}
	}
	const unsigned char mask[] = { 1, 2, 3, 4 };
	memcpy(output + offset, mask, 4);
	offset += 4;
	for (size_t i = 0; i < length; i++) {
		output[offset++] = payload[i] ^ mask[i % 4];
	}
	return offset;
}

static void websocket_frames(void) {
	unsigned char *wire = malloc(262200);
	size_t length = frame(wire, 0x81, json_change, strlen(json_change));
	changes = 0;
	parse(wire, length, 2, false, 0);
	ASSERT_EQ_INT(1, changes);
	for (size_t cut = 1; cut < length; cut++) {
		changes = 0;
		parse(wire, cut, 2, false, 0);
		ASSERT_EQ_INT(0, changes);
	}
	unsigned char bad_headers[][10] = { { 0x81, 0xff, 0, 0, 0, 1, 0, 0, 0, 1 }, { 0x81, 0xff, 0x80, 0, 0, 0, 0, 0, 0, 1 }, { 0x81, 0xfe, 0 }, { 0x81, 0xff, 0, 0, 0, 0 } };
	for (size_t i = 0; i < ARRAY_SIZE(bad_headers); i++) {
		changes = 0;
		parse(bad_headers[i], i == 2 ? 3 : i == 3 ? 6 : 10, 2, false, 0);
		ASSERT_EQ_INT(0, changes);
	}
	length = frame(wire, 0x81, json_change, strlen(json_change));
	wire[1] &= 0x7f;
	changes = 0;
	parse(wire, length, 2, false, 0);
	ASSERT_EQ_INT(0, changes);
	unsigned bad_opcodes[] = { 0x82, 0x80, 0xc1, 0x09, 0x83 };
	for (size_t i = 0; i < ARRAY_SIZE(bad_opcodes); i++) {
		length = frame(wire, bad_opcodes[i], json_change, strlen(json_change));
		changes = 0;
		parse(wire, length, 2, false, 0);
		ASSERT_EQ_INT(0, changes);
	}
	length = frame(wire, 0x01, json_change, 12);
	length += frame(wire + length, 0x8a, "pong", 4);
	length += frame(wire + length, 0x80, json_change + 12, strlen(json_change) - 12);
	changes = 0;
	parse(wire, length, 2, false, 0);
	ASSERT_EQ_INT(1, changes);
	char *payload = malloc(262144);
	memset(payload, ' ', 262144);
	memcpy(payload, json_change, strlen(json_change));
	length = frame(wire, 0x81, payload, 262144);
	changes = 0;
	parse(wire, length, 2, false, 0);
	ASSERT_EQ_INT(1, changes);
	free(payload);
	free(wire);
}

static void websocket_controls(void) {
	for (int close_frame = 0; close_frame < 2; close_frame++) {
		unsigned char wire[32];
		size_t length = frame(wire, close_frame ? 0x88 : 0x89, close_frame ? "" : "ping", close_frame ? 0 : 4);
		FILE *file = tmpfile();
		ASSERT_TRUE(file != NULL);
		ASSERT_EQ_INT(length, fwrite(wire, 1, length, file));
		fflush(file);
		rewind(file);
		indigo_uni_handle *handle = indigo_uni_create_file_handle(dup(fileno(file)), INDIGO_LOG_NONE);
		FILE *output = tmpfile();
		ASSERT_TRUE(output != NULL);
		indigo_uni_handle *out = indigo_uni_create_file_handle(dup(fileno(output)), INDIGO_LOG_NONE);
		indigo_client *adapter = indigo_json_device_adapter(handle, out, true);
		indigo_json_parse(NULL, adapter);
		indigo_release_json_device_adapter(adapter);
		indigo_uni_close(&handle);
		indigo_uni_close(&out);
		rewind(output);
		unsigned char reply[6] = { 0 };
		ASSERT_EQ_INT(close_frame ? 2 : 6, fread(reply, 1, sizeof(reply), output));
		fclose(file);
		fclose(output);
		ASSERT_EQ_INT(close_frame ? 0x88 : 0x8a, reply[0]);
		ASSERT_EQ_INT(close_frame ? 0 : 4, reply[1]);
		if (!close_frame) {
			ASSERT_TRUE(!memcmp(reply + 2, "ping", 4));
		}
	}
}

int main(void) {
	indigo_test_use_private_home();
	indigo_autoenumerate = false;
	indigo_use_host_suffix = false;
	indigo_use_blob_caching = false;
	indigo_start();
	indigo_attach_device(&device);
	indigo_attach_client(&observer);
	const indigo_test_case tests[] = {
		{ "xml_attribute_boundaries", xml_attribute_boundaries },
		{ "xml_name_boundaries", xml_name_boundaries },
		{ "xml_entity_boundaries", xml_entity_boundaries },
		{ "xml_wrong_direction", xml_wrong_direction },
		{ "xml_blob_owned_items_and_padding", xml_blob_owned_items_and_padding },
		{ "xml_blob_empty_after_nonempty", xml_blob_empty_after_nonempty },
		{ "xml_blob_rejects_mismatch_and_malformed", xml_blob_rejects_mismatch_and_malformed },
		{ "xml_blob_crosses_input_buffers", xml_blob_crosses_input_buffers },
		{ "xml_messages_are_literal", xml_messages_are_literal },
		{ "json_token_boundaries", json_token_boundaries },
		{ "json_number_and_logical_boundaries", json_number_and_logical_boundaries },
		{ "websocket_frames", websocket_frames },
		{ "websocket_controls", websocket_controls }
	};
	int result = indigo_run_tests("Protocol security", tests, ARRAY_SIZE(tests));
	indigo_detach_client(&observer);
	indigo_detach_device(&device);
	indigo_stop();
	indigo_test_remove_private_home();
	return result;
}
