// Copyright (c) 2026 INDIGO initiative
// All rights reserved.
//
// You may use this software under the terms of 'INDIGO Astronomy
// open-source license' (see LICENSE.md).
//
// THIS SOFTWARE IS PROVIDED BY THE AUTHORS 'AS IS' AND ANY EXPRESS
// OR IMPLIED WARRANTIES, INCLUDING, BUT NOT LIMITED TO, THE IMPLIED
// WARRANTIES OF MERCHANTABILITY AND FITNESS FOR A PARTICULAR PURPOSE
// ARE DISCLAIMED. IN NO EVENT SHALL THE AUTHOR BE LIABLE FOR ANY
// DIRECT, INDIRECT, INCIDENTAL, SPECIAL, EXEMPLARY, OR CONSEQUENTIAL
// DAMAGES (INCLUDING, BUT NOT LIMITED TO, PROCUREMENT OF SUBSTITUTE
// GOODS OR SERVICES; LOSS OF USE, DATA, OR PROFITS; OR BUSINESS
// INTERRUPTION) HOWEVER CAUSED AND ON ANY THEORY OF LIABILITY,
// WHETHER IN CONTRACT, STRICT LIABILITY, OR TORT (INCLUDING
// NEGLIGENCE OR OTHERWISE) ARISING IN ANY WAY OUT OF THE USE OF THIS
// SOFTWARE, EVEN IF ADVISED OF THE POSSIBILITY OF SUCH DAMAGE.

// Code is generated by AI

#include "../../indigo_libs/indigo_mount_driver.c"
#include "../test_runner.h"

static bool write_alignment(indigo_device *device, const char *text) {
	indigo_uni_handle *handle = indigo_open_config_file(device->name, 0, true, ".alignment");
	if (handle == NULL) {
		return false;
	}
	bool result = indigo_uni_printf(handle, "%s", text) > 0;
	indigo_uni_close(&handle);
	return result;
}

static void alignment_load_commits_complete_files_and_preserves_state_on_rejection(void) {
	indigo_device storage = { .name = "Audit Alignment Test" };
	indigo_device *device = &storage;
	ASSERT_EQ_INT(INDIGO_OK, indigo_start());
	ASSERT_EQ_INT(INDIGO_OK, indigo_mount_attach(device, "audit-test", 1));
	ASSERT_TRUE(write_alignment(device, "2\n1 5.5 -20 5.4 -19.5 12 0\n0 6 30 6.1 29.5 13 1\n"));
	ASSERT_TRUE(mount_read_alignment_points(device));
	ASSERT_EQ_INT(2, MOUNT_CONTEXT->alignment_point_count);
	ASSERT_EQ_INT(2, MOUNT_ALIGNMENT_SELECT_POINTS_PROPERTY->count);
	ASSERT_EQ_INT(3, MOUNT_ALIGNMENT_DELETE_POINTS_PROPERTY->count);
	ASSERT_NEAR(5.5, MOUNT_CONTEXT->alignment_points[0].ra, 1e-12);
	ASSERT_NEAR(29.5, MOUNT_CONTEXT->alignment_points[1].raw_dec, 1e-12);
	ASSERT_TRUE(MOUNT_CONTEXT->alignment_points[0].used);
	ASSERT_TRUE(!MOUNT_CONTEXT->alignment_points[1].used);
	indigo_alignment_point saved[2];
	memcpy(saved, MOUNT_CONTEXT->alignment_points, sizeof(saved));
	char label[INDIGO_VALUE_SIZE];
	INDIGO_COPY_VALUE(label, MOUNT_ALIGNMENT_SELECT_POINTS_PROPERTY->items[0].label);
	const char *incomplete[] = { "invalid count\n", "2\n1 5.5 -20 5.4 -19.5 12 0\n", "1\n1 5.5 -20\n", "-1\n", "101\n", "1\n1 25 -20 5.4 -19.5 12 0\n", "1\n1 5.5 -91 5.4 -19.5 12 0\n" };
	for (int i = 0; i < (int)(sizeof(incomplete) / sizeof(*incomplete)); i++) {
		ASSERT_TRUE(write_alignment(device, incomplete[i]));
		ASSERT_TRUE(!mount_read_alignment_points(device));
		ASSERT_EQ_INT(2, MOUNT_CONTEXT->alignment_point_count);
		ASSERT_EQ_INT(2, MOUNT_ALIGNMENT_SELECT_POINTS_PROPERTY->count);
		ASSERT_EQ_INT(3, MOUNT_ALIGNMENT_DELETE_POINTS_PROPERTY->count);
		ASSERT_TRUE(!memcmp(saved, MOUNT_CONTEXT->alignment_points, sizeof(saved)));
		ASSERT_STREQ(label, MOUNT_ALIGNMENT_SELECT_POINTS_PROPERTY->items[0].label);
	}
	ASSERT_TRUE(write_alignment(device, "0\n"));
	ASSERT_TRUE(mount_read_alignment_points(device));
	ASSERT_EQ_INT(0, MOUNT_CONTEXT->alignment_point_count);
	ASSERT_EQ_INT(0, MOUNT_ALIGNMENT_SELECT_POINTS_PROPERTY->count);
	ASSERT_EQ_INT(0, MOUNT_ALIGNMENT_DELETE_POINTS_PROPERTY->count);
	ASSERT_EQ_INT(INDIGO_OK, indigo_mount_detach(device));
	ASSERT_EQ_INT(INDIGO_OK, indigo_stop());
}

// MULTI_POINT has no model: its translations returned INDIGO_OK without writing the result, so callers used whatever
// their output variables held, now they pass the coordinates through like CONTROLLER
static void multi_point_translations_pass_coordinates_through(void) {
	indigo_device storage = { .name = "Audit Multi Point Test" };
	indigo_device *device = &storage;
	ASSERT_EQ_INT(INDIGO_OK, indigo_start());
	ASSERT_EQ_INT(INDIGO_OK, indigo_mount_attach(device, "audit-test", 1));
	indigo_set_switch(MOUNT_ALIGNMENT_MODE_PROPERTY, MOUNT_ALIGNMENT_MODE_MULTI_POINT_ITEM, true);
	bool selected = MOUNT_ALIGNMENT_MODE_MULTI_POINT_ITEM->sw.value && !MOUNT_ALIGNMENT_MODE_CONTROLLER_ITEM->sw.value;
	// a stored alignment point does not change the result either
	bool loaded = write_alignment(device, "1\n1 5.5 -20 5.4 -19.5 12 0\n") && mount_read_alignment_points(device);
	double ra[4] = { -1, -1, -1, -1 }, dec[4] = { -1, -1, -1, -1 };
	indigo_result results[4];
	results[0] = indigo_translated_to_raw(device, 5.25, -12.5, ra + 0, dec + 0);
	results[1] = indigo_translated_to_raw_with_lst(device, 11.0, 5.25, -12.5, MOUNT_SIDE_EAST, ra + 1, dec + 1);
	results[2] = indigo_raw_to_translated(device, 5.25, -12.5, ra + 2, dec + 2);
	results[3] = indigo_raw_to_translated_with_lst(device, 11.0, 5.25, -12.5, MOUNT_SIDE_WEST, ra + 3, dec + 3);
	ASSERT_EQ_INT(INDIGO_OK, indigo_mount_detach(device));
	ASSERT_EQ_INT(INDIGO_OK, indigo_stop());
	ASSERT_TRUE(selected);
	ASSERT_TRUE(loaded);
	for (int i = 0; i < 4; i++) {
		ASSERT_EQ_INT(INDIGO_OK, results[i]);
		ASSERT_NEAR(5.25, ra[i], 1e-12);
		ASSERT_NEAR(-12.5, dec[i], 1e-12);
	}
}

static int pole_warnings;

static indigo_result pole_warning_message(indigo_client *client, indigo_device *device, indigo_property *property, const char *message) {
	if (property == BUSY_PROPERTY && message != NULL && strstr(message, "celestial pole") != NULL) {
		pole_warnings++;
	}
	return INDIGO_OK;
}

static indigo_client pole_warning_client = { .name = "Pole warning test client", .version = INDIGO_VERSION_CURRENT, .send_message = pole_warning_message };

// A sync near the pole adds an alignment point whose RA offset is arbitrary there but shifts the targets it is used for, so it
// is accepted with a warning; the warning looks at both the requested and the raw declination
static void sync_near_the_pole_is_accepted_with_a_warning(void) {
	indigo_device storage = { .name = "Audit Pole Sync Test" };
	indigo_device *device = &storage;
	ASSERT_EQ_INT(INDIGO_OK, indigo_start());
	ASSERT_EQ_INT(INDIGO_OK, indigo_attach_client(&pole_warning_client));
	ASSERT_EQ_INT(INDIGO_OK, indigo_mount_attach(device, "audit-test", 1));
	indigo_set_switch(MOUNT_ON_COORDINATES_SET_PROPERTY, MOUNT_ON_COORDINATES_SET_SYNC_ITEM, true);
	MOUNT_EQUATORIAL_COORDINATES_PROPERTY->defined = true;
	indigo_property *request = indigo_init_number_property(NULL, device->name, MOUNT_EQUATORIAL_COORDINATES_PROPERTY_NAME, NULL, NULL, INDIGO_OK_STATE, INDIGO_RW_PERM, 2);
	indigo_init_number_item(request->items + 0, MOUNT_EQUATORIAL_COORDINATES_RA_ITEM_NAME, NULL, 0, 24, 0, 0);
	indigo_init_number_item(request->items + 1, MOUNT_EQUATORIAL_COORDINATES_DEC_ITEM_NAME, NULL, -90, 90, 0, 0);
	const struct { double dec, raw_dec; bool warned; bool single; } cases[] = { { 90, 90, true, false }, { 6, 89.5, true, false }, { 86, 40, true, false }, { -89, -89, true, false }, { 60, 60, false, false }, { 85, 85, false, false }, { -85, -84, false, false }, { 90, 90, true, true }, { 60, 60, false, true } };
	int count = (int)(sizeof(cases) / sizeof(*cases));
	int warned[sizeof(cases) / sizeof(*cases)];
	int points[sizeof(cases) / sizeof(*cases)];
	indigo_property_state states[sizeof(cases) / sizeof(*cases)];
	for (int i = 0; i < count; i++) {
		indigo_set_switch(MOUNT_ALIGNMENT_MODE_PROPERTY, cases[i].single ? MOUNT_ALIGNMENT_MODE_SINGLE_POINT_ITEM : MOUNT_ALIGNMENT_MODE_NEAREST_POINT_ITEM, true);
		MOUNT_EQUATORIAL_COORDINATES_PROPERTY->state = INDIGO_IDLE_STATE;
		MOUNT_RAW_COORDINATES_RA_ITEM->number.value = 0;
		MOUNT_RAW_COORDINATES_DEC_ITEM->number.value = cases[i].raw_dec;
		request->items[0].number.value = request->items[0].number.target = 6;
		request->items[1].number.value = request->items[1].number.target = cases[i].dec;
		pole_warnings = 0;
		indigo_mount_change_property(device, NULL, request);
		warned[i] = pole_warnings;
		points[i] = MOUNT_CONTEXT->alignment_point_count;
		states[i] = MOUNT_EQUATORIAL_COORDINATES_PROPERTY->state;
	}
	indigo_release_property(request);
	ASSERT_EQ_INT(INDIGO_OK, indigo_mount_detach(device));
	ASSERT_EQ_INT(INDIGO_OK, indigo_detach_client(&pole_warning_client));
	ASSERT_EQ_INT(INDIGO_OK, indigo_stop());
	for (int i = 0; i < count; i++) {
		ASSERT_EQ_INT(cases[i].warned ? 1 : 0, warned[i]);
		// the warning does not refuse the sync, every request adds its point
		ASSERT_EQ_INT(i + 1, points[i]);
		ASSERT_EQ_INT(INDIGO_OK_STATE, states[i]);
	}
}

int main(void) {
	if (!indigo_test_use_private_home()) {
		return 1;
	}
	const indigo_test_case tests[] = {
		{ "alignment_load_commits_complete_files_and_preserves_state_on_rejection", alignment_load_commits_complete_files_and_preserves_state_on_rejection },
		{ "multi_point_translations_pass_coordinates_through", multi_point_translations_pass_coordinates_through },
		{ "sync_near_the_pole_is_accepted_with_a_warning", sync_near_the_pole_is_accepted_with_a_warning }
	};
	int result = indigo_run_tests("Alignment file load", tests, sizeof(tests) / sizeof(*tests));
	indigo_test_remove_private_home();
	return result;
}
