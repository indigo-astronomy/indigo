// Copyright (c) 2026 INDIGO initiative
// All rights reserved.
//
// You may use this software under the terms of 'INDIGO Astronomy
// open-source license' (see LICENSE.md).
//
// THIS SOFTWARE IS PROVIDED BY THE AUTHORS 'AS IS' AND ANY EXPRESS
// OR IMPLIED WARRANTIES, INCLUDING, BUT NOT LIMITED TO, THE IMPLIED
// WARRANTIES OF MERCHANTABILITY AND FITNESS FOR A PARTICULAR PURPOSE
// ARE DISCLAIMED. IN NO EVENT SHALL THE AUTHOR BE LIABLE FOR ANY
// DIRECT, INDIRECT, INCIDENTAL, SPECIAL, EXEMPLARY, OR CONSEQUENTIAL
// DAMAGES (INCLUDING, BUT NOT LIMITED TO, PROCUREMENT OF SUBSTITUTE
// GOODS OR SERVICES; LOSS OF USE, DATA, OR PROFITS; OR BUSINESS
// INTERRUPTION) HOWEVER CAUSED AND ON ANY THEORY OF LIABILITY,
// WHETHER IN CONTRACT, STRICT LIABILITY, OR TORT (INCLUDING
// NEGLIGENCE OR OTHERWISE) ARISING IN ANY WAY OUT OF THE USE OF THIS
// SOFTWARE, EVEN IF ADVISED OF THE POSSIBILITY OF SUCH DAMAGE.

// Code is generated by AI

#include <stdio.h>
#include <stdlib.h>
#include <string.h>
#include <unistd.h>
#include <fcntl.h>
#include <time.h>
#include <limits.h>
#include <pthread.h>
#include <signal.h>
#include <stdbool.h>
#include <sys/socket.h>
#include <netinet/in.h>
#include <arpa/inet.h>
#if defined(INDIGO_LINUX) || defined(INDIGO_MACOS)
#include <errno.h>
#endif

#include <indigo/indigo_bus.h>
#include <indigo/indigo_uni_io.h>

#include "../test_runner.h"

#if defined(INDIGO_LINUX) || defined(INDIGO_MACOS)
static const char *serial_exclusive_test_port;

static void serial_port_open_is_exclusive(void) {
	const char *first_error = "unset";
	indigo_uni_handle *first = indigo_uni_open_serial2(serial_exclusive_test_port, INDIGO_LOG_ERROR, &first_error);
	ASSERT_TRUE(first != NULL);
	ASSERT_TRUE(first_error == NULL);
	const char *second_error = NULL;
	indigo_uni_handle *second = indigo_uni_open_serial2(serial_exclusive_test_port, INDIGO_LOG_ERROR, &second_error);
	bool second_open_rejected = second == NULL;
	if (second != NULL) {
		indigo_uni_close(&second);
	}
	indigo_uni_close(&first);
	const char *reopen_error = "unset";
	indigo_uni_handle *reopened = indigo_uni_open_serial2(serial_exclusive_test_port, INDIGO_LOG_ERROR, &reopen_error);
	bool reopened_successfully = reopened != NULL;
	indigo_uni_close(&reopened);
	ASSERT_TRUE(second_open_rejected);
	ASSERT_TRUE(second_error != NULL);
	ASSERT_STREQ("Serial port is already in use", second_error);
	ASSERT_TRUE(reopened_successfully);
	ASSERT_TRUE(reopen_error == NULL);
}
#endif

#if defined(INDIGO_LINUX) || defined(INDIGO_MACOS)
static void serial_open_reports_open_error(void) {
	const char *error_message = NULL;
	indigo_uni_handle *handle = indigo_uni_open_serial2("/dev/indigo-test-nonexistent-serial", INDIGO_LOG_ERROR, &error_message);
	ASSERT_TRUE(handle == NULL);
	ASSERT_TRUE(error_message != NULL);
	ASSERT_STREQ("Serial port does not exist", error_message);
	error_message = NULL;
	handle = indigo_uni_open_serial_with_speed2("/dev/indigo-test-nonexistent-serial", 9600, INDIGO_LOG_ERROR, &error_message);
	ASSERT_TRUE(handle == NULL);
	ASSERT_TRUE(error_message != NULL);
	ASSERT_STREQ("Serial port does not exist", error_message);
	error_message = NULL;
	handle = indigo_uni_open_serial_with_config2("auto:///dev/indigo-test-nonexistent-serial", "9600-8N1", INDIGO_LOG_ERROR, &error_message);
	ASSERT_TRUE(handle == NULL);
	ASSERT_TRUE(error_message != NULL);
	ASSERT_STREQ("Serial port does not exist", error_message);
}

static void serial_open_reports_configuration_error(void) {
	const char *error_message = NULL;
	indigo_uni_handle *handle = indigo_uni_open_serial_with_config2("/unused", "invalid", INDIGO_LOG_ERROR, &error_message);
	ASSERT_TRUE(handle == NULL);
	ASSERT_TRUE(error_message != NULL);
	ASSERT_STREQ("Invalid serial port configuration", error_message);
}

static void serial_open_reports_not_a_serial_port(void) {
	// A regular file produces ENOTTY; /dev/null can produce ENODEV on macOS.
	char path[] = "/tmp/indigo-uni-io-nonserial.XXXXXX";
	int descriptor = mkstemp(path);
	ASSERT_TRUE(descriptor >= 0);
	close(descriptor);
	const char *error_message = NULL;
	indigo_uni_handle *handle = indigo_uni_open_serial2(path, INDIGO_LOG_ERROR, &error_message);
	bool open_failed = handle == NULL;
	indigo_uni_close(&handle);
	int unlink_result = unlink(path);
	ASSERT_EQ_INT(0, unlink_result);
	ASSERT_TRUE(open_failed);
	ASSERT_TRUE(error_message != NULL);
	ASSERT_STREQ("Not a serial port", error_message);
}

static void serial_open_clears_error_on_success(void) {
	int master = posix_openpt(O_RDWR | O_NOCTTY);
	ASSERT_TRUE(master >= 0);
	ASSERT_EQ_INT(0, grantpt(master));
	ASSERT_EQ_INT(0, unlockpt(master));
	const char *error_message = "unset";
	indigo_uni_handle *handle = indigo_uni_open_serial2(ptsname(master), INDIGO_LOG_ERROR, &error_message);
	bool opened = handle != NULL;
	indigo_uni_close(&handle);
	close(master);
	ASSERT_TRUE(opened);
	ASSERT_TRUE(error_message == NULL);
}

// The port is opened exclusively; closing it must release the claim even while the other end of
// the line stays open. A Linux pseudo-terminal keeps TIOCEXCL after its last descriptor is
// closed, which refused every reconnect to a serial simulator with EBUSY.
static void serial_port_reopens_after_close(void) {
	int master = posix_openpt(O_RDWR | O_NOCTTY);
	ASSERT_TRUE(master >= 0);
	ASSERT_EQ_INT(0, grantpt(master));
	ASSERT_EQ_INT(0, unlockpt(master));
	const char *error_message = NULL;
	indigo_uni_handle *handle = indigo_uni_open_serial2(ptsname(master), INDIGO_LOG_ERROR, &error_message);
	bool opened = handle != NULL;
	indigo_uni_close(&handle);
	error_message = "unset";
	handle = indigo_uni_open_serial2(ptsname(master), INDIGO_LOG_ERROR, &error_message);
	bool reopened = handle != NULL;
	const char *reopen_error = error_message;
	indigo_uni_close(&handle);
	close(master);
	ASSERT_TRUE(opened);
	ASSERT_TRUE(reopened);
	ASSERT_TRUE(reopen_error == NULL);
}
#endif

// A file handle is enough to exercise the delimited reader: with both timeouts
// set to -1 the reader skips indigo_uni_wait_for_data() and goes straight to
// the data.
static indigo_uni_handle *open_handle_with(const char *content, char *path, size_t size) {
	snprintf(path, size, "/tmp/indigo-uni-io-test.XXXXXX");
	int descriptor = mkstemp(path);
	if (descriptor < 0) {
		return NULL;
	}
	if (write(descriptor, content, strlen(content)) != (ssize_t)strlen(content)) {
		close(descriptor);
		unlink(path);
		return NULL;
	}
	close(descriptor);
	return indigo_uni_open_file(path, INDIGO_LOG_ERROR);
}

// indigo_uni_io.h documents the ignore list as optional ("or NULL"), but the
// reader used to dereference it unconditionally and died with SIGSEGV on the
// first byte.
static void read_section_accepts_null_ignore_list(void) {
	char path[PATH_MAX] = { 0 };
	char buffer[32] = { 0 };

	indigo_uni_handle *handle = open_handle_with("ab#cd", path, sizeof(path));
	ASSERT_TRUE(handle != NULL);
	ASSERT_EQ_INT(3, (int)indigo_uni_read_section2(handle, buffer, sizeof(buffer) - 1, "#", NULL, -1, -1));
	ASSERT_TRUE(buffer != NULL);
	ASSERT_STREQ("ab#", buffer);
	indigo_uni_close(&handle);
	unlink(path);
}

// A NULL terminator list means 'no terminator', so the reader stops at the
// requested length instead of crashing.
static void read_section_accepts_null_terminator_list(void) {
	char path[PATH_MAX] = { 0 };
	char buffer[32] = { 0 };

	indigo_uni_handle *handle = open_handle_with("abcdef", path, sizeof(path));
	ASSERT_TRUE(handle != NULL);
	ASSERT_EQ_INT(4, (int)indigo_uni_read_section2(handle, buffer, 4, NULL, NULL, -1, -1));
	ASSERT_TRUE(buffer != NULL);
	ASSERT_STREQ("abcd", buffer);
	indigo_uni_close(&handle);
	unlink(path);
}

// The documented behaviour is unchanged: ignored characters are dropped from
// the buffer but still end the read when they are terminators.
static void read_section_still_ignores_and_terminates(void) {
	char path[PATH_MAX] = { 0 };
	char buffer[32] = { 0 };

	indigo_uni_handle *handle = open_handle_with("a\rb\r\ncd", path, sizeof(path));
	ASSERT_TRUE(handle != NULL);
	ASSERT_EQ_INT(2, (int)indigo_uni_read_section2(handle, buffer, sizeof(buffer) - 1, "\n", "\r\n", -1, -1));
	ASSERT_TRUE(buffer != NULL);
	ASSERT_STREQ("ab", buffer);
	indigo_uni_close(&handle);
	unlink(path);
}

// ---- interrupted system calls ----

// A signal delivered to a thread waiting in select() makes it return EINTR. That is not an error of the port: the
// wait went on to fail with -1 and stored EINTR as the error of the handle, so every later read and write of a
// working port failed until it was closed.

static void interrupt_handler(int signal) {
}

typedef struct {
	pthread_t target;
	int master;
	bool send_data;
} interrupter;

static void *interrupt_thread(void *data) {
	interrupter *context = data;
	indigo_usleep(100000);
	pthread_kill(context->target, SIGUSR1);
	if (context->send_data) {
		indigo_usleep(200000);
		if (write(context->master, "x\n", 2) != 2) {
			return NULL;
		}
	}
	return NULL;
}

// A pseudo-terminal stands in for the serial port, so the wait really goes through select().
static indigo_uni_handle *open_pseudo_terminal(int *master) {
	*master = posix_openpt(O_RDWR | O_NOCTTY);
	if (*master < 0 || grantpt(*master) != 0 || unlockpt(*master) != 0) {
		return NULL;
	}
	return indigo_uni_open_serial(ptsname(*master), INDIGO_LOG_ERROR);
}

// Installed without SA_RESTART, so the signal interrupts select() instead of restarting it.
static void interrupt_wait(bool send_data, long timeout, int *result, double *elapsed, int *last_error, char *line, int line_size) {
	struct sigaction action, previous;
	memset(&action, 0, sizeof(action));
	action.sa_handler = interrupt_handler;
	sigemptyset(&action.sa_mask);
	sigaction(SIGUSR1, &action, &previous);
	int master = -1;
	indigo_uni_handle *handle = open_pseudo_terminal(&master);
	ASSERT_TRUE(handle != NULL);
	interrupter context = { pthread_self(), master, send_data };
	pthread_t thread;
	ASSERT_EQ_INT(0, pthread_create(&thread, NULL, interrupt_thread, &context));
	struct timespec start, end;
	clock_gettime(CLOCK_MONOTONIC, &start);
	*result = indigo_uni_wait_for_data(handle, timeout);
	clock_gettime(CLOCK_MONOTONIC, &end);
	*elapsed = (end.tv_sec - start.tv_sec) + (end.tv_nsec - start.tv_nsec) / 1e9;
	*last_error = handle->last_error;
	if (*result > 0) {
		indigo_uni_read_section(handle, line, line_size, "\n", "\r\n", INDIGO_DELAY(1));
	}
	pthread_join(thread, NULL);
	indigo_uni_close(&handle);
	close(master);
	sigaction(SIGUSR1, &previous, NULL);
}

static void wait_for_data_continues_after_signal(void) {
	int result, last_error;
	double elapsed;
	char line[16] = { 0 };
	interrupt_wait(true, INDIGO_DELAY(2), &result, &elapsed, &last_error, line, sizeof(line));
	ASSERT_EQ_INT(1, result);
	ASSERT_EQ_INT(0, last_error);
	ASSERT_TRUE(line != NULL);
	ASSERT_STREQ("x", line);
}

static void wait_for_data_keeps_timeout_after_signal(void) {
	int result, last_error;
	double elapsed;
	char line[16] = { 0 };
	interrupt_wait(false, INDIGO_DELAY(0.5), &result, &elapsed, &last_error, line, sizeof(line));
	ASSERT_EQ_INT(0, result);
	ASSERT_EQ_INT(0, last_error);
	ASSERT_TRUE(elapsed >= 0.45);
}

// ---- indigo_uni_discover() ----

// Loopback UDP responder: answers every request with 'replies' datagrams "R<n>" and counts the requests.
typedef struct {
	int fd;
	int port;
	int replies;
	int requests;
	char last_request[64];
	pthread_t thread;
} discovery_responder;

static void *discovery_responder_thread(void *data) {
	discovery_responder *responder = (discovery_responder *)data;
	while (true) {
		char request[64] = { 0 };
		struct sockaddr_in from;
		socklen_t from_length = sizeof(from);
		long length = recvfrom(responder->fd, request, sizeof(request) - 1, 0, (struct sockaddr *)&from, &from_length);
		if (length <= 0) {
			break;
		}
		responder->requests++;
		strncpy(responder->last_request, request, sizeof(responder->last_request) - 1);
		for (int i = 0; i < responder->replies; i++) {
			char reply[16];
			snprintf(reply, sizeof(reply), "R%d", i);
			sendto(responder->fd, reply, strlen(reply), 0, (struct sockaddr *)&from, from_length);
		}
	}
	return NULL;
}

static bool start_discovery_responder(discovery_responder *responder, int replies) {
	memset(responder, 0, sizeof(*responder));
	responder->replies = replies;
	responder->fd = socket(AF_INET, SOCK_DGRAM, 0);
	if (responder->fd < 0) {
		return false;
	}
	struct sockaddr_in address = { 0 };
	address.sin_family = AF_INET;
	address.sin_addr.s_addr = htonl(INADDR_LOOPBACK);
	socklen_t length = sizeof(address);
	struct timeval tv = { 3, 0 };
	setsockopt(responder->fd, SOL_SOCKET, SO_RCVTIMEO, &tv, sizeof(tv));
	if (bind(responder->fd, (struct sockaddr *)&address, sizeof(address)) < 0 || getsockname(responder->fd, (struct sockaddr *)&address, &length) < 0) {
		close(responder->fd);
		return false;
	}
	responder->port = ntohs(address.sin_port);
	return pthread_create(&responder->thread, NULL, discovery_responder_thread, responder) == 0;
}

static void stop_discovery_responder(discovery_responder *responder) {
	shutdown(responder->fd, SHUT_RDWR);
	close(responder->fd);
	pthread_join(responder->thread, NULL);
}

typedef struct {
	int count;
	int stop_after;
	char replies[8][16];
	char responder[32];
} discovery_result;

static bool collect_reply(const char *responder, int responder_port, const char *reply, long length, void *context) {
	discovery_result *result = (discovery_result *)context;
	if (result->count < 8) {
		strncpy(result->replies[result->count], reply, sizeof(result->replies[0]) - 1);
	}
	strncpy(result->responder, responder, sizeof(result->responder) - 1);
	result->count++;
	return result->stop_after == 0 || result->count < result->stop_after;
}

static double now_seconds(void) {
	struct timespec time;
	clock_gettime(CLOCK_MONOTONIC, &time);
	return time.tv_sec + time.tv_nsec / 1e9;
}

// Every reply is passed to the callback together with the responder address.
static void discover_collects_all_replies(void) {
	discovery_responder responder;
	discovery_result result = { 0 };
	ASSERT_TRUE(start_discovery_responder(&responder, 3));
	int count = indigo_uni_discover("127.0.0.1", responder.port, "hello", 5, 1, INDIGO_DELAY(0.3), false, collect_reply, &result);
	stop_discovery_responder(&responder);
	ASSERT_EQ_INT(3, count);
	ASSERT_EQ_INT(3, result.count);
	ASSERT_STREQ("R0", result.replies[0]);
	ASSERT_STREQ("R2", result.replies[2]);
	ASSERT_STREQ("127.0.0.1", result.responder);
	ASSERT_STREQ("hello", responder.last_request);
	ASSERT_EQ_INT(1, responder.requests);
}

// Each poll sends the request again; duplicates are left to the caller.
static void discover_repeats_request_for_each_poll(void) {
	discovery_responder responder;
	discovery_result result = { 0 };
	ASSERT_TRUE(start_discovery_responder(&responder, 1));
	int count = indigo_uni_discover("127.0.0.1", responder.port, "hello", 5, 3, INDIGO_DELAY(0.2), false, collect_reply, &result);
	stop_discovery_responder(&responder);
	ASSERT_EQ_INT(3, responder.requests);
	ASSERT_EQ_INT(3, count);
}

// Returning false from the callback ends the discovery immediately.
static void discover_stops_when_callback_returns_false(void) {
	discovery_responder responder;
	discovery_result result = { 0 };
	result.stop_after = 2;
	ASSERT_TRUE(start_discovery_responder(&responder, 5));
	int count = indigo_uni_discover("127.0.0.1", responder.port, "hello", 5, 3, INDIGO_DELAY(0.3), false, collect_reply, &result);
	stop_discovery_responder(&responder);
	ASSERT_EQ_INT(2, count);
	ASSERT_EQ_INT(1, responder.requests);
}

// Without any responder the call returns after polls * timeout with no reply.
static void discover_without_responder_times_out(void) {
	discovery_responder responder;
	discovery_result result = { 0 };
	ASSERT_TRUE(start_discovery_responder(&responder, 0));
	double start = now_seconds();
	int count = indigo_uni_discover("127.0.0.1", responder.port, "hello", 5, 2, INDIGO_DELAY(0.2), false, collect_reply, &result);
	double elapsed = now_seconds() - start;
	stop_discovery_responder(&responder);
	ASSERT_EQ_INT(0, count);
	ASSERT_EQ_INT(2, responder.requests);
	ASSERT_TRUE(elapsed >= 0.35 && elapsed < 2.0);
}

// Without a target and with include_loopback set, a responder that listens on 127.0.0.1 only (e.g. an Alpaca server started
// with --urls=http://127.0.0.1:<port>) is found. macOS has no broadcast on lo0, so 127.255.255.255 alone never reaches it there.
static void discover_reaches_loopback_responder(void) {
	discovery_responder responder;
	discovery_result result = { 0 };
	ASSERT_TRUE(start_discovery_responder(&responder, 1));
	int count = indigo_uni_discover(NULL, responder.port, "hello", 5, 1, INDIGO_DELAY(0.3), true, collect_reply, &result);
	stop_discovery_responder(&responder);
	ASSERT_TRUE(count >= 1);
	ASSERT_TRUE(responder.requests >= 1);
	ASSERT_STREQ("127.0.0.1", result.responder);
	ASSERT_STREQ("hello", responder.last_request);
}

// Invalid arguments are rejected without sending anything.
static void discover_rejects_invalid_arguments(void) {
	discovery_result result = { 0 };
	ASSERT_EQ_INT(0, indigo_uni_discover("not an address", 1, "hello", 5, 1, INDIGO_DELAY(0.1), false, collect_reply, &result));
	ASSERT_EQ_INT(0, indigo_uni_discover("127.0.0.1", 1, NULL, 5, 1, INDIGO_DELAY(0.1), false, collect_reply, &result));
	ASSERT_EQ_INT(0, indigo_uni_discover("127.0.0.1", 1, "hello", 5, 1, INDIGO_DELAY(0.1), false, NULL, &result));
	ASSERT_EQ_INT(0, result.count);
}

// ---- indigo_uni_open_client_socket_with_timeout() ----

static int open_tcp_listener(int *port) {
	int fd = socket(AF_INET, SOCK_STREAM, 0);
	struct sockaddr_in address = { 0 };
	address.sin_family = AF_INET;
	address.sin_addr.s_addr = htonl(INADDR_LOOPBACK);
	socklen_t length = sizeof(address);
	if (fd < 0 || bind(fd, (struct sockaddr *)&address, sizeof(address)) < 0 || listen(fd, 4) < 0 || getsockname(fd, (struct sockaddr *)&address, &length) < 0) {
		if (fd >= 0) {
			close(fd);
		}
		return -1;
	}
	*port = ntohs(address.sin_port);
	return fd;
}

// A listening peer is connected within the timeout and the socket is left in blocking mode.
static void connect_with_timeout_succeeds(void) {
	int port = 0;
	int listener = open_tcp_listener(&port);
	ASSERT_TRUE(listener >= 0);
	indigo_uni_handle *handle = indigo_uni_open_client_socket_with_timeout("127.0.0.1", port, SOCK_STREAM, INDIGO_DELAY(1), INDIGO_LOG_ERROR);
	ASSERT_TRUE(handle != NULL);
	ASSERT_EQ_INT(INDIGO_TCP_HANDLE, handle->type);
	ASSERT_EQ_INT(0, fcntl(handle->fd, F_GETFL, 0) & O_NONBLOCK);
	indigo_uni_close(&handle);
	close(listener);
}

// A refused connection fails immediately, not after the timeout.
static void connect_with_timeout_reports_refused_connection(void) {
	int port = 0;
	int listener = open_tcp_listener(&port);
	ASSERT_TRUE(listener >= 0);
	close(listener);
	double start = now_seconds();
	indigo_uni_handle *handle = indigo_uni_open_client_socket_with_timeout("127.0.0.1", port, SOCK_STREAM, INDIGO_DELAY(3), INDIGO_LOG_ERROR);
	double elapsed = now_seconds() - start;
	ASSERT_TRUE(handle == NULL);
	ASSERT_TRUE(elapsed < 1.0);
}

// A peer that doesn't complete the handshake never blocks longer than the timeout. On Linux a listener with
// zero backlog whose accept queue is already occupied drops further SYNs, so the connection attempt hangs.
static void connect_with_timeout_is_bounded(void) {
#if defined(__linux__)
	int port = 0;
	int listener = open_tcp_listener(&port);
	ASSERT_TRUE(listener >= 0);
	ASSERT_EQ_INT(0, listen(listener, 0));
	indigo_uni_handle *filler = indigo_uni_open_client_socket_with_timeout("127.0.0.1", port, SOCK_STREAM, INDIGO_DELAY(1), INDIGO_LOG_ERROR);
	ASSERT_TRUE(filler != NULL);
	double start = now_seconds();
	indigo_uni_handle *handle = indigo_uni_open_client_socket_with_timeout("127.0.0.1", port, SOCK_STREAM, INDIGO_DELAY(0.3), INDIGO_LOG_ERROR);
	double elapsed = now_seconds() - start;
	ASSERT_TRUE(handle == NULL);
	ASSERT_TRUE(elapsed >= 0.25 && elapsed < 1.5);
	indigo_uni_close(&filler);
	close(listener);
#endif
}

// ---- indigo_uni_is_connection_lost() ----

// A serial port whose device went away: the write fails and the error stays on the handle. A garbled reply is not
// a loss, so data that arrives does not change the answer.
static void connection_lost_after_serial_failure(void) {
	int master = -1;
	indigo_uni_handle *handle = open_pseudo_terminal(&master);
	ASSERT_TRUE(handle != NULL);
	ASSERT_FALSE(indigo_uni_is_connection_lost(handle));
	ASSERT_EQ_INT(2, (int)write(master, "?!", 2));
	indigo_usleep(50000);
	ASSERT_FALSE(indigo_uni_is_connection_lost(handle));
	close(master);
	indigo_uni_write(handle, "x", 1);
	char c;
	indigo_uni_read(handle, &c, 1);
	ASSERT_TRUE(handle->last_error != 0);
	ASSERT_TRUE(indigo_uni_is_connection_lost(handle));
	indigo_uni_close(&handle);
	ASSERT_FALSE(indigo_uni_is_connection_lost(handle));
}

// A TCP connection is lost once the peer closes it, not while it is open or has unread data.
static void connection_lost_after_peer_close(void) {
	int port = 0;
	int listener = open_tcp_listener(&port);
	ASSERT_TRUE(listener >= 0);
	indigo_uni_handle *handle = indigo_uni_open_client_socket_with_timeout("127.0.0.1", port, SOCK_STREAM, INDIGO_DELAY(1), INDIGO_LOG_ERROR);
	ASSERT_TRUE(handle != NULL);
	int peer = accept(listener, NULL, NULL);
	ASSERT_TRUE(peer >= 0);
	ASSERT_FALSE(indigo_uni_is_connection_lost(handle));
	ASSERT_EQ_INT(3, (int)send(peer, "abc", 3, 0));
	indigo_usleep(50000);
	ASSERT_FALSE(indigo_uni_is_connection_lost(handle));
	char buffer[8];
	ASSERT_EQ_INT(3, (int)indigo_uni_read(handle, buffer, 3));
	close(peer);
	indigo_usleep(50000);
	ASSERT_TRUE(indigo_uni_is_connection_lost(handle));
	indigo_uni_close(&handle);
	close(listener);
}

static void standard_stream_handles_have_file_descriptors(void) {
	indigo_uni_handle *handles[] = { indigo_stdin_handle, indigo_stdout_handle, indigo_stderr_handle };
	for (int i = 0; i < 3; i++) {
		ASSERT_EQ_INT(INDIGO_FILE_HANDLE, handles[i]->type);
		ASSERT_EQ_INT(i, handles[i]->fd);
	}
}

int main(void) {
	const indigo_test_case tests[] = {
		{ "standard_stream_handles_have_file_descriptors", standard_stream_handles_have_file_descriptors },
		{ "read_section_accepts_null_ignore_list", read_section_accepts_null_ignore_list },
		{ "read_section_accepts_null_terminator_list", read_section_accepts_null_terminator_list },
		{ "read_section_still_ignores_and_terminates", read_section_still_ignores_and_terminates },
#if defined(INDIGO_LINUX) || defined(INDIGO_MACOS)
		{ "serial_open_reports_open_error", serial_open_reports_open_error },
		{ "serial_open_reports_configuration_error", serial_open_reports_configuration_error },
		{ "serial_open_reports_not_a_serial_port", serial_open_reports_not_a_serial_port },
		{ "serial_open_clears_error_on_success", serial_open_clears_error_on_success },
		{ "serial_port_reopens_after_close", serial_port_reopens_after_close },
#endif
		{ "wait_for_data_continues_after_signal", wait_for_data_continues_after_signal },
		{ "wait_for_data_keeps_timeout_after_signal", wait_for_data_keeps_timeout_after_signal },
		{ "discover_collects_all_replies", discover_collects_all_replies },
		{ "discover_repeats_request_for_each_poll", discover_repeats_request_for_each_poll },
		{ "discover_stops_when_callback_returns_false", discover_stops_when_callback_returns_false },
		{ "discover_without_responder_times_out", discover_without_responder_times_out },
		{ "discover_reaches_loopback_responder", discover_reaches_loopback_responder },
		{ "discover_rejects_invalid_arguments", discover_rejects_invalid_arguments },
		{ "connect_with_timeout_succeeds", connect_with_timeout_succeeds },
		{ "connect_with_timeout_reports_refused_connection", connect_with_timeout_reports_refused_connection },
		{ "connect_with_timeout_is_bounded", connect_with_timeout_is_bounded },
		{ "connection_lost_after_serial_failure", connection_lost_after_serial_failure },
		{ "connection_lost_after_peer_close", connection_lost_after_peer_close }
	};
#if defined(INDIGO_LINUX) || defined(INDIGO_MACOS)
	// Set INDIGO_TEST_TIOCEXCL_PORT to opt into testing one physical serial port.
	serial_exclusive_test_port = getenv("INDIGO_TEST_TIOCEXCL_PORT");
	if (serial_exclusive_test_port != NULL) {
		if (*serial_exclusive_test_port == '\0') {
			fprintf(stderr, "INDIGO_TEST_TIOCEXCL_PORT must contain one serial port path\n");
			return 1;
		}
		const indigo_test_case serial_test[] = {
			{ "serial_port_open_is_exclusive", serial_port_open_is_exclusive }
		};
		if (indigo_run_tests("indigo_uni_io TIOCEXCL physical-port test", serial_test, sizeof(serial_test) / sizeof(serial_test[0]))) {
			return 1;
		}
	}
#endif
	return indigo_run_tests("indigo_uni_io unit tests", tests, sizeof(tests) / sizeof(tests[0]));
}
