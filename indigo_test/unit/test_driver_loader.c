// Copyright (c) 2026 INDIGO initiative
// All rights reserved.
//
// You may use this software under the terms of 'INDIGO Astronomy
// open-source license' (see LICENSE.md).
//
// THIS SOFTWARE IS PROVIDED BY THE AUTHORS 'AS IS' AND ANY EXPRESS
// OR IMPLIED WARRANTIES, INCLUDING, BUT NOT LIMITED TO, THE IMPLIED
// WARRANTIES OF MERCHANTABILITY AND FITNESS FOR A PARTICULAR PURPOSE
// ARE DISCLAIMED. IN NO EVENT SHALL THE AUTHOR BE LIABLE FOR ANY
// DIRECT, INDIRECT, INCIDENTAL, SPECIAL, EXEMPLARY, OR CONSEQUENTIAL
// DAMAGES (INCLUDING, BUT NOT LIMITED TO, PROCUREMENT OF SUBSTITUTE
// GOODS OR SERVICES; LOSS OF USE, DATA, OR PROFITS; OR BUSINESS
// INTERRUPTION) HOWEVER CAUSED AND ON ANY THEORY OF LIABILITY,
// WHETHER IN CONTRACT, STRICT LIABILITY, OR TORT (INCLUDING
// NEGLIGENCE OR OTHERWISE) ARISING IN ANY WAY OUT OF THE USE OF THIS
// SOFTWARE, EVEN IF ADVISED OF THE POSSIBILITY OF SUCH DAMAGE.

// Code is generated by AI

#include <stdio.h>
#include <stdlib.h>
#include <string.h>
#include <unistd.h>
#include <limits.h>
#include <sys/socket.h>
#include <netinet/in.h>
#include <arpa/inet.h>

#include <indigo/indigo_client.h>
#include <indigo/indigo_bus.h>

#include "../test_runner.h"

#if defined(INDIGO_MACOS)
#define LIBRARY_EXTENSION ".dylib"
#else
#define LIBRARY_EXTENSION ".so"
#endif

static char fixture_directory[PATH_MAX];

// the fixture is reachable only through a path longer than INDIGO_NAME_SIZE
static bool make_fixture_directory(void) {
	snprintf(fixture_directory, sizeof(fixture_directory), "%s/indigo_test_driver_loader.XXXXXX", getenv("TMPDIR") ? getenv("TMPDIR") : "/tmp");
	if (mkdtemp(fixture_directory) == NULL) {
		return false;
	}
	strncat(fixture_directory, "/a_directory_name_long_enough_to_push_the_library_path_past_the_old_fixed_size_driver_name_buffer_of_the_loader", sizeof(fixture_directory) - strlen(fixture_directory) - 1);
	if (mkdir(fixture_directory, 0700) != 0) {
		return false;
	}
	char link[PATH_MAX];
	snprintf(link, sizeof(link), "%s/indigo_test_loader_driver%s", fixture_directory, LIBRARY_EXTENSION);
	if (symlink(LOADER_FIXTURE, link) != 0) {
		return false;
	}
	// the same library under another name has no matching entry point
	snprintf(link, sizeof(link), "%s/indigo_test_loader_missing%s", fixture_directory, LIBRARY_EXTENSION);
	return symlink(LOADER_FIXTURE, link) == 0;
}

static void remove_fixture_directory(void) {
	char path[PATH_MAX];
	snprintf(path, sizeof(path), "%s/indigo_test_loader_driver%s", fixture_directory, LIBRARY_EXTENSION);
	unlink(path);
	snprintf(path, sizeof(path), "%s/indigo_test_loader_missing%s", fixture_directory, LIBRARY_EXTENSION);
	unlink(path);
	rmdir(fixture_directory);
	char *slash = strrchr(fixture_directory, '/');
	if (slash) {
		*slash = '\0';
		rmdir(fixture_directory);
	}
}

static void long_path_without_extension_loads_driver(void) {
	char name[PATH_MAX];
	snprintf(name, sizeof(name), "%s/indigo_test_loader_driver", fixture_directory);
	ASSERT_TRUE(strlen(name) >= INDIGO_NAME_SIZE);
	indigo_driver_entry *driver = NULL;
	ASSERT_EQ_INT(INDIGO_OK, indigo_load_driver(name, true, &driver));
	ASSERT_TRUE(driver != NULL);
	if (driver != NULL) {
		ASSERT_STREQ("indigo_test_loader_driver", driver->name);
		ASSERT_EQ_INT(INDIGO_OK, indigo_remove_driver(driver));
	}
}

static void long_path_with_extension_loads_driver(void) {
	char name[PATH_MAX];
	snprintf(name, sizeof(name), "%s/indigo_test_loader_driver%s", fixture_directory, LIBRARY_EXTENSION);
	indigo_driver_entry *driver = NULL;
	ASSERT_EQ_INT(INDIGO_OK, indigo_load_driver(name, true, &driver));
	ASSERT_TRUE(driver != NULL);
	if (driver != NULL) {
		ASSERT_STREQ("indigo_test_loader_driver", driver->name);
		ASSERT_EQ_INT(INDIGO_OK, indigo_remove_driver(driver));
	}
}

static void name_longer_than_path_limit_is_rejected(void) {
	char *name = malloc(PATH_MAX + 64);
	ASSERT_TRUE(name != NULL);
	if (name == NULL) {
		return;
	}
	memset(name, 'x', PATH_MAX + 63);
	name[PATH_MAX + 63] = '\0';
	indigo_driver_entry *driver = NULL;
	ASSERT_EQ_INT(INDIGO_FAILED, indigo_load_driver(name, true, &driver));
	ASSERT_TRUE(driver == NULL);
	free(name);
}

static void too_long_entry_point_name_is_rejected(void) {
	char name[INDIGO_NAME_SIZE + 32];
	memset(name, 'x', sizeof(name) - 1);
	name[sizeof(name) - 1] = '\0';
	ASSERT_EQ_INT(INDIGO_FAILED, indigo_load_driver(name, true, NULL));
}

static void missing_entry_point_is_reported_and_driver_still_loads(void) {
	char name[PATH_MAX];
	snprintf(name, sizeof(name), "%s/indigo_test_loader_missing", fixture_directory);
	ASSERT_EQ_INT(INDIGO_NOT_FOUND, indigo_load_driver(name, true, NULL));
	ASSERT_EQ_INT(INDIGO_NOT_FOUND, indigo_load_driver(name, true, NULL));
	snprintf(name, sizeof(name), "%s/indigo_test_loader_driver", fixture_directory);
	indigo_driver_entry *driver = NULL;
	ASSERT_EQ_INT(INDIGO_OK, indigo_load_driver(name, true, &driver));
	if (driver != NULL) {
		ASSERT_EQ_INT(INDIGO_OK, indigo_remove_driver(driver));
	}
}

// The registries tested 'empty_slot > capacity', so with every slot in use the next distinct entry was stored past the
// end of the array instead of being refused with INDIGO_TOO_MANY_ELEMENTS
static indigo_result capacity_driver(const char *suffix, indigo_driver_action action, indigo_driver_info *info) {
	if (action == INDIGO_DRIVER_INFO && info != NULL) {
		memset(info, 0, sizeof(*info));
		snprintf(info->name, sizeof(info->name), "capacity_driver_%s", suffix);
		snprintf(info->description, sizeof(info->description), "Capacity driver %s", suffix);
		info->version = 0x0001;
	}
	return INDIGO_OK;
}

// every entry point has its own body, so the linker can not fold them into one address
#define CAPACITY_DRIVER(n) static indigo_result capacity_driver_##n(indigo_driver_action action, indigo_driver_info *info) { return capacity_driver(#n, action, info); }
#define CAPACITY_ENTRY(n) capacity_driver_##n,
#define CAPACITY_4(M, p) M(p##0) M(p##1) M(p##2) M(p##3)
#define CAPACITY_16(M, p) CAPACITY_4(M, p##0) CAPACITY_4(M, p##1) CAPACITY_4(M, p##2) CAPACITY_4(M, p##3)
#define CAPACITY_64(M, p) CAPACITY_16(M, p##0) CAPACITY_16(M, p##1) CAPACITY_16(M, p##2) CAPACITY_16(M, p##3)
#define CAPACITY_256(M, p) CAPACITY_64(M, p##0) CAPACITY_64(M, p##1) CAPACITY_64(M, p##2) CAPACITY_64(M, p##3)

CAPACITY_256(CAPACITY_DRIVER, d)
CAPACITY_DRIVER(extra)

static const driver_entry_point capacity_drivers[] = { CAPACITY_256(CAPACITY_ENTRY, d) capacity_driver_extra };

static void driver_registry_refuses_entry_past_capacity(void) {
	const int count = (int)(sizeof(capacity_drivers) / sizeof(capacity_drivers[0]));
	ASSERT_EQ_INT(INDIGO_MAX_DRIVERS + 1, count);
	int occupied = 0;
	for (int i = 0; i < INDIGO_MAX_DRIVERS; i++) {
		if (indigo_available_drivers[i].driver != NULL) {
			occupied++;
		}
	}
	indigo_driver_entry *entries[INDIGO_MAX_DRIVERS + 1] = { NULL };
	int added = 0;
	indigo_result refused = INDIGO_OK;
	for (int i = 0; i < count; i++) {
		indigo_result result = indigo_add_driver(capacity_drivers[i], false, entries + i);
		if (result != INDIGO_OK) {
			refused = result;
			break;
		}
		added++;
	}
	// a removed entry leaves a gap that the refused driver fills
	indigo_result reused = INDIGO_FAILED;
	indigo_driver_entry *gap = entries[0];
	if (added > 0 && added < count && indigo_remove_driver(entries[0]) == INDIGO_OK) {
		entries[0] = NULL;
		reused = indigo_add_driver(capacity_drivers[added], false, entries + added);
	}
	bool gap_filled = entries[added] == gap;
	for (int i = 0; i < count; i++) {
		if (entries[i] != NULL && entries[i]->driver != NULL) {
			indigo_remove_driver(entries[i]);
		}
	}
	ASSERT_EQ_INT(INDIGO_MAX_DRIVERS - occupied, added);
	ASSERT_EQ_INT(INDIGO_TOO_MANY_ELEMENTS, refused);
	ASSERT_EQ_INT(INDIGO_OK, reused);
	ASSERT_TRUE(gap_filled);
}

static bool wait_for_server_thread_stop(indigo_server_entry *server) {
	for (int i = 0; i < 50; i++) {
		if (!server->thread_started) {
			return true;
		}
		indigo_usleep(100000);
	}
	return false;
}

// Every server is a loopback port that was free a moment ago, so its connection attempts are refused at once; a port
// that is still bound without listening is no good, macOS lets a connection to it hang instead of refusing it.
static void server_registry_refuses_entry_past_capacity(void) {
	int sockets[INDIGO_MAX_SERVERS + 1];
	int ports[INDIGO_MAX_SERVERS + 1];
	bool bound = true;
	for (int i = 0; i <= INDIGO_MAX_SERVERS; i++) {
		sockets[i] = socket(AF_INET, SOCK_STREAM, 0);
		struct sockaddr_in address = { 0 };
		address.sin_family = AF_INET;
		address.sin_addr.s_addr = htonl(INADDR_LOOPBACK);
		socklen_t length = sizeof(address);
		if (sockets[i] < 0 || bind(sockets[i], (struct sockaddr *)&address, sizeof(address)) != 0 || getsockname(sockets[i], (struct sockaddr *)&address, &length) != 0) {
			bound = false;
			ports[i] = 0;
		} else {
			ports[i] = ntohs(address.sin_port);
		}
	}
	// all sockets stay bound until every port is known, so the ports are distinct
	for (int i = 0; i <= INDIGO_MAX_SERVERS; i++) {
		if (sockets[i] >= 0) {
			close(sockets[i]);
		}
	}
	indigo_server_entry *entries[INDIGO_MAX_SERVERS + 1] = { NULL };
	int added = 0;
	indigo_result refused = INDIGO_OK;
	for (int i = 0; bound && i <= INDIGO_MAX_SERVERS; i++) {
		indigo_result result = indigo_connect_server(NULL, "127.0.0.1", ports[i], entries + i, NULL);
		if (result != INDIGO_OK) {
			refused = result;
			entries[i] = NULL;
			break;
		}
		added++;
	}
	// a disconnected server frees its slot for the refused one
	indigo_result reused = INDIGO_FAILED;
	if (added == INDIGO_MAX_SERVERS) {
		indigo_disconnect_server(entries[0]);
		if (wait_for_server_thread_stop(entries[0])) {
			entries[0] = NULL;
			reused = indigo_connect_server(NULL, "127.0.0.1", ports[added], entries + added, NULL);
		}
	}
	bool stopped = true;
	for (int i = 0; i <= INDIGO_MAX_SERVERS; i++) {
		if (entries[i] != NULL) {
			indigo_disconnect_server(entries[i]);
			stopped = wait_for_server_thread_stop(entries[i]) && stopped;
		}
	}
	ASSERT_TRUE(bound);
	ASSERT_EQ_INT(INDIGO_MAX_SERVERS, added);
	ASSERT_EQ_INT(INDIGO_TOO_MANY_ELEMENTS, refused);
	ASSERT_EQ_INT(INDIGO_OK, reused);
	ASSERT_TRUE(stopped);
}

int main(void) {
	if (!make_fixture_directory()) {
		fprintf(stderr, "Can't create driver loader fixture directory\n");
		return 1;
	}
	const indigo_test_case tests[] = {
		{ "long_path_without_extension_loads_driver", long_path_without_extension_loads_driver },
		{ "long_path_with_extension_loads_driver", long_path_with_extension_loads_driver },
		{ "name_longer_than_path_limit_is_rejected", name_longer_than_path_limit_is_rejected },
		{ "too_long_entry_point_name_is_rejected", too_long_entry_point_name_is_rejected },
		{ "missing_entry_point_is_reported_and_driver_still_loads", missing_entry_point_is_reported_and_driver_still_loads },
		{ "driver_registry_refuses_entry_past_capacity", driver_registry_refuses_entry_past_capacity },
		{ "server_registry_refuses_entry_past_capacity", server_registry_refuses_entry_past_capacity }
	};
	int result = indigo_run_tests("driver loader unit tests", tests, (int)(sizeof(tests) / sizeof(tests[0])));
	remove_fixture_directory();
	return result;
}
