// Copyright (c) 2026 INDIGO initiative
// All rights reserved.
//
// You may use this software under the terms of 'INDIGO Astronomy
// open-source license' (see LICENSE.md).
//
// THIS SOFTWARE IS PROVIDED BY THE AUTHORS 'AS IS' AND ANY EXPRESS
// OR IMPLIED WARRANTIES, INCLUDING, BUT NOT LIMITED TO, THE IMPLIED
// WARRANTIES OF MERCHANTABILITY AND FITNESS FOR A PARTICULAR PURPOSE
// ARE DISCLAIMED. IN NO EVENT SHALL THE AUTHOR BE LIABLE FOR ANY
// DIRECT, INDIRECT, INCIDENTAL, SPECIAL, EXEMPLARY, OR CONSEQUENTIAL
// DAMAGES (INCLUDING, BUT NOT LIMITED TO, PROCUREMENT OF SUBSTITUTE
// GOODS OR SERVICES; LOSS OF USE, DATA, OR PROFITS; OR BUSINESS
// INTERRUPTION) HOWEVER CAUSED AND ON ANY THEORY OF LIABILITY,
// WHETHER IN CONTRACT, STRICT LIABILITY, OR TORT (INCLUDING
// NEGLIGENCE OR OTHERWISE) ARISING IN ANY WAY OUT OF THE USE OF THIS
// SOFTWARE, EVEN IF ADVISED OF THE POSSIBILITY OF SUCH DAMAGE.

// Code is generated by AI

// Ephemeris grid and constraints of the Scheduler Agent at fixed dates and sites,
// see indigo_docs/SCHEDULER.md "Ephemeris grid" and "Header keys".

#include <stdio.h>
#include <string.h>
#include <math.h>
#include <time.h>
#include <stdint.h>

#include <indigo/indigo_bus.h>

#include "indigo_drivers/agent_scheduler/indigo_agent_scheduler_sky.h"
#include "../test_runner.h"

#define T_EQUINOX_NOON		1774008000	// 2026-03-20 12:00 UTC
#define T_EQUINOX_MIDNIGHT	1773964800	// 2026-03-20 00:00 UTC
#define T_FULL_MOON			1772537880	// 2026-03-03 11:38 UTC
#define T_NEW_MOON			1773883380	// 2026-03-19 01:23 UTC
#define T_NOVEMBER_NIGHT	1794524400	// 2026-11-12 23:00 UTC
#define T_NOVEMBER_NOON		1794484800	// 2026-11-12 12:00 UTC

#define LATITUDE			48.15
#define LONGITUDE			17.11

static scheduler_sky_grid sky;
static scheduler_target_grid target;

static scheduler_header make_header(void) {
	scheduler_header header;
	memset(&header, 0, sizeof(header));
	strcpy(header.name, "test");
	header.priority_class = SCHEDULER_PRIORITY_NORMAL;
	header.level = 50;
	header.repeat = 1;
	header.enabled = true;
	return header;
}

static void set_target(scheduler_header *header, double ra, double dec) {
	header->has_target = true;
	header->ra = ra;
	header->dec = dec;
	indigo_scheduler_target_build(&sky, header, &target);
}

static scheduler_header polaris(void) {
	scheduler_header header = make_header();
	set_target(&header, 2.530303, 89.264108);
	return header;
}

static void test_sun_at_equinox(void) {
	indigo_scheduler_sky_build(&sky, T_EQUINOX_NOON, 0, 0, 0);
	ASSERT_TRUE(sky.valid);
	ASSERT_EQ_INT(T_EQUINOX_NOON, (int)sky.start);
	ASSERT_TRUE(sky.sun_altitude[0] > 85);
	indigo_scheduler_sky_build(&sky, T_EQUINOX_MIDNIGHT, 0, 0, 0);
	ASSERT_TRUE(sky.sun_altitude[0] < -85);
}

static void test_grid_alignment_and_coverage(void) {
	indigo_scheduler_sky_build(&sky, T_NOVEMBER_NIGHT + 299, LATITUDE, LONGITUDE, 140);
	ASSERT_EQ_INT(T_NOVEMBER_NIGHT, (int)sky.start);
	ASSERT_TRUE(indigo_scheduler_sky_covers(&sky, T_NOVEMBER_NIGHT, T_NOVEMBER_NIGHT + 48 * 3600));
	ASSERT_FALSE(indigo_scheduler_sky_covers(&sky, T_NOVEMBER_NIGHT, T_NOVEMBER_NIGHT + 48 * 3600 + 1));
	ASSERT_FALSE(indigo_scheduler_sky_covers(&sky, T_NOVEMBER_NIGHT - 1, T_NOVEMBER_NIGHT + 60));
}

static void test_moon_phase(void) {
	indigo_scheduler_sky_build(&sky, T_FULL_MOON, LATITUDE, LONGITUDE, 140);
	ASSERT_TRUE(sky.moon_days_from_full[0] < 0.6);
	ASSERT_TRUE(sky.moon_illumination[0] > 98);
	indigo_scheduler_sky_build(&sky, T_NEW_MOON, LATITUDE, LONGITUDE, 140);
	ASSERT_TRUE(sky.moon_days_from_full[0] > 14.1);
	ASSERT_TRUE(sky.moon_illumination[0] < 2);
}

static void test_lorentzian_limit(void) {
	ASSERT_NEAR(40, indigo_scheduler_moon_limit(40, 7, 0), 1e-9);
	ASSERT_NEAR(33.8, indigo_scheduler_moon_limit(40, 7, 3), 0.05);
	ASSERT_NEAR(20, indigo_scheduler_moon_limit(40, 7, 7), 1e-9);
	ASSERT_NEAR(11.5, indigo_scheduler_moon_limit(40, 7, 11), 0.05);
	ASSERT_NEAR(7.3, indigo_scheduler_moon_limit(40, 7, 14.77), 0.05);
	ASSERT_NEAR(40, indigo_scheduler_moon_limit(40, 0, 14.77), 1e-9);
}

static void test_polaris_altitude_airmass_and_hour_angle(void) {
	indigo_scheduler_sky_build(&sky, T_NOVEMBER_NIGHT, LATITUDE, LONGITUDE, 140);
	scheduler_header header = polaris();
	ASSERT_TRUE(target.valid);
	for (int i = 0; i < SCHEDULER_GRID_POINTS; i += 12) {
		ASSERT_NEAR(LATITUDE, target.altitude[i], 1.5);
	}
	// one hour later the hour angle grew by one sidereal hour
	double dha = target.hour_angle[12] - target.hour_angle[0];
	if (dha < -12) {
		dha += 24;
	}
	ASSERT_NEAR(1.0027, dha, 0.002);
	const char *reason = NULL;
	header.has_max_airmass = true;
	header.max_airmass = 1.2;
	ASSERT_FALSE(indigo_scheduler_sky_point_ok(&sky, &target, &header, 0, &reason));
	ASSERT_STREQ("airmass too high", reason);
	header.max_airmass = 1.5;
	ASSERT_TRUE(indigo_scheduler_sky_point_ok(&sky, &target, &header, 0, &reason));
	header.has_min_altitude = true;
	header.min_altitude = 50;
	ASSERT_FALSE(indigo_scheduler_sky_point_ok(&sky, &target, &header, 0, &reason));
	ASSERT_STREQ("target below the altitude limit", reason);
	header.min_altitude = 45;
	ASSERT_TRUE(indigo_scheduler_sky_point_ok(&sky, &target, &header, 0, &reason));
	double ha = target.hour_angle[0];
	header.has_ha = true;
	header.ha_from = ha - 0.5;
	header.ha_to = ha + 0.5;
	ASSERT_TRUE(indigo_scheduler_sky_point_ok(&sky, &target, &header, 0, &reason));
	ASSERT_FALSE(indigo_scheduler_sky_point_ok(&sky, &target, &header, 12, &reason));
	ASSERT_STREQ("hour angle out of range", reason);
	// from greater than to is the wrapped range, which excludes ha - 0.5 .. ha + 0.5 here
	header.ha_from = ha + 0.5;
	header.ha_to = ha - 0.5;
	ASSERT_FALSE(indigo_scheduler_sky_point_ok(&sky, &target, &header, 0, &reason));
	ASSERT_TRUE(indigo_scheduler_sky_point_ok(&sky, &target, &header, 12, &reason));
}

static void test_target_below_horizon(void) {
	indigo_scheduler_sky_build(&sky, T_NOVEMBER_NIGHT, LATITUDE, LONGITUDE, 140);
	scheduler_header header = make_header();
	set_target(&header, 6, -80);
	const char *reason = NULL;
	ASSERT_FALSE(indigo_scheduler_sky_point_ok(&sky, &target, &header, 0, &reason));
	ASSERT_STREQ("target below the horizon", reason);
}

static void test_twilight(void) {
	scheduler_header header = make_header();
	const char *reason = NULL;
	header.twilight = SCHEDULER_TWILIGHT_ASTRONOMICAL;
	indigo_scheduler_sky_build(&sky, T_NOVEMBER_NIGHT, LATITUDE, LONGITUDE, 140);
	ASSERT_TRUE(indigo_scheduler_sky_point_ok(&sky, &target, &header, 0, &reason));
	indigo_scheduler_sky_build(&sky, T_NOVEMBER_NOON, LATITUDE, LONGITUDE, 140);
	ASSERT_FALSE(indigo_scheduler_sky_point_ok(&sky, &target, &header, 0, &reason));
	ASSERT_STREQ("too bright (twilight)", reason);
	header.twilight = SCHEDULER_TWILIGHT_NONE;
	ASSERT_TRUE(indigo_scheduler_sky_point_ok(&sky, &target, &header, 0, &reason));
}

static int find_moon(double min_altitude, double max_altitude) {
	for (int i = 0; i < SCHEDULER_GRID_POINTS; i++) {
		if (sky.moon_altitude[i] > min_altitude && sky.moon_altitude[i] < max_altitude) {
			return i;
		}
	}
	return -1;
}

static void test_moon_separation_and_illumination(void) {
	indigo_scheduler_sky_build(&sky, T_FULL_MOON, LATITUDE, LONGITUDE, 140);
	int up = find_moon(20, 90);
	ASSERT_TRUE(up >= 0);
	scheduler_header header = make_header();
	const char *reason = NULL;
	// a target next to the moon, its J2000 position differs from the moon of date by less than a degree
	set_target(&header, sky.moon_ra[up], sky.moon_dec[up]);
	ASSERT_TRUE(target.moon_separation[up] < 2);
	header.has_moon = true;
	header.moon_separation = 10;
	ASSERT_FALSE(indigo_scheduler_sky_point_ok(&sky, &target, &header, up, &reason));
	ASSERT_STREQ("too close to the moon", reason);
	header.has_moon = false;
	header.has_illumination = true;
	header.max_illumination = 90;
	ASSERT_FALSE(indigo_scheduler_sky_point_ok(&sky, &target, &header, up, &reason));
	ASSERT_STREQ("moon too bright", reason);
	header.max_illumination = 100;
	ASSERT_TRUE(indigo_scheduler_sky_point_ok(&sky, &target, &header, up, &reason));
}

static void test_moon_below_horizon_is_ignored(void) {
	indigo_scheduler_sky_build(&sky, T_FULL_MOON, LATITUDE, LONGITUDE, 140);
	int down = find_moon(-90, -10);
	ASSERT_TRUE(down >= 0);
	scheduler_header header = polaris();
	const char *reason = NULL;
	header.has_moon = true;
	header.moon_separation = 180;
	header.has_illumination = true;
	header.max_illumination = 0;
	ASSERT_TRUE(indigo_scheduler_sky_point_ok(&sky, &target, &header, down, &reason));
	int up = find_moon(10, 90);
	ASSERT_TRUE(up >= 0);
	ASSERT_FALSE(indigo_scheduler_sky_point_ok(&sky, &target, &header, up, &reason));
}

static void test_absolute_window(void) {
	scheduler_header header = make_header();
	const char *reason = NULL;
	header.window_kind = SCHEDULER_WINDOW_ABSOLUTE;
	header.has_window_start = header.has_window_end = true;
	header.window_start = 1000000;
	header.window_end = 1003600;
	ASSERT_FALSE(indigo_scheduler_window_ok(&header, 999999, 1000600, &reason));
	ASSERT_STREQ("window not open yet", reason);
	ASSERT_TRUE(indigo_scheduler_window_ok(&header, 1000000, 1003600, &reason));
	ASSERT_FALSE(indigo_scheduler_window_ok(&header, 1003000, 1003601, &reason));
	ASSERT_STREQ("window ends before the task can finish", reason);
	ASSERT_FALSE(indigo_scheduler_window_expired(&header, 1003599));
	ASSERT_TRUE(indigo_scheduler_window_expired(&header, 1003600));
	header.has_window_end = false;
	ASSERT_FALSE(indigo_scheduler_window_expired(&header, 2000000000));
}

static void test_nightly_window(void) {
	scheduler_header header = make_header();
	const char *reason = NULL;
	time_t day = T_NOVEMBER_NIGHT - T_NOVEMBER_NIGHT % 86400;
	header.window_kind = SCHEDULER_WINDOW_NIGHTLY;
	header.has_window_start = header.has_window_end = true;
	header.window_start_minute = 22 * 60;
	header.window_end_minute = 3 * 60;
	ASSERT_TRUE(indigo_scheduler_window_ok(&header, day + 23 * 3600, day + 26 * 3600, &reason));
	ASSERT_FALSE(indigo_scheduler_window_ok(&header, day + 23 * 3600, day + 27 * 3600 + 1, &reason));
	ASSERT_STREQ("nightly window ends before the task can finish", reason);
	ASSERT_TRUE(indigo_scheduler_window_ok(&header, day + 1 * 3600, day + 2 * 3600, &reason));
	ASSERT_FALSE(indigo_scheduler_window_ok(&header, day + 12 * 3600, day + 13 * 3600, &reason));
	ASSERT_STREQ("outside of the nightly window", reason);
	header.window_start_minute = 18 * 60;
	header.window_end_minute = 20 * 60;
	ASSERT_TRUE(indigo_scheduler_window_ok(&header, day + 18 * 3600, day + 20 * 3600, &reason));
	ASSERT_FALSE(indigo_scheduler_window_ok(&header, day + 17 * 3600, day + 18 * 3600, &reason));
	ASSERT_FALSE(indigo_scheduler_window_expired(&header, 2000000000));
}

static void test_interval_next_eligible_and_time_to_set(void) {
	indigo_scheduler_sky_build(&sky, T_NOVEMBER_NIGHT, LATITUDE, LONGITUDE, 140);
	scheduler_header header = make_header();
	const char *reason = NULL;
	header.window_kind = SCHEDULER_WINDOW_ABSOLUTE;
	header.has_window_start = header.has_window_end = true;
	header.window_start = T_NOVEMBER_NIGHT + 7200 + 60;
	header.window_end = T_NOVEMBER_NIGHT + 4 * 3600;
	ASSERT_EQ_INT((int)header.window_start, (int)indigo_scheduler_next_eligible(&sky, &target, &header, T_NOVEMBER_NIGHT, 1800, &reason));
	ASSERT_STREQ("window not open yet", reason);
	ASSERT_EQ_INT(0, (int)indigo_scheduler_next_eligible(&sky, &target, &header, T_NOVEMBER_NIGHT, 3 * 3600, &reason));
	ASSERT_EQ_INT(2 * 3600 - 60, indigo_scheduler_time_to_set(&sky, &target, &header, header.window_start));
	header.window_end = T_NOVEMBER_NIGHT + 20 * 3600;
	ASSERT_EQ_INT(SCHEDULER_SETTING_HORIZON, indigo_scheduler_time_to_set(&sky, &target, &header, header.window_start));
	// an astronomical-darkness task at noon waits until the evening
	scheduler_header dark = make_header();
	dark.twilight = SCHEDULER_TWILIGHT_ASTRONOMICAL;
	indigo_scheduler_sky_build(&sky, T_NOVEMBER_NOON, LATITUDE, LONGITUDE, 140);
	time_t next = indigo_scheduler_next_eligible(&sky, &target, &dark, T_NOVEMBER_NOON, 3600, &reason);
	ASSERT_STREQ("too bright (twilight)", reason);
	ASSERT_TRUE(next > T_NOVEMBER_NOON + 4 * 3600 && next < T_NOVEMBER_NOON + 7 * 3600);
	ASSERT_TRUE(indigo_scheduler_interval_ok(&sky, &target, &dark, next, next + 3600, &reason));
}

static void test_unknown_site(void) {
	scheduler_header header = polaris();
	scheduler_sky_grid unknown;
	memset(&unknown, 0, sizeof(unknown));
	const char *reason = NULL;
	ASSERT_FALSE(indigo_scheduler_interval_ok(&unknown, &target, &header, T_NOVEMBER_NIGHT, T_NOVEMBER_NIGHT + 600, &reason));
	ASSERT_STREQ("site coordinates unknown", reason);
	scheduler_header plain = make_header();
	ASSERT_TRUE(indigo_scheduler_interval_ok(&unknown, NULL, &plain, T_NOVEMBER_NIGHT, T_NOVEMBER_NIGHT + 600, &reason));
}

// deterministic pseudo random numbers, the tests never depend on the platform rand()
static uint32_t random_state = 20261113;

static double random_unit(void) {
	random_state = random_state * 1664525u + 1013904223u;
	return (random_state >> 8) / (double)(1u << 24);
}

static scheduler_header random_header(void) {
	scheduler_header header = make_header();
	if (random_unit() < 0.8) {
		header.has_target = true;
		header.ra = random_unit() * 24;
		header.dec = random_unit() * 150 - 60;
		header.has_min_altitude = random_unit() < 0.5;
		header.min_altitude = random_unit() * 60;
		header.has_max_airmass = random_unit() < 0.3;
		header.max_airmass = 1 + random_unit() * 2;
		header.has_ha = random_unit() < 0.3;
		header.ha_from = random_unit() * 24 - 12;
		header.ha_to = random_unit() * 24 - 12;
		header.has_moon = random_unit() < 0.4;
		header.moon_separation = random_unit() * 90;
		header.moon_width = random_unit() < 0.5 ? 0 : 1 + random_unit() * 10;
		header.has_illumination = random_unit() < 0.3;
		header.max_illumination = random_unit() * 100;
	}
	header.twilight = (scheduler_twilight)(int)(random_unit() * 4);
	double window = random_unit();
	if (window < 0.3) {
		header.window_kind = SCHEDULER_WINDOW_ABSOLUTE;
		header.has_window_start = random_unit() < 0.7;
		header.has_window_end = !header.has_window_start || random_unit() < 0.7;
		header.window_start = sky.start + (time_t)(random_unit() * 20 * 3600);
		header.window_end = header.window_start + 600 + (time_t)(random_unit() * 20 * 3600);
	} else if (window < 0.5) {
		header.window_kind = SCHEDULER_WINDOW_NIGHTLY;
		header.has_window_start = header.has_window_end = true;
		header.window_start_minute = (int)(random_unit() * 1440);
		header.window_end_minute = (int)(random_unit() * 1440);
	}
	return header;
}

// the precomputed tables must answer exactly as the reference functions, reasons included
static void test_points_match_reference(void) {
	indigo_scheduler_sky_build(&sky, T_FULL_MOON + 7 * 3600, LATITUDE, LONGITUDE, 140);
	scheduler_task_points points;
	int checks = 0;
	for (int n = 0; n < 60; n++) {
		scheduler_header header = random_header();
		if (header.has_target) {
			indigo_scheduler_target_build(&sky, &header, &target);
		}
		indigo_scheduler_points_build(&sky, &target, &header, &points);
		ASSERT_TRUE(points.valid);
		for (int k = 0; k < 12; k++) {
			time_t from = sky.start + (time_t)(random_unit() * 24 * 3600);
			int duration = 60 + (int)(random_unit() * 6 * 3600);
			const char *slow_reason = NULL, *fast_reason = NULL;
			bool slow = indigo_scheduler_interval_ok(&sky, &target, &header, from, from + duration, &slow_reason);
			bool fast = indigo_scheduler_points_ok(&sky, &points, &header, from, from + duration, &fast_reason);
			ASSERT_EQ_INT(slow, fast);
			if (!slow) {
				ASSERT_STREQ(slow_reason, fast_reason);
			}
			slow_reason = fast_reason = NULL;
			time_t slow_next = indigo_scheduler_next_eligible(&sky, &target, &header, from, duration, &slow_reason);
			time_t fast_next = indigo_scheduler_points_next(&sky, &points, &header, from, duration, 0, &fast_reason);
			ASSERT_EQ_INT((int)slow_next, (int)fast_next);
			ASSERT_TRUE((slow_reason == NULL && fast_reason == NULL) || (slow_reason && fast_reason && !strcmp(slow_reason, fast_reason)));
			ASSERT_EQ_INT(indigo_scheduler_time_to_set(&sky, &target, &header, from), indigo_scheduler_points_time_to_set(&sky, &points, &header, from));
			checks++;
		}
	}
	ASSERT_EQ_INT(720, checks);
	// grid boundaries: starts and ends on grid points, before the grid and at its end
	scheduler_header header = make_header();
	set_target(&header, 2.530303, 60);
	header.has_min_altitude = true;
	header.min_altitude = 30;
	header.twilight = SCHEDULER_TWILIGHT_NAUTICAL;
	indigo_scheduler_points_build(&sky, &target, &header, &points);
	time_t last = sky.start + (SCHEDULER_GRID_POINTS - 1) * SCHEDULER_GRID_STEP;
	time_t froms[] = { sky.start - 600, sky.start, sky.start + SCHEDULER_GRID_STEP, sky.start + 12 * 3600, last - 3600, last - SCHEDULER_GRID_STEP, last };
	int durations[] = { 60, SCHEDULER_GRID_STEP, 3600, 3 * 3600 };
	for (unsigned i = 0; i < sizeof(froms) / sizeof(froms[0]); i++) {
		for (unsigned j = 0; j < sizeof(durations) / sizeof(durations[0]); j++) {
			const char *slow_reason = NULL, *fast_reason = NULL;
			ASSERT_EQ_INT(indigo_scheduler_interval_ok(&sky, &target, &header, froms[i], froms[i] + durations[j], &slow_reason), indigo_scheduler_points_ok(&sky, &points, &header, froms[i], froms[i] + durations[j], &fast_reason));
			ASSERT_TRUE((slow_reason == NULL && fast_reason == NULL) || (slow_reason && fast_reason && !strcmp(slow_reason, fast_reason)));
			slow_reason = fast_reason = NULL;
			ASSERT_EQ_INT((int)indigo_scheduler_next_eligible(&sky, &target, &header, froms[i], durations[j], &slow_reason), (int)indigo_scheduler_points_next(&sky, &points, &header, froms[i], durations[j], 0, &fast_reason));
			ASSERT_TRUE((slow_reason == NULL && fast_reason == NULL) || (slow_reason && fast_reason && !strcmp(slow_reason, fast_reason)));
		}
	}
	// a table of an older grid and an invalid grid are never used
	time_t from = sky.start + 12 * 3600;
	const char *reason = NULL;
	points.start = sky.start - SCHEDULER_GRID_STEP;
	ASSERT_FALSE(indigo_scheduler_points_ok(&sky, &points, &header, from, from + 60, &reason));
	ASSERT_STREQ("site coordinates unknown", reason);
	indigo_scheduler_points_build(&sky, &target, &header, &points);
	sky.valid = false;
	reason = NULL;
	ASSERT_FALSE(indigo_scheduler_points_ok(&sky, &points, &header, from, from + 60, &reason));
	ASSERT_STREQ("site coordinates unknown", reason);
	sky.valid = true;
}

static void test_night_end(void) {
	// by day the night ends at the sunrise after the next sunset, by night at the next sunrise
	indigo_scheduler_sky_build(&sky, T_NOVEMBER_NOON, LATITUDE, LONGITUDE, 140);
	time_t end = indigo_scheduler_night_end(&sky, T_NOVEMBER_NOON);
	ASSERT_TRUE(end > T_NOVEMBER_NOON + 16 * 3600 && end < T_NOVEMBER_NOON + 20 * 3600);
	indigo_scheduler_sky_build(&sky, T_NOVEMBER_NIGHT, LATITUDE, LONGITUDE, 140);
	end = indigo_scheduler_night_end(&sky, T_NOVEMBER_NIGHT);
	ASSERT_TRUE(end > T_NOVEMBER_NIGHT + 5 * 3600 && end < T_NOVEMBER_NIGHT + 9 * 3600);
	// in the polar night the sun does not rise within the grid
	indigo_scheduler_sky_build(&sky, T_NOVEMBER_NIGHT, 85, LONGITUDE, 0);
	ASSERT_EQ_INT((int)(T_NOVEMBER_NIGHT + 86400), (int)indigo_scheduler_night_end(&sky, T_NOVEMBER_NIGHT));
}

int main(void) {
	indigo_test_case cases[] = {
		{ "sun_at_equinox", test_sun_at_equinox },
		{ "grid_alignment_and_coverage", test_grid_alignment_and_coverage },
		{ "moon_phase", test_moon_phase },
		{ "lorentzian_limit", test_lorentzian_limit },
		{ "polaris_altitude_airmass_and_hour_angle", test_polaris_altitude_airmass_and_hour_angle },
		{ "target_below_horizon", test_target_below_horizon },
		{ "twilight", test_twilight },
		{ "moon_separation_and_illumination", test_moon_separation_and_illumination },
		{ "moon_below_horizon_is_ignored", test_moon_below_horizon_is_ignored },
		{ "absolute_window", test_absolute_window },
		{ "nightly_window", test_nightly_window },
		{ "interval_next_eligible_and_time_to_set", test_interval_next_eligible_and_time_to_set },
		{ "unknown_site", test_unknown_site },
		{ "points_match_reference", test_points_match_reference },
		{ "night_end", test_night_end },
	};
	return indigo_run_tests("test_agent_scheduler_sky", cases, sizeof(cases) / sizeof(cases[0]));
}
