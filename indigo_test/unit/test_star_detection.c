// Copyright (c) 2026 INDIGO initiative
// All rights reserved.
//
// You may use this software under the terms of 'INDIGO Astronomy
// open-source license' (see LICENSE.md).
//
// THIS SOFTWARE IS PROVIDED BY THE AUTHORS 'AS IS' AND ANY EXPRESS
// OR IMPLIED WARRANTIES, INCLUDING, BUT NOT LIMITED TO, THE IMPLIED
// WARRANTIES OF MERCHANTABILITY AND FITNESS FOR A PARTICULAR PURPOSE
// ARE DISCLAIMED. IN NO EVENT SHALL THE AUTHOR BE LIABLE FOR ANY
// DIRECT, INDIRECT, INCIDENTAL, SPECIAL, EXEMPLARY, OR CONSEQUENTIAL
// DAMAGES (INCLUDING, BUT NOT LIMITED TO, PROCUREMENT OF SUBSTITUTE
// GOODS OR SERVICES; LOSS OF USE, DATA, OR PROFITS; OR BUSINESS
// INTERRUPTION) HOWEVER CAUSED AND ON ANY THEORY OF LIABILITY,
// WHETHER IN CONTRACT, STRICT LIABILITY, OR TORT (INCLUDING
// NEGLIGENCE OR OTHERWISE) ARISING IN ANY WAY OUT OF THE USE OF THIS
// SOFTWARE, EVEN IF ADVISED OF THE POSSIBILITY OF SUCH DAMAGE.

// Code is generated by AI

#include <limits.h>
#include <stdint.h>
#include <indigo/indigo_bus.h>
#include <indigo/indigo_raw_utils.h>
#include "../test_runner.h"

typedef indigo_result (*detector_function)(indigo_raw_type, const void *, int, double, int, int, int, indigo_star_detection *, int *);
static detector_function detectors[] = { indigo_find_stars_precise_threshold, indigo_find_stars_fast_threshold };
static const indigo_raw_type formats[] = { INDIGO_RAW_MONO8, INDIGO_RAW_MONO16, INDIGO_RAW_RGB24, INDIGO_RAW_RGBA32, INDIGO_RAW_ABGR32, INDIGO_RAW_RGB48 };
static const int channels[] = { 1, 1, 3, 4, 4, 3 };

static void *make_image(int format, int width, int height, int bright_pixel, bool star) {
	bool wide = format == 1 || format == 5;
	void *image = calloc((size_t)width * height * channels[format], wide ? sizeof(uint16_t) : sizeof(uint8_t));
	assert(image);
	for (int y = 0; y < height; y++) {
		for (int x = 0; x < width; x++) {
			int offset = y * width + x;
			double dx = x - width / 2, dy = y - height / 2;
			unsigned value = star ? 10 + (unsigned)(220 * exp(-(dx * dx + dy * dy) / 4.5)) : offset == bright_pixel ? 230 : 10;
			for (int c = 0; c < channels[format]; c++) {
				if (wide) {
					((uint16_t *)image)[offset * channels[format] + c] = value * 200;
				} else {
					((uint8_t *)image)[offset * channels[format] + c] = value;
				}
			}
		}
	}
	return image;
}

static void small_images_have_safe_neighbor_scans(void) {
	const int dimensions[][2] = { { 1, 1 }, { 1, 144 }, { 144, 1 }, { 2, 144 }, { 144, 2 }, { 3, 3 }, { 3, 144 }, { 144, 3 }, { 4, 4 }, { 8, 8 }, { 64, 64 } };
	const int radii[] = { 0, 1, 3, 16, 128 };
	for (unsigned d = 0; d < sizeof(dimensions) / sizeof(dimensions[0]); d++) {
		int width = dimensions[d][0], height = dimensions[d][1];
		const int positions[] = { -1, 0, width - 1, (height - 1) * width, width * height - 1, (height / 2) * width + width / 2 };
		for (int f = 0; f < 6; f++) {
			for (unsigned p = 0; p < sizeof(positions) / sizeof(positions[0]); p++) {
				void *image = make_image(f, width, height, positions[p], false);
				for (unsigned r = 0; r < sizeof(radii) / sizeof(radii[0]); r++) {
					for (int detector = 0; detector < 2; detector++) {
						indigo_star_detection stars[8];
						int count = -1;
						indigo_result result = detectors[detector](formats[f], image, radii[r], 5.0, width, height, 8, stars, &count);
						if (result != INDIGO_OK || count != 0) {
							free(image);
							ASSERT_EQ_INT(INDIGO_OK, result);
							ASSERT_EQ_INT(0, count);
						}
					}
				}
				free(image);
			}
		}
	}
}

static void invalid_radius_and_geometry_fail_before_reading(void) {
	const int radii[] = { INT_MIN, -1, 129, 32768, (INT_MAX - 1) / 2, INT_MAX };
	const int dimensions[][2] = { { 0, 64 }, { 64, 0 }, { -1, 64 }, { 64, -1 }, { INT_MAX, 1 }, { 1, INT_MAX }, { 46341, 46341 }, { 32768, 32768 }, { INT_MAX / 12 + 1, 1 }, { 1, INT_MAX / 12 + 1 } };
	uint16_t pixel = 10;
	indigo_star_detection stars[8];
	for (int detector = 0; detector < 2; detector++) {
		for (int f = 0; f < 6; f++) {
			for (unsigned r = 0; r < sizeof(radii) / sizeof(radii[0]); r++) {
				int count = -1;
				ASSERT_EQ_INT(INDIGO_FAILED, detectors[detector](formats[f], &pixel, radii[r], 5.0, 64, 64, 8, stars, &count));
				ASSERT_EQ_INT(-1, count);
			}
			for (unsigned d = 0; d < sizeof(dimensions) / sizeof(dimensions[0]); d++) {
				int count = -1;
				ASSERT_EQ_INT(INDIGO_FAILED, detectors[detector](formats[f], &pixel, 3, 5.0, dimensions[d][0], dimensions[d][1], 8, stars, &count));
				ASSERT_EQ_INT(-1, count);
			}
		}
		int count = -1;
		ASSERT_EQ_INT(INDIGO_FAILED, detectors[detector](INDIGO_RAW_MONO16, NULL, 3, 5.0, 64, 64, 8, stars, &count));
		ASSERT_EQ_INT(INDIGO_FAILED, detectors[detector](INDIGO_RAW_MONO16, &pixel, 3, 5.0, 64, 64, 8, NULL, &count));
		ASSERT_EQ_INT(INDIGO_FAILED, detectors[detector](INDIGO_RAW_MONO16, &pixel, 3, 5.0, 64, 64, 8, stars, NULL));
		ASSERT_EQ_INT(INDIGO_FAILED, detectors[detector](INDIGO_RAW_MONO16, &pixel, 3, 5.0, 64, 64, 0, stars, &count));
	}
}

static void ordinary_stars_and_zero_radius_keep_their_behavior(void) {
	const int radii[] = { 0, 1, 3, 16 };
	for (int f = 0; f < 6; f++) {
		void *image = make_image(f, 96, 96, -1, true);
		for (int detector = 0; detector < 2; detector++) {
			for (unsigned r = 0; r < sizeof(radii) / sizeof(radii[0]); r++) {
				indigo_star_detection stars[8];
				int count = -1;
				indigo_result result = detectors[detector](formats[f], image, radii[r], 5.0, 96, 96, 8, stars, &count);
				if (result != INDIGO_OK || (radii[r] < 3 ? count != 0 : count != 1)) {
					fprintf(stderr, "format=%d detector=%d radius=%d count=%d\n", f, detector, radii[r], count);
					free(image);
					ASSERT_EQ_INT(INDIGO_OK, result);
					ASSERT_EQ_INT(radii[r] < 3 ? 0 : 1, count);
				}
				if (count == 1) {
					ASSERT_TRUE(fabs(stars[0].x - 48.5) < 0.1 && fabs(stars[0].y - 48.5) < 0.1);
				}
			}
		}
		free(image);
	}
}

static void maximum_supported_radius_detects_a_star(void) {
	for (int f = 0; f < 6; f++) {
		void *image = make_image(f, 272, 272, -1, true);
		for (int detector = 0; detector < 2; detector++) {
			indigo_star_detection stars[8];
			int count = -1;
			indigo_result result = detectors[detector](formats[f], image, 128, 5.0, 272, 272, 8, stars, &count);
			if (result != INDIGO_OK || count != 1) {
				free(image);
				ASSERT_EQ_INT(INDIGO_OK, result);
				ASSERT_EQ_INT(1, count);
			}
			ASSERT_TRUE(fabs(stars[0].x - 136.5) < 0.1 && fabs(stars[0].y - 136.5) < 0.1);
		}
		free(image);
	}
}

int main(void) {
	const indigo_test_case tests[] = {
		{ "small_images_have_safe_neighbor_scans", small_images_have_safe_neighbor_scans },
		{ "invalid_radius_and_geometry_fail_before_reading", invalid_radius_and_geometry_fail_before_reading },
		{ "ordinary_stars_and_zero_radius_keep_their_behavior", ordinary_stars_and_zero_radius_keep_their_behavior },
		{ "maximum_supported_radius_detects_a_star", maximum_supported_radius_detects_a_star }
	};
	return indigo_run_tests("Star detection", tests, sizeof(tests) / sizeof(tests[0]));
}
