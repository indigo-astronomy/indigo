// Copyright (c) 2026 INDIGO initiative
// All rights reserved.
//
// You may use this software under the terms of 'INDIGO Astronomy
// open-source license' (see LICENSE.md).
//
// THIS SOFTWARE IS PROVIDED BY THE AUTHORS 'AS IS' AND ANY EXPRESS
// OR IMPLIED WARRANTIES, INCLUDING, BUT NOT LIMITED TO, THE IMPLIED
// WARRANTIES OF MERCHANTABILITY AND FITNESS FOR A PARTICULAR PURPOSE
// ARE DISCLAIMED. IN NO EVENT SHALL THE AUTHOR BE LIABLE FOR ANY
// DIRECT, INDIRECT, INCIDENTAL, SPECIAL, EXEMPLARY, OR CONSEQUENTIAL
// DAMAGES (INCLUDING, BUT NOT LIMITED TO, PROCUREMENT OF SUBSTITUTE
// GOODS OR SERVICES; LOSS OF USE, DATA, OR PROFITS; OR BUSINESS
// INTERRUPTION) HOWEVER CAUSED AND ON ANY THEORY OF LIABILITY,
// WHETHER IN CONTRACT, STRICT LIABILITY, OR TORT (INCLUDING
// NEGLIGENCE OR OTHERWISE) ARISING IN ANY WAY OUT OF THE USE OF THIS
// SOFTWARE, EVEN IF ADVISED OF THE POSSIBILITY OF SUCH DAMAGE.

// Code is generated by AI

#include <CoreFoundation/CoreFoundation.h>
#include <IOKit/IOKitLib.h>
#include <IOKit/usb/IOUSBLib.h>
#include <IOKit/serial/IOSerialKeys.h>
#include <indigo/indigo_usbserial_utils.h>
#include "../test_runner.h"

#define USB_ITERATOR 1
#define USB_DEVICE_BASE 10
#define SERIAL_ITERATOR_BASE 20
#define SERIAL_SERVICE_BASE 100

static int device_count, outer_position, endpoints[2], serial_positions[2], classes[2];
static int references[256], acquired, released, cf_created, cf_released, invalid_releases;
static int fail_matching, fail_services, fail_descendants, bad_path;

static io_object_t acquire_object(io_object_t object) {
	references[object]++;
	acquired++;
	return object;
}

static CFTypeRef number_property(int value) {
	cf_created++;
	return CFNumberCreate(kCFAllocatorDefault, kCFNumberIntType, &value);
}

static CFTypeRef string_property(const char *value) {
	cf_created++;
	return CFStringCreateWithCString(kCFAllocatorDefault, value, kCFStringEncodingUTF8);
}

// Only the instrumented production object calls these fake platform entry points.
CFMutableDictionaryRef usb_test_IOServiceMatching(const char *name) {
	if (fail_matching) {
		return NULL;
	}
	cf_created++;
	return CFDictionaryCreateMutable(kCFAllocatorDefault, 0, &kCFTypeDictionaryKeyCallBacks, &kCFTypeDictionaryValueCallBacks);
}

void usb_test_CFRelease(CFTypeRef value) {
	cf_released++;
	CFRelease(value);
}

kern_return_t usb_test_IOServiceGetMatchingServices(mach_port_t port, CFDictionaryRef matching, io_iterator_t *iterator) {
	usb_test_CFRelease(matching);
	if (fail_services) {
		return KERN_FAILURE;
	}
	*iterator = acquire_object(USB_ITERATOR);
	return KERN_SUCCESS;
}

io_object_t usb_test_IOIteratorNext(io_iterator_t iterator) {
	if (iterator == USB_ITERATOR) {
		return outer_position < device_count ? acquire_object(USB_DEVICE_BASE + outer_position++) : 0;
	}
	int device = iterator - SERIAL_ITERATOR_BASE;
	if (device >= 0 && device < device_count && serial_positions[device] < endpoints[device]) {
		return acquire_object(SERIAL_SERVICE_BASE + device * 10 + serial_positions[device]++);
	}
	return 0;
}

kern_return_t usb_test_IOObjectRelease(io_object_t object) {
	if (object >= 256 || references[object] != 1) {
		invalid_releases++;
		return KERN_FAILURE;
	}
	references[object]--;
	released++;
	return KERN_SUCCESS;
}

kern_return_t usb_test_IORegistryEntryCreateIterator(io_registry_entry_t entry, const io_name_t plane, IOOptionBits options, io_iterator_t *iterator) {
	int device = entry - USB_DEVICE_BASE;
	if (fail_descendants == device) {
		return KERN_FAILURE;
	}
	*iterator = acquire_object(SERIAL_ITERATOR_BASE + device);
	return KERN_SUCCESS;
}

CFTypeRef usb_test_IORegistryEntryCreateCFProperty(io_registry_entry_t entry, CFStringRef key, CFAllocatorRef allocator, IOOptionBits options) {
	if (entry >= SERIAL_SERVICE_BASE) {
		if (bad_path == entry) {
			return NULL;
		}
		char path[64];
		snprintf(path, sizeof(path), "/dev/cu.fixture-%u", entry - SERIAL_SERVICE_BASE);
		return string_property(path);
	}
	int device = entry - USB_DEVICE_BASE;
	if (CFEqual(key, CFSTR(kUSBVendorID))) {
		return number_property(0x1234 + device);
	}
	if (CFEqual(key, CFSTR(kUSBProductID))) {
		return number_property(0x5678 + device);
	}
	if (CFEqual(key, CFSTR(kUSBDeviceClass))) {
		return number_property(classes[device]);
	}
	if (CFEqual(key, CFSTR(kUSBVendorString))) {
		return string_property("Fixture vendor");
	}
	if (CFEqual(key, CFSTR(kUSBProductString))) {
		return string_property("Fixture product");
	}
	if (CFEqual(key, CFSTR(kUSBSerialNumberString))) {
		return string_property("Fixture serial");
	}
	return NULL;
}

static void reset_fixture(void) {
	device_count = 2;
	outer_position = acquired = released = cf_created = cf_released = invalid_releases = 0;
	memset(references, 0, sizeof(references));
	memset(serial_positions, 0, sizeof(serial_positions));
	memset(classes, 0, sizeof(classes));
	endpoints[0] = 2;
	endpoints[1] = 1;
	fail_matching = fail_services = 0;
	fail_descendants = bad_path = -1;
}

static void assert_released(void) {
	ASSERT_EQ_INT(0, invalid_releases);
	ASSERT_EQ_INT(acquired, released);
	ASSERT_EQ_INT(cf_created, cf_released);
	for (int i = 0; i < 256; i++) {
		ASSERT_EQ_INT(0, references[i]);
	}
}

static void all_endpoints_preserve_metadata_and_order(void) {
	reset_fixture();
	indigo_serial_info output[4] = { 0 };
	ASSERT_EQ_INT(3, indigo_enumerate_usbserial_devices(output, 4));
	ASSERT_EQ_INT(0x1234, output[0].vendor_id);
	ASSERT_EQ_INT(0x5678, output[1].product_id);
	ASSERT_EQ_INT(0x1235, output[2].vendor_id);
	ASSERT_STREQ("Fixture vendor", output[0].vendor_string);
	ASSERT_STREQ("Fixture product", output[1].product_string);
	ASSERT_STREQ("Fixture serial", output[2].serial_string);
	ASSERT_STREQ("/dev/cu.fixture-0", output[0].path);
	ASSERT_STREQ("/dev/cu.fixture-1", output[1].path);
	ASSERT_STREQ("/dev/cu.fixture-10", output[2].path);
	assert_released();
}

static void capacity_one_stops_before_another_endpoint(void) {
	reset_fixture();
	struct {
		indigo_serial_info output;
		unsigned char canary[32];
	} fixture;
	memset(&fixture, 0xa5, sizeof(fixture));
	ASSERT_EQ_INT(1, indigo_enumerate_usbserial_devices(&fixture.output, 1));
	ASSERT_STREQ("/dev/cu.fixture-0", fixture.output.path);
	for (int i = 0; i < sizeof(fixture.canary); i++) {
		ASSERT_EQ_INT(0xa5, fixture.canary[i]);
	}
	ASSERT_EQ_INT(1, outer_position);
	ASSERT_EQ_INT(1, serial_positions[0]);
	assert_released();
}

static void exact_capacity_does_not_acquire_next_usb_device(void) {
	reset_fixture();
	indigo_serial_info output[2] = { 0 };
	ASSERT_EQ_INT(2, indigo_enumerate_usbserial_devices(output, 2));
	ASSERT_EQ_INT(1, outer_position);
	ASSERT_EQ_INT(2, serial_positions[0]);
	assert_released();
}

static void nonpositive_capacity_does_not_acquire_resources(void) {
	for (int capacity = -1; capacity <= 0; capacity++) {
		reset_fixture();
		ASSERT_EQ_INT(0, indigo_enumerate_usbserial_devices(NULL, capacity));
		ASSERT_EQ_INT(0, acquired);
		ASSERT_EQ_INT(0, cf_created);
		assert_released();
	}
}

static void hubs_missing_paths_and_failed_iterators_release_resources(void) {
	for (int mode = 0; mode < 3; mode++) {
		reset_fixture();
		if (mode == 0) {
			classes[0] = 0x09;
		} else if (mode == 1) {
			fail_descendants = 0;
		} else {
			bad_path = SERIAL_SERVICE_BASE;
		}
		indigo_serial_info output[4] = { 0 };
		ASSERT_EQ_INT(mode == 2 ? 2 : 1, indigo_enumerate_usbserial_devices(output, 4));
		ASSERT_STREQ(mode == 2 ? "/dev/cu.fixture-1" : "/dev/cu.fixture-10", output[0].path);
		assert_released();
	}
}

static void discovery_setup_failures_have_no_owned_resources(void) {
	for (int mode = 0; mode < 2; mode++) {
		reset_fixture();
		fail_matching = mode == 0;
		fail_services = mode == 1;
		indigo_serial_info output;
		ASSERT_EQ_INT(-1, indigo_enumerate_usbserial_devices(&output, 1));
		assert_released();
	}
}

int main(void) {
	const indigo_test_case tests[] = {
		{ "all_endpoints_preserve_metadata_and_order", all_endpoints_preserve_metadata_and_order },
		{ "capacity_one_stops_before_another_endpoint", capacity_one_stops_before_another_endpoint },
		{ "exact_capacity_does_not_acquire_next_usb_device", exact_capacity_does_not_acquire_next_usb_device },
		{ "nonpositive_capacity_does_not_acquire_resources", nonpositive_capacity_does_not_acquire_resources },
		{ "hubs_missing_paths_and_failed_iterators_release_resources", hubs_missing_paths_and_failed_iterators_release_resources },
		{ "discovery_setup_failures_have_no_owned_resources", discovery_setup_failures_have_no_owned_resources }
	};
	return indigo_run_tests("macOS USB serial enumeration", tests, sizeof(tests) / sizeof(tests[0]));
}
