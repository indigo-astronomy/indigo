// Copyright (c) 2026 INDIGO initiative
// All rights reserved.
//
// You may use this software under the terms of 'INDIGO Astronomy
// open-source license' (see LICENSE.md).
//
// THIS SOFTWARE IS PROVIDED BY THE AUTHORS 'AS IS' AND ANY EXPRESS
// OR IMPLIED WARRANTIES, INCLUDING, BUT NOT LIMITED TO, THE IMPLIED
// WARRANTIES OF MERCHANTABILITY AND FITNESS FOR A PARTICULAR PURPOSE
// ARE DISCLAIMED. IN NO EVENT SHALL THE AUTHOR BE LIABLE FOR ANY
// DIRECT, INDIRECT, INCIDENTAL, SPECIAL, EXEMPLARY, OR CONSEQUENTIAL
// DAMAGES (INCLUDING, BUT NOT LIMITED TO, PROCUREMENT OF SUBSTITUTE
// GOODS OR SERVICES; LOSS OF USE, DATA, OR PROFITS; OR BUSINESS
// INTERRUPTION) HOWEVER CAUSED AND ON ANY THEORY OF LIABILITY,
// WHETHER IN CONTRACT, STRICT LIABILITY, OR TORT (INCLUDING
// NEGLIGENCE OR OTHERWISE) ARISING IN ANY WAY OUT OF THE USE OF THIS
// SOFTWARE, EVEN IF ADVISED OF THE POSSIBILITY OF SUCH DAMAGE.

// Code is generated by AI

// Cache lifetime and upload ownership regressions; no sockets or hardware.

#include <indigo/indigo_bus.h>
#include <pthread.h>
#include <stdatomic.h>
#include "../test_runner.h"

static indigo_property *make_property(indigo_property_perm perm) {
	indigo_property *property = indigo_init_blob_property(NULL, "Transport fixture", "X_UPLOAD", "Test", "Upload", INDIGO_OK_STATE, 1);
	property->perm = perm;
	indigo_init_blob_item(property->items, "ITEM", "Item");
	indigo_define_property(NULL, property, NULL);
	return property;
}

static void retired_upload_is_not_registered(void) {
	indigo_property *property = make_property(INDIGO_WO_PERM);
	indigo_item *address = property->items;
	ASSERT_TRUE(indigo_validate_blob(address) != NULL);
	indigo_release_property(property);
	ASSERT_TRUE(indigo_validate_blob(address) == NULL);
}

#ifndef INDIGO_TRANSPORT_BASELINE
static void retained_content_survives_property_release(void) {
	indigo_property *property = make_property(INDIGO_WO_PERM);
	indigo_blob_entry *entry = indigo_acquire_blob(property->items);
	ASSERT_TRUE(entry != NULL);
	void *buffer = indigo_allocate_blob_upload(4);
	ASSERT_TRUE(buffer != NULL);
	memcpy(buffer, "ABCD", 4);
	ASSERT_TRUE(indigo_publish_blob_upload(entry, buffer, 4));
	indigo_item *address = property->items;
	indigo_release_property(property);
	ASSERT_TRUE(indigo_acquire_blob(address) == NULL);
	indigo_item copy;
	ASSERT_TRUE(indigo_snapshot_blob(entry, &copy));
	ASSERT_EQ_INT(4, copy.blob.size);
	ASSERT_TRUE(memcmp(copy.blob.value, "ABCD", 4) == 0);
	free(copy.blob.value);
	buffer = indigo_allocate_blob_upload(1);
	ASSERT_TRUE(buffer != NULL);
	ASSERT_FALSE(indigo_publish_blob_upload(entry, buffer, 1));
	indigo_free_blob_upload(buffer, 1);
	indigo_release_blob(entry);
}

static void retirement_covers_changed_permissions(void) {
	for (int perm = INDIGO_RO_PERM; perm <= INDIGO_RW_PERM; perm++) {
		indigo_property *property = make_property(INDIGO_WO_PERM);
		indigo_item *address = property->items;
		indigo_blob_entry *entry = indigo_acquire_blob(address);
		ASSERT_TRUE(entry != NULL);
		property->perm = perm;
		indigo_release_property(property);
		ASSERT_TRUE(indigo_acquire_blob(address) == NULL);
		indigo_release_blob(entry);
	}
}

static void resize_preserves_live_entries_and_retires_removed_items(void) {
	indigo_property *property = make_property(INDIGO_WO_PERM);
	indigo_item *old_address = property->items;
	indigo_blob_entry *entry = indigo_acquire_blob(old_address);
	void *buffer = indigo_allocate_blob_upload(4);
	ASSERT_TRUE(buffer != NULL);
	memcpy(buffer, "move", 4);
	ASSERT_TRUE(indigo_publish_blob_upload(entry, buffer, 4));
	property = indigo_resize_property(property, 8);
	if (property->items != old_address) {
		ASSERT_TRUE(indigo_acquire_blob(old_address) == NULL);
	}
	indigo_blob_entry *moved = indigo_acquire_blob(property->items);
	ASSERT_TRUE(moved == entry);
	indigo_release_blob(moved);
	indigo_item copy;
	ASSERT_TRUE(indigo_snapshot_blob(entry, &copy));
	ASSERT_TRUE(copy.blob.size == 4 && memcmp(copy.blob.value, "move", 4) == 0);
	free(copy.blob.value);
	for (int i = 1; i < 8; i++) {
		char name[32];
		snprintf(name, sizeof(name), "ITEM%d", i);
		indigo_init_blob_item(property->items + i, name, "Item");
	}
	indigo_define_property(NULL, property, NULL);
	indigo_item *removed_address = property->items + 7;
	indigo_blob_entry *removed = indigo_acquire_blob(removed_address);
	ASSERT_TRUE(removed != NULL);
	property = indigo_resize_property(property, 1);
	ASSERT_TRUE(indigo_acquire_blob(removed_address) == NULL);
	ASSERT_TRUE(indigo_snapshot_blob(removed, &copy));
	free(copy.blob.value);
	indigo_release_blob(removed);
	indigo_release_property(property);
	indigo_release_blob(entry);
}

static void budgets_include_published_and_retired_buffers(void) {
	// Small compile-time limits keep this check bounded; production-limit builds skip allocations.
	ASSERT_TRUE(indigo_allocate_blob_upload((size_t)INDIGO_BLOB_UPLOAD_LIMIT + 1) == NULL);
	if (INDIGO_BLOB_UPLOAD_BUDGET > 65536) {
		return;
	}
	indigo_property *property = make_property(INDIGO_WO_PERM);
	indigo_blob_entry *entry = indigo_acquire_blob(property->items);
	void *buffers[32] = { 0 };
	size_t used = 0;
	int count = 0;
	while (used < INDIGO_BLOB_UPLOAD_BUDGET && count < 32) {
		size_t amount = INDIGO_BLOB_UPLOAD_BUDGET - used;
		if (amount > INDIGO_BLOB_UPLOAD_LIMIT) {
			amount = INDIGO_BLOB_UPLOAD_LIMIT;
		}
		buffers[count] = indigo_allocate_blob_upload(amount);
		ASSERT_TRUE(buffers[count] != NULL);
		used += amount;
		count++;
	}
	ASSERT_TRUE(indigo_allocate_blob_upload(1) == NULL);
	ASSERT_TRUE(indigo_publish_blob_upload(entry, buffers[0], INDIGO_BLOB_UPLOAD_LIMIT));
	indigo_release_property(property);
	ASSERT_TRUE(indigo_allocate_blob_upload(1) == NULL);
	indigo_release_blob(entry);
	void *available = indigo_allocate_blob_upload(INDIGO_BLOB_UPLOAD_LIMIT);
	ASSERT_TRUE(available != NULL);
	indigo_free_blob_upload(available, INDIGO_BLOB_UPLOAD_LIMIT);
	for (int i = 1; i < count; i++) {
		size_t amount = INDIGO_BLOB_UPLOAD_BUDGET - (size_t)i * INDIGO_BLOB_UPLOAD_LIMIT;
		if (amount > INDIGO_BLOB_UPLOAD_LIMIT) {
			amount = INDIGO_BLOB_UPLOAD_LIMIT;
		}
		indigo_free_blob_upload(buffers[i], amount);
	}
}

static void readonly_upload_preserves_snapshot(void) {
	indigo_property *property = make_property(INDIGO_RO_PERM);
	property->items[0].blob.value = "read-only";
	property->items[0].blob.size = 9;
	indigo_device fixture = { .name = "Transport fixture" };
	indigo_update_property(&fixture, property, NULL);
	indigo_blob_entry *entry = indigo_acquire_blob(property->items);
	ASSERT_TRUE(entry != NULL);
	ASSERT_FALSE(indigo_blob_upload_allowed(entry));
	void *buffer = indigo_allocate_blob_upload(4);
	ASSERT_TRUE(buffer != NULL);
	memcpy(buffer, "bad!", 4);
	ASSERT_FALSE(indigo_publish_blob_upload(entry, buffer, 4));
	indigo_free_blob_upload(buffer, 4);
	indigo_item copy = { 0 };
	ASSERT_FALSE(indigo_consume_blob_upload(entry, &copy, INDIGO_BLOB_UPLOAD_BUDGET));
	ASSERT_TRUE(indigo_snapshot_blob(entry, &copy));
	ASSERT_EQ_INT(9, copy.blob.size);
	ASSERT_TRUE(!memcmp(copy.blob.value, "read-only", 9));
	free(copy.blob.value);
	indigo_release_blob(entry);
	indigo_release_property(property);
}

static void permission_publication_revokes_staging(void) {
	indigo_device fixture = { .name = "Transport fixture" };
	indigo_client observer = { .name = "Permission observer" };
	for (int transition = 0; transition < 5; transition++) {
		indigo_property *property = make_property(INDIGO_WO_PERM);
		indigo_blob_entry *entry = indigo_acquire_blob(property->items);
		void *buffer = indigo_allocate_blob_upload(4);
		ASSERT_TRUE(buffer != NULL);
		memcpy(buffer, "once", 4);
		ASSERT_TRUE(indigo_publish_blob_upload(entry, buffer, 4));
		property->perm = INDIGO_RO_PERM;
		if (transition == 0) {
			indigo_define_property(&fixture, property, NULL);
		} else if (transition == 1) {
			indigo_define_property_to_client(&fixture, &observer, property, NULL);
		} else {
			property->state = transition == 2 ? INDIGO_BUSY_STATE : transition == 3 ? INDIGO_ALERT_STATE : INDIGO_IDLE_STATE;
			indigo_update_property(&fixture, property, NULL);
		}
		ASSERT_FALSE(indigo_blob_upload_allowed(entry));
		indigo_item copy = { 0 };
		ASSERT_FALSE(indigo_consume_blob_upload(entry, &copy, INDIGO_BLOB_UPLOAD_BUDGET));
		buffer = indigo_allocate_blob_upload(4);
		ASSERT_TRUE(buffer != NULL);
		ASSERT_FALSE(indigo_publish_blob_upload(entry, buffer, 4));
		indigo_free_blob_upload(buffer, 4);
		property->perm = INDIGO_WO_PERM;
		indigo_define_property(&fixture, property, NULL);
		ASSERT_TRUE(indigo_blob_upload_allowed(entry));
		ASSERT_FALSE(indigo_consume_blob_upload(entry, &copy, INDIGO_BLOB_UPLOAD_BUDGET));
		indigo_release_blob(entry);
		indigo_release_property(property);
	}
}

static void uploaded_staging_consumed_once(void) {
	indigo_property *property = make_property(INDIGO_WO_PERM);
	indigo_blob_entry *entry = indigo_acquire_blob(property->items);
	for (int size = 0; size <= 4; size += 4) {
		void *buffer = indigo_allocate_blob_upload(size);
		ASSERT_TRUE(buffer != NULL);
		memcpy(buffer, "once", size);
		ASSERT_TRUE(indigo_publish_blob_upload(entry, buffer, size));
		indigo_item copy = { 0 };
		ASSERT_TRUE(indigo_consume_blob_upload(entry, &copy, INDIGO_BLOB_UPLOAD_BUDGET));
		ASSERT_EQ_INT(size, copy.blob.size);
		ASSERT_TRUE(copy.blob.value != NULL && !memcmp(copy.blob.value, "once", size));
		free(copy.blob.value);
		memset(&copy, 0, sizeof(copy));
		ASSERT_FALSE(indigo_consume_blob_upload(entry, &copy, INDIGO_BLOB_UPLOAD_BUDGET));
		ASSERT_TRUE(copy.blob.value == NULL);
	}
	indigo_release_blob(entry);
	indigo_release_property(property);
}

static void empty_upload_and_replacement(void) {
	indigo_property *property = make_property(INDIGO_WO_PERM);
	indigo_blob_entry *entry = indigo_acquire_blob(property->items);
	void *buffer = indigo_allocate_blob_upload(0);
	ASSERT_TRUE(buffer != NULL);
	ASSERT_TRUE(indigo_publish_blob_upload(entry, buffer, 0));
	indigo_item copy;
	ASSERT_TRUE(indigo_snapshot_blob(entry, &copy));
	ASSERT_EQ_INT(0, copy.blob.size);
	ASSERT_TRUE(copy.blob.value == NULL);
	buffer = indigo_allocate_blob_upload(3);
	ASSERT_TRUE(buffer != NULL);
	memcpy(buffer, "new", 3);
	ASSERT_TRUE(indigo_publish_blob_upload(entry, buffer, 3));
	ASSERT_TRUE(indigo_snapshot_blob(entry, &copy));
	ASSERT_TRUE(memcmp(copy.blob.value, "new", 3) == 0);
	free(copy.blob.value);
	indigo_release_property(property);
	indigo_release_blob(entry);
}

static indigo_item *race_item;
static atomic_bool race_stop;
static atomic_bool race_started;
static atomic_int race_errors;

static void *read_retiring_entry(void *unused) {
	while (!atomic_load(&race_stop)) {
		indigo_blob_entry *entry = indigo_acquire_blob(race_item);
		if (entry) {
			indigo_item copy;
			if (!indigo_snapshot_blob(entry, &copy)) {
				atomic_fetch_add(&race_errors, 1);
			} else {
				if (copy.blob.size != 4 || memcmp(copy.blob.value, "race", 4)) {
					atomic_fetch_add(&race_errors, 1);
				}
				free(copy.blob.value);
			}
			indigo_release_blob(entry);
			atomic_store(&race_started, true);
		}
	}
	return NULL;
}

static void concurrent_retirement_and_lookup(void) {
	for (int iteration = 0; iteration < 50; iteration++) {
		indigo_property *property = make_property(INDIGO_WO_PERM);
		race_item = property->items;
		indigo_blob_entry *entry = indigo_acquire_blob(race_item);
		void *buffer = indigo_allocate_blob_upload(4);
		ASSERT_TRUE(buffer != NULL);
		memcpy(buffer, "race", 4);
		ASSERT_TRUE(indigo_publish_blob_upload(entry, buffer, 4));
		indigo_release_blob(entry);
		atomic_store(&race_stop, false);
		atomic_store(&race_started, false);
		atomic_store(&race_errors, 0);
		pthread_t thread;
		ASSERT_EQ_INT(0, pthread_create(&thread, NULL, read_retiring_entry, NULL));
		for (int wait = 0; wait < 1000 && !atomic_load(&race_started); wait++) {
			usleep(1000);
		}
		bool started = atomic_load(&race_started);
		indigo_release_property(property);
		atomic_store(&race_stop, true);
		pthread_join(thread, NULL);
		ASSERT_TRUE(started);
		ASSERT_EQ_INT(0, atomic_load(&race_errors));
	}
}

#ifdef INDIGO_TRANSPORT_ALLOC_FAILURE
static bool fail_allocation;

void *transport_test_malloc(size_t size) {
	if (fail_allocation) {
		fail_allocation = false;
		return NULL;
	}
	return malloc(size);
}

static void allocation_failure_restores_budget(void) {
	fail_allocation = true;
	ASSERT_TRUE(indigo_allocate_blob_upload(4) == NULL);
	budgets_include_published_and_retired_buffers();
}
#endif
#endif

int main(int argc, char **argv) {
	indigo_test_use_private_home();
	indigo_use_blob_caching = true;
	indigo_start();
	indigo_test_case tests[] = {
		{ "retired upload is unregistered", retired_upload_is_not_registered },
#ifndef INDIGO_TRANSPORT_BASELINE
		{ "retained bytes survive release", retained_content_survives_property_release },
		{ "all permission classes retire", retirement_covers_changed_permissions },
		{ "resize and shrink cache lifetime", resize_preserves_live_entries_and_retires_removed_items },
		{ "pending published retired budget", budgets_include_published_and_retired_buffers },
		{ "RO upload preserves snapshot", readonly_upload_preserves_snapshot },
		{ "permission publication revokes staging", permission_publication_revokes_staging },
		{ "uploaded staging consumed once", uploaded_staging_consumed_once },
		{ "empty upload and replacement", empty_upload_and_replacement },
		{ "concurrent retirement and lookup", concurrent_retirement_and_lookup },
#ifdef INDIGO_TRANSPORT_ALLOC_FAILURE
		{ "allocation failure releases budget", allocation_failure_restores_budget },
#endif
#endif
	};
	int result = indigo_run_tests("transport cache security", tests, sizeof(tests) / sizeof(tests[0]));
	indigo_stop();
	indigo_test_remove_private_home();
	return result;
}
