// Copyright (c) 2026 INDIGO initiative
// All rights reserved.
//
// You may use this software under the terms of 'INDIGO Astronomy
// open-source license' (see LICENSE.md).
//
// THIS SOFTWARE IS PROVIDED BY THE AUTHORS 'AS IS' AND ANY EXPRESS
// OR IMPLIED WARRANTIES, INCLUDING, BUT NOT LIMITED TO, THE IMPLIED
// WARRANTIES OF MERCHANTABILITY AND FITNESS FOR A PARTICULAR PURPOSE
// ARE DISCLAIMED. IN NO EVENT SHALL THE AUTHOR BE LIABLE FOR ANY
// DIRECT, INDIRECT, INCIDENTAL, SPECIAL, EXEMPLARY, OR CONSEQUENTIAL
// DAMAGES (INCLUDING, BUT NOT LIMITED TO, PROCUREMENT OF SUBSTITUTE
// GOODS OR SERVICES; LOSS OF USE, DATA, OR PROFITS; OR BUSINESS
// INTERRUPTION) HOWEVER CAUSED AND ON ANY THEORY OF LIABILITY,
// WHETHER IN CONTRACT, STRICT LIABILITY, OR TORT (INCLUDING
// NEGLIGENCE OR OTHERWISE) ARISING IN ANY WAY OUT OF THE USE OF THIS
// SOFTWARE, EVEN IF ADVISED OF THE POSSIBILITY OF SUCH DAMAGE.

// Code is generated by AI

#include <netdb.h>
#include <string.h>
#include <stdio.h>
#include <indigo/indigo_bus.h>
#include <indigo/indigo_io.h>
#include <indigo/indigo_uni_io.h>
#include "../test_runner.h"

static int resolutions;
static char resolved_host[4096];
static char resolved_port[32];
static int resolved_type;

int indigo_test_getaddrinfo(const char *host, const char *service, const struct addrinfo *hints, struct addrinfo **result) {
	resolutions++;
	snprintf(resolved_host, sizeof(resolved_host), "%s", host);
	snprintf(resolved_port, sizeof(resolved_port), "%s", service);
	resolved_type = hints->ai_socktype;
	*result = NULL;
	return EAI_NONAME;
}

static void check_url(const char *url, int default_port, const char *expected_host, const char *expected_port, bool udp) {
	for (int api = 0; api < 2; api++) {
		resolutions = 0;
		bool known_scheme = url != NULL && (!strncmp(url, "tcp://", 6) || !strncmp(url, "udp://", 6));
		bool hint_udp = known_scheme ? !udp : udp;
		if (api == 0) {
			indigo_network_protocol protocol = hint_udp ? INDIGO_PROTOCOL_UDP : INDIGO_PROTOCOL_TCP;
			ASSERT_EQ_INT(-1, indigo_open_network_device(url, default_port, &protocol));
		} else {
			ASSERT_TRUE(indigo_uni_open_url(url, default_port, hint_udp ? INDIGO_UDP_HANDLE : INDIGO_TCP_HANDLE, INDIGO_LOG_ERROR) == NULL);
		}
		ASSERT_EQ_INT(expected_host != NULL, resolutions);
		if (expected_host != NULL) {
			ASSERT_STREQ(expected_host, resolved_host);
			ASSERT_STREQ(expected_port, resolved_port);
			ASSERT_EQ_INT(udp ? SOCK_DGRAM : SOCK_STREAM, resolved_type);
		}
	}
}

static void hostname_boundaries(void) {
	const size_t lengths[] = { INDIGO_NAME_SIZE - 1, INDIGO_NAME_SIZE, INDIGO_NAME_SIZE + 1, 2048, 0 };
	for (size_t i = 0; i < sizeof(lengths) / sizeof(*lengths); i++) {
		char host[2049], url[2100];
		memset(host, 'a', lengths[i]);
		host[lengths[i]] = 0;
		for (int explicit_port = 1; explicit_port >= 0; explicit_port--) {
			snprintf(url, sizeof(url), "tcp://%s%s", host, explicit_port ? ":1234" : "");
			check_url(url, 1234, lengths[i] > 0 && lengths[i] < INDIGO_NAME_SIZE ? host : NULL, "1234", false);
		}
	}
}

static void rejects_malformed_authorities(void) {
	const char *invalid[] = { NULL, "", "localhost:1234", "://host:1234", "tcp://:1234", "1bad://host:1", "bad scheme://host:1", "tcp://host:", "tcp://host:0", "tcp://host:65536", "tcp://host:-1", "tcp://host:+1", "tcp://host: 1", "tcp://host:1 ", "tcp://host:1x", "tcp://host:99999999999999999999999999999999999", "tcp://host:1:2", "tcp://host/path:1", "tcp://user@host:1", "tcp://host?query:1", "tcp://host#fragment:1", "tcp://ho st:1", "tcp://ho\tst:1", "tcp://ho\nst:1", "tcp://[::1]:1" };
	for (size_t i = 0; i < sizeof(invalid) / sizeof(*invalid); i++) {
		check_url(invalid[i], 1234, NULL, NULL, false);
	}
	check_url("tcp://host", 0, NULL, NULL, false);
	check_url("tcp://host", 65536, NULL, NULL, false);
	ASSERT_EQ_INT(-1, indigo_open_network_device("tcp://host:1234", 1234, NULL));
}

static void preserves_protocol_and_ports(void) {
	check_url("tcp://localhost:1", 1234, "localhost", "1", false);
	check_url("udp://127.0.0.1:65535", 1234, "127.0.0.1", "65535", true);
	check_url("custom://device-name.local:00080", 1234, "device-name.local", "80", false);
	check_url("custom+v1.0-test://device_name", 1234, "device_name", "1234", true);
	check_url("tcp://localhost:1234", 0, "localhost", "1234", false);
	check_url("udp://localhost", 65535, "localhost", "65535", true);
}

int main(void) {
	indigo_test_case cases[] = {
		{ "hostname_boundaries", hostname_boundaries },
		{ "rejects_malformed_authorities", rejects_malformed_authorities },
		{ "preserves_protocol_and_ports", preserves_protocol_and_ports }
	};
	return indigo_run_tests("network_url", cases, sizeof(cases) / sizeof(*cases));
}
