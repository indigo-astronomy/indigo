// Copyright (c) 2026 INDIGO initiative
// All rights reserved.
//
// You may use this software under the terms of 'INDIGO Astronomy
// open-source license' (see LICENSE.md).
//
// THIS SOFTWARE IS PROVIDED BY THE AUTHORS 'AS IS' AND ANY EXPRESS
// OR IMPLIED WARRANTIES, INCLUDING, BUT NOT LIMITED TO, THE IMPLIED
// WARRANTIES OF MERCHANTABILITY AND FITNESS FOR A PARTICULAR PURPOSE
// ARE DISCLAIMED. IN NO EVENT SHALL THE AUTHOR BE LIABLE FOR ANY
// DIRECT, INDIRECT, INCIDENTAL, SPECIAL, EXEMPLARY, OR CONSEQUENTIAL
// DAMAGES (INCLUDING, BUT NOT LIMITED TO, PROCUREMENT OF SUBSTITUTE
// GOODS OR SERVICES; LOSS OF USE, DATA, OR PROFITS; OR BUSINESS
// INTERRUPTION) HOWEVER CAUSED AND ON ANY THEORY OF LIABILITY,
// WHETHER IN CONTRACT, STRICT LIABILITY, OR TORT (INCLUDING
// NEGLIGENCE OR OTHERWISE) ARISING IN ANY WAY OUT OF THE USE OF THIS
// SOFTWARE, EVEN IF ADVISED OF THE POSSIBILITY OF SUCH DAMAGE.

// Code is generated by AI

// Nights and night hook decisions of the Scheduler Agent at fixed dates and sites, and over synthetic nights,
// see indigo_drivers/agent_scheduler/doc/SCHEDULER.md "Night hooks".

#include <stdio.h>
#include <string.h>
#include <math.h>
#include <time.h>

#include <indigo/indigo_bus.h>

#include "indigo_drivers/agent_scheduler/indigo_agent_scheduler_night.h"
#include "../test_runner.h"

#define T_NOVEMBER_NIGHT	1794524400	// 2026-11-12 23:00 UTC
#define T_JUNE_NOON				1781956800	// 2026-06-20 12:00 UTC
#define T_DECEMBER_NOON		1797854400	// 2026-12-21 12:00 UTC

#define LATITUDE					48.15
#define LONGITUDE					17.11
#define ELEVATION					140

static scheduler_nights nights, other;

static void build(time_t now, double latitude, double limit, int start_offset, int end_offset) {
	indigo_scheduler_nights_build(&nights, now, latitude, LONGITUDE, ELEVATION, limit, start_offset, end_offset);
}

// -------------------------------------------------------------------------------- Night computation

static void test_ends_lie_on_the_limit(void) {
	double limits[] = { -6, -12, -18 };
	for (int l = 0; l < 3; l++) {
		build(T_NOVEMBER_NIGHT, LATITUDE, limits[l], 0, 0);
		ASSERT_TRUE(nights.valid);
		ASSERT_EQ_INT(3, nights.count);
		for (int i = 0; i < nights.count; i++) {
			scheduler_night *night = nights.nights + i;
			ASSERT_TRUE(night->start_known && night->end_known);
			ASSERT_NEAR(limits[l], indigo_scheduler_sun_altitude(night->start, LATITUDE, LONGITUDE, ELEVATION), 0.1);
			ASSERT_NEAR(limits[l], indigo_scheduler_sun_altitude(night->end, LATITUDE, LONGITUDE, ELEVATION), 0.1);
			ASSERT_TRUE(indigo_scheduler_sun_altitude(night->start - 600, LATITUDE, LONGITUDE, ELEVATION) > limits[l]);
			ASSERT_TRUE(indigo_scheduler_sun_altitude(night->start + 600, LATITUDE, LONGITUDE, ELEVATION) < limits[l]);
			ASSERT_TRUE(indigo_scheduler_sun_altitude(night->end + 600, LATITUDE, LONGITUDE, ELEVATION) > limits[l]);
		}
	}
	// the night around 23:00 in November lasts about 12 hours at the nautical limit
	build(T_NOVEMBER_NIGHT, LATITUDE, -12, 0, 0);
	const scheduler_night *night = indigo_scheduler_night_at(&nights, T_NOVEMBER_NIGHT);
	ASSERT_TRUE(night != NULL);
	ASSERT_TRUE(night->end - night->start > 11 * 3600 && night->end - night->start < 13 * 3600);
}

static void test_limits_nest(void) {
	build(T_NOVEMBER_NIGHT, LATITUDE, -6, 0, 0);
	scheduler_night civil = *indigo_scheduler_night_at(&nights, T_NOVEMBER_NIGHT);
	build(T_NOVEMBER_NIGHT, LATITUDE, -12, 0, 0);
	scheduler_night nautical = *indigo_scheduler_night_at(&nights, T_NOVEMBER_NIGHT);
	build(T_NOVEMBER_NIGHT, LATITUDE, -18, 0, 0);
	scheduler_night astronomical = *indigo_scheduler_night_at(&nights, T_NOVEMBER_NIGHT);
	// each degree takes several minutes at this latitude
	ASSERT_TRUE(civil.start + 20 * 60 < nautical.start && nautical.start + 20 * 60 < astronomical.start);
	ASSERT_TRUE(astronomical.end + 20 * 60 < nautical.end && nautical.end + 20 * 60 < civil.end);
}

static void test_offsets_move_the_ends(void) {
	build(T_NOVEMBER_NIGHT, LATITUDE, -12, 0, 0);
	scheduler_night plain = *indigo_scheduler_night_at(&nights, T_NOVEMBER_NIGHT);
	build(T_NOVEMBER_NIGHT, LATITUDE, -12, -30, 45);
	scheduler_night moved = *indigo_scheduler_night_at(&nights, T_NOVEMBER_NIGHT);
	ASSERT_EQ_INT((int)(plain.start - 30 * 60), (int)moved.start);
	ASSERT_EQ_INT((int)(plain.end + 45 * 60), (int)moved.end);
	build(T_NOVEMBER_NIGHT, LATITUDE, -12, 60, -90);
	moved = *indigo_scheduler_night_at(&nights, T_NOVEMBER_NIGHT);
	ASSERT_EQ_INT((int)(plain.start + 60 * 60), (int)moved.start);
	ASSERT_EQ_INT((int)(plain.end - 90 * 60), (int)moved.end);
	// offsets are limited to 240 minutes
	build(T_NOVEMBER_NIGHT, LATITUDE, -12, -1000, 1000);
	ASSERT_EQ_INT(-SCHEDULER_NIGHT_OFFSET_LIMIT, nights.start_offset);
	ASSERT_EQ_INT(SCHEDULER_NIGHT_OFFSET_LIMIT, nights.end_offset);
	moved = *indigo_scheduler_night_at(&nights, T_NOVEMBER_NIGHT);
	ASSERT_EQ_INT((int)(plain.start - 240 * 60), (int)moved.start);
	ASSERT_EQ_INT((int)(plain.end + 240 * 60), (int)moved.end);
}

static void test_offsets_leave_no_time(void) {
	// a June night at the nautical limit lasts about 4.6 hours; 2 hours from both ends leave 0.6 hours
	build(T_JUNE_NOON, LATITUDE, -12, 0, 0);
	const scheduler_night *night = indigo_scheduler_night_next(&nights, T_JUNE_NOON);
	ASSERT_TRUE(night != NULL && night->end - night->start > 4 * 3600 && night->end - night->start < 5 * 3600);
	build(T_JUNE_NOON, LATITUDE, -12, 120, -120);
	night = indigo_scheduler_night_next(&nights, T_JUNE_NOON);
	ASSERT_TRUE(night != NULL && night->end - night->start < 3600);
	// the astronomical night is shorter than the offsets take away
	build(T_JUNE_NOON, LATITUDE, -18, 60, -60);
	ASSERT_EQ_INT(0, nights.count);
	ASSERT_TRUE(indigo_scheduler_night_next(&nights, T_JUNE_NOON) == NULL);
}

static void test_offsets_merge_nights(void) {
	// a December day above the civil limit at 62 degrees is shorter than 8 hours, so offsets of 4 hours join the nights
	indigo_scheduler_nights_build(&nights, T_DECEMBER_NOON, 62, LONGITUDE, 0, -6, 0, 0);
	ASSERT_TRUE(nights.count >= 3);
	indigo_scheduler_nights_build(&nights, T_DECEMBER_NOON, 62, LONGITUDE, 0, -6, -240, 240);
	ASSERT_EQ_INT(1, nights.count);
	ASSERT_TRUE(indigo_scheduler_night_at(&nights, T_DECEMBER_NOON) != NULL);
	ASSERT_FALSE(nights.nights[0].end_known);
}

static void test_no_night_and_polar_night(void) {
	// no astronomical night in June at 60 degrees, no nautical night at 85 degrees
	indigo_scheduler_nights_build(&nights, T_JUNE_NOON, 60, LONGITUDE, 0, -18, 0, 0);
	ASSERT_EQ_INT(0, nights.count);
	indigo_scheduler_nights_build(&nights, T_JUNE_NOON, 85, LONGITUDE, 0, -12, 0, 0);
	ASSERT_EQ_INT(0, nights.count);
	// the polar night has no known ends
	indigo_scheduler_nights_build(&nights, T_NOVEMBER_NIGHT, 85, LONGITUDE, 0, -12, 0, 0);
	ASSERT_EQ_INT(1, nights.count);
	ASSERT_FALSE(nights.nights[0].start_known);
	ASSERT_FALSE(nights.nights[0].end_known);
	ASSERT_TRUE(indigo_scheduler_night_at(&nights, T_NOVEMBER_NIGHT) != NULL);
}

static void test_lookup(void) {
	build(T_NOVEMBER_NIGHT, LATITUDE, -12, 0, 0);
	const scheduler_night *night = indigo_scheduler_night_at(&nights, T_NOVEMBER_NIGHT);
	ASSERT_TRUE(night != NULL);
	ASSERT_TRUE(indigo_scheduler_night_at(&nights, night->start) == night);
	ASSERT_TRUE(indigo_scheduler_night_at(&nights, night->end) == NULL);
	ASSERT_TRUE(indigo_scheduler_night_at(&nights, night->start - 1) == NULL);
	ASSERT_TRUE(indigo_scheduler_night_next(&nights, night->start - 3600) == night);
	ASSERT_TRUE(indigo_scheduler_night_next(&nights, night->end) == night + 1);
	ASSERT_TRUE(indigo_scheduler_night_at(NULL, T_NOVEMBER_NIGHT) == NULL);
	scheduler_nights invalid = { 0 };
	ASSERT_TRUE(indigo_scheduler_night_at(&invalid, T_NOVEMBER_NIGHT) == NULL);
	ASSERT_TRUE(indigo_scheduler_night_next(&invalid, T_NOVEMBER_NIGHT) == NULL);
}

// -------------------------------------------------------------------------------- Night hook decisions over synthetic nights

// three nights: 1000-2000, 3000-4000 and 5000-6000
static void synthetic(scheduler_nights *target) {
	memset(target, 0, sizeof(*target));
	target->valid = true;
	target->count = 3;
	for (int i = 0; i < 3; i++) {
		target->nights[i].start = 1000 + 2000 * i;
		target->nights[i].end = 2000 + 2000 * i;
		target->nights[i].start_known = target->nights[i].end_known = true;
	}
}

static scheduler_night_action decide(scheduler_night_state *state, time_t now, bool has_work) {
	return indigo_scheduler_night_decide(state, &nights, now, has_work);
}

static void test_once_per_night_over_three_nights(void) {
	synthetic(&nights);
	scheduler_night_state state;
	indigo_scheduler_night_reset(&state);
	char sequence[64] = "";
	for (time_t t = 0; t <= 7000; t += 50) {
		scheduler_night_action action;
		while ((action = decide(&state, t, true)) != SCHEDULER_NIGHT_NONE) {
			strcat(sequence, action == SCHEDULER_NIGHT_START ? "S" : action == SCHEDULER_NIGHT_END ? "E" : "K");
			ASSERT_TRUE(strlen(sequence) < 20);
			if (action == SCHEDULER_NIGHT_START) {
				ASSERT_TRUE(t >= 1000 && (t - 1000) % 2000 < 50);
			} else if (action == SCHEDULER_NIGHT_END) {
				ASSERT_TRUE(t >= 2000 && t % 2000 < 50);
			}
		}
	}
	ASSERT_STREQ("SESESE", sequence);
}

static void test_start_during_night_and_day(void) {
	synthetic(&nights);
	scheduler_night_state state;
	// START in the night: the night start is handled at once
	indigo_scheduler_night_reset(&state);
	ASSERT_EQ_INT(SCHEDULER_NIGHT_START, decide(&state, 1500, true));
	ASSERT_EQ_INT(SCHEDULER_NIGHT_NONE, decide(&state, 1600, true));
	ASSERT_EQ_INT(SCHEDULER_NIGHT_END, decide(&state, 2000, true));
	// STOP and START within one night: START resets the state, the night start runs again
	indigo_scheduler_night_reset(&state);
	ASSERT_EQ_INT(SCHEDULER_NIGHT_START, decide(&state, 3100, true));
	indigo_scheduler_night_reset(&state);
	ASSERT_EQ_INT(SCHEDULER_NIGHT_START, decide(&state, 3200, true));
	// START in the day: nothing until the night starts, and no end of the night before
	indigo_scheduler_night_reset(&state);
	ASSERT_EQ_INT(SCHEDULER_NIGHT_NONE, decide(&state, 2500, true));
	ASSERT_EQ_INT(SCHEDULER_NIGHT_NONE, decide(&state, 2999, true));
	ASSERT_EQ_INT(SCHEDULER_NIGHT_START, decide(&state, 3000, true));
}

static void test_boundaries_passing_during_a_task(void) {
	synthetic(&nights);
	scheduler_night_state state;
	indigo_scheduler_night_reset(&state);
	// a task runs from 900 to 1500: the night start is handled when it ends
	ASSERT_EQ_INT(SCHEDULER_NIGHT_NONE, decide(&state, 900, true));
	ASSERT_EQ_INT(SCHEDULER_NIGHT_START, decide(&state, 1500, true));
	// a task runs from 1500 to 2300: the night end is handled when it ends
	ASSERT_EQ_INT(SCHEDULER_NIGHT_END, decide(&state, 2300, true));
	ASSERT_EQ_INT(SCHEDULER_NIGHT_NONE, decide(&state, 2300, true));
	// a task runs from 3500 in the second night until 5500 in the third: both hooks, the end first
	ASSERT_EQ_INT(SCHEDULER_NIGHT_START, decide(&state, 3500, true));
	ASSERT_EQ_INT(SCHEDULER_NIGHT_END, decide(&state, 5500, true));
	ASSERT_EQ_INT(SCHEDULER_NIGHT_START, decide(&state, 5500, true));
	ASSERT_EQ_INT(SCHEDULER_NIGHT_NONE, decide(&state, 5500, true));
	// a task that covers a whole night: that night is neither started nor ended
	indigo_scheduler_night_reset(&state);
	ASSERT_EQ_INT(SCHEDULER_NIGHT_NONE, decide(&state, 900, true));
	ASSERT_EQ_INT(SCHEDULER_NIGHT_NONE, decide(&state, 2100, true));
}

static void test_night_without_work(void) {
	synthetic(&nights);
	scheduler_night_state state;
	indigo_scheduler_night_reset(&state);
	ASSERT_EQ_INT(SCHEDULER_NIGHT_SKIP, decide(&state, 1000, false));
	// told once
	ASSERT_EQ_INT(SCHEDULER_NIGHT_NONE, decide(&state, 1100, false));
	// no end hook for a night without a start hook
	ASSERT_EQ_INT(SCHEDULER_NIGHT_NONE, decide(&state, 2000, false));
	// the next night has work: it starts and ends as usual
	ASSERT_EQ_INT(SCHEDULER_NIGHT_START, decide(&state, 3000, true));
	ASSERT_EQ_INT(SCHEDULER_NIGHT_END, decide(&state, 4000, false));
}

static void test_work_appears_late(void) {
	synthetic(&nights);
	scheduler_night_state state;
	indigo_scheduler_night_reset(&state);
	ASSERT_EQ_INT(SCHEDULER_NIGHT_SKIP, decide(&state, 1000, false));
	ASSERT_EQ_INT(SCHEDULER_NIGHT_NONE, decide(&state, 1300, false));
	// an upload, a reset, an urgent task or a constraint that clears
	ASSERT_EQ_INT(SCHEDULER_NIGHT_START, decide(&state, 1400, true));
	ASSERT_EQ_INT(SCHEDULER_NIGHT_NONE, decide(&state, 1500, false));
	ASSERT_EQ_INT(SCHEDULER_NIGHT_END, decide(&state, 2000, false));
}

static void test_night_loses_its_work(void) {
	synthetic(&nights);
	scheduler_night_state state;
	indigo_scheduler_night_reset(&state);
	ASSERT_EQ_INT(SCHEDULER_NIGHT_START, decide(&state, 1000, true));
	// the tasks were deleted or failed: the night still ends with its end hook
	ASSERT_EQ_INT(SCHEDULER_NIGHT_NONE, decide(&state, 1500, false));
	ASSERT_EQ_INT(SCHEDULER_NIGHT_END, decide(&state, 2000, false));
}

static void test_recomputed_and_moved_nights(void) {
	synthetic(&nights);
	scheduler_night_state state;
	indigo_scheduler_night_reset(&state);
	ASSERT_EQ_INT(SCHEDULER_NIGHT_START, decide(&state, 1200, true));
	// the hourly computation moves the ends by a few seconds: still the same night
	nights.nights[0].start = 1010;
	nights.nights[0].end = 1990;
	ASSERT_EQ_INT(SCHEDULER_NIGHT_NONE, decide(&state, 1300, true));
	ASSERT_EQ_INT(1990, (int)state.night.end);
	// a new site ends the night earlier
	nights.nights[0].end = 1400;
	ASSERT_EQ_INT(SCHEDULER_NIGHT_END, decide(&state, 1500, true));
	// a new site where it is another night: the old one ends, the new one starts
	synthetic(&nights);
	indigo_scheduler_night_reset(&state);
	ASSERT_EQ_INT(SCHEDULER_NIGHT_START, decide(&state, 1200, true));
	synthetic(&other);
	other.nights[0].start = 1600;
	other.nights[0].end = 2600;
	ASSERT_EQ_INT(SCHEDULER_NIGHT_NONE, indigo_scheduler_night_decide(&state, &other, 1700, true));
	nights = other;
	nights.nights[0].start = 1650;
	nights.nights[0].end = 2650;
	state.night.start = 1000;
	state.night.end = 1500;
	ASSERT_EQ_INT(SCHEDULER_NIGHT_END, decide(&state, 1700, true));
	ASSERT_EQ_INT(SCHEDULER_NIGHT_START, decide(&state, 1700, true));
}

static void test_endless_and_missing_nights(void) {
	scheduler_night_state state;
	indigo_scheduler_night_reset(&state);
	// the polar night starts once and does not end
	memset(&nights, 0, sizeof(nights));
	nights.valid = true;
	nights.count = 1;
	nights.nights[0].start = 0;
	nights.nights[0].end = 100000;
	char sequence[16] = "";
	for (time_t t = 100; t < 100000; t += 1000) {
		scheduler_night_action action = decide(&state, t, true);
		if (action != SCHEDULER_NIGHT_NONE) {
			strcat(sequence, action == SCHEDULER_NIGHT_START ? "S" : "E");
		}
		// the span moves with every computation
		nights.nights[0].start = t - 50000;
		nights.nights[0].end = t + 50000;
	}
	ASSERT_STREQ("S", sequence);
	// no night at all
	indigo_scheduler_night_reset(&state);
	memset(&nights, 0, sizeof(nights));
	nights.valid = true;
	for (time_t t = 0; t < 100000; t += 1000) {
		ASSERT_EQ_INT(SCHEDULER_NIGHT_NONE, decide(&state, t, true));
	}
}

static void test_real_nights_over_three_days(void) {
	// the night start and end once per night at a real site, with hourly recomputation
	scheduler_night_state state;
	indigo_scheduler_night_reset(&state);
	time_t from = T_NOVEMBER_NIGHT - 12 * 3600;
	char sequence[32] = "";
	for (time_t t = from; t < from + 3 * 86400; t += 300) {
		if ((t - from) % 3600 == 0) {
			build(t, LATITUDE, -12, -30, 0);
		}
		scheduler_night_action action;
		while ((action = decide(&state, t, true)) != SCHEDULER_NIGHT_NONE) {
			strcat(sequence, action == SCHEDULER_NIGHT_START ? "S" : action == SCHEDULER_NIGHT_END ? "E" : "K");
			ASSERT_TRUE(strlen(sequence) < 20);
			double altitude = indigo_scheduler_sun_altitude(action == SCHEDULER_NIGHT_START ? t + 30 * 60 : t, LATITUDE, LONGITUDE, ELEVATION);
			// decisions every five minutes: the Sun is at most about a degree past the limit
			ASSERT_NEAR(-12, altitude, 1.5);
		}
	}
	ASSERT_STREQ("SESESE", sequence);
}

int main(void) {
	indigo_test_case cases[] = {
		{ "ends_lie_on_the_limit", test_ends_lie_on_the_limit },
		{ "limits_nest", test_limits_nest },
		{ "offsets_move_the_ends", test_offsets_move_the_ends },
		{ "offsets_leave_no_time", test_offsets_leave_no_time },
		{ "offsets_merge_nights", test_offsets_merge_nights },
		{ "no_night_and_polar_night", test_no_night_and_polar_night },
		{ "lookup", test_lookup },
		{ "once_per_night_over_three_nights", test_once_per_night_over_three_nights },
		{ "start_during_night_and_day", test_start_during_night_and_day },
		{ "boundaries_passing_during_a_task", test_boundaries_passing_during_a_task },
		{ "night_without_work", test_night_without_work },
		{ "work_appears_late", test_work_appears_late },
		{ "night_loses_its_work", test_night_loses_its_work },
		{ "recomputed_and_moved_nights", test_recomputed_and_moved_nights },
		{ "endless_and_missing_nights", test_endless_and_missing_nights },
		{ "real_nights_over_three_days", test_real_nights_over_three_days },
	};
	return indigo_run_tests("test_agent_scheduler_night", cases, sizeof(cases) / sizeof(cases[0]));
}
