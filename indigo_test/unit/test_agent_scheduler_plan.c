// Copyright (c) 2026 INDIGO initiative
// All rights reserved.
//
// You may use this software under the terms of 'INDIGO Astronomy
// open-source license' (see LICENSE.md).
//
// THIS SOFTWARE IS PROVIDED BY THE AUTHORS 'AS IS' AND ANY EXPRESS
// OR IMPLIED WARRANTIES, INCLUDING, BUT NOT LIMITED TO, THE IMPLIED
// WARRANTIES OF MERCHANTABILITY AND FITNESS FOR A PARTICULAR PURPOSE
// ARE DISCLAIMED. IN NO EVENT SHALL THE AUTHOR BE LIABLE FOR ANY
// DIRECT, INDIRECT, INCIDENTAL, SPECIAL, EXEMPLARY, OR CONSEQUENTIAL
// DAMAGES (INCLUDING, BUT NOT LIMITED TO, PROCUREMENT OF SUBSTITUTE
// GOODS OR SERVICES; LOSS OF USE, DATA, OR PROFITS; OR BUSINESS
// INTERRUPTION) HOWEVER CAUSED AND ON ANY THEORY OF LIABILITY,
// WHETHER IN CONTRACT, STRICT LIABILITY, OR TORT (INCLUDING
// NEGLIGENCE OR OTHERWISE) ARISING IN ANY WAY OUT OF THE USE OF THIS
// SOFTWARE, EVEN IF ADVISED OF THE POSSIBILITY OF SUCH DAMAGE.

// Code is generated by AI

// Task score and night plan simulation of the Scheduler Agent,
// see indigo_docs/SCHEDULER.md "Night plan".

#include <stdio.h>
#include <string.h>
#include <time.h>
#include <stdint.h>

#include <indigo/indigo_bus.h>

#include "indigo_drivers/agent_scheduler/indigo_agent_scheduler_plan.h"
#include "../test_runner.h"

#define T_NOVEMBER_NOON		1794484800	// 2026-11-12 12:00 UTC

#define LATITUDE			48.15
#define LONGITUDE			17.11

#define MAX_TASKS			128

static scheduler_sky_grid sky;
static scheduler_header headers[MAX_TASKS];
static scheduler_target_grid targets[MAX_TASKS];
static scheduler_task_points points[MAX_TASKS];
static scheduler_plan_task tasks[MAX_TASKS];
static scheduler_plan_run runs[512];

static void add_task(int i, const char *name, scheduler_priority_class priority_class, int level, int minutes) {
	scheduler_header *header = &headers[i];
	memset(header, 0, sizeof(*header));
	snprintf(header->name, sizeof(header->name), "%s", name);
	header->priority_class = priority_class;
	header->level = level;
	header->repeat = 1;
	header->enabled = true;
	header->twilight = SCHEDULER_TWILIGHT_ASTRONOMICAL;
	memset(&tasks[i], 0, sizeof(tasks[i]));
	tasks[i].header = header;
	tasks[i].target = &targets[i];
	tasks[i].points = &points[i];
	tasks[i].selectable = true;
	tasks[i].duration = minutes * 60;
	tasks[i].runs_left = 1;
}

// the tables are built after the header is complete
static void build_task(int i) {
	memset(&targets[i], 0, sizeof(targets[i]));
	if (headers[i].has_target) {
		indigo_scheduler_target_build(&sky, &headers[i], &targets[i]);
	}
	indigo_scheduler_points_build(&sky, &targets[i], &headers[i], &points[i]);
}

static int plan(int count, time_t now) {
	for (int i = 0; i < count; i++) {
		build_task(i);
	}
	return indigo_scheduler_plan(&sky, tasks, count, now, indigo_scheduler_night_end(&sky, now), 0, 0, runs, 512);
}

// the first time after now the astronomical twilight condition holds
static time_t dark_from(time_t now) {
	scheduler_header header;
	memset(&header, 0, sizeof(header));
	header.twilight = SCHEDULER_TWILIGHT_ASTRONOMICAL;
	header.repeat = 1;
	scheduler_target_grid none;
	memset(&none, 0, sizeof(none));
	scheduler_task_points dark;
	indigo_scheduler_points_build(&sky, &none, &header, &dark);
	return indigo_scheduler_points_next(&sky, &dark, &header, now, 60, 0, NULL);
}

static void test_score(void) {
	indigo_scheduler_sky_build(&sky, T_NOVEMBER_NOON, LATITUDE, LONGITUDE, 140);
	add_task(0, "low", SCHEDULER_PRIORITY_LOW, 100, 60);
	add_task(1, "normal", SCHEDULER_PRIORITY_NORMAL, 0, 60);
	add_task(2, "high", SCHEDULER_PRIORITY_HIGH, 10, 60);
	for (int i = 0; i < 3; i++) {
		build_task(i);
	}
	time_t t = dark_from(T_NOVEMBER_NOON);
	double low = indigo_scheduler_score(&sky, &targets[0], &points[0], &headers[0], t, 0, 0);
	double normal = indigo_scheduler_score(&sky, &targets[1], &points[1], &headers[1], t, 0, 0);
	double high = indigo_scheduler_score(&sky, &targets[2], &points[2], &headers[2], t, 0, 0);
	ASSERT_TRUE(low < normal && normal < high);
	ASSERT_TRUE(low == 100 && normal == 1000 && high == 2010);
}

static void test_order_and_times(void) {
	indigo_scheduler_sky_build(&sky, T_NOVEMBER_NOON, LATITUDE, LONGITUDE, 140);
	add_task(0, "first", SCHEDULER_PRIORITY_NORMAL, 10, 60);
	add_task(1, "second", SCHEDULER_PRIORITY_NORMAL, 90, 30);
	add_task(2, "third", SCHEDULER_PRIORITY_HIGH, 0, 45);
	int count = plan(3, T_NOVEMBER_NOON);
	ASSERT_EQ_INT(3, count);
	time_t dark = dark_from(T_NOVEMBER_NOON);
	ASSERT_EQ_INT(2, runs[0].task);
	ASSERT_EQ_INT(1, runs[1].task);
	ASSERT_EQ_INT(0, runs[2].task);
	ASSERT_EQ_INT((int)dark, (int)runs[0].start);
	ASSERT_EQ_INT((int)(dark + 45 * 60), (int)runs[1].start);
	ASSERT_EQ_INT((int)(dark + 75 * 60), (int)runs[2].start);
	ASSERT_EQ_INT((int)(dark + 135 * 60), (int)runs[2].end);
	ASSERT_FALSE(runs[0].running);
}

static void test_ties_to_earlier_task(void) {
	indigo_scheduler_sky_build(&sky, T_NOVEMBER_NOON, LATITUDE, LONGITUDE, 140);
	add_task(0, "a", SCHEDULER_PRIORITY_NORMAL, 50, 30);
	add_task(1, "b", SCHEDULER_PRIORITY_NORMAL, 50, 30);
	ASSERT_EQ_INT(2, plan(2, T_NOVEMBER_NOON));
	ASSERT_EQ_INT(0, runs[0].task);
	ASSERT_EQ_INT(1, runs[1].task);
}

static void test_urgent_first(void) {
	indigo_scheduler_sky_build(&sky, T_NOVEMBER_NOON, LATITUDE, LONGITUDE, 140);
	add_task(0, "high", SCHEDULER_PRIORITY_HIGH, 100, 30);
	add_task(1, "urgent late", SCHEDULER_PRIORITY_URGENT, 0, 30);
	add_task(2, "urgent early", SCHEDULER_PRIORITY_URGENT, 0, 30);
	tasks[1].urgent_order = 7;
	tasks[2].urgent_order = 3;
	ASSERT_EQ_INT(3, plan(3, T_NOVEMBER_NOON));
	ASSERT_EQ_INT(2, runs[0].task);
	ASSERT_EQ_INT(1, runs[1].task);
	ASSERT_EQ_INT(0, runs[2].task);
}

static void test_running_task_first(void) {
	indigo_scheduler_sky_build(&sky, T_NOVEMBER_NOON, LATITUDE, LONGITUDE, 140);
	time_t now = dark_from(T_NOVEMBER_NOON) + 3600;
	add_task(0, "waiting", SCHEDULER_PRIORITY_HIGH, 100, 30);
	add_task(1, "running", SCHEDULER_PRIORITY_LOW, 0, 60);
	tasks[1].running = true;
	tasks[1].running_start = now - 40 * 60;
	tasks[1].running_end = now + 20 * 60;
	ASSERT_EQ_INT(2, plan(2, now));
	ASSERT_EQ_INT(1, runs[0].task);
	ASSERT_TRUE(runs[0].running);
	ASSERT_EQ_INT((int)(now - 40 * 60), (int)runs[0].start);
	ASSERT_EQ_INT((int)(now + 20 * 60), (int)runs[0].end);
	ASSERT_EQ_INT(0, runs[1].task);
	ASSERT_EQ_INT((int)(now + 20 * 60), (int)runs[1].start);
}

// an overrunning task keeps its real start, the agent moves only its end
static void test_running_task_overrun(void) {
	indigo_scheduler_sky_build(&sky, T_NOVEMBER_NOON, LATITUDE, LONGITUDE, 140);
	time_t now = dark_from(T_NOVEMBER_NOON) + 3600;
	add_task(0, "running", SCHEDULER_PRIORITY_NORMAL, 50, 30);
	headers[0].repeat = 2;
	headers[0].repeat_every = 10;
	tasks[0].runs_left = 2;
	tasks[0].running = true;
	tasks[0].running_start = now - 45 * 60;
	tasks[0].running_end = now + 60;
	ASSERT_EQ_INT(2, plan(1, now));
	ASSERT_TRUE(runs[0].running);
	ASSERT_EQ_INT(1, runs[0].run);
	ASSERT_EQ_INT((int)(now - 45 * 60), (int)runs[0].start);
	ASSERT_EQ_INT((int)(now + 60), (int)runs[0].end);
	// the repeat follows after its interval
	ASSERT_FALSE(runs[1].running);
	ASSERT_EQ_INT(2, runs[1].run);
	ASSERT_EQ_INT((int)(now + 60 + 10 * 60), (int)runs[1].start);
}

// a task waiting for its retry delay starts when the delay ends
static void test_initial_delay(void) {
	indigo_scheduler_sky_build(&sky, T_NOVEMBER_NOON, LATITUDE, LONGITUDE, 140);
	time_t now = dark_from(T_NOVEMBER_NOON) + 3600;
	add_task(0, "retry", SCHEDULER_PRIORITY_HIGH, 50, 30);
	tasks[0].available_from = now + 15 * 60;
	add_task(1, "filler", SCHEDULER_PRIORITY_LOW, 0, 10);
	ASSERT_EQ_INT(2, plan(2, now));
	ASSERT_EQ_INT(1, runs[0].task);
	ASSERT_EQ_INT((int)now, (int)runs[0].start);
	ASSERT_EQ_INT(0, runs[1].task);
	ASSERT_EQ_INT((int)(now + 15 * 60), (int)runs[1].start);
}

// as in the scheduler, an urgent task queued again for its next run waits behind the urgent tasks already queued
static void test_urgent_repeat_queues_behind(void) {
	indigo_scheduler_sky_build(&sky, T_NOVEMBER_NOON, LATITUDE, LONGITUDE, 140);
	add_task(0, "a", SCHEDULER_PRIORITY_URGENT, 0, 10);
	headers[0].repeat = 2;
	tasks[0].runs_left = 2;
	tasks[0].urgent_order = 1;
	add_task(1, "b", SCHEDULER_PRIORITY_URGENT, 0, 10);
	tasks[1].urgent_order = 2;
	add_task(2, "c", SCHEDULER_PRIORITY_URGENT, 0, 10);
	tasks[2].urgent_order = 3;
	tasks[2].available_from = T_NOVEMBER_NOON + 60;
	ASSERT_EQ_INT(4, plan(3, T_NOVEMBER_NOON));
	ASSERT_EQ_INT(0, runs[0].task);
	ASSERT_EQ_INT(1, runs[1].task);
	// c was delayed before a finished its first run, so it was queued first
	ASSERT_EQ_INT(2, runs[2].task);
	ASSERT_EQ_INT(0, runs[3].task);
	ASSERT_EQ_INT(2, runs[3].run);
}

static void test_repeats(void) {
	indigo_scheduler_sky_build(&sky, T_NOVEMBER_NOON, LATITUDE, LONGITUDE, 140);
	add_task(0, "repeated", SCHEDULER_PRIORITY_NORMAL, 50, 30);
	headers[0].repeat = 3;
	headers[0].repeat_every = 60;
	tasks[0].runs_left = 3;
	add_task(1, "filler", SCHEDULER_PRIORITY_LOW, 0, 20);
	ASSERT_EQ_INT(4, plan(2, T_NOVEMBER_NOON));
	time_t dark = dark_from(T_NOVEMBER_NOON);
	ASSERT_EQ_INT(0, runs[0].task);
	ASSERT_EQ_INT(1, runs[0].run);
	ASSERT_EQ_INT((int)dark, (int)runs[0].start);
	// the filler takes the gap, the next run waits for its repeat delay
	ASSERT_EQ_INT(1, runs[1].task);
	ASSERT_EQ_INT((int)(dark + 30 * 60), (int)runs[1].start);
	ASSERT_EQ_INT(0, runs[2].task);
	ASSERT_EQ_INT(2, runs[2].run);
	ASSERT_EQ_INT((int)(dark + 90 * 60), (int)runs[2].start);
	ASSERT_EQ_INT(3, runs[3].run);
	ASSERT_EQ_INT((int)(dark + 180 * 60), (int)runs[3].start);
}

static void test_unschedulable_tasks(void) {
	indigo_scheduler_sky_build(&sky, T_NOVEMBER_NOON, LATITUDE, LONGITUDE, 140);
	add_task(0, "disabled", SCHEDULER_PRIORITY_HIGH, 100, 30);
	tasks[0].selectable = false;
	add_task(1, "done", SCHEDULER_PRIORITY_HIGH, 100, 30);
	tasks[1].runs_left = 0;
	add_task(2, "never up", SCHEDULER_PRIORITY_HIGH, 100, 30);
	headers[2].has_target = true;
	headers[2].ra = 12;
	headers[2].dec = -80;
	add_task(3, "too long", SCHEDULER_PRIORITY_HIGH, 100, 20 * 60);
	add_task(4, "fine", SCHEDULER_PRIORITY_LOW, 0, 30);
	ASSERT_EQ_INT(1, plan(5, T_NOVEMBER_NOON));
	ASSERT_EQ_INT(4, runs[0].task);
}

static void test_window_and_night_end(void) {
	indigo_scheduler_sky_build(&sky, T_NOVEMBER_NOON, LATITUDE, LONGITUDE, 140);
	time_t dark = dark_from(T_NOVEMBER_NOON);
	add_task(0, "windowed", SCHEDULER_PRIORITY_HIGH, 0, 30);
	headers[0].window_kind = SCHEDULER_WINDOW_ABSOLUTE;
	headers[0].has_window_start = true;
	headers[0].window_start = dark + 3 * 3600;
	add_task(1, "tomorrow", SCHEDULER_PRIORITY_HIGH, 0, 30);
	headers[1].window_kind = SCHEDULER_WINDOW_ABSOLUTE;
	headers[1].has_window_start = true;
	headers[1].window_start = T_NOVEMBER_NOON + 30 * 3600;
	ASSERT_EQ_INT(1, plan(2, T_NOVEMBER_NOON));
	ASSERT_EQ_INT(0, runs[0].task);
	ASSERT_EQ_INT((int)(dark + 3 * 3600), (int)runs[0].start);
}

static void test_max_runs(void) {
	indigo_scheduler_sky_build(&sky, T_NOVEMBER_NOON, LATITUDE, LONGITUDE, 140);
	add_task(0, "many", SCHEDULER_PRIORITY_NORMAL, 50, 5);
	headers[0].repeat = 1000;
	tasks[0].runs_left = 1000;
	build_task(0);
	ASSERT_EQ_INT(10, indigo_scheduler_plan(&sky, tasks, 1, T_NOVEMBER_NOON, indigo_scheduler_night_end(&sky, T_NOVEMBER_NOON), 0, 0, runs, 10));
}

// deterministic pseudo random numbers, the tests never depend on the platform rand()
static uint32_t random_state = 20261113;

static double random_unit(void) {
	random_state = random_state * 1664525u + 1013904223u;
	return (random_state >> 8) / (double)(1u << 24);
}

static double seconds(struct timespec *from, struct timespec *to) {
	return (to->tv_sec - from->tv_sec) + (to->tv_nsec - from->tv_nsec) / 1e9;
}

static void test_performance(void) {
	indigo_scheduler_sky_build(&sky, T_NOVEMBER_NOON, LATITUDE, LONGITUDE, 140);
	for (int i = 0; i < MAX_TASKS; i++) {
		char name[16];
		snprintf(name, sizeof(name), "task %d", i);
		add_task(i, name, (scheduler_priority_class)(int)(random_unit() * 3), (int)(random_unit() * 100), 5 + (int)(random_unit() * 60));
		headers[i].has_target = true;
		headers[i].ra = random_unit() * 24;
		headers[i].dec = random_unit() * 150 - 60;
		headers[i].has_min_altitude = true;
		headers[i].min_altitude = 20 + random_unit() * 20;
		headers[i].has_moon = random_unit() < 0.5;
		headers[i].moon_separation = 30;
		headers[i].moon_width = 7;
		headers[i].repeat = 1 + (int)(random_unit() * 3);
		tasks[i].runs_left = headers[i].repeat;
	}
	struct timespec begin, finish;
	clock_gettime(CLOCK_MONOTONIC, &begin);
	for (int i = 0; i < MAX_TASKS; i++) {
		build_task(i);
	}
	int count = indigo_scheduler_plan(&sky, tasks, MAX_TASKS, T_NOVEMBER_NOON, indigo_scheduler_night_end(&sky, T_NOVEMBER_NOON), 1, 1, runs, 256);
	clock_gettime(CLOCK_MONOTONIC, &finish);
	double elapsed = seconds(&begin, &finish);
	printf("    %d runs of %d tasks planned in %.3f s\n", count, MAX_TASKS, elapsed);
	ASSERT_TRUE(count > 0);
	ASSERT_TRUE(elapsed < 1.0);
	// the runs follow each other and never overlap
	for (int i = 1; i < count; i++) {
		ASSERT_TRUE(runs[i].start >= runs[i - 1].end);
	}
}

// the worst case of the search for the next start: 128 tasks of 24 hours searched over the whole grid
static void test_next_start_search_cost(void) {
	indigo_scheduler_sky_build(&sky, T_NOVEMBER_NOON, LATITUDE, LONGITUDE, 140);
	for (int i = 0; i < MAX_TASKS; i++) {
		add_task(i, "long", SCHEDULER_PRIORITY_NORMAL, 50, 24 * 60);
		headers[i].has_target = true;
		headers[i].ra = random_unit() * 24;
		headers[i].dec = random_unit() * 150 - 60;
		headers[i].has_min_altitude = true;
		headers[i].min_altitude = 30;
		headers[i].twilight = SCHEDULER_TWILIGHT_NONE;
		build_task(i);
	}
	struct timespec begin, finish;
	clock_gettime(CLOCK_MONOTONIC, &begin);
	int found = 0;
	for (int round = 0; round < 10; round++) {
		for (int i = 0; i < MAX_TASKS; i++) {
			if (indigo_scheduler_points_next(&sky, &points[i], &headers[i], T_NOVEMBER_NOON, tasks[i].duration, 0, NULL) > 0) {
				found++;
			}
		}
	}
	clock_gettime(CLOCK_MONOTONIC, &finish);
	double elapsed = seconds(&begin, &finish);
	printf("    10 searches of %d tasks of 24 h in %.3f s, %d starts found\n", MAX_TASKS, elapsed, found);
	// only circumpolar targets above 30 degrees all day can run for 24 hours
	ASSERT_TRUE(found > 0 && found < 10 * MAX_TASKS);
	ASSERT_TRUE(elapsed < 1.0);
}

int main(void) {
	indigo_test_case cases[] = {
		{ "score", test_score },
		{ "order_and_times", test_order_and_times },
		{ "ties_to_earlier_task", test_ties_to_earlier_task },
		{ "urgent_first", test_urgent_first },
		{ "running_task_first", test_running_task_first },
		{ "running_task_overrun", test_running_task_overrun },
		{ "initial_delay", test_initial_delay },
		{ "urgent_repeat_queues_behind", test_urgent_repeat_queues_behind },
		{ "repeats", test_repeats },
		{ "unschedulable_tasks", test_unschedulable_tasks },
		{ "window_and_night_end", test_window_and_night_end },
		{ "max_runs", test_max_runs },
		{ "performance", test_performance },
		{ "next_start_search_cost", test_next_start_search_cost },
	};
	return indigo_run_tests("test_agent_scheduler_plan", cases, sizeof(cases) / sizeof(cases[0]));
}
