// Copyright (c) 2026 INDIGO initiative
// All rights reserved.
//
// You may use this software under the terms of 'INDIGO Astronomy
// open-source license' (see LICENSE.md).
//
// THIS SOFTWARE IS PROVIDED BY THE AUTHORS 'AS IS' AND ANY EXPRESS
// OR IMPLIED WARRANTIES, INCLUDING, BUT NOT LIMITED TO, THE IMPLIED
// WARRANTIES OF MERCHANTABILITY AND FITNESS FOR A PARTICULAR PURPOSE
// ARE DISCLAIMED. IN NO EVENT SHALL THE AUTHOR BE LIABLE FOR ANY
// DIRECT, INDIRECT, INCIDENTAL, SPECIAL, EXEMPLARY, OR CONSEQUENTIAL
// DAMAGES (INCLUDING, BUT NOT LIMITED TO, PROCUREMENT OF SUBSTITUTE
// GOODS OR SERVICES; LOSS OF USE, DATA, OR PROFITS; OR BUSINESS
// INTERRUPTION) HOWEVER CAUSED AND ON ANY THEORY OF LIABILITY,
// WHETHER IN CONTRACT, STRICT LIABILITY, OR TORT (INCLUDING
// NEGLIGENCE OR OTHERWISE) ARISING IN ANY WAY OUT OF THE USE OF THIS
// SOFTWARE, EVEN IF ADVISED OF THE POSSIBILITY OF SUCH DAMAGE.

// Code is generated by AI

// Bahtinov mask analysis tests on synthetic patterns with known geometry. The outer spikes cross at the star centre and the
// central spike is shifted by a known perpendicular offset, so the expected absolute focus error equals that offset. The
// geometry (central spike 5.3 deg from vertical, outer spikes +-12.6 deg, first order dots at 19 and 25 px for OIII and Ha,
// star core about 15 px) follows real frames taken with a Bahtinov mask on a Poseidon-C PRO camera.

#include <math.h>
#include <stdint.h>
#include <stdlib.h>
#include <string.h>

#include <indigo/indigo_bus.h>
#include <indigo/indigo_bahtinov.h>

#include "../test_runner.h"

#define SIZE					300
#define BACKGROUND		500.0
#define NOISE					8.0
#define MASK_ANGLE		12.6
#define TOLERANCE			0.35

typedef struct {
	double theta;					// central spike angle from vertical (deg)
	double offset;				// perpendicular offset of the central spike (px), the expected focus error
	double delta;					// outer spike angle relative to the central spike (deg), 0 = no spikes
	double amplitude;			// spike amplitude
	bool dotted;					// narrowband pattern: diffraction dots instead of continuous spikes
	bool bayer;						// signal only in the R and G sites of an RGGB mosaic
	unsigned int seed;
} pattern;

static double gauss_noise(unsigned int *seed) {
	*seed = *seed * 1103515245 + 12345;
	double u1 = ((*seed >> 8) % 1000000 + 1) / 1000001.0;
	*seed = *seed * 1103515245 + 12345;
	double u2 = ((*seed >> 8) % 1000000) / 1000000.0;
	return sqrt(-2 * log(u1)) * cos(2 * M_PI * u2);
}

// brightness of one spike at signed distance t along it and perpendicular distance o from it
static double spike(const pattern *p, double t, double o) {
	double r = fabs(t);
	if (r < 2) {
		return 0;
	}
	if (!p->dotted) {
		return p->amplitude * exp(-r / 60) * exp(-o * o / 2);
	}
	double dots = 0;
	const double radius[] = { 19, 25, 38, 50 }, weight[] = { 1, 1, 0.5, 0.5 };
	for (int i = 0; i < 4; i++) {
		dots += weight[i] * exp(-(r - radius[i]) * (r - radius[i]) / (2 * 1.5 * 1.5));
	}
	return p->amplitude * dots * exp(-o * o / 2);
}

static double *render(const pattern *p) {
	double *image = malloc(SIZE * SIZE * sizeof(double));
	double c = SIZE / 2.0;
	unsigned int seed = p->seed;
	for (int y = 0; y < SIZE; y++) {
		for (int x = 0; x < SIZE; x++) {
			double px = x + 0.5 - c, py = y + 0.5 - c;
			double signal = 6000 * exp(-(px * px + py * py) / (2 * 4.0 * 4.0));
			if (p->delta > 0) {
				for (int i = -1; i <= 1; i++) {
					double th = (p->theta + i * p->delta) * M_PI / 180, d = i == 0 ? p->offset : 0;
					double ux = sin(th), uy = -cos(th), nx = cos(th), ny = sin(th);
					signal += (i == 0 ? 1.0 : 0.7) * spike(p, px * ux + py * uy, px * nx + py * ny - d);
				}
			}
			if (p->bayer && x % 2 == 1 && y % 2 == 1) {
				signal = 0;
			}
			image[y * SIZE + x] = BACKGROUND + signal + NOISE * gauss_noise(&seed);
		}
	}
	return image;
}

static uint16_t *render_mono16(const pattern *p) {
	double *image = render(p);
	uint16_t *data = malloc(SIZE * SIZE * sizeof(uint16_t));
	for (int i = 0; i < SIZE * SIZE; i++) {
		data[i] = (uint16_t)fmax(0, fmin(65535, image[i]));
	}
	free(image);
	return data;
}

static bool analyze(const pattern *p, const double *mask_angle, indigo_bahtinov_result *result) {
	uint16_t *data = render_mono16(p);
	bool found = indigo_bahtinov_analyze(INDIGO_RAW_MONO16, data, SIZE, SIZE, mask_angle, result);
	free(data);
	if (found) {
		printf("    theta %.1f offset %+.2f -> error %+.3f, angles %+.2f / %+.2f, SNR %.1f / %.1f / %.1f, confidence %.2f\n", p->theta, p->offset, result->error, result->angle[0], result->angle[1], result->snr[0], result->snr[1], result->snr[2], result->confidence);
	} else {
		printf("    theta %.1f offset %+.2f -> not found\n", p->theta, p->offset);
	}
	return found;
}

static void assert_error_matches(const pattern *p, const double *mask_angle) {
	indigo_bahtinov_result result;
	ASSERT_TRUE(analyze(p, mask_angle, &result));
	ASSERT_TRUE(fabs(fabs(result.error) - fabs(p->offset)) < TOLERANCE);
	ASSERT_TRUE(fabs(result.angle[0] + p->delta) < 0.5);
	ASSERT_TRUE(fabs(result.angle[1] - p->delta) < 0.5);
}

static void broadband_error_matches_central_spike_offset(void) {
	const double offsets[] = { 0, 1.5, -1.5, 4, -4, 8 };
	for (int i = 0; i < 6; i++) {
		pattern p = { 5.3, offsets[i], MASK_ANGLE, 120, false, false, 1 + i };
		assert_error_matches(&p, NULL);
	}
}

static void error_sign_follows_defocus_direction(void) {
	pattern inside = { 5.3, 3, MASK_ANGLE, 120, false, false, 7 }, outside = { 5.3, -3, MASK_ANGLE, 120, false, false, 7 };
	indigo_bahtinov_result a, b;
	ASSERT_TRUE(analyze(&inside, NULL, &a));
	ASSERT_TRUE(analyze(&outside, NULL, &b));
	ASSERT_TRUE(a.error * b.error < 0);
}

static void vertical_horizontal_and_oblique_patterns_are_measured(void) {
	const double angles[] = { 0, 90, 47, -30 };
	for (int i = 0; i < 4; i++) {
		pattern p = { angles[i], 3, MASK_ANGLE, 120, false, false, 11 + i };
		assert_error_matches(&p, NULL);
	}
}

static void free_search_reports_mask_angle_and_confidence(void) {
	pattern p = { 5.3, 2, 20, 120, false, false, 17 };
	indigo_bahtinov_result result;
	ASSERT_TRUE(analyze(&p, NULL, &result));
	ASSERT_TRUE(fabs(result.angle[0] + 20) < 0.5);
	ASSERT_TRUE(fabs(result.angle[1] - 20) < 0.5);
	ASSERT_TRUE(result.confidence >= 1.2);
	ASSERT_TRUE(result.snr[0] >= 8);
}

static void narrowband_dotted_pattern_with_known_mask_angle(void) {
	const double mask_angle[2] = { -MASK_ANGLE, MASK_ANGLE };
	const double offsets[] = { 0, 1, -2, 3 };
	for (int i = 0; i < 4; i++) {
		pattern p = { 5.3, offsets[i], MASK_ANGLE, 300, true, false, 21 + i };
		assert_error_matches(&p, mask_angle);
	}
}

static void narrowband_dotted_pattern_with_free_search(void) {
	pattern p = { 5.3, -1.5, MASK_ANGLE, 400, true, false, 31 };
	assert_error_matches(&p, NULL);
}

static void undebayered_mosaic_is_measured(void) {
	pattern p = { 5.3, 2.5, MASK_ANGLE, 150, false, true, 41 };
	assert_error_matches(&p, NULL);
}

static void mono8_and_rgb24_frames_are_measured(void) {
	pattern p = { 5.3, -2.5, MASK_ANGLE, 120, false, false, 51 };
	double *image = render(&p);
	uint8_t *mono8 = malloc(SIZE * SIZE), *rgb24 = malloc(3 * SIZE * SIZE);
	for (int i = 0; i < SIZE * SIZE; i++) {
		uint8_t value = (uint8_t)fmax(0, fmin(255, (image[i] - BACKGROUND) / 30 + 20));
		mono8[i] = value;
		rgb24[3 * i] = rgb24[3 * i + 1] = rgb24[3 * i + 2] = value;
	}
	free(image);
	indigo_bahtinov_result a, b;
	bool found_mono8 = indigo_bahtinov_analyze(INDIGO_RAW_MONO8, mono8, SIZE, SIZE, NULL, &a);
	bool found_rgb24 = indigo_bahtinov_analyze(INDIGO_RAW_RGB24, rgb24, SIZE, SIZE, NULL, &b);
	free(mono8);
	free(rgb24);
	ASSERT_TRUE(found_mono8);
	ASSERT_TRUE(found_rgb24);
	ASSERT_TRUE(fabs(fabs(a.error) - 2.5) < TOLERANCE);
	ASSERT_TRUE(fabs(fabs(b.error) - 2.5) < TOLERANCE);
}

static void frame_without_star_is_rejected(void) {
	uint16_t *data = malloc(SIZE * SIZE * sizeof(uint16_t));
	unsigned int seed = 61;
	for (int i = 0; i < SIZE * SIZE; i++) {
		data[i] = (uint16_t)(BACKGROUND + NOISE * gauss_noise(&seed));
	}
	indigo_bahtinov_result result;
	bool found = indigo_bahtinov_analyze(INDIGO_RAW_MONO16, data, SIZE, SIZE, NULL, &result);
	free(data);
	ASSERT_FALSE(found);
}

static void star_without_mask_is_rejected(void) {
	pattern p = { 5.3, 0, 0, 0, false, false, 71 };
	indigo_bahtinov_result result;
	ASSERT_FALSE(analyze(&p, NULL, &result));
}

static void compatibility_wrapper_returns_absolute_error_and_spikes(void) {
	pattern p = { 5.3, -3, MASK_ANGLE, 120, false, false, 91 };
	uint16_t *data = render_mono16(&p);
	double rho1, theta1, rho2, theta2, rho3, theta3;
	double error = indigo_bahtinov_error(INDIGO_RAW_MONO16, data, SIZE, SIZE, 0.15, &rho1, &theta1, &rho2, &theta2, &rho3, &theta3);
	free(data);
	ASSERT_TRUE(fabs(error - 3) < TOLERANCE);
	ASSERT_TRUE(theta1 >= 0 && theta1 < M_PI && theta2 >= 0 && theta2 < M_PI && theta3 >= 0 && theta3 < M_PI);
	// the central spike passes the star centre at the given offset, spikes are in pixel index coordinates (pixel centres at integers)
	double c = SIZE / 2.0 - 0.5;
	ASSERT_TRUE(fabs(fabs(c * cos(theta1) + c * sin(theta1) - rho1) - 3) < TOLERANCE);
}

static void compatibility_wrapper_reports_failure(void) {
	pattern p = { 5.3, 0, 0, 0, false, false, 101 };
	uint16_t *data = render_mono16(&p);
	double rho1 = 1, theta1 = 1, rho2 = 1, theta2 = 1, rho3 = 1, theta3 = 1;
	double error = indigo_bahtinov_error(INDIGO_RAW_MONO16, data, SIZE, SIZE, 0.15, &rho1, &theta1, &rho2, &theta2, &rho3, &theta3);
	free(data);
	ASSERT_TRUE(error == -1);
	ASSERT_TRUE(rho1 == 0 && theta1 == 0 && rho2 == 0 && theta2 == 0 && rho3 == 0 && theta3 == 0);
}

int main(void) {
	const indigo_test_case tests[] = {
		{ "broadband_error_matches_central_spike_offset", broadband_error_matches_central_spike_offset },
		{ "error_sign_follows_defocus_direction", error_sign_follows_defocus_direction },
		{ "vertical_horizontal_and_oblique_patterns_are_measured", vertical_horizontal_and_oblique_patterns_are_measured },
		{ "free_search_reports_mask_angle_and_confidence", free_search_reports_mask_angle_and_confidence },
		{ "narrowband_dotted_pattern_with_known_mask_angle", narrowband_dotted_pattern_with_known_mask_angle },
		{ "narrowband_dotted_pattern_with_free_search", narrowband_dotted_pattern_with_free_search },
		{ "undebayered_mosaic_is_measured", undebayered_mosaic_is_measured },
		{ "mono8_and_rgb24_frames_are_measured", mono8_and_rgb24_frames_are_measured },
		{ "frame_without_star_is_rejected", frame_without_star_is_rejected },
		{ "star_without_mask_is_rejected", star_without_mask_is_rejected },
		{ "compatibility_wrapper_returns_absolute_error_and_spikes", compatibility_wrapper_returns_absolute_error_and_spikes },
		{ "compatibility_wrapper_reports_failure", compatibility_wrapper_reports_failure },
	};
	return indigo_run_tests("bahtinov unit tests", tests, (int)(sizeof(tests) / sizeof(tests[0])));
}
