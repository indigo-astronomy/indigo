// Copyright (c) 2026 INDIGO initiative
// All rights reserved.
//
// You may use this software under the terms of 'INDIGO Astronomy
// open-source license' (see LICENSE.md).
//
// THIS SOFTWARE IS PROVIDED BY THE AUTHORS 'AS IS' AND ANY EXPRESS
// OR IMPLIED WARRANTIES, INCLUDING, BUT NOT LIMITED TO, THE IMPLIED
// WARRANTIES OF MERCHANTABILITY AND FITNESS FOR A PARTICULAR PURPOSE
// ARE DISCLAIMED. IN NO EVENT SHALL THE AUTHOR BE LIABLE FOR ANY
// DIRECT, INDIRECT, INCIDENTAL, SPECIAL, EXEMPLARY, OR CONSEQUENTIAL
// DAMAGES (INCLUDING, BUT NOT LIMITED TO, PROCUREMENT OF SUBSTITUTE
// GOODS OR SERVICES; LOSS OF USE, DATA, OR PROFITS; OR BUSINESS
// INTERRUPTION) HOWEVER CAUSED AND ON ANY THEORY OF LIABILITY,
// WHETHER IN CONTRACT, STRICT LIABILITY, OR TORT (INCLUDING
// NEGLIGENCE OR OTHERWISE) ARISING IN ANY WAY OUT OF THE USE OF THIS
// SOFTWARE, EVEN IF ADVISED OF THE POSSIBILITY OF SUCH DAMAGE.

// Code is generated by AI

#include "../test_runner.h"
#include <math.h>
#include <stdio.h>
#include <string.h>
#include <indigo/indigo_bus.h>
#include <indigo/indigo_stretch.h>
#include <indigo/indigo_raw_utils.h>
#include <indigo/indigo_align.h>

static void stretch_identity_and_limits(void) {
	const uint8_t input[] = { 0, 64, 128, 255 };
	const uint16_t input16[] = { 0, 16448, 32896, 65535 };
	uint8_t output[4];
	double shadows[] = { 0 }, midtones[] = { 0.5 }, highlights[] = { 1 };
	indigo_stretch_8(input, 4, 1, output, shadows, midtones, highlights);
	ASSERT_TRUE(memcmp(input, output, 4) == 0);
	indigo_stretch_16(input16, 4, 1, output, shadows, midtones, highlights);
	ASSERT_TRUE(memcmp(input, output, 4) == 0);
	uint8_t ramp[256], ramp_output[256];
	for (int i = 0; i < 256; i++) {
		ramp[i] = i;
	}
	midtones[0] = 0;
	indigo_stretch_8(ramp, 256, 1, ramp_output, shadows, midtones, highlights);
	for (int i = 0; i < 256; i++) {
		ASSERT_EQ_INT(i ? 255 : 0, ramp_output[i]);
	}
	midtones[0] = 1;
	indigo_stretch_8(ramp, 256, 1, ramp_output, shadows, midtones, highlights);
	for (int i = 0; i < 256; i++) {
		ASSERT_EQ_INT(i == 255 ? 255 : 0, ramp_output[i]);
	}
	midtones[0] = 0.5;
	shadows[0] = highlights[0] = 0.5;
	indigo_stretch_8(input, 4, 1, output, shadows, midtones, highlights);
	ASSERT_TRUE(output[0] == 0 && output[1] == 0 && output[2] == 255 && output[3] == 255);
}

static void stretch_white_balance_ties_and_black(void) {
	const uint8_t input[] = { 80, 80, 40 };
	const uint16_t input16[] = { 20560, 20560, 10280 };
	uint8_t output[3];
	double shadows[] = { 0, 0, 0 }, midtones[] = { 0.5, 0.5, 0.25 }, highlights[] = { 1, 1, 1 };
	unsigned long totals[] = { 100, 100, 50 };
	indigo_stretch_24(input, 1, 1, output, shadows, midtones, highlights, totals);
	ASSERT_TRUE(output[0] == 80 && output[1] == 80 && output[2] == 80);
	indigo_stretch_48(input16, 1, 1, output, shadows, midtones, highlights, totals);
	ASSERT_TRUE(output[0] == 80 && output[1] == 80 && output[2] == 80);
	const uint8_t black[] = { 0, 0, 0 };
	const uint16_t black16[] = { 0, 0, 0 };
	memset(totals, 0, sizeof(totals));
	indigo_stretch_24(black, 1, 1, output, shadows, midtones, highlights, totals);
	ASSERT_TRUE(output[0] == 0 && output[1] == 0 && output[2] == 0);
	indigo_stretch_48(black16, 1, 1, output, shadows, midtones, highlights, totals);
	ASSERT_TRUE(output[0] == 0 && output[1] == 0 && output[2] == 0);
	totals[0] = 100;
	const uint8_t red[] = { 80, 0, 0 };
	indigo_stretch_24(red, 1, 1, output, shadows, midtones, highlights, totals);
	ASSERT_TRUE(output[0] == 80 && output[1] == 0 && output[2] == 0);
}

static void polar_alignment_symmetric_and_singular(void) {
	const double expected_u = 0.001, expected_v = -0.002;
	indigo_spherical_point_t points[3] = { { -M_PI / 12, 0, 0 }, { M_PI / 12, 0, 0 }, { M_PI / 4, 0, 0 } };
	for (int i = 0; i < 3; i++) {
		points[i].d = 0.5 + expected_u * cos(-points[i].a) + expected_v * sin(-points[i].a);
	}
	double d2, d3, u, v;
	ASSERT_TRUE(indigo_polar_alignment_error_3p(points, points + 1, points + 2, &d2, &d3, &u, &v));
	ASSERT_TRUE(fabs(u - expected_u) < 1e-12 && fabs(v - expected_v) < 1e-12);
	ASSERT_TRUE(!indigo_polar_alignment_error_3p(points, points, points, &d2, &d3, &u, &v));
	points[2].d = NAN;
	ASSERT_TRUE(!indigo_polar_alignment_error_3p(points, points + 1, points + 2, &d2, &d3, &u, &v));
}

static void contrast_empty_mask_and_valid_samples(void) {
	uint8_t data8[16 * 3], mask[16] = { 0 };
	uint16_t data16[16 * 3];
	memset(data8, 255, sizeof(data8));
	for (int i = 0; i < 16 * 3; i++) {
		data16[i] = 65535;
	}
	const indigo_raw_type types[] = { INDIGO_RAW_MONO8, INDIGO_RAW_MONO16, INDIGO_RAW_RGB24, INDIGO_RAW_RGB48 };
	for (int i = 0; i < 4; i++) {
		const void *data = i % 2 ? (const void *)data16 : (const void *)data8;
		bool saturated;
		ASSERT_TRUE(indigo_contrast(types[i], data, mask, 4, 4, &saturated) == 0);
	}
	memset(mask, 1, sizeof(mask));
	data8[5] = 0;
	ASSERT_TRUE(indigo_contrast(INDIGO_RAW_MONO8, data8, mask, 4, 4, NULL) > 0);
}

static void donuts_rejects_unsupported_regions(void) {
	uint8_t data[64 * 64 * 3] = { 0 };
	indigo_frame_digest digest = { 0 };
	ASSERT_TRUE(indigo_donuts_frame_digest_clipped(INDIGO_RAW_MONO8, data, 64, 64, 0, 0, 11, 32, &digest) == INDIGO_FAILED);
	ASSERT_TRUE(indigo_donuts_frame_digest_clipped(INDIGO_RAW_RGB24, data, 64, 64, 0, 0, 32, 11, &digest) == INDIGO_FAILED);
	ASSERT_TRUE(indigo_donuts_frame_digest_clipped(INDIGO_RAW_MONO8, data, 64, 64, -1, 0, 32, 32, &digest) == INDIGO_FAILED);
	ASSERT_TRUE(indigo_donuts_frame_digest_clipped(INDIGO_RAW_MONO8, data, 64, 64, 40, 0, 32, 32, &digest) == INDIGO_FAILED);
	ASSERT_TRUE(digest.fft_x == NULL && digest.fft_y == NULL);
	uint8_t mono[64 * 64] = { 0 };
	for (int y = 6; y < 10; y++) {
		for (int x = 6; x < 10; x++) {
			mono[y * 64 + x] = 200;
			for (int channel = 0; channel < 3; channel++) {
				data[3 * (y * 64 + x) + channel] = 200;
			}
		}
	}
	ASSERT_EQ_INT(INDIGO_OK, indigo_donuts_frame_digest_clipped(INDIGO_RAW_MONO8, mono, 64, 64, 2, 2, 12, 12, &digest));
	ASSERT_EQ_INT(16, digest.width);
	ASSERT_EQ_INT(16, digest.height);
	ASSERT_EQ_INT(INDIGO_OK, indigo_delete_frame_digest(&digest));
	memset(&digest, 0, sizeof(digest));
	ASSERT_EQ_INT(INDIGO_OK, indigo_donuts_frame_digest_clipped(INDIGO_RAW_RGB24, data, 64, 64, 2, 2, 12, 12, &digest));
	ASSERT_EQ_INT(INDIGO_OK, indigo_delete_frame_digest(&digest));
}

typedef void (*debayer_8_fn)(const uint8_t *input_buffer, int width, int height, uint8_t *output_buffer);
typedef void (*debayer_16_fn)(const uint16_t *input_buffer, int width, int height, uint8_t *output_buffer);

static const struct {
	const char *pattern;
	debayer_8_fn debayer_8;
	debayer_16_fn debayer_16;
} debayer_patterns[] = {
	{ "RGGB", indigo_debayer_8_rggb, indigo_debayer_16_rggb },
	{ "GBRG", indigo_debayer_8_gbrg, indigo_debayer_16_gbrg },
	{ "GRBG", indigo_debayer_8_grbg, indigo_debayer_16_grbg },
	{ "BGGR", indigo_debayer_8_bggr, indigo_debayer_16_bggr }
};

static int bayer_channel(const char *pattern, int row, int column) {
	char color = pattern[(row & 1) * 2 + (column & 1)];
	return color == 'R' ? 0 : color == 'G' ? 1 : 2;
}

// Reference interpolation: every channel is the mean of the in-bounds pixels of that color in the 3x3 neighbourhood.
static double bayer_reference(const double *raw, const char *pattern, int width, int height, int row, int column, int channel) {
	if (bayer_channel(pattern, row, column) == channel) {
		return raw[row * width + column];
	}
	double sum = 0;
	int count = 0;
	for (int r = row - 1; r <= row + 1; r++) {
		for (int c = column - 1; c <= column + 1; c++) {
			if (r < 0 || c < 0 || r >= height || c >= width || (r == row && c == column)) {
				continue;
			}
			if (bayer_channel(pattern, r, c) == channel) {
				sum += raw[r * width + c];
				count++;
			}
		}
	}
	return count ? sum / count : -1;
}

static void debayer_uses_only_in_bounds_neighbours(void) {
	const int sizes[][2] = { { 2, 2 }, { 4, 2 }, { 2, 4 }, { 4, 4 }, { 6, 4 }, { 5, 3 } };
	for (unsigned p = 0; p < sizeof(debayer_patterns) / sizeof(debayer_patterns[0]); p++) {
		for (unsigned s = 0; s < sizeof(sizes) / sizeof(sizes[0]); s++) {
			const int width = sizes[s][0], height = sizes[s][1], size = width * height;
			/* the frame is followed by sentinel pixels which an out of frame read would average in */
			uint8_t input_8[6 * 4 + 16];
			uint16_t input_16[6 * 4 + 16];
			double reference_8[6 * 4], reference_16[6 * 4];
			uint8_t output_8[6 * 4 * 3], output_16[6 * 4 * 3];
			for (int i = 0; i < size + 16; i++) {
				input_8[i] = i < size ? (uint8_t)(10 + 7 * i) : 255;
				input_16[i] = i < size ? (uint16_t)(2560 + 1792 * i) : 65535;
			}
			for (int i = 0; i < size; i++) {
				reference_8[i] = input_8[i];
				reference_16[i] = input_16[i];
			}
			debayer_patterns[p].debayer_8(input_8, width, height, output_8);
			debayer_patterns[p].debayer_16(input_16, width, height, output_16);
			for (int row = 0; row < height; row++) {
				for (int column = 0; column < width; column++) {
					for (int channel = 0; channel < 3; channel++) {
						int index = 3 * (row * width + column) + channel;
						uint8_t expected_8 = (uint8_t)bayer_reference(reference_8, debayer_patterns[p].pattern, width, height, row, column, channel);
						uint8_t expected_16 = (uint8_t)((uint16_t)bayer_reference(reference_16, debayer_patterns[p].pattern, width, height, row, column, channel) >> 8);
						if (expected_8 != output_8[index] || expected_16 != output_16[index]) {
							fprintf(stderr, "%s %dx%d pixel (%d, %d) channel %d: expected %d/%d, got %d/%d\n", debayer_patterns[p].pattern, width, height, column, row, channel, expected_8, expected_16, output_8[index], output_16[index]);
						}
						ASSERT_EQ_INT(expected_8, output_8[index]);
						ASSERT_EQ_INT(expected_16, output_16[index]);
					}
				}
			}
		}
	}
}

int main(void) {
	const indigo_test_case tests[] = {
		{ "stretch_identity_and_limits", stretch_identity_and_limits },
		{ "stretch_white_balance_ties_and_black", stretch_white_balance_ties_and_black },
		{ "polar_alignment_symmetric_and_singular", polar_alignment_symmetric_and_singular },
		{ "contrast_empty_mask_and_valid_samples", contrast_empty_mask_and_valid_samples },
		{ "donuts_rejects_unsupported_regions", donuts_rejects_unsupported_regions },
		{ "debayer_uses_only_in_bounds_neighbours", debayer_uses_only_in_bounds_neighbours }
	};
	return indigo_run_tests("Image math regressions", tests, sizeof(tests) / sizeof(*tests));
}
