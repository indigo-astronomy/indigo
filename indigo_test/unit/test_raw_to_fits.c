// Copyright (c) 2026 INDIGO initiative
// All rights reserved.
//
// You may use this software under the terms of 'INDIGO Astronomy
// open-source license' (see LICENSE.md).
//
// THIS SOFTWARE IS PROVIDED BY THE AUTHORS 'AS IS' AND ANY EXPRESS
// OR IMPLIED WARRANTIES, INCLUDING, BUT NOT LIMITED TO, THE IMPLIED
// WARRANTIES OF MERCHANTABILITY AND FITNESS FOR A PARTICULAR PURPOSE
// ARE DISCLAIMED. IN NO EVENT SHALL THE AUTHOR BE LIABLE FOR ANY
// DIRECT, INDIRECT, INCIDENTAL, SPECIAL, EXEMPLARY, OR CONSEQUENTIAL
// DAMAGES (INCLUDING, BUT NOT LIMITED TO, PROCUREMENT OF SUBSTITUTE
// GOODS OR SERVICES; LOSS OF USE, DATA, OR PROFITS; OR BUSINESS
// INTERRUPTION) HOWEVER CAUSED AND ON ANY THEORY OF LIABILITY,
// WHETHER IN CONTRACT, STRICT LIABILITY, OR TORT (INCLUDING
// NEGLIGENCE OR OTHERWISE) ARISING IN ANY WAY OUT OF THE USE OF THIS
// SOFTWARE, EVEN IF ADVISED OF THE POSSIBILITY OF SUCH DAMAGE.

// Code is generated by AI

#include <errno.h>
#include <limits.h>
#include <string.h>
#include <indigo/indigo_bus.h>
#include <indigo/indigo_fits.h>
#include "../test_runner.h"

static char *raw_image(const char *signature, uint32_t width, uint32_t height, size_t payload, const char *extension, size_t extension_size) {
	char *raw = malloc(sizeof(indigo_raw_header) + payload + extension_size);
	indigo_raw_header header = { 0, width, height };
	memcpy(&header.signature, signature, 4);
	memcpy(raw, &header, sizeof(header));
	memset(raw + sizeof(header), 42, payload);
	if (extension_size) {
		memcpy(raw + sizeof(header) + payload, extension, extension_size);
	}
	return raw;
}

static void short_headers_are_rejected(void) {
	for (int length = 0; length < (int)sizeof(indigo_raw_header); length++) {
		char *raw = malloc(length ? length : 1);
		memset(raw, 'R', length);
		char *fits = NULL;
		int size = 99;
		ASSERT_EQ_INT(INDIGO_FAILED, indigo_raw_to_fits(raw, length, &fits, &size, NULL));
		ASSERT_TRUE(fits == NULL);
		ASSERT_EQ_INT(99, size);
		free(raw);
	}
}

static void invalid_arguments_and_dimensions_preserve_output(void) {
	char *raw = raw_image("RAW1", 1, 1, 1, NULL, 0);
	char *fits = malloc(32);
	memset(fits, 'Q', 32);
	char *previous = fits;
	int size = 32;
	ASSERT_EQ_INT(INDIGO_FAILED, indigo_raw_to_fits(NULL, 13, &fits, &size, NULL));
	ASSERT_EQ_INT(INDIGO_FAILED, indigo_raw_to_fits(raw, -1, &fits, &size, NULL));
	ASSERT_EQ_INT(INDIGO_FAILED, indigo_raw_to_fits(raw, 13, NULL, &size, NULL));
	ASSERT_EQ_INT(INDIGO_FAILED, indigo_raw_to_fits(raw, 13, &fits, NULL, NULL));
	const uint32_t dimensions[][2] = { { 0, 1 }, { 1, 0 }, { UINT32_MAX, UINT32_MAX }, { INT_MAX, 2 }, { 65536, 65536 } };
	for (size_t i = 0; i < sizeof(dimensions) / sizeof(dimensions[0]); i++) {
		indigo_raw_header header = { INDIGO_RAW_MONO8, dimensions[i][0], dimensions[i][1] };
		memcpy(raw, &header, sizeof(header));
		ASSERT_EQ_INT(INDIGO_FAILED, indigo_raw_to_fits(raw, 13, &fits, &size, NULL));
	}
	memcpy(raw, "RAW9", 4);
	ASSERT_EQ_INT(INDIGO_FAILED, indigo_raw_to_fits(raw, 13, &fits, &size, NULL));
	ASSERT_TRUE(fits == previous);
	ASSERT_EQ_INT(32, size);
	for (int i = 0; i < 32; i++) {
		ASSERT_EQ_INT('Q', fits[i]);
	}
	free(raw);
	free(fits);
}

static void all_component_payloads_are_required(void) {
	const char *signatures[] = { "RAW1", "RAW2", "RAW3", "RAW6" };
	const int bytes[] = { 1, 2, 3, 6 };
	for (int i = 0; i < 4; i++) {
		char *raw = raw_image(signatures[i], 2, 2, 4 * bytes[i] - 1, NULL, 0);
		char *fits = NULL;
		int size = 0;
		ASSERT_EQ_INT(INDIGO_FAILED, indigo_raw_to_fits(raw, sizeof(indigo_raw_header) + 4 * bytes[i] - 1, &fits, &size, NULL));
		ASSERT_TRUE(fits == NULL);
		free(raw);
	}
}

static void pixel_formats_remain_correct(void) {
	const char *signatures[] = { "RAW1", "RAW2", "RAW3", "RAW6" };
	const int bytes[] = { 1, 2, 3, 6 };
	const unsigned char input8[] = { 1, 2, 3, 4, 5, 6 };
	const uint16_t input16[] = { 0, 32768, 65535, 1, 32767, 32769 };
	const unsigned char mono16[] = { 0x80, 0, 0, 0 };
	const unsigned char rgb8[] = { 1, 4, 2, 5, 3, 6 };
	const unsigned char rgb16[] = { 0x80, 0, 0x80, 1, 0, 0, 0xff, 0xff, 0x7f, 0xff, 0, 1 };
	const unsigned char *expected[] = { input8, mono16, rgb8, rgb16 };
	for (int i = 0; i < 4; i++) {
		char *raw = raw_image(signatures[i], 2, 1, 2 * bytes[i], NULL, 0);
		memcpy(raw + sizeof(indigo_raw_header), i % 2 ? (const void *)input16 : (const void *)input8, 2 * bytes[i]);
		char *fits = NULL;
		int size = 0;
		ASSERT_EQ_INT(INDIGO_OK, indigo_raw_to_fits(raw, sizeof(indigo_raw_header) + 2 * bytes[i], &fits, &size, NULL));
		ASSERT_EQ_INT(2 * FITS_RECORD_SIZE, size);
		ASSERT_TRUE(memcmp(fits + FITS_RECORD_SIZE, expected[i], 2 * bytes[i]) == 0);
		free(fits);
		free(raw);
	}
}

static void unaligned_input_is_supported(void) {
	char *raw = raw_image("RAW2", 1, 1, 2, NULL, 0);
	char *unaligned = malloc(15);
	memcpy(unaligned + 1, raw, 14);
	char *fits = NULL;
	int size = 0;
	ASSERT_EQ_INT(INDIGO_OK, indigo_raw_to_fits(unaligned + 1, 14, &fits, &size, NULL));
	free(fits);
	free(unaligned);
	free(raw);
}

static void header_record_boundaries_preserve_pixels(void) {
	char *raw = raw_image("RAW1", 1, 1, 1, NULL, 0);
	indigo_fits_keyword keywords[102] = { 0 };
	for (int count = 25; count <= 100; count++) {
		for (int i = 0; i < count; i++) {
			keywords[i] = (indigo_fits_keyword){ .type = INDIGO_FITS_NUMBER, .name = "EXPTIME", .number = 1.5, .comment = "seconds" };
		}
		char *fits = NULL;
		int size = 0;
		ASSERT_EQ_INT(INDIGO_OK, indigo_raw_to_fits(raw, 13, &fits, &size, keywords));
		int cards = 6 + count + 5;
		int header_size = (cards * 80 + FITS_RECORD_SIZE - 1) / FITS_RECORD_SIZE * FITS_RECORD_SIZE;
		ASSERT_TRUE(memcmp(fits + (cards - 1) * 80, "END", 3) == 0);
		ASSERT_EQ_INT(header_size + FITS_RECORD_SIZE, size);
		ASSERT_EQ_INT(42, fits[header_size]);
		free(fits);
	}
	free(raw);
}

static void embedded_rgb_metadata_follows_full_payload(void) {
	const char extension[] = "SIMPLE=T;BAYERPAT='RGGB';EXPTIME=1.5;";
	char *raw = raw_image("RAW6", 2, 2, 24, extension, sizeof(extension) - 1);
	char *fits = NULL;
	int size = 0;
	ASSERT_EQ_INT(INDIGO_OK, indigo_raw_to_fits(raw, 12 + 24 + sizeof(extension) - 1, &fits, &size, NULL));
	ASSERT_TRUE(memcmp(fits + 9 * 80, "BAYERPAT= 'RGGB'", 15) == 0);
	ASSERT_TRUE(memcmp(fits + 10 * 80, "EXPTIME = 1.5", 13) == 0);
	free(raw);
	free(fits);
}

static void embedded_metadata_can_span_records(void) {
	char extension[4096] = "SIMPLE=T;";
	for (int i = 0; i < 100; i++) {
		strcat(extension, "EXPTIME=1.5;");
	}
	char *raw = raw_image("RAW3", 1, 1, 3, extension, strlen(extension));
	char *fits = NULL;
	int size = 0;
	ASSERT_EQ_INT(INDIGO_OK, indigo_raw_to_fits(raw, 15 + strlen(extension), &fits, &size, NULL));
	ASSERT_TRUE(memcmp(fits + 111 * 80, "END", 3) == 0);
	ASSERT_EQ_INT(5 * FITS_RECORD_SIZE, size);
	ASSERT_EQ_INT(42, fits[4 * FITS_RECORD_SIZE]);
	free(raw);
	free(fits);
}

static void malformed_and_oversized_cards_are_rejected(void) {
	const char *extensions[] = { "SIMPLE=T;X;", "SIMPLE=T;BAYERPAT='unterminated;", "SIMPLE=T;BAYERPAT='RGGB'", "SIMPLE=T;TOOLONGNAME=1;" };
	for (size_t i = 0; i < sizeof(extensions) / sizeof(extensions[0]); i++) {
		char *raw = raw_image("RAW1", 1, 1, 1, extensions[i], strlen(extensions[i]));
		char *fits = NULL;
		int size = 0;
		ASSERT_EQ_INT(INDIGO_FAILED, indigo_raw_to_fits(raw, 13 + strlen(extensions[i]), &fits, &size, NULL));
		ASSERT_TRUE(fits == NULL);
		free(raw);
	}
	char text[4096];
	memset(text, 'a', sizeof(text) - 1);
	text[sizeof(text) - 1] = 0;
	indigo_fits_keyword keywords[] = { { .type = INDIGO_FITS_STRING, .name = "OBJECT", .string = text, .comment = "object" }, { 0 } };
	char *raw = raw_image("RAW1", 1, 1, 1, NULL, 0);
	char *fits = NULL;
	int size = 0;
	ASSERT_EQ_INT(INDIGO_FAILED, indigo_raw_to_fits(raw, 13, &fits, &size, keywords));
	ASSERT_TRUE(fits == NULL);
	keywords[0] = (indigo_fits_keyword){ .type = INDIGO_FITS_NUMBER, .name = text, .number = 1 };
	ASSERT_EQ_INT(INDIGO_FAILED, indigo_raw_to_fits(raw, 13, &fits, &size, keywords));
	free(raw);
}

static void exact_card_capacity_and_padding_are_preserved(void) {
	char value[72];
	memset(value, 'x', 70);
	value[70] = 0;
	char extension[96];
	snprintf(extension, sizeof(extension), "SIMPLE=T;OBJECT=%s;", value);
	char *raw = raw_image("RAW1", 1, 1, 1, extension, strlen(extension));
	char *fits = NULL;
	int size = 0;
	ASSERT_EQ_INT(INDIGO_OK, indigo_raw_to_fits(raw, 13 + strlen(extension), &fits, &size, NULL));
	ASSERT_TRUE(memcmp(fits + 6 * 80, "OBJECT  = ", 10) == 0);
	ASSERT_TRUE(memcmp(fits + 6 * 80 + 10, value, 70) == 0);
	for (int i = FITS_RECORD_SIZE + 1; i < size; i++) {
		ASSERT_EQ_INT(0, fits[i]);
	}
	free(raw);
	value[70] = 'x';
	value[71] = 0;
	snprintf(extension, sizeof(extension), "SIMPLE=T;OBJECT=%s;", value);
	raw = raw_image("RAW1", 1, 1, 1, extension, strlen(extension));
	char *previous = fits;
	ASSERT_EQ_INT(INDIGO_FAILED, indigo_raw_to_fits(raw, 13 + strlen(extension), &fits, &size, NULL));
	ASSERT_TRUE(fits == previous);
	ASSERT_EQ_INT(2 * FITS_RECORD_SIZE, size);
	ASSERT_EQ_INT(42, fits[FITS_RECORD_SIZE]);
	free(raw);
	free(fits);
}

static void combined_metadata_and_keyword_types_are_preserved(void) {
	const char extension[] = "SIMPLE=T;GAIN=2;";
	char *raw = raw_image("RAW1", 1, 1, 1, extension, sizeof(extension));
	indigo_fits_keyword keywords[31] = { 0 };
	for (int i = 0; i < 28; i++) {
		keywords[i] = (indigo_fits_keyword){ .type = INDIGO_FITS_NUMBER, .name = "EXPTIME", .number = 1.5, .comment = NULL };
	}
	keywords[28] = (indigo_fits_keyword){ .type = INDIGO_FITS_LOGICAL, .name = "TEST", .logical = true, .comment = "flag" };
	keywords[29] = (indigo_fits_keyword){ .type = INDIGO_FITS_STRING, .name = "OBJECT", .string = "M31", .comment = "object" };
	char *fits = NULL;
	int size = 0;
	ASSERT_EQ_INT(INDIGO_OK, indigo_raw_to_fits(raw, 13 + sizeof(extension), &fits, &size, keywords));
	ASSERT_TRUE(memcmp(fits + 34 * 80, "TEST    =                    T / flag", 37) == 0);
	ASSERT_TRUE(memcmp(fits + 35 * 80, "OBJECT  = 'M31'", 15) == 0);
	ASSERT_TRUE(memcmp(fits + 36 * 80, "GAIN    = 2", 11) == 0);
	ASSERT_EQ_INT(3 * FITS_RECORD_SIZE, size);
	ASSERT_EQ_INT(42, fits[2 * FITS_RECORD_SIZE]);
	free(raw);
	free(fits);
}

int main(void) {
	const indigo_test_case tests[] = {
		{ "exact_card_capacity_and_padding_are_preserved", exact_card_capacity_and_padding_are_preserved },
		{ "combined_metadata_and_keyword_types_are_preserved", combined_metadata_and_keyword_types_are_preserved },
		{ "short_headers_are_rejected", short_headers_are_rejected },
		{ "invalid_arguments_and_dimensions_preserve_output", invalid_arguments_and_dimensions_preserve_output },
		{ "all_component_payloads_are_required", all_component_payloads_are_required },
		{ "pixel_formats_remain_correct", pixel_formats_remain_correct },
		{ "unaligned_input_is_supported", unaligned_input_is_supported },
		{ "header_record_boundaries_preserve_pixels", header_record_boundaries_preserve_pixels },
		{ "embedded_rgb_metadata_follows_full_payload", embedded_rgb_metadata_follows_full_payload },
		{ "embedded_metadata_can_span_records", embedded_metadata_can_span_records },
		{ "malformed_and_oversized_cards_are_rejected", malformed_and_oversized_cards_are_rejected }
	};
	return indigo_run_tests("RAW to FITS unit tests", tests, sizeof(tests) / sizeof(tests[0]));
}
