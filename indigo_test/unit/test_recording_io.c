// Copyright (c) 2026 INDIGO initiative
// All rights reserved.
//
// You may use this software under the terms of 'INDIGO Astronomy
// open-source license' (see LICENSE.md).
//
// THIS SOFTWARE IS PROVIDED BY THE AUTHORS 'AS IS' AND ANY EXPRESS
// OR IMPLIED WARRANTIES, INCLUDING, BUT NOT LIMITED TO, THE IMPLIED
// WARRANTIES OF MERCHANTABILITY AND FITNESS FOR A PARTICULAR PURPOSE
// ARE DISCLAIMED. IN NO EVENT SHALL THE AUTHOR BE LIABLE FOR ANY
// DIRECT, INDIRECT, INCIDENTAL, SPECIAL, EXEMPLARY, OR CONSEQUENTIAL
// DAMAGES (INCLUDING, BUT NOT LIMITED TO, PROCUREMENT OF SUBSTITUTE
// GOODS OR SERVICES; LOSS OF USE, DATA, OR PROFITS; OR BUSINESS
// INTERRUPTION) HOWEVER CAUSED AND ON ANY THEORY OF LIABILITY,
// WHETHER IN CONTRACT, STRICT LIABILITY, OR TORT (INCLUDING
// NEGLIGENCE OR OTHERWISE) ARISING IN ANY WAY OUT OF THE USE OF THIS
// SOFTWARE, EVEN IF ADVISED OF THE POSSIBILITY OF SUCH DAMAGE.

// Code is generated by AI

// AVI and SER writers must treat failed I/O (-1) and short writes as failures,
// and count a frame only after it is completely written.

#include <errno.h>
#include <stdio.h>
#include <stdlib.h>
#include <string.h>
#include <unistd.h>

#include <indigo/indigo_bus.h>
#include <indigo/indigo_io.h>
#include <indigo/indigo_avi.h>
#include <indigo/indigo_ser.h>
#include <indigo/indigo_raw_utils.h>

#include "../test_runner.h"

static char recording_path[2048];

static const char *recording_file(const char *name) {
	snprintf(recording_path, sizeof(recording_path), "%s/%s", indigo_test_home, name);
	return recording_path;
}

static long file_size(const char *path) {
	FILE *file = fopen(path, "rb");
	if (file == NULL) {
		return -1;
	}
	fseek(file, 0, SEEK_END);
	long size = ftell(file);
	fclose(file);
	return size;
}

static uint32_t read_le32(const char *path, long offset) {
	unsigned char buffer[4] = { 0 };
	FILE *file = fopen(path, "rb");
	if (file != NULL) {
		fseek(file, offset, SEEK_SET);
		if (fread(buffer, 1, 4, file) != 4) {
			memset(buffer, 0, sizeof(buffer));
		}
		fclose(file);
	}
	return buffer[0] | buffer[1] << 8 | buffer[2] << 16 | (uint32_t)buffer[3] << 24;
}

/* replace the writer's file descriptor by the write end of a pipe, so writes succeed and seeks fail */
static int replace_with_pipe(indigo_uni_handle *handle) {
	int pipe_fds[2];
	if (pipe(pipe_fds) != 0) {
		return -1;
	}
	int result = dup2(pipe_fds[1], handle->fd) == handle->fd ? pipe_fds[0] : -1;
	close(pipe_fds[1]);
	if (result < 0) {
		close(pipe_fds[0]);
	}
	return result;
}

#define SER_WIDTH 16
#define SER_HEIGHT 16

typedef struct {
	indigo_raw_header header;
	uint8_t pixels[SER_WIDTH * SER_HEIGHT];
} ser_frame;

static void ser_frame_write_failure_is_not_counted(void) {
	ser_frame frame = { { INDIGO_RAW_MONO8, SER_WIDTH, SER_HEIGHT }, { 0 } };
	const char *path = recording_file("failure.ser");
	indigo_ser *ser = indigo_ser_open(path, &frame);
	ASSERT_TRUE(ser != NULL);
	ASSERT_TRUE(indigo_ser_add_frame(ser, &frame));
	ASSERT_EQ_INT(1, ser->count);
	/* a failed write returns -1, which must not be reported as success */
	ser->handle->last_error = EIO;
	ASSERT_FALSE(indigo_ser_add_frame(ser, &frame));
	ASSERT_EQ_INT(1, ser->count);
	ASSERT_FALSE(indigo_ser_close(ser));
}

static void ser_close_seek_failure_is_reported(void) {
	ser_frame frame = { { INDIGO_RAW_MONO8, SER_WIDTH, SER_HEIGHT }, { 0 } };
	const char *path = recording_file("seek.ser");
	indigo_ser *ser = indigo_ser_open(path, &frame);
	ASSERT_TRUE(ser != NULL);
	ASSERT_TRUE(indigo_ser_add_frame(ser, &frame));
	int pipe_read = replace_with_pipe(ser->handle);
	ASSERT_TRUE(pipe_read >= 0);
	ASSERT_FALSE(indigo_ser_close(ser));
	close(pipe_read);
}

static void ser_complete_recording_counts_frames(void) {
	ser_frame frame = { { INDIGO_RAW_MONO8, SER_WIDTH, SER_HEIGHT }, { 0 } };
	const char *path = recording_file("complete.ser");
	indigo_ser *ser = indigo_ser_open(path, &frame);
	ASSERT_TRUE(ser != NULL);
	for (int i = 0; i < 3; i++) {
		ASSERT_TRUE(indigo_ser_add_frame(ser, &frame));
	}
	ASSERT_TRUE(indigo_ser_close(ser));
	ASSERT_EQ_INT(178 + 3 * SER_WIDTH * SER_HEIGHT, file_size(path));
	ASSERT_EQ_INT(3, read_le32(path, 38));
}

#define AVI_FRAME_SIZE 258

static void avi_frame_write_failure_is_not_counted(void) {
	unsigned char frame[AVI_FRAME_SIZE] = { 0 };
	struct gwavi_t *avi = gwavi_open(recording_file("failure.avi"), 16, 16, "MJPG", 5);
	ASSERT_TRUE(avi != NULL);
	ASSERT_TRUE(gwavi_add_frame(avi, frame, sizeof(frame)));
	ASSERT_EQ_INT(1, avi->offset_count);
	ASSERT_EQ_INT(1, avi->offsets_ptr);
	ASSERT_EQ_INT(1, avi->stream_header.data_length);
	avi->handle->last_error = EIO;
	ASSERT_FALSE(gwavi_add_frame(avi, frame, sizeof(frame)));
	ASSERT_EQ_INT(1, avi->offset_count);
	ASSERT_EQ_INT(1, avi->offsets_ptr);
	ASSERT_EQ_INT(1, avi->stream_header.data_length);
	ASSERT_FALSE(gwavi_close(avi));
}

static void avi_close_seek_failure_is_reported(void) {
	unsigned char frame[AVI_FRAME_SIZE] = { 0 };
	struct gwavi_t *avi = gwavi_open(recording_file("seek.avi"), 16, 16, "MJPG", 5);
	ASSERT_TRUE(avi != NULL);
	ASSERT_TRUE(gwavi_add_frame(avi, frame, sizeof(frame)));
	int pipe_read = replace_with_pipe(avi->handle);
	ASSERT_TRUE(pipe_read >= 0);
	ASSERT_FALSE(gwavi_close(avi));
	close(pipe_read);
}

static void avi_complete_recording_grows_offsets_table(void) {
	unsigned char frame[AVI_FRAME_SIZE] = { 0 };
	const char *path = recording_file("complete.avi");
	struct gwavi_t *avi = gwavi_open(path, 16, 16, "MJPG", 5);
	ASSERT_TRUE(avi != NULL);
	/* more frames than the initial 1024 entry offsets table */
	const int frames = 1100;
	for (int i = 0; i < frames; i++) {
		ASSERT_TRUE(gwavi_add_frame(avi, frame, sizeof(frame)));
	}
	ASSERT_EQ_INT(frames, avi->offset_count);
	ASSERT_TRUE(avi->offsets_len > frames);
	ASSERT_TRUE(gwavi_close(avi));
	long size = file_size(path);
	ASSERT_EQ_INT(size - 8, read_le32(path, 4));
	/* the idx1 chunk holds one 16 byte record per frame and ends the file */
	ASSERT_EQ_INT(16 * frames, read_le32(path, size - 16 * frames - 4));
	/* frame count in the main AVI header */
	ASSERT_EQ_INT(frames, read_le32(path, 48));
}

int main(void) {
	if (!indigo_test_use_private_home()) {
		return 1;
	}
	const indigo_test_case tests[] = {
		{ "ser_frame_write_failure_is_not_counted", ser_frame_write_failure_is_not_counted },
		{ "ser_close_seek_failure_is_reported", ser_close_seek_failure_is_reported },
		{ "ser_complete_recording_counts_frames", ser_complete_recording_counts_frames },
		{ "avi_frame_write_failure_is_not_counted", avi_frame_write_failure_is_not_counted },
		{ "avi_close_seek_failure_is_reported", avi_close_seek_failure_is_reported },
		{ "avi_complete_recording_grows_offsets_table", avi_complete_recording_grows_offsets_table }
	};
	int result = indigo_run_tests("AVI and SER recording I/O", tests, (int)(sizeof(tests) / sizeof(tests[0])));
	indigo_test_remove_private_home();
	return result;
}
