// USB_Focus v3 serial simulator
//
// Copyright (c) 2026 CloudMakers, s. r. o.
// All rights reserved.
//
// You can use this software under the terms of 'INDIGO Astronomy
// open-source license' (see LICENSE.md).
//
// This source file was generated by a Codex agent.

#define _DEFAULT_SOURCE
#define _XOPEN_SOURCE 600

#include <errno.h>
#include <signal.h>
#include <stdbool.h>
#include <stdio.h>
#include <stdlib.h>
#include <string.h>
#include <unistd.h>

#include "../../../indigo_test/simulator_common/serial_simulator_common.h"
#include "../../../indigo_test/simulator_common/serial_motion.h"

#define COMMAND_LENGTH 6

typedef struct {
	bool headless;
	bool trace;
	const char *ready_file;
	const char *profile;
} simulator_options;

static simulator_options options = {
	.headless = false,
	.trace = true,
	.profile = "normal",
	.ready_file = NULL
};

static const char *simulator_name = "focuser_usbv3";
static volatile sig_atomic_t running = 1;
static int serial_fd = -1;
static int position = 1000;
static serial_motion motion = { .position = 1000, .target = 1000 };
static int target_position = 1000;
static int max_position = 65535;
static int direction = 0;
static int stepmode = 0;
static int speed = 4;
static int steps_per_degree = 10;
static int threshold = 1;
static int firmware = 305;
static bool moving = false;
static bool automatic = false;
static double temperature = 22.5;
static const char *identity = "UFO";
static bool report_config = true;
static FILE *events = NULL;

static void usage(const char *name) {
	printf("USB_Focus v3 serial simulator\n");
	printf("Usage: %s [OPTIONS]\n", name);
	printf("  --headless              Disable terminal-oriented output\n");
	printf("  --ready-file <path>     Write INDIGO_SIMULATOR_PORT after PTY setup\n");
	printf("  --trace                 Log protocol requests and replies\n");
	printf("  --profile <name>        normal, configured, no-handshake, bad-config or\n");
	printf("                          external-motion, default is normal\n");
	printf("  -h, --help              Show this help and exit\n");
	printf("\n");
	printf("INDIGO_USBV3_EVENTS names a file receiving every accepted request, one per line.\n");
	printf("INDIGO_USBV3_FAULT names a file holding '<command prefix> <silent|garbage|close>'\n");
	printf("which is applied once to the next matching request and then removed.\n");
}

static void signal_handler(int sig) {
	(void)sig;
	running = 0;
	if (serial_fd >= 0) {
		close(serial_fd);
		serial_fd = -1;
	}
}

static bool parse_args(int argc, char *argv[]) {
	for (int i = 1; i < argc; i++) {
		if (!strcmp(argv[i], "-h") || !strcmp(argv[i], "--help")) {
			usage(argv[0]);
			exit(0);
		} else if (!strcmp(argv[i], "--headless")) {
			options.headless = true;
			options.trace = false;
		} else if (!strcmp(argv[i], "--trace")) {
			options.trace = true;
		} else if (!strcmp(argv[i], "--ready-file")) {
			if (++i == argc) {
				fprintf(stderr, "--ready-file requires a path\n");
				return false;
			}
			options.ready_file = argv[i];
		} else if (!strcmp(argv[i], "--profile")) {
			if (++i == argc) {
				fprintf(stderr, "--profile requires a name\n");
				return false;
			}
			options.profile = argv[i];
		} else {
			fprintf(stderr, "Unknown option '%s'\n", argv[i]);
			return false;
		}
	}
	return true;
}

static void send_line(const char *line) {
	if (options.trace) {
		fprintf(stderr, "-> %s\n", line);
	}
	serial_simulator_write_all(serial_fd, line, strlen(line));
	serial_simulator_write_all(serial_fd, "\n", 1);
}

static int parse_suffix(const char *command) {
	return atoi(command + 1);
}

static void clamp_position(void) {
	if (target_position < 0) {
		target_position = 0;
	} else if (target_position > max_position) {
		target_position = max_position;
	}
}

// The controller state a scenario needs is selected once at startup, so a
// connecting driver reads back exactly the configuration under test.
static void apply_profile(void) {
	if (!strcmp(options.profile, "configured")) {
		direction = 1;
		stepmode = 1;
		speed = 7;
		steps_per_degree = -25;
		threshold = 3;
		firmware = 310;
		max_position = 30000;
		position = target_position = 5000;
		serial_motion_sync(&motion, position);
	} else if (!strcmp(options.profile, "no-handshake")) {
		identity = "XXX";
	} else if (!strcmp(options.profile, "bad-config")) {
		report_config = false;
	} else if (!strcmp(options.profile, "external-motion")) {
		target_position = 1200;
		serial_motion_start(&motion, target_position, 500);
		moving = true;
	}
}

// One-shot fault injection. The control file names a command prefix and the way
// the next matching request has to misbehave, so a test can fail exactly one
// transaction without disturbing the rest of the session.
static const char *pending_fault(const char *command) {
	static char action[32];
	const char *path = getenv("INDIGO_USBV3_FAULT");
	if (path == NULL) {
		return NULL;
	}
	FILE *file = fopen(path, "r");
	if (file == NULL) {
		return NULL;
	}
	char prefix[32] = { 0 };
	action[0] = '\0';
	bool matched = fscanf(file, "%31s %31s", prefix, action) == 2 && !strncmp(command, prefix, strlen(prefix));
	fclose(file);
	if (!matched) {
		return NULL;
	}
	unlink(path);
	return action;
}

static void handle_command(const char *command) {
	position = (int)serial_motion_update(&motion);
	char response[128] = { 0 };

	if (options.trace) {
		fprintf(stderr, "<- %s\n", command);
	}
	if (events != NULL) {
		fprintf(events, "%s\n", command);
		fflush(events);
	}
	const char *fault = pending_fault(command);
	if (fault != NULL) {
		if (!strcmp(fault, "close")) {
			running = 0;
			if (serial_fd >= 0) {
				close(serial_fd);
				serial_fd = -1;
			}
			return;
		}
		if (!strcmp(fault, "silent")) {
			return;
		}
		if (!strcmp(fault, "garbage")) {
			send_line("ERR");
			return;
		}
	}
	if (!strcmp(command, "SWHOIS")) {
		send_line(identity);
	} else if (!strcmp(command, "SGETAL")) {
		if (report_config) {
			snprintf(response, sizeof(response), "C=%d-%d-%d-%d-%d-%d-%d", direction, stepmode, speed, abs(steps_per_degree), threshold, firmware, max_position);
		} else {
			snprintf(response, sizeof(response), "ERR");
		}
		send_line(response);
	} else if (!strcmp(command, "FPOSRO")) {
		if (moving && motion.duration == 0) {
			moving = false;
			send_line("*");
		}
		snprintf(response, sizeof(response), "P=%d", position);
		send_line(response);
	} else if (!strcmp(command, "FTMPRO")) {
		snprintf(response, sizeof(response), "T=%.1f", temperature);
		send_line(response);
	} else if (!strcmp(command, "FMANUA")) {
		automatic = false;
		snprintf(response, sizeof(response), "P=%d", position);
		send_line(response);
	} else if (!strcmp(command, "FAUTOM")) {
		automatic = true;
		(void)automatic;
		send_line("A=1");
	} else if (!strcmp(command, "FTxxxA")) {
		send_line(steps_per_degree < 0 ? "A=0" : "A=1");
	} else if (!strncmp(command, "FLX", 3)) {
		steps_per_degree = atoi(command + 3);
		send_line("OK");
	} else if (!strncmp(command, "FZSIG", 5)) {
		if (command[5] == '0' && steps_per_degree > 0) {
			steps_per_degree = -steps_per_degree;
		} else if (command[5] == '1' && steps_per_degree < 0) {
			steps_per_degree = -steps_per_degree;
		}
		send_line("OK");
	} else if (!strncmp(command, "SMA", 3)) {
		threshold = atoi(command + 3);
		send_line("OK");
	} else if (!strcmp(command, "SMSTPF")) {
		stepmode = 0;
	} else if (!strcmp(command, "SMSTPD")) {
		stepmode = 1;
	} else if (!strncmp(command, "SMO", 3)) {
		speed = atoi(command + 3);
	} else if (!strncmp(command, "O", 1)) {
		target_position = position + parse_suffix(command);
		clamp_position();
		serial_motion_start(&motion, target_position, 1000);
		moving = true;
	} else if (!strncmp(command, "I", 1)) {
		target_position = position - parse_suffix(command);
		clamp_position();
		serial_motion_start(&motion, target_position, 1000);
		moving = true;
	} else if (!strncmp(command, "M", 1)) {
		max_position = parse_suffix(command);
		if (max_position < 0) {
			max_position = 0;
		}
		clamp_position();
	} else if (!strcmp(command, "FQUITx")) {
		serial_motion_stop(&motion);
		target_position = position;
		moving = false;
		send_line("*");
	}
}

static void run_protocol_loop(void) {
	char buffer[COMMAND_LENGTH + 1] = { 0 };
	size_t length = 0;

	while (running) {
		char c = '\0';
		ssize_t bytes_read = read(serial_fd, &c, 1);
		if (bytes_read < 0) {
			if (errno == EINTR) {
				continue;
			}
			if (errno == EAGAIN || errno == EWOULDBLOCK || errno == EIO) {
				usleep(1000);
				continue;
			}
			perror("read");
			break;
		}
		if (bytes_read == 0) {
			continue;
		}
		if (c == '\r' || c == '\n') {
			continue;
		}
		buffer[length++] = c;
		if (length == COMMAND_LENGTH) {
			buffer[length] = '\0';
			handle_command(buffer);
			length = 0;
			buffer[0] = '\0';
		}
	}
}

int main(int argc, char *argv[]) {
	char port[256] = { 0 };

	if (!parse_args(argc, argv)) {
		return 1;
	}
	apply_profile();
	const char *journal = getenv("INDIGO_USBV3_EVENTS");
	events = journal == NULL ? NULL : fopen(journal, "w");
	signal(SIGTERM, signal_handler);
	signal(SIGINT, signal_handler);

	serial_fd = serial_simulator_open_pty(port, sizeof(port));
	if (serial_fd < 0) {
		return 1;
	}
	if (options.ready_file != NULL && !serial_simulator_write_ready_file(options.ready_file, simulator_name, port)) {
		close(serial_fd);
		return 1;
	}
	if (!options.headless) {
		printf("USB_Focus v3 simulator ready on %s\n", port);
	}

	run_protocol_loop();
	if (serial_fd >= 0) {
		close(serial_fd);
	}
	if (events != NULL) {
		fclose(events);
	}
	return 0;
}
