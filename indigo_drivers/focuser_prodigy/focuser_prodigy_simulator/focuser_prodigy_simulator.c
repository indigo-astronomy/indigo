// PegasusAstro Prodigy Microfocuser serial simulator
//
// Copyright (c) 2026 CloudMakers, s. r. o.
// All rights reserved.
//
// You can use this software under the terms of 'INDIGO Astronomy
// open-source license' (see LICENSE.md).
//
// This source file was generated by a Codex agent.

#define _DEFAULT_SOURCE
#define _XOPEN_SOURCE 600

#include <errno.h>
#include <signal.h>
#include <stdbool.h>
#include <stdio.h>
#include <stdlib.h>
#include <string.h>
#include <unistd.h>

#include "../../../indigo_test/simulator_common/serial_simulator_common.h"

#include "../../../indigo_test/simulator_common/serial_motion.h"

#define COMMAND_LENGTH 256

typedef struct {
	bool headless;
	bool trace;
	const char *ready_file;
} simulator_options;

static simulator_options options = {
	.headless = false,
	.trace = true,
	.ready_file = NULL
};

static const char *simulator_name = "focuser_prodigy";
static volatile sig_atomic_t running = 1;
static int serial_fd = -1;
static int position = 50;
static serial_motion motion;
static bool stalled;
static const char *profile = "normal";
static FILE *events;
static double reboot_until;
static int speed = 400;
static int backlash = 100;
static double temperature = 22.4;
static bool power_1 = false;
static bool power_2 = false;
static bool usb_1 = false;
static bool usb_2 = false;

static void usage(const char *name) {
	printf("PegasusAstro Prodigy Microfocuser serial simulator\n");
	printf("Usage: %s [OPTIONS]\n", name);
	printf("  --headless              Disable terminal-oriented output\n");
	printf("  --ready-file <path>     Write INDIGO_SIMULATOR_PORT after PTY setup\n");
	printf("  --trace                 Log protocol requests and replies\n");
	printf("  -h, --help              Show this help and exit\n");
}

static void signal_handler(int sig) {
	(void)sig;
	running = 0;
	if (serial_fd >= 0) {
		close(serial_fd);
		serial_fd = -1;
	}
}

static bool parse_args(int argc, char *argv[]) {
	for (int i = 1; i < argc; i++) {
		if (!strcmp(argv[i], "-h") || !strcmp(argv[i], "--help")) {
			usage(argv[0]);
			exit(0);
		} else if (!strcmp(argv[i], "--headless")) {
			options.headless = true;
			options.trace = false;
		} else if (!strcmp(argv[i], "--trace")) {
			options.trace = true;
		} else if (!strcmp(argv[i], "--profile") && i + 1 < argc) {
			profile = argv[++i];
		} else if (!strcmp(argv[i], "--ready-file")) {
			if (++i == argc) {
				fprintf(stderr, "--ready-file requires a path\n");
				return false;
			}
			options.ready_file = argv[i];
		} else {
			fprintf(stderr, "Unknown option '%s'\n", argv[i]);
			return false;
		}
	}
	return true;
}

static void send_line(const char *line) {
	serial_simulator_trace_line(false, "TX", line);
	if (options.trace) {
		fprintf(stderr, "-> %s\n", line);
	}
	if (!strcmp(profile, "split") && strlen(line) > 1) {
		serial_simulator_write_all(serial_fd, line, 1);
		usleep(20000);
		line++;
	}
	serial_simulator_write_all(serial_fd, line, strlen(line));
	serial_simulator_write_all(serial_fd, "\n", 1);
}

static void start_motion(int target) {
	serial_motion_start(&motion, target, 100000);
}

static bool is_moving(void) {
	return motion.duration > 0;
}

static void handle_command(const char *command) {
	char response[COMMAND_LENGTH] = { 0 }, action[256] = { 0 }, key[64];
	position = (int)(stalled ? motion.position : serial_motion_update(&motion));
	if (events) {
		fprintf(events, "%s\n", command);
		fflush(events);
	}
	const char *fault = getenv("INDIGO_PRODIGY_FAULT");
	FILE *file = fault ? fopen(fault, "r") : NULL;
	if (file) {
		if (fscanf(file, "%63s %255[^\n]", key, action) != 2 || strcmp(key, command)) {
			action[0] = 0;
		} else {
			unlink(fault);
		}
		fclose(file);
	}
	if (!strncmp(profile, "init_", 5) && command[0] == profile[5]) {
		strcpy(action, profile + 7);
		profile = "normal";
	}
	if (!strcmp(action, "close")) {
		running = 0;
		return;
	}
	if (!strcmp(action, "silent") || serial_motion_time() < reboot_until) {
		return;
	}
	if (!strcmp(action, "overlong")) {
		memset(response, '9', sizeof(response) - 1);
		send_line(response);
		return;
	}
	if (!strcmp(action, "partial")) {
		serial_simulator_write_all(serial_fd, "123", 3);
		return;
	}
	if (!strncmp(action, "reply=", 6)) {
		send_line(action + 6);
		return;
	}
	if (!strncmp(action, "position=", 9)) {
		serial_motion_sync(&motion, atoi(action + 9));
		position = (int)motion.position;
	}
	if (!strncmp(action, "temp=", 5)) {
		temperature = atof(action + 5);
	}
	if (!strcmp(action, "reject")) {
		send_line("ERR");
		return;
	}
	if (!strcmp(action, "ignore")) {
		send_line(command);
		return;
	}
	stalled = !strcmp(action, "stall") || stalled;

	if (options.trace) {
		fprintf(stderr, "<- %s\n", command);
	}
	if (!strcmp(command, "#")) {
		send_line("OK_PRDG");
	} else if (!strcmp(command, "A")) {
		snprintf(response, sizeof(response), "OK_PRDG:%s:1:%.1f:%d:%d:0:0:0:%d", !strcmp(profile, "firmware_minor") ? "1.10" : "1.4", temperature, position, is_moving() ? 1 : 0, backlash);
		send_line(response);
	} else if (!strcmp(command, "D")) {
		snprintf(response, sizeof(response), "D:%d:%d:%d:%d", power_1 ? 1 : 0, power_2 ? 1 : 0, usb_1 ? 1 : 0, usb_2 ? 1 : 0);
		send_line(response);
	} else if (!strcmp(command, "B")) {
		snprintf(response, sizeof(response), "B:%d", speed);
		send_line(response);
	} else if (!strncmp(command, "S:", 2)) {
		speed = atoi(command + 2);
		(void)speed;
		send_line(command);
	} else if (!strncmp(command, "G:", 2)) {
		start_motion(position + atoi(command + 2));
		send_line(command);
	} else if (!strncmp(command, "M:", 2)) {
		start_motion(atoi(command + 2));
		send_line(command);
	} else if (!strncmp(command, "W:", 2)) {
		serial_motion_sync(&motion, atoi(command + 2));
		stalled = false;
		send_line(command);
	} else if (!strcmp(command, "H")) {
		if (!stalled) {
			serial_motion_stop(&motion);
		} else {
			serial_motion_sync(&motion, motion.position);
		}
		stalled = false;
		send_line("0");
	} else if (!strncmp(command, "C:", 2)) {
		backlash = atoi(command + 2);
		send_line(command);
	} else if (!strcmp(command, "T")) {
		snprintf(response, sizeof(response), "%.1f", temperature);
		send_line(response);
	} else if (!strcmp(command, "P")) {
		snprintf(response, sizeof(response), "%d", position);
		send_line(response);
	} else if (!strcmp(command, "I")) {
		send_line(is_moving() ? "1" : "0");
	} else if (!strcmp(command, "Z")) {
		start_motion(0);
		send_line("Z:1");
	} else if (!strncmp(command, "U:", 2)) {
		usb_1 = atoi(command + 2) != 0;
		send_line(command);
	} else if (!strncmp(command, "J:", 2)) {
		usb_2 = atoi(command + 2) != 0;
		send_line(command);
	} else if (!strncmp(command, "X:", 2)) {
		power_1 = atoi(command + 2) != 0;
		send_line(command);
	} else if (!strncmp(command, "Y:", 2)) {
		power_2 = atoi(command + 2) != 0;
		send_line(command);
	} else if (!strcmp(command, "Q")) {
		reboot_until = serial_motion_time() + (!strcmp(action, "rebootstall") ? 60 : 0.7);
	}
}

static void run_protocol_loop(void) {
	char buffer[COMMAND_LENGTH] = { 0 };
	size_t length = 0;
	while (running) {
		if (!stalled) {
			serial_motion_update(&motion);
		}
		char c = '\0';
		ssize_t bytes_read = read(serial_fd, &c, 1);
		if (bytes_read < 0) {
			if (errno == EINTR) {
				continue;
			}
			if (errno == EAGAIN || errno == EWOULDBLOCK || errno == EIO) {
				usleep(1000);
				continue;
			}
			perror("read");
			break;
		}
		if (bytes_read == 0) {
			continue;
		}
		if (c == '\r') {
			continue;
		}
		if (c == '\n') {
			if (length > 0) {
				buffer[length] = '\0';
				handle_command(buffer);
				length = 0;
				buffer[0] = '\0';
			}
			continue;
		}
		if (length < sizeof(buffer) - 1) {
			buffer[length++] = c;
		} else {
			length = 0;
			buffer[0] = '\0';
		}
	}
}

int main(int argc, char *argv[]) {
	char port[256] = { 0 };
	if (!parse_args(argc, argv)) {
		return 1;
	}
	serial_motion_sync(&motion, !strcmp(profile, "alternate") ? 500 : 50);
	const char *journal = getenv("INDIGO_PRODIGY_EVENTS");
	events = journal ? fopen(journal, "w") : NULL;
	signal(SIGTERM, signal_handler);
	signal(SIGINT, signal_handler);
	serial_fd = serial_simulator_open_pty(port, sizeof(port));
	if (serial_fd < 0) {
		return 1;
	}
	if (options.ready_file != NULL && !serial_simulator_write_ready_file(options.ready_file, simulator_name, port)) {
		close(serial_fd);
		return 1;
	}
	if (!options.headless) {
		printf("PegasusAstro Prodigy Microfocuser simulator ready on %s\n", port);
	}
	run_protocol_loop();
	if (events) {
		fclose(events);
	}
	if (serial_fd >= 0) {
		close(serial_fd);
	}
	return 0;
}
