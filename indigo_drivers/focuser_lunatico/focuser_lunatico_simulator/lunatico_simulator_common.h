// Copyright (c) 2026 INDIGO initiative
// All rights reserved.
//
// You may use this software under the terms of 'INDIGO Astronomy
// open-source license' (see LICENSE.md).
//
// THIS SOFTWARE IS PROVIDED BY THE AUTHORS 'AS IS' AND ANY EXPRESS
// OR IMPLIED WARRANTIES, INCLUDING, BUT NOT LIMITED TO, THE IMPLIED
// WARRANTIES OF MERCHANTABILITY AND FITNESS FOR A PARTICULAR PURPOSE
// ARE DISCLAIMED. IN NO EVENT SHALL THE AUTHOR BE LIABLE FOR ANY
// DIRECT, INDIRECT, INCIDENTAL, SPECIAL, EXEMPLARY, OR CONSEQUENTIAL
// DAMAGES (INCLUDING, BUT NOT LIMITED TO, PROCUREMENT OF SUBSTITUTE
// GOODS OR SERVICES; LOSS OF USE, DATA, OR PROFITS; OR BUSINESS
// INTERRUPTION) HOWEVER CAUSED AND ON ANY THEORY OF LIABILITY,
// WHETHER IN CONTRACT, STRICT LIABILITY, OR TORT (INCLUDING
// NEGLIGENCE OR OTHERWISE) ARISING IN ANY WAY OUT OF THE USE OF THIS
// SOFTWARE, EVEN IF ADVISED OF THE POSSIBILITY OF SUCH DAMAGE.

// Code is generated by AI

// Lunatico Astronomia Limpet / Seletek / Armadillo / Platypus controller
// simulator, shared by the focuser_lunatico and rotator_lunatico simulator
// executables exactly as shared/lunatico_shared.c is shared by the two
// drivers.
//
// Protocol sources:
//   SLP framing, the !seletek version:<MOPFF> encoding and the documented
//   subset of the step group (goto, stop, getpos, setpos, ismoving):
//     https://lunaticoastro.com/slp_docs/data/commands.json
//   The public catalogue does not document gopr, halfstep, wiremode, model,
//   movepow, stoppow, speedrangeus, setswlimits, delswlimits, read temps,
//   read an or write dig, all of which the driver issues. Their request form,
//   argument ranges and ":0#" / ":-1#" reply convention are taken from the
//   driver itself and from the author's reference simulator for the same SLP
//   family, ../../aux_dragonfly/relio_simulator/relio_simulator.pl.
//   DB9 pin assignment and the horizontal pin flip: ../README.md.

#ifndef LUNATICO_SIMULATOR_COMMON_H
#define LUNATICO_SIMULATOR_COMMON_H

#ifndef SIM_UDP
#define SIM_UDP 0
#endif
#define SIM_TERMINATOR '#'
#include "../../../indigo_test/simulator_common/aux_simulator_common.h"
#include "../../../indigo_test/simulator_common/serial_motion.h"
#include <math.h>

#define LUNATICO_PORTS           3
#define LUNATICO_PINS            10

// Model digit of !seletek version:<MOPFF>#.
#define LUNATICO_SELETEK         1
#define LUNATICO_ARMADILLO       2
#define LUNATICO_PLATYPUS        3
#define LUNATICO_DRAGONFLY       4
#define LUNATICO_LIMPET          5

// Raw !read temps values. The driver converts the internal sensor with
// ((raw - 261) * 1.8 - 250) / 10 and the external one with
// ((raw - 192) * 1.7 - 0) / 10, so 511 is 20.0 C internal and 310 is 20.06 C
// external. Raw 0 maps to about -72 C internal, which is below the driver's
// NO_TEMP_READING of -25 C and therefore reads as a disconnected sensor.
#define LUNATICO_TEMP_INTERNAL   511
#define LUNATICO_TEMP_EXTERNAL   310
#define LUNATICO_TEMP_ABSENT     0

// Power-up state of the three ports. Port 0 starts at 1800 steps, which is
// 0 deg for a rotator with the default 3600 steps per revolution and a -180 deg
// minimum limit.
#define LUNATICO_HOME_MAIN       1800
#define LUNATICO_HOME_OTHER      1000

// Default step rate. The driver asks for 0.1 kHz, which it sends as
// !step speedrangeus <port> 10000 10000#, so 1000000 / 10000 = 100 steps/s.
#define LUNATICO_DEFAULT_SPEED   100.0

typedef struct {
	serial_motion motion;
	double speed;
	bool limits;
	int low, high;
	int halfstep, wiremode, motor, movepow, stoppow;
	int output[LUNATICO_PINS];
} lunatico_port;

static lunatico_port sim_port[LUNATICO_PORTS];
static int sim_model = LUNATICO_PLATYPUS;
static int sim_oper = 0;
static int sim_temperature[2] = { LUNATICO_TEMP_INTERNAL, LUNATICO_TEMP_EXTERNAL };
static bool sim_has_moved;
static const char *sim_ready_file;

// A profile is a '+' separated set of flags, so one scenario can combine
// independent device conditions, for example "armadillo+goto-error".
static bool sim_flag(const char *flag) {
	size_t length = strlen(flag);
	for (const char *pnt = sim_profile; pnt != NULL; ) {
		const char *end = strchr(pnt, '+');
		size_t size = end != NULL ? (size_t)(end - pnt) : strlen(pnt);
		if (size == length && !strncmp(pnt, flag, length)) {
			return true;
		}
		pnt = end != NULL ? end + 1 : NULL;
	}
	return false;
}

static void lunatico_configure(void) {
	for (int i = 0; i < LUNATICO_PORTS; i++) {
		serial_motion_sync(&sim_port[i].motion, i == 0 ? LUNATICO_HOME_MAIN : LUNATICO_HOME_OTHER);
		sim_port[i].speed = LUNATICO_DEFAULT_SPEED;
		sim_port[i].wiremode = -1;
		sim_port[i].motor = -1;
		sim_port[i].halfstep = -1;
		sim_port[i].movepow = -1;
		sim_port[i].stoppow = -1;
	}
	if (sim_flag("limpet")) {
		sim_model = LUNATICO_LIMPET;
	} else if (sim_flag("armadillo")) {
		sim_model = LUNATICO_ARMADILLO;
	} else if (sim_flag("seletek")) {
		sim_model = LUNATICO_SELETEK;
	} else if (sim_flag("wrong-model")) {
		sim_model = LUNATICO_DRAGONFLY;
	}
	if (sim_flag("bootloader")) {
		sim_oper = 2;
	}
	if (sim_flag("no-temp-sensor")) {
		sim_temperature[0] = LUNATICO_TEMP_ABSENT;
		sim_temperature[1] = LUNATICO_TEMP_ABSENT;
	}
}

// Test controls are out-of-band files, never hardware commands. They let a
// scenario change the controller's state behind the driver's back, which is
// how externally moved axes and temperature drift are simulated.
static void lunatico_load_control(void) {
	if (sim_ready_file == NULL) {
		return;
	}
	char path[PATH_MAX];
	snprintf(path, sizeof(path), "%s.control", sim_ready_file);
	FILE *file = fopen(path, "r");
	if (file == NULL) {
		return;
	}
	char control[160] = { 0 };
	if (fgets(control, sizeof(control), file) == NULL) {
		*control = 0;
	}
	fclose(file);
	unlink(path);
	control[strcspn(control, "\r\n")] = 0;
	int port = 0, value = 0;
	if (sscanf(control, "temperature:%d", &value) == 1) {
		sim_temperature[0] = value;
	} else if (sscanf(control, "temperature-external:%d", &value) == 1) {
		sim_temperature[1] = value;
	} else if (sscanf(control, "position:%d:%d", &port, &value) == 2 && port >= 0 && port < LUNATICO_PORTS) {
		serial_motion_sync(&sim_port[port].motion, value);
	}
}

// Every request the controller receives is appended here, so a scenario can
// assert the exact command the driver issued, including its arguments and the
// DB9 pin flip, which the protocol itself offers no way to read back.
static void lunatico_record(const char *command) {
	if (sim_ready_file == NULL) {
		return;
	}
	char path[PATH_MAX];
	snprintf(path, sizeof(path), "%s.events", sim_ready_file);
	FILE *file = fopen(path, "a");
	if (file != NULL) {
		fprintf(file, "%s\n", command);
		fclose(file);
	}
}

static void lunatico_reply(const char *command, const char *payload) {
	char response[512];
	snprintf(response, sizeof(response), "%.*s:%s#", (int)strlen(command) - 1, command, payload);
	serial_simulator_trace_line(sim_trace, "<-", response);
	sim_send(response, strlen(response));
}

static void lunatico_reply_int(const char *command, int value) {
	char payload[32];
	snprintf(payload, sizeof(payload), "%d", value);
	lunatico_reply(command, payload);
}

// The step group answers ":0#" on success and ":-1#" on a rejected request.
static void lunatico_reply_status(const char *command, bool accepted) {
	lunatico_reply_int(command, accepted ? 0 : -1);
}

static bool lunatico_read_fault(void) {
	return sim_has_moved && sim_flag("read-error");
}

static void lunatico_step(const char *command, const char *verb, int port, int a, int b, int arguments) {
	lunatico_port *target = sim_port + port;
	if (!strcmp(verb, "getpos")) {
		if (lunatico_read_fault()) {
			lunatico_reply(command, "invalid");
		} else {
			lunatico_reply_int(command, (int)lround(serial_motion_update(&target->motion)));
		}
	} else if (!strcmp(verb, "ismoving")) {
		if (lunatico_read_fault()) {
			lunatico_reply(command, "invalid");
		} else {
			serial_motion_update(&target->motion);
			lunatico_reply_int(command, target->motion.duration > 0 ? 1 : 0);
		}
	} else if (!strcmp(verb, "goto") || !strcmp(verb, "gopr")) {
		// goto takes an absolute position and a backlash compensation, gopr a
		// relative step count.
		int requested = !strcmp(verb, "gopr") ? (int)lround(serial_motion_update(&target->motion)) + a : a;
		if (arguments < 2 || sim_flag("goto-error") || (target->limits && (requested < target->low || requested > target->high))) {
			lunatico_reply_status(command, false);
		} else {
			serial_motion_start(&target->motion, requested, target->speed);
			sim_has_moved = true;
			lunatico_reply_status(command, true);
		}
	} else if (!strcmp(verb, "setpos")) {
		if (arguments < 2 || sim_flag("setpos-error")) {
			lunatico_reply_status(command, false);
		} else {
			serial_motion_sync(&target->motion, a);
			lunatico_reply_status(command, true);
		}
	} else if (!strcmp(verb, "stop")) {
		if (sim_flag("stop-error")) {
			lunatico_reply_status(command, false);
		} else {
			serial_motion_stop(&target->motion);
			lunatico_reply_status(command, true);
		}
	} else if (!strcmp(verb, "speedrangeus")) {
		// The driver derives microseconds from kHz and sends the same value as
		// the slow and the fast end of the range.
		bool accepted = arguments >= 3 && a == b && a >= 50 && a <= 500000 && !sim_flag("speed-error");
		if (accepted) {
			target->speed = 1000000.0 / a;
		}
		lunatico_reply_status(command, accepted);
	} else if (!strcmp(verb, "setswlimits")) {
		bool accepted = arguments >= 3 && a <= b && !sim_flag("limits-error");
		if (accepted) {
			target->limits = true;
			target->low = a;
			target->high = b;
		}
		lunatico_reply_status(command, accepted);
	} else if (!strcmp(verb, "delswlimits")) {
		bool accepted = !sim_flag("limits-error");
		if (accepted) {
			target->limits = false;
		}
		lunatico_reply_status(command, accepted);
	} else if (!strcmp(verb, "halfstep")) {
		bool accepted = arguments >= 2 && a >= 0 && a <= 1 && !sim_flag("step-mode-error");
		if (accepted) {
			target->halfstep = a;
		}
		lunatico_reply_status(command, accepted);
	} else if (!strcmp(verb, "wiremode")) {
		bool accepted = arguments >= 2 && a >= 0 && a <= 3 && !sim_flag("wiring-error");
		if (accepted) {
			target->wiremode = a;
		}
		lunatico_reply_status(command, accepted);
	} else if (!strcmp(verb, "model")) {
		bool accepted = arguments >= 2 && a >= 0 && a <= 3 && !sim_flag("motor-error");
		if (accepted) {
			target->motor = a;
		}
		lunatico_reply_status(command, accepted);
	} else if (!strcmp(verb, "movepow") || !strcmp(verb, "stoppow")) {
		// The driver sends percent * 10.23, so full scale is 1023.
		bool accepted = arguments >= 2 && a >= 0 && a <= 1023 && !sim_flag("power-error");
		if (accepted) {
			if (*verb == 'm') {
				target->movepow = a;
			} else {
				target->stoppow = a;
			}
		}
		lunatico_reply_status(command, accepted);
	} else {
		lunatico_reply_status(command, false);
	}
}

static void sim_dispatch(const char *command) {
	lunatico_load_control();
	for (int i = 0; i < LUNATICO_PORTS; i++) {
		serial_motion_update(&sim_port[i].motion);
	}
	if (command == NULL) {
		return;
	}
	lunatico_record(command);
	if (sim_flag("silent")) {
		return;
	}
	if (sim_flag("oversized")) {
		// 100 bytes with no terminator, which is exactly the reply buffer size
		// of the driver.
		char response[100];
		memset(response, 'x', sizeof(response));
		sim_send(response, sizeof(response));
		return;
	}
	char group[24], verb[24];
	int port = 0, a = 0, b = 0;
	if (!strcmp(command, "!seletek version#")) {
		if (sim_flag("bad-version")) {
			lunatico_reply(command, "not-a-number");
		} else {
			// oper * 10000 + model * 1000 + major * 100 + minor.
			lunatico_reply_int(command, sim_oper * 10000 + sim_model * 1000 + 529);
		}
		return;
	}
	int arguments = sscanf(command, "!%23s %23s %d %d %d", group, verb, &port, &a, &b) - 2;
	if (arguments < 1) {
		lunatico_reply_status(command, false);
		return;
	}
	if (!strcmp(group, "step")) {
		if (port < 0 || port >= LUNATICO_PORTS) {
			lunatico_reply_status(command, false);
		} else {
			lunatico_step(command, verb, port, a, b, arguments);
		}
	} else if (!strcmp(group, "read") && !strcmp(verb, "temps")) {
		// The sensor index is the only argument, so it lands in "port".
		if (port < 0 || port > 1 || sim_flag("temperature-error")) {
			lunatico_reply_status(command, false);
		} else {
			lunatico_reply_int(command, sim_temperature[port]);
		}
	} else if (!strcmp(group, "read") && !strcmp(verb, "an")) {
		// Analog inputs are DB9 pins 5...8 and answer a distinct value per pin,
		// so a scenario can tell which pin an item was read from.
		if (arguments < 2 || port < 0 || port >= LUNATICO_PORTS || a < 0 || a >= LUNATICO_PINS || sim_flag("sensor-error")) {
			lunatico_reply_status(command, false);
		} else {
			lunatico_reply_int(command, 500 + a);
		}
	} else if (!strcmp(group, "write") && !strcmp(verb, "dig")) {
		if (arguments < 3 || port < 0 || port >= LUNATICO_PORTS || a < 0 || a >= LUNATICO_PINS || sim_flag("outlet-error")) {
			lunatico_reply_status(command, false);
		} else {
			sim_port[port].output[a] = b != 0;
			lunatico_reply_status(command, true);
		}
	} else {
		lunatico_reply_status(command, false);
	}
}

static int lunatico_simulator_main(int argc, char **argv) {
	for (int i = 1; i < argc; i++) {
		if (!strcmp(argv[i], "--profile") && i + 1 < argc) {
			sim_profile = argv[i + 1];
		} else if (!strcmp(argv[i], "--ready-file") && i + 1 < argc) {
			sim_ready_file = argv[i + 1];
		}
	}
	lunatico_configure();
	return sim_main(argc, argv);
}

#endif /* LUNATICO_SIMULATOR_COMMON_H */
