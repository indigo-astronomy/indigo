// Geoptik flat field generator simulator
//
// Copyright (c) 2026 INDIGO initiative
// All rights reserved.
//
// You can use this software under the terms of 'INDIGO Astronomy
// open-source license' (see LICENSE.md).
//
// THIS SOFTWARE IS PROVIDED BY THE AUTHORS 'AS IS' AND ANY EXPRESS
// OR IMPLIED WARRANTIES, INCLUDING, BUT NOT LIMITED TO, THE IMPLIED
// WARRANTIES OF MERCHANTABILITY AND FITNESS FOR A PARTICULAR PURPOSE
// ARE DISCLAIMED. IN NO EVENT SHALL THE AUTHOR BE LIABLE FOR ANY
// DIRECT, INDIRECT, INCIDENTAL, SPECIAL, EXEMPLARY, OR CONSEQUENTIAL
// DAMAGES (INCLUDING, BUT NOT LIMITED TO, PROCUREMENT OF SUBSTITUTE
// GOODS OR SERVICES; LOSS OF USE, DATA, OR PROFITS; OR BUSINESS
// INTERRUPTION) HOWEVER CAUSED AND ON ANY THEORY OF LIABILITY,
// WHETHER IN CONTRACT, STRICT LIABILITY, OR TORT (INCLUDING
// NEGLIGENCE OR OTHERWISE) ARISING IN ANY WAY OUT OF THE USE OF THIS
// SOFTWARE, EVEN IF ADVISED OF THE POSSIBILITY OF SUCH DAMAGE.

// Code is generated by AI

// The Geoptik flat field generator speaks the Alnitak generic command set, documented in
// ../../aux_flipflat/Alnitak_GenericCommandsR4.pdf:
//
//   send ">POOO" CR -> receive "*Pii" "OOO" LF    ping, used to find the device
//   send ">VOOO" CR -> receive "*Vii" vvv  LF    firmware version, vvv is three digits
//   send ">LOOO" CR -> receive "*Lii" "OOO" LF    light on
//   send ">DOOO" CR -> receive "*Dii" "OOO" LF    light off
//   send ">Bxxx" CR -> receive "*Bii" xxx  LF    set brightness, xxx is 000-255
//
// ">" leads every request and "*" every reply, ii is the two digit product id and the reply is
// terminated by LF alone - there is no CR in front of it. indigo_aux_geoptikflat uses exactly
// these five commands; the documented ">JOOO" and ">SOOO" readbacks are not implemented here
// because the driver never sends them.

#include <stdio.h>
#include <stdlib.h>
#include <stdbool.h>
#include <unistd.h>
#include <string.h>
#include <errno.h>
#include <stdarg.h>
#include <signal.h>
#include <limits.h>

#include "../../../indigo_test/simulator_common/serial_simulator_common.h"

// ----------------------------------------------------------------- options

typedef struct {
	bool headless;
	bool trace;
	const char *ready_file;
	const char *firmware;
	int device_id;
	char control_file[PATH_MAX];
	char event_file[PATH_MAX];
} simulator_options;

static simulator_options options = {
	.headless = false,
	.trace = true,
	.ready_file = NULL,
	.firmware = "003",
	.device_id = 19
};

static const char *simulator_name = "aux_geoptikflat";

static void usage(const char *name) {
	printf("Geoptik flat field generator simulator\n");
	printf("Usage: %s [OPTIONS]\n", name);
	printf("  --headless              Disable terminal-oriented output\n");
	printf("  --ready-file <path>     Write INDIGO_SIMULATOR_PORT after PTY setup\n");
	printf("  --trace                 Log protocol requests and replies\n");
	printf("  --device-id <id>        Set reported product id, default is 19\n");
	printf("  --firmware <version>    Set reported firmware version, default is 003\n");
	printf("  Runtime control is read once from <ready-file>.control as ACTION SELECTOR\n");
	printf("  and every complete command is recorded in <ready-file>.events.\n");
	printf("  -h, --help              Show this help and exit\n");
}

static bool parse_args(int argc, char *argv[]) {
	for (int i = 1; i < argc; i++) {
		if (!strcmp(argv[i], "-h") || !strcmp(argv[i], "--help")) {
			usage(argv[0]);
			exit(0);
		} else if (!strcmp(argv[i], "--headless")) {
			options.headless = true;
			options.trace = false;
		} else if (!strcmp(argv[i], "--trace")) {
			options.trace = true;
		} else if (!strcmp(argv[i], "--ready-file")) {
			if (++i == argc) {
				fprintf(stderr, "--ready-file requires a path\n");
				return false;
			}
			options.ready_file = argv[i];
		} else if (!strcmp(argv[i], "--device-id")) {
			if (++i == argc) {
				fprintf(stderr, "--device-id requires an id\n");
				return false;
			}
			options.device_id = atoi(argv[i]) % 100;
		} else if (!strcmp(argv[i], "--firmware")) {
			if (++i == argc) {
				fprintf(stderr, "--firmware requires a version\n");
				return false;
			}
			options.firmware = argv[i];
		} else {
			fprintf(stderr, "Unknown option '%s'\n", argv[i]);
			return false;
		}
	}
	if (options.ready_file != NULL) {
		snprintf(options.control_file, sizeof(options.control_file), "%s.control", options.ready_file);
		snprintf(options.event_file, sizeof(options.event_file), "%s.events", options.ready_file);
	}
	return true;
}

// ----------------------------------------------------------------- state

static volatile sig_atomic_t running = 1;
static int serial_fd = -1;

static bool light_on = false;
static int brightness = 0;

static void signal_handler(int sig) {
	(void)sig;
	running = 0;
	if (serial_fd >= 0) {
		close(serial_fd);
		serial_fd = -1;
	}
}

// ----------------------------------------------------------------- protocol

static bool sim_printf(int fd, const char *format, ...) {
	char buffer[64];
	va_list args;
	va_start(args, format);
	int length = vsnprintf(buffer, sizeof(buffer), format, args);
	va_end(args);
	if (length < 0 || length >= (int)sizeof(buffer)) {
		return false;
	}
	serial_simulator_trace_line(options.trace, "<-", buffer);
	return serial_simulator_write_all(fd, buffer, (size_t)length);
}

static int sim_read_byte(int fd, char *byte) {
	while (running) {
		ssize_t count = read(fd, byte, 1);
		if (count == 1) {
			return 0;
		}
		if (count < 0) {
			if (errno == EINTR) {
				continue;
			}
			if (errno == EAGAIN || errno == EWOULDBLOCK || errno == EIO) {
				usleep(500);
				continue;
			}
			return -1;
		}
		usleep(500);
	}
	return -1;
}

// Requests are terminated by CR; an LF is tolerated so a terminal emulator can drive the
// simulator the same way it drives the device.
static int sim_read_command(int fd, char *buffer, size_t length) {
	char byte = '\0';
	size_t used = 0;
	while (running && used + 1 < length) {
		if (sim_read_byte(fd, &byte) < 0) {
			return -1;
		}
		if (byte == '\n') {
			continue;
		}
		if (byte == '\r') {
			buffer[used] = '\0';
			if (used > 0) {
				serial_simulator_trace_line(options.trace, "->", buffer);
			}
			return (int)used;
		}
		buffer[used++] = byte;
	}
	buffer[0] = '\0';
	return -1;
}

static void record_command(const char *command) {
	if (*options.event_file == '\0') {
		return;
	}
	FILE *file = fopen(options.event_file, "a");
	if (file == NULL) {
		return;
	}
	fprintf(file, "%s\n", command);
	fclose(file);
}

// One fault is armed at a time and consumed by the first command that matches its selector, so a
// case can aim a fault at ">B" without disturbing the handshake that precedes it.
static bool apply_control(int fd, const char *command) {
	if (*options.control_file == '\0') {
		return false;
	}
	FILE *file = fopen(options.control_file, "r");
	if (file == NULL) {
		return false;
	}
	char action[16] = { 0 };
	char selector[16] = { 0 };
	int count = fscanf(file, "%15s %15s", action, selector);
	fclose(file);
	if (count != 2 || (strcmp(selector, "*") && (command[0] != '>' || command[1] != selector[0] || selector[1] != '\0'))) {
		return false;
	}
	unlink(options.control_file);
	if (!strcmp(action, "drop")) {
		return true;
	}
	if (!strcmp(action, "short")) {
		// The product id arrives but the three character payload does not.
		sim_printf(fd, "*%c%02d\n", command[1], options.device_id);
		return true;
	}
	if (!strcmp(action, "malformed")) {
		// A reply that does not start with the documented "*".
		sim_printf(fd, "#%c%02d000\n", command[1], options.device_id);
		return true;
	}
	if (!strcmp(action, "mismatch")) {
		// A well formed reply to a different command than the one that was sent.
		sim_printf(fd, "*S%02d000\n", options.device_id);
		return true;
	}
	if (!strcmp(action, "stale")) {
		// An unsolicited line left over from an earlier session arrives first; the correct reply
		// follows it and must be drained before the next command is answered.
		sim_printf(fd, "*S%02d000\n", options.device_id);
		sim_printf(fd, "*%c%02d000\n", command[1], options.device_id);
		return true;
	}
	if (!strcmp(action, "close")) {
		running = 0;
		close(serial_fd);
		serial_fd = -1;
		return true;
	}
	return false;
}

static bool valid_command(const char *command, char operation) {
	return strlen(command) == 5 && command[0] == '>' && command[1] == operation;
}

static bool valid_brightness(const char *command) {
	return valid_command(command, 'B') && command[2] >= '0' && command[2] <= '9' && command[3] >= '0' && command[3] <= '9' && command[4] >= '0' && command[4] <= '9';
}

static void trace_state(void) {
	char state[64];
	snprintf(state, sizeof(state), "light %s, brightness %03d", light_on ? "on" : "off", brightness);
	serial_simulator_trace_line(options.trace, "==", state);
}

static void dispatch_command(int fd, const char *buffer) {
	record_command(buffer);
	if (apply_control(fd, buffer)) {
		return;
	}
	if (valid_command(buffer, 'P')) {
		sim_printf(fd, "*P%02dOOO\n", options.device_id);
	} else if (valid_command(buffer, 'V')) {
		sim_printf(fd, "*V%02d%s\n", options.device_id, options.firmware);
	} else if (valid_command(buffer, 'L')) {
		light_on = true;
		sim_printf(fd, "*L%02dOOO\n", options.device_id);
		trace_state();
	} else if (valid_command(buffer, 'D')) {
		light_on = false;
		sim_printf(fd, "*D%02dOOO\n", options.device_id);
		trace_state();
	} else if (valid_brightness(buffer)) {
		brightness = atoi(buffer + 2);
		sim_printf(fd, "*B%02d%03d\n", options.device_id, brightness);
		trace_state();
	} else {
		serial_simulator_trace_line(options.trace, "??", buffer);
	}
}

// ----------------------------------------------------------------- main

int main(int argc, char *argv[]) {
	char command[64];
	char port[128];

	if (!parse_args(argc, argv)) {
		usage(argv[0]);
		return 1;
	}

	signal(SIGTERM, signal_handler);
	signal(SIGINT, signal_handler);

	serial_fd = serial_simulator_open_pty(port, sizeof(port));
	if (serial_fd < 0) {
		return 1;
	}

	if (options.ready_file != NULL && !serial_simulator_write_ready_file(options.ready_file, simulator_name, port)) {
		close(serial_fd);
		serial_fd = -1;
		return 1;
	}

	if (!options.headless) {
		printf("Geoptik flat field generator simulator is running on %s\n", port);
		fflush(stdout);
	}

	while (running) {
		if (sim_read_command(serial_fd, command, sizeof(command)) > 0) {
			dispatch_command(serial_fd, command);
		} else {
			usleep(1000);
		}
	}

	if (serial_fd >= 0) {
		close(serial_fd);
		serial_fd = -1;
	}
	return 0;
}
