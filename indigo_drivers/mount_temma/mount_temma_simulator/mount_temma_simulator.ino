// Generated by ChatGPT

#include <Arduino.h>

#if defined(ARDUINO_AVR_MEGA2560) || defined(ARDUINO_AVR_MEGA)
  #define MOUNT_SERIAL Serial1
#else
  #define MOUNT_SERIAL Serial
#endif

static const uint32_t BAUD = 19200;

// ---- IMPORTANT: flip if your host uses opposite STN semantics ----
// true  => "STN-ON" means motors ON
// false => "STN-ON" means standby ON (motors OFF)
static const bool STN_ON_MEANS_MOTORS_ON = false;

// ---- RX buffer (bytes, not C-string) ----
static const uint16_t RX_MAX = 128;
static uint8_t rx[RX_MAX];
static uint16_t rxLen = 0;

// ---------- Mount state ----------
static bool haveLST = false;
static bool haveLAT = false;

static double lst_h = 0.0;      // [0..24)
static double lat_d = 0.0;      // [-90..+90]
static char hemisphere = 'N';

static bool motorsOn = true;

static double ha_h = 0.0;       // [0..24) mechanical hour angle
static double dec_d = 0.0;      // [-90..+90]

static bool trackingEnabled = true;

static bool cometTracking = false;
static int cometRA_secPerDay = 0;   // RA adjust seconds/day
static int cometDEC_minPerDay = 0;  // DEC drift minutes/day

static uint8_t corrRA_pct = 90;      // 10..90
static uint8_t corrDEC_pct = 90;     // 10..90

static bool slewingGoto = false;
static double targetHA_h = 0.0;
static double targetDEC_d = 0.0;

static char telescopeSide = 'W';     // 'E' or 'W'
static bool handboxOperational = true;
static uint8_t fReadsRemaining = 0;

static uint8_t motionMask = 0;

static uint32_t lastUpdateMs = 0;

// ---------- Helpers ----------
static void sendLine(const String &s) {
  MOUNT_SERIAL.print(s);
  MOUNT_SERIAL.print("\r\n");
}

static void replyR(uint8_t code) { // R1 OK, R2 RA err, R3 DEC err, R4 format
  sendLine(String("R") + String(code));
}

static double wrap24(double h) {
  while (h < 0) h += 24.0;
  while (h >= 24.0) h -= 24.0;
  return h;
}

static double clamp(double v, double lo, double hi) {
  if (v < lo) return lo;
  if (v > hi) return hi;
  return v;
}

static void updateHemisphere() { hemisphere = (lat_d < 0) ? 'S' : 'N'; }

static double reportedRA_h() { return wrap24(lst_h - ha_h); }

static void formatRA6(double ra_h, char out[7]) {
  ra_h = wrap24(ra_h);
  int hh = (int)ra_h;
  int mm = (int)(ra_h * 60.0) % 60;
  int ss = (int)(ra_h * 3600.0 + 0.5) % 60;
  snprintf(out, 7, "%02d%02d%02d", hh, mm, ss);
}

// returns sign separately, digits are DDMMt (t = 1/10 arc-minute)
static void formatDEC5(double d, char &sign, char out[6]) {
  sign = (d < 0) ? '-' : '+';
  d = fabs(d);
  int dd = (int)d;
  int mm = (int)(d * 60.0) % 60;
  int t  = (int)(d * 600.0 + 0.5) % 10;
  snprintf(out, 6, "%02d%02d%1d", dd, mm, t);
}

// Parse payload: HHMMSS±DDMMt (12 ASCII chars)
static bool parseRADEC_payload_ascii(const char *p, double &ra_h, double &dec_out, char &decSign) {
  if (!p || strlen(p) < 12) return false;

  int rh=0, rm=0, rs=0;
  if (sscanf(p, "%02d%02d%02d", &rh, &rm, &rs) != 3) return false;
  ra_h = rh + rm / 60.0 + rs / 3600.0;

  decSign = p[6];
  if (decSign != '+' && decSign != '-' && decSign != ' ') return false;

  int dd=0, dm=0, dt=0;
  if (sscanf(p + 7, "%02d%02d%1d", &dd, &dm, &dt) != 3) return false;

  double v = dd + dm/60.0 + dt/600.0;
  if (decSign == '-') v = -v;
  dec_out = v;
  return true;
}

// Convert rx bytes to an ASCII String (stops at rxLen, includes any byte values as chars)
static String rxAsString() {
  String s;
  s.reserve(rxLen);
  for (uint16_t i = 0; i < rxLen; i++) s += (char)rx[i];
  return s;
}

// ---------- Simulation step ----------
static void stepSim(uint32_t nowMs) {
  if (lastUpdateMs == 0) lastUpdateMs = nowMs;
  double dt = (nowMs - lastUpdateMs) / 1000.0;
  lastUpdateMs = nowMs;

  // LST ticks internally once set (host only sets on connect)
  if (haveLST) {
    const double sid_hps = 24.0 / 86164.0;
    lst_h = wrap24(lst_h + sid_hps * dt);
  }

  // Motors off => no mechanical motion
  if (!motorsOn) return;

  // Manual motion mask (from M*)
  if (motionMask != 0) {
    bool high = (motionMask & (1 << 0)) != 0;
    double ra_degps  = high ? 2.5 : 0.6;
    double dec_degps = high ? 2.5 : 0.6;

    // RA = LST - HA => RA Right increases RA => decreases HA
    if (motionMask & (1 << 1)) ha_h = wrap24(ha_h - (ra_degps / 15.0) * dt);
    if (motionMask & (1 << 2)) ha_h = wrap24(ha_h + (ra_degps / 15.0) * dt);
    if (motionMask & (1 << 3)) dec_d = clamp(dec_d + dec_degps * dt, -90.0, 90.0);
    if (motionMask & (1 << 4)) dec_d = clamp(dec_d - dec_degps * dt, -90.0, 90.0);
  }

  // GOTO slew
  if (slewingGoto) {
    const double ha_hps  = 0.12;
    const double dec_dps = 1.8;

    double dha = targetHA_h - ha_h;
    if (dha > 12) dha -= 24;
    if (dha < -12) dha += 24;

    double stepHA = ha_hps * dt;
    if (fabs(dha) <= stepHA) ha_h = targetHA_h;
    else ha_h = wrap24(ha_h + (dha > 0 ? stepHA : -stepHA));

    double ddec = targetDEC_d - dec_d;
    double stepDEC = dec_dps * dt;
    if (fabs(ddec) <= stepDEC) dec_d = targetDEC_d;
    else dec_d += (ddec > 0 ? stepDEC : -stepDEC);

    if (fabs(dha) < 0.0005 && fabs(ddec) < 0.01) slewingGoto = false;
  }

  // Tracking (sidereal / comet)
  if (trackingEnabled && !slewingGoto && motionMask == 0 && haveLST) {
    const double sid_hps = 24.0 / 86164.0;

    // comet RA drift: seconds/day -> hours/sec
    double raAdj_hps = 0.0;
    if (cometTracking) raAdj_hps = (double)cometRA_secPerDay / (3600.0 * 86400.0);

    // dHA = dLST - dRA; want dRA = raAdj_hps
    ha_h = wrap24(ha_h + (sid_hps - raAdj_hps) * dt);

    if (cometTracking) {
      // comet DEC drift: minutes/day -> deg/sec
      double dec_dps = (double)cometDEC_minPerDay / (60.0 * 86400.0);
      dec_d = clamp(dec_d + dec_dps * dt, -90.0, 90.0);
    }
  }
}

// ---------- Command execution ----------
static void execCommand() {
  if (rxLen == 0) return;

  // 1) Binary M* detection: exactly 2 bytes: 'M' + mask
  if (rxLen == 2 && rx[0] == (uint8_t)'M') {
    motionMask = rx[1];
    replyR(1);
    return;
  }

  // 2) Everything else treated as ASCII
  String cmd = rxAsString();

  // --- Always-0 query ---
  if (cmd == "s") { sendLine("s0"); return; }

  // --- STN motor/standby ---
  if (cmd == "STN-ON") {
    motorsOn = STN_ON_MEANS_MOTORS_ON ? true : false;
    if (!motorsOn) { slewingGoto = false; motionMask = 0; }
    replyR(1);
    return;
  }
  if (cmd == "STN-OFF") {
    motorsOn = STN_ON_MEANS_MOTORS_ON ? false : true;
    if (!motorsOn) { slewingGoto = false; motionMask = 0; }
    replyR(1);
    return;
  }
  if (cmd == "STN-COD") {
    // Return polarity-consistent status (hosts vary).
    if (STN_ON_MEANS_MOTORS_ON) sendLine(String("STN-COD ") + (motorsOn ? "on" : "off"));
    else                        sendLine(String("STN-COD ") + (motorsOn ? "off" : "on"));
    return;
  }

  // --- Version / voltage ---
  if (cmd == "v")  { sendLine("vTEMMA_SIM-ARDUINO"); return; }
  if (cmd == "v1" || cmd == "v2") { replyR(1); return; }

  // --- Z handshake ---
  if (cmd == "Z") { replyR(1); return; }

  // --- LK / LL ---
  if (cmd == "LK" || cmd == "LL") { trackingEnabled = true; replyR(1); return; }

  // --- PS: stop goto/manual/comet but keep sidereal tracking enabled ---
  if (cmd == "PS") {
    slewingGoto = false;
    motionMask = 0;
    cometTracking = false;
    cometRA_secPerDay = 0;
    cometDEC_minPerDay = 0;
    trackingEnabled = true;
    replyR(1);
    return;
  }

  // --- PT: flip side ---
  if (cmd == "PT") {
    telescopeSide = (telescopeSide == 'W') ? 'E' : 'W';
    replyR(1);
    return;
  }

  // --- Set LST: T HHMMSS ---
  if (cmd.length() == 7 && cmd[0] == 'T') {
    int hh=0, mm=0, ss=0;
    if (sscanf(cmd.c_str() + 1, "%02d%02d%02d", &hh, &mm, &ss) != 3) { replyR(4); return; }
    if (hh > 23 || mm > 59 || ss > 59) { replyR(4); return; }
    lst_h = wrap24(hh + mm/60.0 + ss/3600.0);
    haveLST = true;
    replyR(1);
    return;
  }

  // --- Get LST: g -> gHHMMSS ---
  if (cmd == "g") {
    if (!haveLST) { sendLine("g999999"); return; }
    int hh = (int)wrap24(lst_h);
    int mm = ((int)(wrap24(lst_h) * 60.0)) % 60;
    int ss = ((int)(wrap24(lst_h) * 3600.0)) % 60;
    char buf[16];
    snprintf(buf, sizeof(buf), "g%02d%02d%02d", hh, mm, ss);
    sendLine(buf);
    return;
  }

  // --- Set latitude: I±DDMMt ---
  if (cmd.length() == 7 && cmd[0] == 'I') {
    char sign = cmd[1];
    if (sign != '+' && sign != '-') { replyR(3); return; }
    int dd=0, mm=0, t=0;
    if (sscanf(cmd.c_str() + 2, "%02d%02d%1d", &dd, &mm, &t) != 3) { replyR(4); return; }
    if (dd > 89 || mm > 59 || t > 9) { replyR(3); return; }
    double v = dd + mm/60.0 + t/600.0;
    if (sign == '-') v = -v;
    lat_d = clamp(v, -90.0, 90.0);
    haveLAT = true;
    updateHemisphere();
    replyR(1);
    return;
  }

  // --- Get latitude: i±DDMMt ---
  if (cmd == "i") {
    if (!haveLAT) { sendLine("i+99999"); return; }
    char s; char d5[6];
    formatDEC5(lat_d, s, d5);
    String out = "i"; out += s; out += d5;
    sendLine(out);
    return;
  }

  // --- Correction speeds ---
  if (cmd.length() == 4 && cmd[0] == 'L' && cmd[1] == 'A') {
    int v = atoi(cmd.c_str() + 2);
    if (v < 10 || v > 90) { replyR(2); return; }
    corrRA_pct = (uint8_t)v;
    replyR(1);
    return;
  }
  if (cmd.length() == 4 && cmd[0] == 'L' && cmd[1] == 'B') {
    int v = atoi(cmd.c_str() + 2);
    if (v < 10 || v > 90) { replyR(3); return; }
    corrDEC_pct = (uint8_t)v;
    replyR(1);
    return;
  }
  if (cmd == "la") { char b[16]; snprintf(b, sizeof(b), "laLA%02u", corrRA_pct); sendLine(b); return; }
  if (cmd == "lb") { char b[16]; snprintf(b, sizeof(b), "lbLB%02u", corrDEC_pct); sendLine(b); return; }
  if (cmd == "lg") { char b[16]; snprintf(b, sizeof(b), "lg%02uD%02u%c", corrRA_pct, corrDEC_pct, hemisphere); sendLine(b); return; }

  // --- Comet tracking: LM<raSecPerDay>,<decMinPerDay> ---
  if (cmd.startsWith("LM")) {
    int comma = cmd.indexOf(',');
    if (comma < 0) { replyR(4); return; }
    int raAdj  = cmd.substring(2, comma).toInt();
    int decAdj = cmd.substring(comma + 1).toInt();

    cometRA_secPerDay  = raAdj;
    cometDEC_minPerDay = decAdj;

    if (raAdj == 0 && decAdj == 0) {
      cometTracking = false;
      trackingEnabled = true;
    } else {
      cometTracking = true;
      trackingEnabled = true;
    }
    replyR(1);
    return;
  }

  if (cmd == "lm") {
    char b[48];
    snprintf(b, sizeof(b), "lmLM%+d,%+d", cometRA_secPerDay, cometDEC_minPerDay);
    sendLine(b);
    return;
  }

  // --- Manual slew ASCII form: M<number> or M0xNN ---
  // (Supported in addition to binary M*)
  if (cmd.length() >= 2 && cmd[0] == 'M') {
    const char *p = cmd.c_str() + 1;
    unsigned long v = 0;
    if (p[0] == '0' && (p[1] == 'x' || p[1] == 'X')) v = strtoul(p, nullptr, 16);
    else v = strtoul(p, nullptr, 10);
    motionMask = (uint8_t)(v & 0xFF);
    replyR(1);
    return;
  }

  // --- Sync location: DHHMMSS±DDMMt ---
  if (cmd.length() >= 13 && cmd[0] == 'D') {
    double ra_h = 0.0, d = 0.0; char sgn = '+';
    if (!parseRADEC_payload_ascii(cmd.c_str() + 1, ra_h, d, sgn)) { replyR(4); return; }
    if (ra_h < 0.0 || ra_h >= 24.0) { replyR(2); return; }
    if (fabs(d) > 90.0) { replyR(3); return; }

    ha_h = haveLST ? wrap24(lst_h - ra_h) : wrap24(-ra_h);
    dec_d = d;

    fReadsRemaining = 4;
    slewingGoto = false;

    replyR(1);
    return;
  }

  // --- Get location: E -> EHHMMSS±DDMMt(E/W/F)(H) ---
  if (cmd == "E") {
    if (!haveLAT || !haveLST) { sendLine("E999999+99999F1"); return; }

    char ra6[7];
    formatRA6(reportedRA_h(), ra6);

    char sign; char d5[6];
    if (fabs(dec_d) < 0.0005) { sign = ' '; snprintf(d5, sizeof(d5), "00000"); }
    else formatDEC5(dec_d, sign, d5);

    char sideOrF = telescopeSide;
    if (fReadsRemaining > 0) { sideOrF = 'F'; fReadsRemaining--; }

    char h = handboxOperational ? '1' : '0';

    String out = "E";
    out += ra6; out += sign; out += d5; out += sideOrF; out += h;
    sendLine(out);
    return;
  }

  // --- GOTO: PHHMMSS±DDMMt ---
  if (cmd.length() >= 13 && cmd[0] == 'P') {
    double ra_h = 0.0, d = 0.0; char sgn = '+';
    if (!parseRADEC_payload_ascii(cmd.c_str() + 1, ra_h, d, sgn)) { replyR(4); return; }
    if (ra_h < 0.0 || ra_h >= 24.0) { replyR(2); return; }
    if (fabs(d) > 90.0) { replyR(3); return; }

    targetHA_h = haveLST ? wrap24(lst_h - ra_h) : wrap24(-ra_h);
    targetDEC_d = d;

    slewingGoto = true;
    trackingEnabled = true;
    replyR(1);
    return;
  }

  // Unknown
  replyR(4);
}

// ---------- RX stream ingestion ----------
static void resetRx() { rxLen = 0; }

static void commitCommand() {
  execCommand();
  resetRx();
}

static void rxPush(uint8_t b) {
  if (rxLen < RX_MAX) rx[rxLen++] = b;
  else {
    // overflow: drop & signal format error, then reset
    replyR(4);
    resetRx();
  }
}

void setup() {
  MOUNT_SERIAL.begin(BAUD);
  lastUpdateMs = millis();

  // deterministic startup
  motorsOn = true;
  trackingEnabled = true;
  resetRx();
}

void loop() {
  stepSim(millis());

  while (MOUNT_SERIAL.available()) {
    uint8_t b = (uint8_t)MOUNT_SERIAL.read();

    // Command terminators: CR or LF
    if (b == '\r' || b == '\n') {
      // ignore multiple terminators
      if (rxLen > 0) commitCommand();
      continue;
    }

    rxPush(b);
  }
}