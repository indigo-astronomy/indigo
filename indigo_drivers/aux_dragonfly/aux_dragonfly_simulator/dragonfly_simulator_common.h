// Copyright (c) 2026 INDIGO initiative
// All rights reserved.
//
// You may use this software under the terms of 'INDIGO Astronomy
// open-source license' (see LICENSE.md).
//
// THIS SOFTWARE IS PROVIDED BY THE AUTHORS 'AS IS' AND ANY EXPRESS
// OR IMPLIED WARRANTIES, INCLUDING, BUT NOT LIMITED TO, THE IMPLIED
// WARRANTIES OF MERCHANTABILITY AND FITNESS FOR A PARTICULAR PURPOSE
// ARE DISCLAIMED. IN NO EVENT SHALL THE AUTHOR BE LIABLE FOR ANY
// DIRECT, INDIRECT, INCIDENTAL, SPECIAL, EXEMPLARY, OR CONSEQUENTIAL
// DAMAGES (INCLUDING, BUT NOT LIMITED TO, PROCUREMENT OF SUBSTITUTE
// GOODS OR SERVICES; LOSS OF USE, DATA, OR PROFITS; OR BUSINESS
// INTERRUPTION) HOWEVER CAUSED AND ON ANY THEORY OF LIABILITY,
// WHETHER IN CONTRACT, STRICT LIABILITY, OR TORT (INCLUDING
// NEGLIGENCE OR OTHERWISE) ARISING IN ANY WAY OUT OF THE USE OF THIS
// SOFTWARE, EVEN IF ADVISED OF THE POSSIBILITY OF SUCH DAMAGE.

// Code is generated by AI

// Lunatico Astronomia Dragonfly controller simulator, shared by the
// aux_dragonfly and dome_dragonfly simulator executables exactly as
// shared/dragonfly_shared.c is shared by the two drivers.
//
// Protocol sources:
//   SLP framing, UDP transport, channel ranges and the version encoding:
//     https://lunaticoastro.com/seletek-developers-guide/
//   Relay pulse units and sensor semantics:
//     https://lunaticoastro.com/df-javascript/
//   Reply forms the public guide leaves to a spreadsheet available on request
//   (echo, the permission-denied form, the unknown-command reply and the
//   single-channel read forms) are taken from the driver author's reference
//   simulator ../relio_simulator/relio_simulator.pl.
//
// Roof wiring, sensor and relay assignment follow
// ../../dome_dragonfly/README.md.

#ifndef DRAGONFLY_SIMULATOR_COMMON_H
#define DRAGONFLY_SIMULATOR_COMMON_H

#define SIM_UDP 1
#define SIM_TERMINATOR '#'
#include "../../../indigo_test/simulator_common/aux_simulator_common.h"

#define DRAGONFLY_CHANNELS 8
#define DRAGONFLY_PASSWORD "123"
#define DRAGONFLY_SENSOR_ACTIVE 900
#define DRAGONFLY_SENSOR_IDLE 10

// Relay and sensor assignment of the dome wiring, see dome_dragonfly/README.md.
#define DRAGONFLY_STOP_RELAY 0
#define DRAGONFLY_OPEN_RELAY 1
#define DRAGONFLY_CLOSE_RELAY 2
#define DRAGONFLY_OPENED_SENSOR 0
#define DRAGONFLY_CLOSED_SENSOR 1
#define DRAGONFLY_PARK_SENSOR 7

static int relay_state[DRAGONFLY_CHANNELS];
static double relay_pulse_until[DRAGONFLY_CHANNELS];
static int general_sensor[DRAGONFLY_CHANNELS] = { 0, 0, 13, 14, 15, 16, 17, 0 };
static double roof_position = 0;
static double roof_travel = 1;
static double roof_updated_at;
static int roof_direction;
static int roof_wiring = 1;
static int access_level = 3;
static bool access_protected;

// A profile is a '+' separated set of flags, so one scenario can combine
// independent device conditions, for example "slow-roof+two-button".
static bool sim_flag(const char *flag) {
	size_t length = strlen(flag);
	for (const char *pnt = sim_profile; pnt != NULL; ) {
		const char *end = strchr(pnt, '+');
		size_t size = end != NULL ? (size_t)(end - pnt) : strlen(pnt);
		if (size == length && !strncmp(pnt, flag, length)) {
			return true;
		}
		pnt = end != NULL ? end + 1 : NULL;
	}
	return false;
}

static void dragonfly_configure(void) {
	roof_updated_at = sim_time();
	if (sim_flag("slow-roof")) {
		roof_travel = 600;
	}
	if (sim_flag("open")) {
		roof_position = 1;
	} else if (sim_flag("half-open")) {
		roof_position = 0.5;
	}
	if (sim_flag("two-button")) {
		roof_wiring = 2;
	} else if (sim_flag("three-button")) {
		roof_wiring = 3;
	}
	if (sim_flag("protected")) {
		access_protected = true;
		access_level = 1;
	}
}

static void dragonfly_update_roof(void) {
	double now = sim_time();
	double elapsed = now - roof_updated_at;
	roof_updated_at = now;
	if (roof_direction > 0) {
		roof_position += elapsed / roof_travel;
		if (roof_position >= 1) {
			roof_position = 1;
			roof_direction = 0;
		}
	} else if (roof_direction < 0) {
		roof_position -= elapsed / roof_travel;
		if (roof_position <= 0) {
			roof_position = 0;
			roof_direction = 0;
		}
	}
}

// The physical controller reacts to the relay contacts, not to the driver's
// intent, so the roof responds to level or edge depending on the wiring.
static void dragonfly_drive_roof(int channel, int previous, int current) {
	if (roof_wiring == 1) {
		if (channel == DRAGONFLY_STOP_RELAY && current && !previous) {
			if (roof_direction != 0) {
				roof_direction = 0;
			} else {
				roof_direction = roof_position >= 1 ? -1 : 1;
			}
		}
	} else if (roof_wiring == 2) {
		if (channel == DRAGONFLY_OPEN_RELAY) {
			if (current) {
				roof_direction = 1;
			} else if (roof_direction > 0) {
				roof_direction = 0;
			}
		} else if (channel == DRAGONFLY_CLOSE_RELAY) {
			if (current) {
				roof_direction = -1;
			} else if (roof_direction < 0) {
				roof_direction = 0;
			}
		}
	} else if (current && !previous) {
		if (channel == DRAGONFLY_STOP_RELAY) {
			roof_direction = 0;
		} else if (channel == DRAGONFLY_OPEN_RELAY) {
			roof_direction = 1;
		} else if (channel == DRAGONFLY_CLOSE_RELAY) {
			roof_direction = -1;
		}
	}
}

static void dragonfly_set_relay(int channel, int value) {
	int previous = relay_state[channel];
	relay_state[channel] = value ? 1 : 0;
	dragonfly_drive_roof(channel, previous, relay_state[channel]);
}

static int dragonfly_sensor(int channel) {
	if (channel == DRAGONFLY_OPENED_SENSOR) {
		return roof_position >= 1 ? DRAGONFLY_SENSOR_ACTIVE : DRAGONFLY_SENSOR_IDLE;
	}
	if (channel == DRAGONFLY_CLOSED_SENSOR) {
		if (sim_flag("both-sensors")) {
			return DRAGONFLY_SENSOR_ACTIVE;
		}
		return roof_position <= 0 ? DRAGONFLY_SENSOR_ACTIVE : DRAGONFLY_SENSOR_IDLE;
	}
	if (channel == DRAGONFLY_PARK_SENSOR) {
		return sim_flag("not-parked") ? DRAGONFLY_SENSOR_IDLE : DRAGONFLY_SENSOR_ACTIVE;
	}
	return general_sensor[channel];
}

static void dragonfly_reply(const char *command, const char *payload) {
	char response[512];
	snprintf(response, sizeof(response), "%.*s:%s#", (int)strlen(command) - 1, command, payload);
	serial_simulator_trace_line(sim_trace, "<-", response);
	sim_send(response, strlen(response));
}

static void dragonfly_deny(const char *command) {
	char response[512];
	snprintf(response, sizeof(response), "!perm %.*s:error -500 protected#", (int)strlen(command) - 2, command + 1);
	serial_simulator_trace_line(sim_trace, "<-", response);
	sim_send(response, strlen(response));
}

static bool dragonfly_writable(void) {
	return !access_protected || access_level >= 2;
}

static void sim_dispatch(const char *command) {
	double now = sim_time();
	for (int i = 0; i < DRAGONFLY_CHANNELS; i++) {
		if (relay_pulse_until[i] != 0 && now >= relay_pulse_until[i]) {
			relay_pulse_until[i] = 0;
			dragonfly_set_relay(i, 0);
		}
	}
	dragonfly_update_roof();
	if (command == NULL) {
		return;
	}
	if (sim_flag("no-reply")) {
		return;
	}
	if (sim_flag("oversized")) {
		char response[200];
		memset(response, 'x', sizeof(response));
		sim_send(response, sizeof(response));
		return;
	}
	char payload[256];
	int port, channel, value;
	if (!strcmp(command, "!seletek version#")) {
		// oper * 10000 + model * 1000 + major * 100 + minor, Dragonfly is model 4.
		if (sim_flag("wrong-model")) {
			strcpy(payload, "2529");
		} else if (sim_flag("bad-version")) {
			strcpy(payload, "not-a-number");
		} else {
			strcpy(payload, "4529");
		}
		dragonfly_reply(command, payload);
	} else if (!strcmp(command, "!seletek echo#")) {
		dragonfly_reply(command, sim_flag("echo-error") ? "-1" : "0");
	} else if (!strcmp(command, "!aux earnaccess#")) {
		snprintf(payload, sizeof(payload), "%d", access_level);
		dragonfly_reply(command, payload);
	} else if (!strncmp(command, "!aux earnaccess ", 16)) {
		char password[128] = { 0 };
		if (sscanf(command, "!aux earnaccess %127[^#]#", password) == 1 && !strcmp(password, DRAGONFLY_PASSWORD)) {
			access_level = 3;
		} else {
			access_level = 1;
		}
		snprintf(payload, sizeof(payload), "%d", access_level);
		dragonfly_reply(command, payload);
	} else if (!strcmp(command, "!relio snanrd 0 0 7#")) {
		if (sim_flag("short-sensors")) {
			strcpy(payload, "11,12");
		} else if (sim_flag("sensor-error")) {
			strcpy(payload, "-1");
		} else {
			int size = 0;
			for (int i = 0; i < DRAGONFLY_CHANNELS; i++) {
				size += snprintf(payload + size, sizeof(payload) - size, i == 0 ? "%d" : ",%d", dragonfly_sensor(i));
			}
		}
		dragonfly_reply(command, payload);
	} else if (!strcmp(command, "!relio rldgrd 0 0 7#")) {
		if (sim_flag("relay-read-error")) {
			strcpy(payload, "-1");
		} else {
			int size = 0;
			for (int i = 0; i < DRAGONFLY_CHANNELS; i++) {
				size += snprintf(payload + size, sizeof(payload) - size, i == 0 ? "%d" : ",%d", relay_state[i]);
			}
		}
		dragonfly_reply(command, payload);
	} else if (sscanf(command, "!relio snanrd %d %d#", &port, &channel) == 2 && channel >= 0 && channel < DRAGONFLY_CHANNELS) {
		snprintf(payload, sizeof(payload), "%d", dragonfly_sensor(channel));
		dragonfly_reply(command, payload);
	} else if (sscanf(command, "!relio sndgrd %d %d#", &port, &channel) == 2 && channel >= 0 && channel < DRAGONFLY_CHANNELS) {
		snprintf(payload, sizeof(payload), "%d", dragonfly_sensor(channel) > 512 ? 1 : 0);
		dragonfly_reply(command, payload);
	} else if (sscanf(command, "!relio rldgrd %d %d#", &port, &channel) == 2 && channel >= 0 && channel < DRAGONFLY_CHANNELS) {
		snprintf(payload, sizeof(payload), "%d", relay_state[channel]);
		dragonfly_reply(command, payload);
	} else if (sscanf(command, "!relio rlset %d %d %d#", &port, &channel, &value) == 3 && channel >= 0 && channel < DRAGONFLY_CHANNELS) {
		if (!dragonfly_writable()) {
			dragonfly_deny(command);
		} else if (sim_flag("relay-error")) {
			dragonfly_reply(command, "-1");
		} else {
			relay_pulse_until[channel] = 0;
			dragonfly_set_relay(channel, value);
			snprintf(payload, sizeof(payload), "%d", relay_state[channel]);
			dragonfly_reply(command, payload);
		}
	} else if (sscanf(command, "!relio rlpulse %d %d %d#", &port, &channel, &value) == 3 && channel >= 0 && channel < DRAGONFLY_CHANNELS && value >= 0) {
		if (!dragonfly_writable()) {
			dragonfly_deny(command);
		} else if (sim_flag("pulse-error")) {
			dragonfly_reply(command, "-1");
		} else {
			dragonfly_set_relay(channel, 1);
			relay_pulse_until[channel] = now + value / 1000.0;
			dragonfly_reply(command, "0");
		}
	} else {
		dragonfly_reply(command, "-1");
	}
}

static int dragonfly_simulator_main(int argc, char **argv) {
	for (int i = 1; i < argc; i++) {
		if (!strcmp(argv[i], "--profile") && i + 1 < argc) {
			sim_profile = argv[i + 1];
		}
	}
	dragonfly_configure();
	return sim_main(argc, argv);
}

#endif /* DRAGONFLY_SIMULATOR_COMMON_H */
