// Copyright (c) 2026 CloudMakers, s. r. o.
// All rights reserved.
//
// You can use this software under the terms of 'INDIGO Astronomy
// open-source license' (see LICENSE.md).
//
// THIS SOFTWARE IS PROVIDED BY THE AUTHORS 'AS IS' AND ANY EXPRESS
// OR IMPLIED WARRANTIES, INCLUDING, BUT NOT LIMITED TO, THE IMPLIED
// WARRANTIES OF MERCHANTABILITY AND FITNESS FOR A PARTICULAR PURPOSE
// ARE DISCLAIMED. IN NO EVENT SHALL THE AUTHOR BE LIABLE FOR ANY
// DIRECT, INDIRECT, INCIDENTAL, SPECIAL, EXEMPLARY, OR CONSEQUENTIAL
// DAMAGES (INCLUDING, BUT NOT LIMITED TO, PROCUREMENT OF SUBSTITUTE
// GOODS OR SERVICES; LOSS OF USE, DATA, OR PROFITS; OR BUSINESS
// INTERRUPTION) HOWEVER CAUSED AND ON ANY THEORY OF LIABILITY,
// WHETHER IN CONTRACT, STRICT LIABILITY, OR TORT (INCLUDING
// NEGLIGENCE OR OTHERWISE) ARISING IN ANY WAY OUT OF THE USE OF THIS
// SOFTWARE, EVEN IF ADVISED OF THE POSSIBILITY OF SUCH DAMAGE.

// version history
// 3.0 by Peter Polakovic <peter.polakovic@cloudmakers.eu>

// Code is generated by AI

/** INDIGO ASCOM Alpaca client driver, HTTP/1.1 client
 \file indigo_system_alpaca_http.c
 */

#include <math.h>
#include <stdint.h>
#include <stdlib.h>
#include <string.h>

#include <indigo/indigo_driver.h>
#include <indigo/indigo_timer.h>

#include "indigo_system_alpaca_http.h"

#ifndef DRIVER_NAME
#define DRIVER_NAME												"indigo_system_alpaca"
#endif

#define ALPACA_HTTP_USER_AGENT						"indigo_system_alpaca"
#define ALPACA_HTTP_HOST_SIZE							256
#define ALPACA_HTTP_MAX_REQUEST_SIZE			(1024 * 1024)
#define ALPACA_HTTP_MAX_INTERIM						8
#define ALPACA_HTTP_MIN_CAPACITY					256
#define ALPACA_HTTP_MIN_READ							65536
#define ALPACA_HTTP_MAX_READ							0x40000000
#define ALPACA_HTTP_MAX_WAIT							1000.0
#define ALPACA_HTTP_TIME_TOLERANCE				0.001

// The socket is opened with a negative log level, so indigo_uni_io logs byte counts instead of the (possibly large and binary) data.
#define ALPACA_HTTP_LOG_LEVEL							(-INDIGO_LOG_TRACE)

struct alpaca_http_connection {
	char host[ALPACA_HTTP_HOST_SIZE];
	int port;
	char host_header[ALPACA_HTTP_HOST_SIZE + 16];
	indigo_uni_handle *handle;
	unsigned connects;
	alpaca_http_buffer request;
	size_t input_start;
	size_t input_end;
	char input[ALPACA_HTTP_MAX_HEADER_SIZE];
};

typedef struct {
	alpaca_http_connection *connection;
	double deadline;
	double first_byte_timeout;
	double inter_byte_timeout;
	double mark;
	bool started;
} alpaca_http_exchange;

typedef struct {
	int status;
	int minor;
	bool chunked;
	bool transfer_encoding;
	bool other_coding;			///< Transfer-Encoding names a coding other than chunked (gzip...), which is never asked for and not decoded
	bool has_length;
	size_t length;
	bool close;
	bool keep_alive;
} alpaca_http_head;

#pragma mark - text helpers

static char alpaca_http_lower(char c) {
	return c >= 'A' && c <= 'Z' ? (char)(c + ('a' - 'A')) : c;
}

// ASCII only and independent of the locale, unlike strcasecmp()
static bool alpaca_http_same(const char *text, size_t length, const char *token) {
	for (size_t i = 0; i < length; i++) {
		if (token[i] == 0 || alpaca_http_lower(text[i]) != alpaca_http_lower(token[i])) {
			return false;
		}
	}
	return token[length] == 0;
}

// true if the comma separated list contains the token; parameters after ';' are ignored
static bool alpaca_http_has_token(const char *list, const char *token) {
	while (*list) {
		while (*list == ' ' || *list == '\t' || *list == ',') {
			list++;
		}
		size_t length = strcspn(list, ",; \t");
		if (length > 0 && alpaca_http_same(list, length, token)) {
			return true;
		}
		list += strcspn(list, ",");
	}
	return false;
}

// True if a list of codings has a coding other than "chunked" (case insensitive, parameters after ';' ignored); empty elements are skipped.
static bool alpaca_http_has_other_coding(const char *list) {
	while (*list) {
		while (*list == ' ' || *list == '\t' || *list == ',') {
			list++;
		}
		size_t length = strcspn(list, ",; \t");
		if (length > 0 && !alpaca_http_same(list, length, "chunked")) {
			return true;
		}
		list += strcspn(list, ",");
	}
	return false;
}

static int alpaca_http_hex_digit(char c) {
	if (c >= '0' && c <= '9') {
		return c - '0';
	}
	if (c >= 'a' && c <= 'f') {
		return c - 'a' + 10;
	}
	if (c >= 'A' && c <= 'F') {
		return c - 'A' + 10;
	}
	return -1;
}

static bool alpaca_http_is_unreserved(unsigned char c) {
	return (c >= 'A' && c <= 'Z') || (c >= 'a' && c <= 'z') || (c >= '0' && c <= '9') || c == '-' || c == '.' || c == '_' || c == '~';
}

// printable ASCII without space: the only bytes allowed in a request target
static bool alpaca_http_is_valid_target(const char *text) {
	for (const unsigned char *c = (const unsigned char *)text; *c; c++) {
		if (*c <= ' ' || *c >= 0x7F) {
			return false;
		}
	}
	return true;
}

static bool alpaca_http_is_valid_headers(const char *headers) {
	if (headers == NULL || *headers == 0) {
		return true;
	}
	size_t length = strlen(headers);
	return length > 2 && strncmp(headers, "\r\n", 2) != 0 && strcmp(headers + length - 2, "\r\n") == 0 && strstr(headers, "\r\n\r\n") == NULL;
}

#pragma mark - buffer

void alpaca_http_buffer_init(alpaca_http_buffer *buffer, size_t max_size) {
	memset(buffer, 0, sizeof(alpaca_http_buffer));
	buffer->max_size = max_size < SIZE_MAX ? max_size : SIZE_MAX - 1;
}

void alpaca_http_buffer_free(alpaca_http_buffer *buffer) {
	indigo_safe_free(buffer->data);
	buffer->data = NULL;
	buffer->size = 0;
	buffer->capacity = 0;
}

void alpaca_http_buffer_clear(alpaca_http_buffer *buffer) {
	buffer->size = 0;
	if (buffer->data != NULL) {
		buffer->data[0] = 0;
	}
}

bool alpaca_http_buffer_reserve(alpaca_http_buffer *buffer, size_t size) {
	if (size > buffer->max_size) {
		return false;
	}
	if (size + 1 > buffer->capacity) {
		size_t capacity = buffer->capacity > SIZE_MAX / 2 ? SIZE_MAX : buffer->capacity * 2;
		if (capacity < ALPACA_HTTP_MIN_CAPACITY) {
			capacity = ALPACA_HTTP_MIN_CAPACITY;
		}
		if (capacity < size + 1) {
			capacity = size + 1;
		}
		if (capacity > buffer->max_size + 1) {
			capacity = buffer->max_size + 1;
		}
		buffer->data = indigo_safe_realloc(buffer->data, capacity);
		buffer->capacity = capacity;
		buffer->data[buffer->size] = 0;
	}
	return true;
}

bool alpaca_http_buffer_append(alpaca_http_buffer *buffer, const void *data, size_t size) {
	if (size > buffer->max_size - buffer->size || !alpaca_http_buffer_reserve(buffer, buffer->size + size)) {
		return false;
	}
	if (size > 0) {
		memcpy(buffer->data + buffer->size, data, size);
	}
	buffer->size += size;
	buffer->data[buffer->size] = 0;
	return true;
}

bool alpaca_http_buffer_append_encoded(alpaca_http_buffer *buffer, const char *text) {
	static const char hex[] = "0123456789ABCDEF";
	if (text == NULL) {
		return false;
	}
	size_t size = 0;
	for (const unsigned char *c = (const unsigned char *)text; *c; c++) {
		size += alpaca_http_is_unreserved(*c) ? 1 : 3;
	}
	if (size > buffer->max_size - buffer->size || !alpaca_http_buffer_reserve(buffer, buffer->size + size)) {
		return false;
	}
	char *out = buffer->data + buffer->size;
	for (const unsigned char *c = (const unsigned char *)text; *c; c++) {
		if (alpaca_http_is_unreserved(*c)) {
			*out++ = (char)*c;
		} else {
			*out++ = '%';
			*out++ = hex[*c >> 4];
			*out++ = hex[*c & 0x0F];
		}
	}
	*out = 0;
	buffer->size += size;
	return true;
}

static bool alpaca_http_buffer_append_text(alpaca_http_buffer *buffer, const char *text) {
	return alpaca_http_buffer_append(buffer, text, strlen(text));
}

#pragma mark - form and query builder

bool alpaca_http_format_double(char *text, size_t size, double value) {
	if (text == NULL || size < ALPACA_HTTP_DOUBLE_SIZE || !isfinite(value)) {
		return false;
	}
	for (int precision = 15; precision <= 17; precision++) {
		snprintf(text, size, "%.*g", precision, value);
		if (strtod(text, NULL) == value) {
			break;
		}
	}
	// printf() writes the decimal separator of LC_NUMERIC, which may be ',' or a multi-byte sequence; everything that is not part of a C number is that separator
	char *out = text;
	bool in_separator = false;
	for (const char *in = text; *in; in++) {
		if ((*in >= '0' && *in <= '9') || *in == '-' || *in == '+' || *in == 'e') {
			*out++ = *in;
			in_separator = false;
		} else if (!in_separator) {
			*out++ = '.';
			in_separator = true;
		}
	}
	*out = 0;
	return true;
}

static bool alpaca_http_form_add(alpaca_http_buffer *form, const char *name, const char *value) {
	size_t mark = form->size;
	if (name != NULL && *name && value != NULL && (mark == 0 || alpaca_http_buffer_append(form, "&", 1)) && alpaca_http_buffer_append_encoded(form, name) && alpaca_http_buffer_append(form, "=", 1) && alpaca_http_buffer_append_encoded(form, value)) {
		return true;
	}
	form->size = mark;
	if (form->data != NULL) {
		form->data[mark] = 0;
	}
	return false;
}

bool alpaca_http_form_add_string(alpaca_http_buffer *form, const char *name, const char *value) {
	return alpaca_http_form_add(form, name, value);
}

bool alpaca_http_form_add_int(alpaca_http_buffer *form, const char *name, long long value) {
	char text[32];
	snprintf(text, sizeof(text), "%lld", value);
	return alpaca_http_form_add(form, name, text);
}

bool alpaca_http_form_add_bool(alpaca_http_buffer *form, const char *name, bool value) {
	return alpaca_http_form_add(form, name, value ? "True" : "False");
}

bool alpaca_http_form_add_double(alpaca_http_buffer *form, const char *name, double value) {
	char text[ALPACA_HTTP_DOUBLE_SIZE];
	return alpaca_http_format_double(text, sizeof(text), value) && alpaca_http_form_add(form, name, text);
}

#pragma mark - response

void alpaca_http_response_init(alpaca_http_response *response, size_t max_body_size) {
	memset(response, 0, sizeof(alpaca_http_response));
	alpaca_http_buffer_init(&response->body, max_body_size);
}

void alpaca_http_response_free(alpaca_http_response *response) {
	alpaca_http_buffer_free(&response->body);
}

bool alpaca_http_response_is(const alpaca_http_response *response, const char *content_type) {
	return content_type != NULL && alpaca_http_same(response->content_type, strcspn(response->content_type, "; \t"), content_type);
}

static void alpaca_http_response_reset(alpaca_http_response *response) {
	response->status = 0;
	response->content_type[0] = 0;
	response->content_encoding[0] = 0;
	response->location[0] = 0;
	alpaca_http_buffer_clear(&response->body);
	alpaca_http_buffer_reserve(&response->body, 0);
}

const char *alpaca_http_result_text(alpaca_http_result result) {
	switch (result) {
		case ALPACA_HTTP_OK:
			return "OK";
		case ALPACA_HTTP_INVALID_REQUEST:
			return "invalid request";
		case ALPACA_HTTP_CONNECT_FAILED:
			return "connection failed";
		case ALPACA_HTTP_CONNECT_TIMEOUT:
			return "connection timeout";
		case ALPACA_HTTP_FIRST_BYTE_TIMEOUT:
			return "no response within timeout";
		case ALPACA_HTTP_TRANSFER_TIMEOUT:
			return "transfer timeout";
		case ALPACA_HTTP_RESET:
			return "connection reset";
		case ALPACA_HTTP_TRUNCATED:
			return "truncated response";
		case ALPACA_HTTP_MALFORMED:
			return "malformed response";
		case ALPACA_HTTP_TOO_LARGE:
			return "response too large";
	}
	return "unknown";
}

#pragma mark - connection

alpaca_http_connection *alpaca_http_connection_create(const char *host, int port) {
	if (host == NULL || *host == 0 || strlen(host) >= ALPACA_HTTP_HOST_SIZE || !alpaca_http_is_valid_target(host) || port < 1 || port > 65535) {
		return NULL;
	}
	alpaca_http_connection *connection = indigo_safe_malloc(sizeof(alpaca_http_connection));
	indigo_safe_strncpy(connection->host, host, sizeof(connection->host));
	connection->port = port;
	// an IPv6 literal goes into brackets and its zone identifier is local to this host, so it never goes on the wire
	int length = (int)strcspn(host, "%");
	if (strchr(host, ':') != NULL) {
		snprintf(connection->host_header, sizeof(connection->host_header), "[%.*s]:%d", length, host, port);
	} else {
		snprintf(connection->host_header, sizeof(connection->host_header), "%.*s:%d", length, host, port);
	}
	alpaca_http_buffer_init(&connection->request, ALPACA_HTTP_MAX_REQUEST_SIZE);
	return connection;
}

void alpaca_http_connection_close(alpaca_http_connection *connection) {
	if (connection != NULL) {
		if (connection->handle != NULL) {
			indigo_uni_close(&connection->handle);
		}
		connection->input_start = 0;
		connection->input_end = 0;
	}
}

void alpaca_http_connection_free(alpaca_http_connection *connection) {
	if (connection != NULL) {
		alpaca_http_connection_close(connection);
		alpaca_http_buffer_free(&connection->request);
		indigo_safe_free(connection);
	}
}

bool alpaca_http_connection_is_open(alpaca_http_connection *connection) {
	if (connection == NULL || connection->handle == NULL) {
		return false;
	}
	// nothing is expected on an idle connection, so a readable socket means an end of file, a reset or stray data
	if (indigo_uni_wait_for_data(connection->handle, 0) != 0) {
		INDIGO_DRIVER_DEBUG(DRIVER_NAME, "%s: idle connection is stale, closing", connection->host_header);
		alpaca_http_connection_close(connection);
		return false;
	}
	return true;
}

unsigned alpaca_http_connection_connects(const alpaca_http_connection *connection) {
	return connection != NULL ? connection->connects : 0;
}

static alpaca_http_result alpaca_http_connect(alpaca_http_connection *connection, double timeout, double deadline) {
	double start = indigo_monotonic_time();
	if (timeout > deadline - start) {
		timeout = deadline - start;
	}
	if (timeout > ALPACA_HTTP_MAX_WAIT) {
		timeout = ALPACA_HTTP_MAX_WAIT;
	}
	if (timeout <= 0) {
		return ALPACA_HTTP_CONNECT_TIMEOUT;
	}
	connection->handle = indigo_uni_open_client_socket_with_timeout(connection->host, connection->port, SOCK_STREAM, (long)(timeout * 1000000.0), ALPACA_HTTP_LOG_LEVEL);
	if (connection->handle == NULL) {
		// indigo_uni_io does not say why the connection failed, but only a timeout takes the whole timeout
		return indigo_monotonic_time() - start >= timeout - ALPACA_HTTP_TIME_TOLERANCE ? ALPACA_HTTP_CONNECT_TIMEOUT : ALPACA_HTTP_CONNECT_FAILED;
	}
	connection->connects++;
	connection->input_start = 0;
	connection->input_end = 0;
	return ALPACA_HTTP_OK;
}

#pragma mark - receiving

// Wait for data within the applicable deadline and read what is available, at most size bytes. An end of file is reported as OK with *received == 0.
static alpaca_http_result alpaca_http_receive(alpaca_http_exchange *exchange, char *data, size_t size, size_t *received) {
	alpaca_http_connection *connection = exchange->connection;
	*received = 0;
	while (true) {
		double limit = exchange->mark + (exchange->started ? exchange->inter_byte_timeout : exchange->first_byte_timeout);
		if (limit > exchange->deadline) {
			limit = exchange->deadline;
		}
		double remaining = limit - indigo_monotonic_time();
		bool last = remaining <= ALPACA_HTTP_MAX_WAIT;
		if (remaining < 0) {
			remaining = 0;
		} else if (remaining > ALPACA_HTTP_MAX_WAIT) {
			remaining = ALPACA_HTTP_MAX_WAIT;
		}
		int result = indigo_uni_wait_for_data(connection->handle, (long)(remaining * 1000000.0));
		if (result < 0) {
			return ALPACA_HTTP_RESET;
		}
		if (result > 0) {
			break;
		}
		if (last) {
			return exchange->started ? ALPACA_HTTP_TRANSFER_TIMEOUT : ALPACA_HTTP_FIRST_BYTE_TIMEOUT;
		}
	}
	long count = indigo_uni_read_available(connection->handle, data, size < ALPACA_HTTP_MAX_READ ? (long)size : ALPACA_HTTP_MAX_READ);
	if (count < 0) {
		return ALPACA_HTTP_RESET;
	}
	if (count > 0) {
		exchange->started = true;
		exchange->mark = indigo_monotonic_time();
		*received = (size_t)count;
	}
	return ALPACA_HTTP_OK;
}

// Return the next line without its terminator. The line lives in the input buffer and is valid until the next call. The budget limits the size of a block of lines.
static alpaca_http_result alpaca_http_read_line(alpaca_http_exchange *exchange, char **line, size_t *budget) {
	alpaca_http_connection *connection = exchange->connection;
	size_t scanned = 0;
	while (true) {
		size_t pending = connection->input_end - connection->input_start;
		char *start = connection->input + connection->input_start;
		char *end = memchr(start + scanned, '\n', pending - scanned);
		if (end != NULL) {
			size_t length = (size_t)(end - start) + 1;
			if (length > *budget) {
				return ALPACA_HTTP_TOO_LARGE;
			}
			*budget -= length;
			*end = 0;
			if (end > start && end[-1] == '\r') {
				end[-1] = 0;
			}
			*line = start;
			connection->input_start += length;
			return ALPACA_HTTP_OK;
		}
		if (pending >= *budget) {
			return ALPACA_HTTP_TOO_LARGE;
		}
		scanned = pending;
		if (connection->input_start > 0) {
			memmove(connection->input, start, pending);
			connection->input_start = 0;
			connection->input_end = pending;
		}
		size_t received = 0;
		alpaca_http_result result = alpaca_http_receive(exchange, connection->input + connection->input_end, sizeof(connection->input) - connection->input_end, &received);
		if (result != ALPACA_HTTP_OK) {
			return result;
		}
		if (received == 0) {
			return exchange->started ? ALPACA_HTTP_TRUNCATED : ALPACA_HTTP_RESET;
		}
		connection->input_end += received;
	}
}

// Append exactly count bytes to the body: first what was read ahead into the input buffer, the rest straight from the socket into the body.
static alpaca_http_result alpaca_http_read_body(alpaca_http_exchange *exchange, alpaca_http_buffer *body, size_t count) {
	alpaca_http_connection *connection = exchange->connection;
	if (count > body->max_size - body->size || !alpaca_http_buffer_reserve(body, body->size + count)) {
		return ALPACA_HTTP_TOO_LARGE;
	}
	size_t buffered = connection->input_end - connection->input_start;
	if (buffered > count) {
		buffered = count;
	}
	memcpy(body->data + body->size, connection->input + connection->input_start, buffered);
	connection->input_start += buffered;
	body->size += buffered;
	count -= buffered;
	alpaca_http_result result = ALPACA_HTTP_OK;
	while (count > 0 && result == ALPACA_HTTP_OK) {
		size_t received = 0;
		result = alpaca_http_receive(exchange, body->data + body->size, count, &received);
		if (result == ALPACA_HTTP_OK && received == 0) {
			result = ALPACA_HTTP_TRUNCATED;
		}
		body->size += received;
		count -= received;
	}
	body->data[body->size] = 0;
	return result;
}

// Append everything up to the end of file to the body, growing the allocation geometrically.
static alpaca_http_result alpaca_http_read_to_eof(alpaca_http_exchange *exchange, alpaca_http_buffer *body) {
	alpaca_http_connection *connection = exchange->connection;
	if (!alpaca_http_buffer_append(body, connection->input + connection->input_start, connection->input_end - connection->input_start)) {
		return ALPACA_HTTP_TOO_LARGE;
	}
	connection->input_start = 0;
	connection->input_end = 0;
	while (true) {
		size_t received = 0;
		if (body->size == body->max_size) {
			char probe;
			alpaca_http_result result = alpaca_http_receive(exchange, &probe, 1, &received);
			if (result != ALPACA_HTTP_OK) {
				return result;
			}
			return received == 0 ? ALPACA_HTTP_OK : ALPACA_HTTP_TOO_LARGE;
		}
		if (body->capacity - 1 - body->size < ALPACA_HTTP_MIN_READ) {
			size_t growth = body->size < ALPACA_HTTP_MIN_READ ? ALPACA_HTTP_MIN_READ : body->size;
			if (growth > body->max_size - body->size) {
				growth = body->max_size - body->size;
			}
			alpaca_http_buffer_reserve(body, body->size + growth);
		}
		alpaca_http_result result = alpaca_http_receive(exchange, body->data + body->size, body->capacity - 1 - body->size, &received);
		body->size += received;
		body->data[body->size] = 0;
		if (result != ALPACA_HTTP_OK) {
			return result;
		}
		if (received == 0) {
			return ALPACA_HTTP_OK;
		}
	}
}

// Transfer-Encoding: chunked, including chunk extensions (ignored) and trailers (skipped).
static alpaca_http_result alpaca_http_read_chunked(alpaca_http_exchange *exchange, alpaca_http_buffer *body) {
	char *line = NULL;
	size_t budget = ALPACA_HTTP_MAX_HEADER_SIZE;
	alpaca_http_result result = alpaca_http_read_line(exchange, &line, &budget);
	while (result == ALPACA_HTTP_OK) {
		size_t size = 0;
		int digits = 0;
		for (int digit = alpaca_http_hex_digit(*line); digit >= 0; digit = alpaca_http_hex_digit(*++line)) {
			if (size > (SIZE_MAX >> 4)) {
				return ALPACA_HTTP_TOO_LARGE;
			}
			size = (size << 4) | (size_t)digit;
			digits++;
		}
		while (*line == ' ' || *line == '\t') {
			line++;
		}
		if (digits == 0 || (*line != 0 && *line != ';')) {
			return ALPACA_HTTP_MALFORMED;
		}
		if (size == 0) {
			break;
		}
		result = alpaca_http_read_body(exchange, body, size);
		if (result != ALPACA_HTTP_OK) {
			return result;
		}
		budget = ALPACA_HTTP_MAX_HEADER_SIZE;
		result = alpaca_http_read_line(exchange, &line, &budget);
		if (result != ALPACA_HTTP_OK) {
			return result;
		}
		if (*line != 0) {
			return ALPACA_HTTP_MALFORMED;
		}
		budget = ALPACA_HTTP_MAX_HEADER_SIZE;
		result = alpaca_http_read_line(exchange, &line, &budget);
	}
	budget = ALPACA_HTTP_MAX_HEADER_SIZE;
	while (result == ALPACA_HTTP_OK) {
		result = alpaca_http_read_line(exchange, &line, &budget);
		if (result == ALPACA_HTTP_OK && *line == 0) {
			break;
		}
	}
	return result;
}

static bool alpaca_http_parse_status(const char *line, alpaca_http_head *head) {
	if (strncmp(line, "HTTP/1.", 7) != 0 || line[7] < '0' || line[7] > '9' || line[8] != ' ') {
		return false;
	}
	const char *code = line + 9;
	for (int i = 0; i < 3; i++) {
		if (code[i] < '0' || code[i] > '9') {
			return false;
		}
	}
	if (code[3] != 0 && code[3] != ' ') {
		return false;
	}
	head->minor = line[7] - '0';
	head->status = (code[0] - '0') * 100 + (code[1] - '0') * 10 + (code[2] - '0');
	return head->status >= 100 && head->status <= 599;
}

static bool alpaca_http_parse_header(char *line, alpaca_http_head *head, alpaca_http_response *response) {
	char *colon = strchr(line, ':');
	if (colon == NULL || colon == line) {
		return false;
	}
	size_t name_length = (size_t)(colon - line);
	while (name_length > 0 && (line[name_length - 1] == ' ' || line[name_length - 1] == '\t')) {
		name_length--;
	}
	char *value = colon + 1;
	while (*value == ' ' || *value == '\t') {
		value++;
	}
	size_t value_length = strlen(value);
	while (value_length > 0 && (value[value_length - 1] == ' ' || value[value_length - 1] == '\t')) {
		value[--value_length] = 0;
	}
	if (alpaca_http_same(line, name_length, "content-length")) {
		size_t length = 0;
		if (value_length == 0) {
			return false;
		}
		for (const char *digit = value; *digit; digit++) {
			if (*digit < '0' || *digit > '9') {
				return false;
			}
			// a length that does not fit is larger than any buffer, so saturate and let the size check refuse it
			length = length > (SIZE_MAX - 9) / 10 ? SIZE_MAX : length * 10 + (size_t)(*digit - '0');
		}
		if (head->has_length && head->length != length) {
			return false;
		}
		head->has_length = true;
		head->length = length;
	} else if (alpaca_http_same(line, name_length, "transfer-encoding")) {
		head->transfer_encoding = true;
		if (alpaca_http_has_token(value, "chunked")) {
			head->chunked = true;
		}
		if (alpaca_http_has_other_coding(value)) {
			head->other_coding = true;
		}
	} else if (alpaca_http_same(line, name_length, "connection")) {
		if (alpaca_http_has_token(value, "close")) {
			head->close = true;
		}
		if (alpaca_http_has_token(value, "keep-alive")) {
			head->keep_alive = true;
		}
	} else if (alpaca_http_same(line, name_length, "content-type")) {
		indigo_safe_strncpy(response->content_type, value, sizeof(response->content_type));
	} else if (alpaca_http_same(line, name_length, "content-encoding")) {
		indigo_safe_strncpy(response->content_encoding, value, sizeof(response->content_encoding));
	} else if (alpaca_http_same(line, name_length, "location")) {
		indigo_safe_strncpy(response->location, value, sizeof(response->location));
	}
	return true;
}

// Status line and header block of the final response; interim 1xx responses are skipped.
static alpaca_http_result alpaca_http_read_head(alpaca_http_exchange *exchange, alpaca_http_head *head, alpaca_http_response *response) {
	for (int interim = 0; interim <= ALPACA_HTTP_MAX_INTERIM; interim++) {
		char *line = NULL;
		size_t budget = ALPACA_HTTP_MAX_HEADER_SIZE;
		memset(head, 0, sizeof(alpaca_http_head));
		response->content_type[0] = 0;
		response->content_encoding[0] = 0;
		response->location[0] = 0;
		alpaca_http_result result = alpaca_http_read_line(exchange, &line, &budget);
		if (result != ALPACA_HTTP_OK) {
			return result;
		}
		if (!alpaca_http_parse_status(line, head)) {
			return ALPACA_HTTP_MALFORMED;
		}
		while (true) {
			result = alpaca_http_read_line(exchange, &line, &budget);
			if (result != ALPACA_HTTP_OK) {
				return result;
			}
			if (*line == 0) {
				break;
			}
			// a line that starts with white space continues the previous header (obsolete folding), none of the headers used here needs it
			if (*line != ' ' && *line != '\t' && !alpaca_http_parse_header(line, head, response)) {
				return ALPACA_HTTP_MALFORMED;
			}
		}
		if (head->status >= 200) {
			response->status = head->status;
			return ALPACA_HTTP_OK;
		}
	}
	return ALPACA_HTTP_MALFORMED;
}

static alpaca_http_result alpaca_http_read_response(alpaca_http_exchange *exchange, alpaca_http_response *response) {
	alpaca_http_connection *connection = exchange->connection;
	alpaca_http_head head = { 0 };
	bool to_eof = false;
	alpaca_http_result result = alpaca_http_read_head(exchange, &head, response);
	if (result != ALPACA_HTTP_OK) {
		return result;
	}
	if (head.status == 204 || head.status == 304) {
		result = ALPACA_HTTP_OK;
	} else if (head.other_coding) {
		// A transfer coding the client does not decode (gzip, deflate...): handing the coded body over as if it were plain would make it
		// garbage that may still pass for data (an image). A server may use such a coding only if the client asks for it with TE, which
		// is never sent. The body is not read, so the connection can not be used again.
		alpaca_http_connection_close(connection);
		return ALPACA_HTTP_MALFORMED;
	} else if (head.chunked) {
		result = alpaca_http_read_chunked(exchange, &response->body);
	} else if (head.has_length && !head.transfer_encoding) {
		result = alpaca_http_read_body(exchange, &response->body, head.length);
	} else {
		to_eof = true;
		result = alpaca_http_read_to_eof(exchange, &response->body);
	}
	if (result != ALPACA_HTTP_OK) {
		return result;
	}
	// the socket is kept only if the end of this response was unambiguous and the server did not ask to close it
	if (to_eof || head.close || (head.minor == 0 && !head.keep_alive) || connection->input_start != connection->input_end) {
		alpaca_http_connection_close(connection);
	}
	return ALPACA_HTTP_OK;
}

#pragma mark - requests

static bool alpaca_http_build_request(alpaca_http_connection *connection, const char *method, const char *path, const char *query, const char *form, const char *headers) {
	alpaca_http_buffer *request = &connection->request;
	alpaca_http_buffer_clear(request);
	bool ok = alpaca_http_buffer_append_text(request, method) && alpaca_http_buffer_append_text(request, " ") && alpaca_http_buffer_append_text(request, path);
	if (query != NULL && *query) {
		ok = ok && alpaca_http_buffer_append_text(request, "?") && alpaca_http_buffer_append_text(request, query);
	}
	ok = ok && alpaca_http_buffer_append_text(request, " HTTP/1.1\r\nHost: ") && alpaca_http_buffer_append_text(request, connection->host_header) && alpaca_http_buffer_append_text(request, "\r\nUser-Agent: " ALPACA_HTTP_USER_AGENT "\r\nConnection: keep-alive\r\n");
	if (form != NULL) {
		char length[32];
		snprintf(length, sizeof(length), "%zu", strlen(form));
		ok = ok && alpaca_http_buffer_append_text(request, "Content-Type: application/x-www-form-urlencoded\r\nContent-Length: ") && alpaca_http_buffer_append_text(request, length) && alpaca_http_buffer_append_text(request, "\r\n");
	}
	if (headers != NULL) {
		ok = ok && alpaca_http_buffer_append_text(request, headers);
	}
	ok = ok && alpaca_http_buffer_append_text(request, "\r\n");
	if (form != NULL) {
		ok = ok && alpaca_http_buffer_append_text(request, form);
	}
	return ok;
}

// Write the request that is in connection->request and read the response.
static alpaca_http_result alpaca_http_exchange_run(alpaca_http_exchange *exchange, alpaca_http_response *response) {
	alpaca_http_connection *connection = exchange->connection;
	double remaining = exchange->deadline - indigo_monotonic_time();
	if (remaining <= 0) {
		return ALPACA_HTTP_TRANSFER_TIMEOUT;
	}
	if (remaining > ALPACA_HTTP_MAX_WAIT) {
		remaining = ALPACA_HTTP_MAX_WAIT;
	}
	// the request is small and normally fits the socket send buffer, the timeout only guards against a peer that does not read at all
	indigo_uni_set_socket_write_timeout(connection->handle, (long)(remaining * 1000000.0) + 1000);
	if (indigo_uni_write(connection->handle, connection->request.data, (long)connection->request.size) != (long)connection->request.size) {
		return indigo_monotonic_time() >= exchange->deadline - ALPACA_HTTP_TIME_TOLERANCE ? ALPACA_HTTP_TRANSFER_TIMEOUT : ALPACA_HTTP_RESET;
	}
	exchange->mark = indigo_monotonic_time();
	return alpaca_http_read_response(exchange, response);
}

static alpaca_http_result alpaca_http_request(alpaca_http_connection *connection, const char *method, bool replayable, const char *path, const char *query, const char *form, const alpaca_http_options *options, alpaca_http_response *response) {
	static const alpaca_http_options default_options = { 0 };
	// A network request takes as long as the server needs; the handler queue task that makes it has no run time limit.
	indigo_set_handler_max_run_time(0);
	if (connection == NULL || response == NULL || path == NULL) {
		return ALPACA_HTTP_INVALID_REQUEST;
	}
	if (options == NULL) {
		options = &default_options;
	}
	alpaca_http_response_reset(response);
	if (*path != '/' || !alpaca_http_is_valid_target(path) || (query != NULL && !alpaca_http_is_valid_target(query)) || !alpaca_http_is_valid_headers(options->headers) || !alpaca_http_build_request(connection, method, path, query, form, options->headers)) {
		INDIGO_DRIVER_DEBUG(DRIVER_NAME, "%s %s%s: invalid request", method, connection->host_header, path);
		return ALPACA_HTTP_INVALID_REQUEST;
	}
	double connect_timeout = (options->timeouts.connect > 0 ? options->timeouts.connect : ALPACA_HTTP_DEFAULT_CONNECT_TIMEOUT) / 1000.0;
	double start = indigo_monotonic_time();
	alpaca_http_exchange exchange = { 0 };
	exchange.connection = connection;
	exchange.first_byte_timeout = (options->timeouts.first_byte > 0 ? options->timeouts.first_byte : ALPACA_HTTP_DEFAULT_FIRST_BYTE_TIMEOUT) / 1000.0;
	exchange.inter_byte_timeout = (options->timeouts.inter_byte > 0 ? options->timeouts.inter_byte : ALPACA_HTTP_DEFAULT_INTER_BYTE_TIMEOUT) / 1000.0;
	exchange.deadline = start + (options->timeouts.total > 0 ? options->timeouts.total : ALPACA_HTTP_DEFAULT_TOTAL_TIMEOUT) / 1000.0;
	alpaca_http_result result = ALPACA_HTTP_OK;
	for (int attempt = 0; attempt < 2; attempt++) {
		// a socket that went stale while it was idle is replaced before anything is written, which is safe for every method
		bool reused = alpaca_http_connection_is_open(connection);
		if (!reused) {
			result = alpaca_http_connect(connection, connect_timeout, exchange.deadline);
			if (result != ALPACA_HTTP_OK) {
				break;
			}
		}
		exchange.started = false;
		result = alpaca_http_exchange_run(&exchange, response);
		if (result == ALPACA_HTTP_OK) {
			INDIGO_DRIVER_TRACE(DRIVER_NAME, "%s %s%s%s%s -> %d, %s, %lu bytes in %.3f s", method, connection->host_header, path, query != NULL && *query ? "?" : "", query != NULL ? query : "", response->status, response->content_type, (unsigned long)response->body.size, indigo_monotonic_time() - start);
			return ALPACA_HTTP_OK;
		}
		alpaca_http_connection_close(connection);
		// The only failure worth a second attempt: a kept-alive socket that the peer dropped before a single byte of the response arrived.
		// The request may have been written into it, so the caller has to allow that for anything that is not a GET.
		if (result != ALPACA_HTTP_RESET || exchange.started || !reused || !replayable) {
			break;
		}
		INDIGO_DRIVER_DEBUG(DRIVER_NAME, "%s %s%s: reused connection was stale, retrying", method, connection->host_header, path);
		alpaca_http_response_reset(response);
	}
	INDIGO_DRIVER_DEBUG(DRIVER_NAME, "%s %s%s%s%s failed: %s (status %d, %lu body bytes) after %.3f s", method, connection->host_header, path, query != NULL && *query ? "?" : "", query != NULL ? query : "", alpaca_http_result_text(result), response->status, (unsigned long)response->body.size, indigo_monotonic_time() - start);
	return result;
}

alpaca_http_result alpaca_http_get(alpaca_http_connection *connection, const char *path, const char *query, const alpaca_http_options *options, alpaca_http_response *response) {
	return alpaca_http_request(connection, "GET", true, path, query, NULL, options, response);
}

alpaca_http_result alpaca_http_put(alpaca_http_connection *connection, const char *path, const char *query, const char *form, const alpaca_http_options *options, alpaca_http_response *response) {
	return alpaca_http_request(connection, "PUT", options != NULL && options->replayable, path, query, form != NULL ? form : "", options, response);
}
