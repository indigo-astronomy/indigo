// ASCOM Alpaca server simulator, Rotator
//
// Copyright (c) 2026 CloudMakers, s. r. o.
// All rights reserved.
//
// You can use this software under the terms of 'INDIGO Astronomy
// open-source license' (see LICENSE.md).
//
// THIS SOFTWARE IS PROVIDED BY THE AUTHORS 'AS IS' AND ANY EXPRESS
// OR IMPLIED WARRANTIES, INCLUDING, BUT NOT LIMITED TO, THE IMPLIED
// WARRANTIES OF MERCHANTABILITY AND FITNESS FOR A PARTICULAR PURPOSE
// ARE DISCLAIMED. IN NO EVENT SHALL THE AUTHOR BE LIABLE FOR ANY
// DIRECT, INDIRECT, INCIDENTAL, SPECIAL, EXEMPLARY, OR CONSEQUENTIAL
// DAMAGES (INCLUDING, BUT NOT LIMITED TO, PROCUREMENT OF SUBSTITUTE
// GOODS OR SERVICES; LOSS OF USE, DATA, OR PROFITS; OR BUSINESS
// INTERRUPTION) HOWEVER CAUSED AND ON ANY THEORY OF LIABILITY,
// WHETHER IN CONTRACT, STRICT LIABILITY, OR TORT (INCLUDING
// NEGLIGENCE OR OTHERWISE) ARISING IN ANY WAY OUT OF THE USE OF THIS
// SOFTWARE, EVEN IF ADVISED OF THE POSSIBILITY OF SUCH DAMAGE.

// Code is generated by AI

// This source file was generated by a Claude agent.

// IRotatorV4 (Platform 7), IRotatorV3 with interface=legacy; MechanicalPosition,
// MoveMechanical and Sync exist from IRotatorV3, so InterfaceVersion=2 hides them.
// Position = MechanicalPosition + sync offset, both in 0 <= angle < 360.
// Simulator assumptions: the rotator turns at DegreesPerSecond and takes the
// shorter way round for absolute moves; an absolute angle outside
// 0 <= angle < 360 and a relative move of a full turn or more are InvalidValue.
// Reverse is stored and reported, it changes neither the reported angles nor
// the moves: this is what the ASCOM OmniSim rotator does, and the standard
// defines the effect of Reverse on the hardware only. Reverse is
// NotImplemented in both directions when CanReverse=false (IRotatorV2;
// IRotatorV3 requires CanReverse to be true).
// StepSizeAvailable=false: StepSize is NotImplemented (a rotator that does not
// know its step size, IRotator.StepSize).
// TargetPosition is "the destination position angle for Move and MoveAbsolute",
// "retained until a subsequent call to Move or MoveAbsolute" (IRotatorV3). The
// standard does not say what MoveMechanical and Sync do to it:
// - TargetTracksMechanical=true (default): TargetPosition is the mechanical
//   target plus the sync offset, so MoveMechanical and Sync change it, as in a
//   device that keeps one target for its hardware.
// - TargetTracksMechanical=false: the literal reading, only Move and
//   MoveAbsolute change it.
// - TargetIsMechanical=true: TargetPosition is the mechanical target, without
//   the sync offset, and Halt sets it to the mechanical position where the
//   rotator stopped. That is what the ASCOM OmniSim 0.5.0 rotator reports
//   (measured 2026-10-03: after Sync to 100 at mechanical 40 a MoveAbsolute 130
//   reads TargetPosition 70); the standard wants the sky angle.

#include <math.h>

#include "system_alpaca_simulator.h"

typedef struct {
	bool can_reverse;
	bool reverse;
	bool is_moving;
	alpaca_motion mechanical;
	double sync_offset;
	double step_size;
	double target_position;
	double degrees_per_second;
	bool step_size_available;
	bool target_tracks_mechanical;
	bool target_is_mechanical;
} rotator_state;

static double rotator_wrap(double angle) {
	angle = fmod(angle, 360);
	return angle < 0 ? angle + 360 : angle;
}

static void rotator_reset(alpaca_device *device) {
	rotator_state *state = device->state;
	state->can_reverse = true;
	state->step_size = 0.01;
	state->degrees_per_second = 10;
	state->step_size_available = true;
	state->target_tracks_mechanical = true;
}

static void rotator_update(alpaca_device *device) {
	rotator_state *state = device->state;
	alpaca_motion_update(&state->mechanical);
	if (!state->mechanical.moving) {
		alpaca_motion_set(&state->mechanical, rotator_wrap(state->mechanical.position));
	}
	state->is_moving = state->mechanical.moving;
}

static void rotator_get_mechanicalposition(alpaca_device *device, alpaca_request *request) {
	rotator_state *state = device->state;
	alpaca_reply_double(request, rotator_wrap(state->mechanical.position));
}

static void rotator_get_position(alpaca_device *device, alpaca_request *request) {
	rotator_state *state = device->state;
	alpaca_reply_double(request, rotator_wrap(state->mechanical.position + state->sync_offset));
}

static void rotator_get_reverse(alpaca_device *device, alpaca_request *request) {
	rotator_state *state = device->state;
	if (!state->can_reverse) {
		alpaca_reply_error(request, ALPACA_ERROR_NOT_IMPLEMENTED, "Reverse is not implemented");
		return;
	}
	alpaca_reply_member(device, request);
}

static void rotator_get_stepsize(alpaca_device *device, alpaca_request *request) {
	rotator_state *state = device->state;
	if (!state->step_size_available) {
		alpaca_reply_error(request, ALPACA_ERROR_NOT_IMPLEMENTED, "StepSize is not implemented");
		return;
	}
	alpaca_reply_member(device, request);
}

static void rotator_put_reverse(alpaca_device *device, alpaca_request *request) {
	rotator_state *state = device->state;
	bool reverse = false;
	if (!alpaca_param_bool(request, "Reverse", &reverse)) {
		return;
	}
	if (!state->can_reverse) {
		alpaca_reply_error(request, ALPACA_ERROR_NOT_IMPLEMENTED, "Reverse is not implemented");
		return;
	}
	state->reverse = reverse;
	alpaca_reply_void(request);
}

static void rotator_put_halt(alpaca_device *device, alpaca_request *request) {
	rotator_state *state = device->state;
	alpaca_motion_stop(&state->mechanical);
	state->is_moving = false;
	if (state->target_is_mechanical) {
		state->target_position = rotator_wrap(state->mechanical.position);
	}
	alpaca_event("STATE", "rotator/%d halt mechanical=%.3f", device->number, rotator_wrap(state->mechanical.position));
	alpaca_reply_void(request);
}

// Starts a move of delta degrees from the current mechanical position.
static void rotator_start(alpaca_device *device, alpaca_request *request, double delta, bool sets_target) {
	rotator_state *state = device->state;
	double origin = alpaca_motion_update(&state->mechanical);
	if (sets_target || state->target_tracks_mechanical) {
		state->target_position = rotator_wrap(origin + delta + (state->target_is_mechanical ? 0 : state->sync_offset));
	}
	alpaca_motion_start(&state->mechanical, origin + delta, state->degrees_per_second);
	state->is_moving = state->mechanical.moving;
	alpaca_event("MOVE", "rotator/%d from=%.3f by=%.3f duration=%.3f", device->number, rotator_wrap(origin), delta, state->mechanical.duration);
	alpaca_reply_void(request);
}

static double rotator_shortest(double delta) {
	delta = rotator_wrap(delta);
	return delta > 180 ? delta - 360 : delta;
}

static bool rotator_angle(alpaca_request *request, double *position) {
	if (!alpaca_param_double(request, "Position", position)) {
		return false;
	}
	if (*position < 0 || *position >= 360) {
		alpaca_reply_error(request, ALPACA_ERROR_INVALID_VALUE, "Position %g is out of range 0 <= angle < 360", *position);
		return false;
	}
	return true;
}

static void rotator_put_move(alpaca_device *device, alpaca_request *request) {
	double position = 0;
	if (!alpaca_param_double(request, "Position", &position)) {
		return;
	}
	if (position <= -360 || position >= 360) {
		alpaca_reply_error(request, ALPACA_ERROR_INVALID_VALUE, "Relative move of %g is out of range -360 < angle < 360", position);
		return;
	}
	rotator_start(device, request, position, true);
}

static void rotator_put_moveabsolute(alpaca_device *device, alpaca_request *request) {
	rotator_state *state = device->state;
	double position = 0;
	if (rotator_angle(request, &position)) {
		rotator_start(device, request, rotator_shortest(position - state->sync_offset - state->mechanical.position), true);
	}
}

static void rotator_put_movemechanical(alpaca_device *device, alpaca_request *request) {
	rotator_state *state = device->state;
	double position = 0;
	if (rotator_angle(request, &position)) {
		rotator_start(device, request, rotator_shortest(position - state->mechanical.position), false);
	}
}

static void rotator_put_sync(alpaca_device *device, alpaca_request *request) {
	rotator_state *state = device->state;
	double position = 0;
	if (!rotator_angle(request, &position)) {
		return;
	}
	state->sync_offset = rotator_shortest(position - state->mechanical.position);
	if (state->target_tracks_mechanical) {
		state->target_position = state->target_is_mechanical ? rotator_wrap(state->mechanical.position) : position;
	}
	alpaca_event("STATE", "rotator/%d sync position=%.3f offset=%.3f", device->number, position, state->sync_offset);
	alpaca_reply_void(request);
}

static const alpaca_member rotator_members[] = {
	{ .name = "CanReverse", .kind = ALPACA_BOOL, .offset = offsetof(rotator_state, can_reverse), .flags = ALPACA_R },
	{ .name = "IsMoving", .kind = ALPACA_BOOL, .offset = offsetof(rotator_state, is_moving), .flags = ALPACA_R | ALPACA_STATE },
	{ .name = "MechanicalPosition", .kind = ALPACA_MOTION, .offset = offsetof(rotator_state, mechanical), .flags = ALPACA_STATE, .since = 3, .get = rotator_get_mechanicalposition },
	{ .name = "Position", .flags = ALPACA_STATE, .get = rotator_get_position },
	{ .name = "Reverse", .kind = ALPACA_BOOL, .offset = offsetof(rotator_state, reverse), .get = rotator_get_reverse, .put = rotator_put_reverse },
	{ .name = "StepSize", .kind = ALPACA_DOUBLE, .offset = offsetof(rotator_state, step_size), .get = rotator_get_stepsize },
	{ .name = "TargetPosition", .kind = ALPACA_DOUBLE, .offset = offsetof(rotator_state, target_position), .flags = ALPACA_R },
	{ .name = "Halt", .put = rotator_put_halt },
	{ .name = "Move", .put = rotator_put_move },
	{ .name = "MoveAbsolute", .put = rotator_put_moveabsolute },
	{ .name = "MoveMechanical", .since = 3, .put = rotator_put_movemechanical },
	{ .name = "Sync", .since = 3, .put = rotator_put_sync },
	{ .name = "SyncOffset", .kind = ALPACA_DOUBLE, .offset = offsetof(rotator_state, sync_offset), .flags = ALPACA_CONFIG },
	{ .name = "DegreesPerSecond", .kind = ALPACA_DOUBLE, .offset = offsetof(rotator_state, degrees_per_second), .flags = ALPACA_CONFIG },
	{ .name = "StepSizeAvailable", .kind = ALPACA_BOOL, .offset = offsetof(rotator_state, step_size_available), .flags = ALPACA_CONFIG },
	{ .name = "TargetTracksMechanical", .kind = ALPACA_BOOL, .offset = offsetof(rotator_state, target_tracks_mechanical), .flags = ALPACA_CONFIG },
	{ .name = "TargetIsMechanical", .kind = ALPACA_BOOL, .offset = offsetof(rotator_state, target_is_mechanical), .flags = ALPACA_CONFIG }
};

const alpaca_type alpaca_rotator_type = {
	.name = "Rotator",
	.interface_version = 4,
	.legacy_interface_version = 3,
	.state_size = sizeof(rotator_state),
	.members = rotator_members,
	.member_count = sizeof(rotator_members) / sizeof(rotator_members[0]),
	.reset = rotator_reset,
	.update = rotator_update
};
