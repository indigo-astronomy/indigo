// ASCOM Alpaca server simulator, CoverCalibrator
//
// Copyright (c) 2026 CloudMakers, s. r. o.
// All rights reserved.
//
// You can use this software under the terms of 'INDIGO Astronomy
// open-source license' (see LICENSE.md).
//
// THIS SOFTWARE IS PROVIDED BY THE AUTHORS 'AS IS' AND ANY EXPRESS
// OR IMPLIED WARRANTIES, INCLUDING, BUT NOT LIMITED TO, THE IMPLIED
// WARRANTIES OF MERCHANTABILITY AND FITNESS FOR A PARTICULAR PURPOSE
// ARE DISCLAIMED. IN NO EVENT SHALL THE AUTHOR BE LIABLE FOR ANY
// DIRECT, INDIRECT, INCIDENTAL, SPECIAL, EXEMPLARY, OR CONSEQUENTIAL
// DAMAGES (INCLUDING, BUT NOT LIMITED TO, PROCUREMENT OF SUBSTITUTE
// GOODS OR SERVICES; LOSS OF USE, DATA, OR PROFITS; OR BUSINESS
// INTERRUPTION) HOWEVER CAUSED AND ON ANY THEORY OF LIABILITY,
// WHETHER IN CONTRACT, STRICT LIABILITY, OR TORT (INCLUDING
// NEGLIGENCE OR OTHERWISE) ARISING IN ANY WAY OUT OF THE USE OF THIS
// SOFTWARE, EVEN IF ADVISED OF THE POSSIBILITY OF SUCH DAMAGE.

// Code is generated by AI

// This source file was generated by a Claude agent.

// ICoverCalibratorV2 (Platform 7), ICoverCalibratorV1 with interface=legacy:
// CalibratorChanging and CoverMoving exist from V2 only.
// CoverState: 0 NotPresent, 1 Closed, 2 Moving, 3 Open, 4 Unknown, 5 Error.
// CalibratorState: 0 NotPresent, 1 Off, 2 NotReady, 3 Ready, 4 Unknown, 5 Error.
// A device without a cover or without a calibrator is made by setting the
// state to 0 (CoverState=0, CalibratorState=0); its methods then answer
// NotImplemented.
// The model follows the ASCOM ICoverCalibratorV2 documentation and the ASCOM
// OmniSim cover calibrator simulator: the cover needs CoverTime to open or
// close, HaltCover leaves a moving cover in Unknown, and the calibrator needs
// CalibratorTime to stabilise (NotReady) after CalibratorOn and after
// CalibratorOff; CalibratorOff sets Brightness to 0. A cover whose movement
// can not be interrupted (CanHaltCover=false, a simulator setting) answers
// NotImplemented to HaltCover, as the documentation of HaltCover requires.

#include "system_alpaca_simulator.h"

#define COVER_NOT_PRESENT				0
#define COVER_CLOSED						1
#define COVER_MOVING						2
#define COVER_OPEN							3
#define COVER_UNKNOWN						4
#define CALIBRATOR_NOT_PRESENT	0
#define CALIBRATOR_OFF					1
#define CALIBRATOR_NOT_READY		2
#define CALIBRATOR_READY				3

typedef struct {
	int cover_state;
	int cover_target;
	double cover_until;
	double cover_time;
	bool cover_moving;
	bool can_halt_cover;
	int calibrator_state;
	int calibrator_target;
	double calibrator_until;
	double calibrator_time;
	bool calibrator_changing;
	int brightness;
	int max_brightness;
} covercalibrator_state;

static void covercalibrator_reset(alpaca_device *device) {
	covercalibrator_state *state = device->state;
	state->cover_state = COVER_CLOSED;
	state->cover_time = 4;
	state->can_halt_cover = true;
	state->calibrator_state = CALIBRATOR_OFF;
	state->calibrator_time = 2;
	state->max_brightness = 255;
}

static void covercalibrator_update(alpaca_device *device) {
	covercalibrator_state *state = device->state;
	if (state->cover_state == COVER_MOVING && alpaca_reached(state->cover_until)) {
		state->cover_state = state->cover_target;
		alpaca_event("STATE", "covercalibrator/%d cover=%d", device->number, state->cover_state);
	}
	if (state->calibrator_state == CALIBRATOR_NOT_READY && alpaca_reached(state->calibrator_until)) {
		state->calibrator_state = state->calibrator_target;
		alpaca_event("STATE", "covercalibrator/%d calibrator=%d brightness=%d", device->number, state->calibrator_state, state->brightness);
	}
	state->cover_moving = state->cover_state == COVER_MOVING;
	state->calibrator_changing = state->calibrator_state == CALIBRATOR_NOT_READY;
}

static bool covercalibrator_has_cover(alpaca_device *device, alpaca_request *request) {
	covercalibrator_state *state = device->state;
	if (state->cover_state == COVER_NOT_PRESENT) {
		alpaca_reply_error(request, ALPACA_ERROR_NOT_IMPLEMENTED, "%s is not implemented, there is no cover", request->member->name);
		return false;
	}
	return true;
}

static bool covercalibrator_has_calibrator(alpaca_device *device, alpaca_request *request) {
	covercalibrator_state *state = device->state;
	if (state->calibrator_state == CALIBRATOR_NOT_PRESENT) {
		alpaca_reply_error(request, ALPACA_ERROR_NOT_IMPLEMENTED, "%s is not implemented, there is no calibrator", request->member->name);
		return false;
	}
	return true;
}

static void covercalibrator_get_calibrator(alpaca_device *device, alpaca_request *request) {
	if (covercalibrator_has_calibrator(device, request)) {
		alpaca_reply_member(device, request);
	}
}

static void covercalibrator_move(alpaca_device *device, alpaca_request *request, int target) {
	covercalibrator_state *state = device->state;
	if (!covercalibrator_has_cover(device, request)) {
		return;
	}
	state->cover_target = target;
	state->cover_until = alpaca_now() + state->cover_time;
	state->cover_state = state->cover_time > 0 ? COVER_MOVING : target;
	state->cover_moving = state->cover_state == COVER_MOVING;
	alpaca_event("MOVE", "covercalibrator/%d cover to=%d duration=%.3f", device->number, target, state->cover_time);
	alpaca_reply_void(request);
}

static void covercalibrator_put_opencover(alpaca_device *device, alpaca_request *request) {
	covercalibrator_move(device, request, COVER_OPEN);
}

static void covercalibrator_put_closecover(alpaca_device *device, alpaca_request *request) {
	covercalibrator_move(device, request, COVER_CLOSED);
}

static void covercalibrator_put_haltcover(alpaca_device *device, alpaca_request *request) {
	covercalibrator_state *state = device->state;
	if (!covercalibrator_has_cover(device, request)) {
		return;
	}
	if (!state->can_halt_cover) {
		alpaca_reply_error(request, ALPACA_ERROR_NOT_IMPLEMENTED, "HaltCover is not implemented, the cover movement can not be interrupted");
		return;
	}
	if (state->cover_state == COVER_MOVING) {
		state->cover_state = COVER_UNKNOWN;
		state->cover_moving = false;
		alpaca_event("STATE", "covercalibrator/%d cover halted", device->number);
	}
	alpaca_reply_void(request);
}

static void covercalibrator_switch(alpaca_device *device, alpaca_request *request, int target, int brightness) {
	covercalibrator_state *state = device->state;
	state->brightness = brightness;
	state->calibrator_target = target;
	state->calibrator_until = alpaca_now() + state->calibrator_time;
	state->calibrator_state = state->calibrator_time > 0 ? CALIBRATOR_NOT_READY : target;
	state->calibrator_changing = state->calibrator_state == CALIBRATOR_NOT_READY;
	alpaca_event("STATE", "covercalibrator/%d calibrator to=%d brightness=%d duration=%.3f", device->number, target, brightness, state->calibrator_time);
	alpaca_reply_void(request);
}

static void covercalibrator_put_calibratoron(alpaca_device *device, alpaca_request *request) {
	covercalibrator_state *state = device->state;
	int brightness = 0;
	if (!alpaca_param_int(request, "Brightness", &brightness) || !covercalibrator_has_calibrator(device, request)) {
		return;
	}
	if (brightness < 0 || brightness > state->max_brightness) {
		alpaca_reply_error(request, ALPACA_ERROR_INVALID_VALUE, "Brightness %d is out of range 0..%d", brightness, state->max_brightness);
		return;
	}
	covercalibrator_switch(device, request, CALIBRATOR_READY, brightness);
}

static void covercalibrator_put_calibratoroff(alpaca_device *device, alpaca_request *request) {
	if (covercalibrator_has_calibrator(device, request)) {
		covercalibrator_switch(device, request, CALIBRATOR_OFF, 0);
	}
}

static const alpaca_member covercalibrator_members[] = {
	{ .name = "Brightness", .kind = ALPACA_INT, .offset = offsetof(covercalibrator_state, brightness), .flags = ALPACA_STATE, .get = covercalibrator_get_calibrator },
	{ .name = "CalibratorChanging", .kind = ALPACA_BOOL, .offset = offsetof(covercalibrator_state, calibrator_changing), .flags = ALPACA_R | ALPACA_STATE, .since = 2 },
	{ .name = "CalibratorState", .kind = ALPACA_INT, .offset = offsetof(covercalibrator_state, calibrator_state), .flags = ALPACA_R | ALPACA_STATE },
	{ .name = "CoverMoving", .kind = ALPACA_BOOL, .offset = offsetof(covercalibrator_state, cover_moving), .flags = ALPACA_R | ALPACA_STATE, .since = 2 },
	{ .name = "CoverState", .kind = ALPACA_INT, .offset = offsetof(covercalibrator_state, cover_state), .flags = ALPACA_R | ALPACA_STATE },
	{ .name = "MaxBrightness", .kind = ALPACA_INT, .offset = offsetof(covercalibrator_state, max_brightness), .get = covercalibrator_get_calibrator },
	{ .name = "CalibratorOff", .put = covercalibrator_put_calibratoroff },
	{ .name = "CalibratorOn", .put = covercalibrator_put_calibratoron },
	{ .name = "CloseCover", .put = covercalibrator_put_closecover },
	{ .name = "HaltCover", .put = covercalibrator_put_haltcover },
	{ .name = "OpenCover", .put = covercalibrator_put_opencover },
	{ .name = "CoverTime", .kind = ALPACA_DOUBLE, .offset = offsetof(covercalibrator_state, cover_time), .flags = ALPACA_CONFIG },
	{ .name = "CanHaltCover", .kind = ALPACA_BOOL, .offset = offsetof(covercalibrator_state, can_halt_cover), .flags = ALPACA_CONFIG },
	{ .name = "CalibratorTime", .kind = ALPACA_DOUBLE, .offset = offsetof(covercalibrator_state, calibrator_time), .flags = ALPACA_CONFIG }
};

const alpaca_type alpaca_covercalibrator_type = {
	.name = "CoverCalibrator",
	.interface_version = 2,
	.legacy_interface_version = 1,
	.state_size = sizeof(covercalibrator_state),
	.members = covercalibrator_members,
	.member_count = sizeof(covercalibrator_members) / sizeof(covercalibrator_members[0]),
	.reset = covercalibrator_reset,
	.update = covercalibrator_update
};
