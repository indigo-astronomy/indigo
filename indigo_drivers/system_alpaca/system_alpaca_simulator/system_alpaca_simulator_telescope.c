// ASCOM Alpaca server simulator, Telescope
//
// Copyright (c) 2026 CloudMakers, s. r. o.
// All rights reserved.
//
// You can use this software under the terms of 'INDIGO Astronomy
// open-source license' (see LICENSE.md).
//
// THIS SOFTWARE IS PROVIDED BY THE AUTHORS 'AS IS' AND ANY EXPRESS
// OR IMPLIED WARRANTIES, INCLUDING, BUT NOT LIMITED TO, THE IMPLIED
// WARRANTIES OF MERCHANTABILITY AND FITNESS FOR A PARTICULAR PURPOSE
// ARE DISCLAIMED. IN NO EVENT SHALL THE AUTHOR BE LIABLE FOR ANY
// DIRECT, INDIRECT, INCIDENTAL, SPECIAL, EXEMPLARY, OR CONSEQUENTIAL
// DAMAGES (INCLUDING, BUT NOT LIMITED TO, PROCUREMENT OF SUBSTITUTE
// GOODS OR SERVICES; LOSS OF USE, DATA, OR PROFITS; OR BUSINESS
// INTERRUPTION) HOWEVER CAUSED AND ON ANY THEORY OF LIABILITY,
// WHETHER IN CONTRACT, STRICT LIABILITY, OR TORT (INCLUDING
// NEGLIGENCE OR OTHERWISE) ARISING IN ANY WAY OUT OF THE USE OF THIS
// SOFTWARE, EVEN IF ADVISED OF THE POSSIBILITY OF SUCH DAMAGE.

// Code is generated by AI

// This source file was generated by a Claude agent.

// ITelescopeV4 (Platform 7), ITelescopeV3 with interface=legacy.
// Units follow the standard: RightAscension, SiderealTime and hour angles in
// hours, everything else in degrees, SiteLongitude positive east, axis and
// guide rates in degrees per second, PulseGuide Duration in milliseconds.
// SideOfPier: 0 pierEast (normal, looking west, hour angle >= 0), 1 pierWest.
// PulseGuide Direction: 0 North (+Dec), 1 South, 2 East (+RA), 3 West.
//
// The model is a German equatorial mount that keeps RightAscension and
// Declination:
// - Tracking=true holds them; Tracking=false lets RightAscension follow the
//   sidereal time, so the hour angle stays where it is.
// - SiderealTime is the mean sidereal time computed from UTCDate and
//   SiteLongitude; Altitude and Azimuth are computed from the hour angle,
//   Declination and SiteLatitude, without refraction.
// - A slew moves both axes linearly at SlewRate degrees per second, takes the
//   shorter way in right ascension and is followed by SlewSettleTime; Slewing
//   is true until then. The deprecated synchronous slews complete at once.
// - Park slews to ParkHourAngle / ParkDeclination, then sets AtPark and stops
//   tracking. FindHome slews to HomeHourAngle / HomeDeclination and sets AtHome.
// - The equatorial slews and syncs need Tracking=true, the alt-az ones need
//   Tracking=false, as the standard says. While AtPark everything that moves
//   the mount answers InvalidWhileParked.
// - MoveAxis turns a mechanical axis at the given rate while it lasts and
//   Slewing is true while an axis rate is not zero. The standard leaves the
//   sense of rotation undefined; the model follows the ASCOM OmniSim
//   (TelescopeHardware.cs): a positive primary rate increases the hour angle,
//   so RightAscension decreases, and a positive secondary rate increases
//   Declination in the normal pointing state and decreases it through the pole,
//   on a northern and a southern site alike (measured on OmniSim 0.5.0).
//   The primary axis then turns at the given rate instead of the tracking rate.
// - PulseGuide moves RightAscension (East +, West -) and Declination (North +)
//   at the guide rates for Duration; a Duration of 0 ends the pulse of that
//   axis, as in OmniSim. AbortSlew does not end a pulse.
// - A tracking mount drifts in RightAscension by the difference between the
//   sidereal rate and its TrackingRate (0 sidereal 15.0410686, 1 lunar 14.685,
//   2 solar 15.0, 3 king 15.0369 arc seconds per second). RightAscensionRate
//   (seconds of RA per sidereal second) and DeclinationRate (arc seconds per
//   second) are added while tracking at the sidereal rate; with another
//   TrackingRate they read 0 and writing them is an InvalidOperation.
// - Writing SideOfPier starts a flip that takes FlipTime with Slewing true;
//   Unpark takes UnparkTime with Slewing and AtPark true (0 = at once).
// - AbortSlew returns at once; Slewing stays true for StopTime while the
//   mount stops (0 = stops at once).
// - Behaviour of the Pegasus NYX-101 Alpaca server (firmware 1.32.1, ITelescopeV2),
//   off by default: StartDelay > 0 makes Park and FindHome start their slew
//   StartDelay seconds after the request, and until then Slewing, AtPark and
//   AtHome are false and the mount does not move; Unpark then clears AtPark at
//   once. QuietParkSlew=true reports Slewing false while a park or a search for
//   home moves the mount (the NYX reported Slewing true for a moment and then
//   false until AtPark became true). A site of 0 / 0 is SiteLatitude=0,
//   SiteLongitude=0, and the NYX closing the connection after every reply is the
//   connection-close fault with Count=-1. SplitAxisRates=true answers AxisRates
//   as the NYX does, every range split into two objects, the first with only
//   Maximum and the next with only Minimum: [{"Maximum":4.5},{"Minimum":0}].
// - SkyAxes=true: MoveAxis as the NYX-101 (firmware 1.32.1) does it, in sky
//   directions on both sides of the pier: a positive primary rate moves east
//   (the right ascension grows), a positive secondary rate moves south.
// - IgnoreAfterSlew > 0: a slew, park, search for home or non-zero MoveAxis that
//   arrives less than IgnoreAfterSlew seconds after the end of a slew is answered
//   with success and does nothing, as the NYX-101 does (about 1.5 s).
// - LateSlewing > 0: Slewing stays true for LateSlewing seconds after a park or a
//   search for home reached its position, while AtPark / AtHome is true already
//   (seen through the proxy against OmniSim 0.5.0: AtHome true with Slewing true).
// Simulator settings (control API and --device only):
//   SlewRate, MaxAxisRate, ParkHourAngle, ParkDeclination, HomeHourAngle,
//   HomeDeclination, FlipTime, UnparkTime, StopTime, StartDelay, QuietParkSlew, SplitAxisRates, LateSlewing, SkyAxes, IgnoreAfterSlew,
//   TrackingRates           supported DriveRates, "0|1|2|3"
//   AxisRates               rate ranges of both axes as "min:max|min:max"; empty = one range 0..MaxAxisRate
//   PulseGuideNeedsTracking PulseGuide is an InvalidOperation while Tracking is false (allowed by the standard)
//   DualAxisPulseGuide      false: a pulse while the other axis is pulsing is an InvalidOperation (allowed by the standard)
//   LinkedGuideRates        true: the mount has one guide rate, writing GuideRateRightAscension or GuideRateDeclination sets both (allowed by the standard)
// Simulator assumptions: the tracking drift is not applied during the part of
// a clock step in which a slew was still running, and the deprecated
// synchronous slews complete at once instead of blocking.

#include <math.h>
#include <stdio.h>

#include "system_alpaca_simulator.h"

#define SIDEREAL_RATIO		1.00273790935
#define RADIANS						(M_PI / 180)
#define GOAL_NONE					0
#define GOAL_PARK					1
#define GOAL_HOME					2
#define GOAL_UNPARK				3
#define GOAL_FLIP					4
#define MAX_RATE_RANGES		8
#define TRACKING_ANY			0
#define TRACKING_ON				1
#define TRACKING_OFF			2

typedef struct {
	bool can_find_home;
	bool can_park;
	bool can_pulse_guide;
	bool can_set_declination_rate;
	bool can_set_guide_rates;
	bool can_set_park;
	bool can_set_pier_side;
	bool can_set_right_ascension_rate;
	bool can_set_tracking;
	bool can_slew;
	bool can_slew_alt_az;
	bool can_slew_alt_az_async;
	bool can_slew_async;
	bool can_sync;
	bool can_sync_alt_az;
	bool can_unpark;
	bool can_move_axis;
	int alignment_mode;
	double aperture_area;
	double aperture_diameter;
	double focal_length;
	int equatorial_system;
	alpaca_motion right_ascension;
	alpaca_motion declination;
	bool at_home;
	bool at_park;
	bool slewing;
	bool tracking;
	bool is_pulse_guiding;
	bool does_refraction;
	int tracking_rate;
	double declination_rate;
	double right_ascension_rate;
	double guide_rate_declination;
	double guide_rate_right_ascension;
	double site_elevation;
	double site_latitude;
	double site_longitude;
	int slew_settle_time;
	bool target_right_ascension_set;
	bool target_declination_set;
	double target_right_ascension;
	double target_declination;
	double utc_offset;
	bool pier_flip;
	bool slew_active;
	double slew_until;
	int goal;
	double axis_rate[2];
	double pulse_rate[2];
	double pulse_until[2];
	double last_update;
	double slew_rate;
	double max_axis_rate;
	double park_hour_angle;
	double park_declination;
	double home_hour_angle;
	double home_declination;
	double flip_time;
	double unpark_time;
	double stop_time;
	double start_delay;
	bool quiet_park_slew;
	bool split_axis_rates;
	double late_slewing;
	bool sky_axes;
	double ignore_after_slew;
	double slew_ended;
	double slewing_until;
	int pending_goal;
	double pending_until;
	bool flip_target;
	bool pulse_guide_needs_tracking;
	bool dual_axis_pulse_guide;
	bool linked_guide_rates;
	char tracking_rates[ALPACA_TEXT_SIZE];
	char axis_rates[ALPACA_TEXT_SIZE];
} telescope_state;

// Tracking rates of DriveRates in arc seconds per second.
static const double telescope_drive_rates[] = { 15.0410686, 14.685, 15.0, 15.0369 };

static double telescope_wrap(double value, double range) {
	value = fmod(value, range);
	return value < 0 ? value + range : value;
}

// Wraps into -range / 2 <= value < range / 2.
static double telescope_wrap_signed(double value, double range) {
	value = telescope_wrap(value, range);
	return value >= range / 2 ? value - range : value;
}

static double telescope_sidereal_time(const telescope_state *state) {
	double days = (alpaca_utc() + state->utc_offset) / 86400.0 + 2440587.5 - 2451545.0;
	return telescope_wrap(18.697374558 + 24.06570982441908 * days + state->site_longitude / 15, 24);
}

static double telescope_hour_angle(const telescope_state *state) {
	return telescope_wrap_signed(telescope_sidereal_time(state) - state->right_ascension.position, 24);
}

static void telescope_horizontal(const telescope_state *state, double *altitude, double *azimuth) {
	double hour_angle = telescope_hour_angle(state) * 15 * RADIANS;
	double declination = state->declination.position * RADIANS;
	double latitude = state->site_latitude * RADIANS;
	*altitude = asin(fmax(-1, fmin(1, sin(declination) * sin(latitude) + cos(declination) * cos(latitude) * cos(hour_angle)))) / RADIANS;
	*azimuth = telescope_wrap(atan2(-cos(declination) * sin(hour_angle), sin(declination) * cos(latitude) - cos(declination) * sin(latitude) * cos(hour_angle)) / RADIANS, 360);
}

static void telescope_equatorial(const telescope_state *state, double altitude, double azimuth, double *right_ascension, double *declination) {
	double latitude = state->site_latitude * RADIANS;
	altitude *= RADIANS;
	azimuth *= RADIANS;
	double hour_angle = atan2(-sin(azimuth) * cos(altitude), sin(altitude) * cos(latitude) - cos(altitude) * sin(latitude) * cos(azimuth)) / RADIANS / 15;
	*declination = asin(fmax(-1, fmin(1, sin(altitude) * sin(latitude) + cos(altitude) * cos(latitude) * cos(azimuth)))) / RADIANS;
	*right_ascension = telescope_wrap(telescope_sidereal_time(state) - hour_angle, 24);
}

static void telescope_reset(alpaca_device *device) {
	telescope_state *state = device->state;
	state->can_find_home = state->can_park = state->can_pulse_guide = state->can_set_declination_rate = state->can_set_guide_rates = state->can_set_park = state->can_set_pier_side = state->can_set_right_ascension_rate = state->can_set_tracking = true;
	state->can_slew = state->can_slew_alt_az = state->can_slew_alt_az_async = state->can_slew_async = state->can_sync = state->can_sync_alt_az = state->can_unpark = state->can_move_axis = true;
	state->dual_axis_pulse_guide = true;
	state->flip_time = 45;
	snprintf(state->tracking_rates, sizeof(state->tracking_rates), "0|1|2|3");
	state->alignment_mode = 2;
	state->aperture_diameter = 0.2;
	state->aperture_area = 0.0269;
	state->focal_length = 1.26;
	state->equatorial_system = 1;
	state->guide_rate_declination = state->guide_rate_right_ascension = 0.00208903;
	state->site_elevation = 140;
	state->site_latitude = 48.1486;
	state->site_longitude = 17.1077;
	state->slew_rate = 4;
	state->max_axis_rate = 4;
	state->park_hour_angle = 6;
	state->home_declination = 90;
	state->last_update = alpaca_now();
	alpaca_motion_set(&state->right_ascension, telescope_wrap(telescope_sidereal_time(state) - 1, 24));
	alpaca_motion_set(&state->declination, 30);
}

static int telescope_side_of_pier(const telescope_state *state, double right_ascension) {
	return telescope_wrap_signed(telescope_sidereal_time(state) - right_ascension, 24) >= 0 ? 0 : 1;
}

// The ranges of AxisRates: "min:max|min:max", or one range from 0 to MaxAxisRate.
static int telescope_rate_ranges(const telescope_state *state, double *minimum, double *maximum) {
	int count = 0;
	const char *cursor = state->axis_rates;
	while (*cursor && count < MAX_RATE_RANGES) {
		int consumed = 0;
		if (sscanf(cursor, "%lf:%lf%n", minimum + count, maximum + count, &consumed) != 2) {
			break;
		}
		count++;
		cursor += consumed;
		cursor += *cursor == '|';
	}
	if (count == 0) {
		minimum[0] = 0;
		maximum[0] = state->max_axis_rate;
		count = 1;
	}
	return count;
}

static bool telescope_tracks_rate(const telescope_state *state, int rate) {
	for (const char *cursor = state->tracking_rates; *cursor; cursor++) {
		if (*cursor == '0' + rate) {
			return true;
		}
	}
	return false;
}

// Slewing as the mount reports it: QuietParkSlew hides a park or a search for home.
static bool telescope_slewing(const telescope_state *state) {
	bool quiet = state->quiet_park_slew && (state->goal == GOAL_PARK || state->goal == GOAL_HOME);
	bool late = state->late_slewing > 0 && !alpaca_reached(state->slewing_until);
	return (state->slew_active && !quiet) || late || state->axis_rate[0] != 0 || state->axis_rate[1] != 0;
}

static void telescope_start_slew(alpaca_device *device, double right_ascension, double declination, int goal, bool immediate);
static double telescope_sidereal_time(const telescope_state *state);

static void telescope_update(alpaca_device *device) {
	telescope_state *state = device->state;
	double now = alpaca_now();
	double elapsed = now - state->last_update;
	alpaca_motion_update(&state->right_ascension);
	alpaca_motion_update(&state->declination);
	if (!state->right_ascension.moving && !state->declination.moving && elapsed > 0) {
		double right_ascension = state->right_ascension.position;
		double declination = state->declination.position;
		bool offsets = state->tracking && !state->at_park && state->tracking_rate == 0;
		if (state->axis_rate[0] != 0) {
			right_ascension += elapsed * SIDEREAL_RATIO / 3600 + (state->sky_axes ? 1 : -1) * state->axis_rate[0] * elapsed / 15;
		} else if (!state->tracking) {
			right_ascension += elapsed * SIDEREAL_RATIO / 3600;
		} else if (offsets) {
			right_ascension += state->right_ascension_rate * elapsed * SIDEREAL_RATIO / 3600;
		} else {
			right_ascension += (telescope_drive_rates[0] - telescope_drive_rates[state->tracking_rate]) / 15 * elapsed / 3600;
		}
		if (state->axis_rate[1] != 0) {
			if (state->sky_axes) {
				declination -= state->axis_rate[1] * elapsed;
			} else {
				declination += ((telescope_side_of_pier(state, state->right_ascension.position) ^ (state->pier_flip ? 1 : 0)) ? -1 : 1) * state->axis_rate[1] * elapsed;
			}
		} else if (offsets) {
			declination += state->declination_rate * elapsed / 3600;
		}
		for (int axis = 0; axis < 2; axis++) {
			double active = fmin(now, state->pulse_until[axis]) - state->last_update;
			if (active > 0 && axis == 0) {
				right_ascension += state->pulse_rate[axis] * active / 15;
			} else if (active > 0) {
				declination += state->pulse_rate[axis] * active;
			}
		}
		alpaca_motion_set(&state->right_ascension, telescope_wrap(right_ascension, 24));
		alpaca_motion_set(&state->declination, fmax(-90, fmin(90, declination)));
	}
	if (state->slew_active && alpaca_reached(state->slew_until)) {
		state->slew_active = false;
		state->slew_ended = state->slew_until;
		switch (state->goal) {
			case GOAL_PARK:
				state->at_park = true;
				state->slewing_until = state->slew_until + state->late_slewing;
				state->tracking = false;
				alpaca_motion_set(&state->right_ascension, telescope_wrap(telescope_sidereal_time(state) - state->park_hour_angle, 24));
				state->pier_flip = false;
				break;
			case GOAL_HOME:
				state->at_home = true;
				state->slewing_until = state->slew_until + state->late_slewing;
				alpaca_motion_set(&state->right_ascension, telescope_wrap(telescope_sidereal_time(state) - state->home_hour_angle, 24));
				state->pier_flip = false;
				break;
			case GOAL_UNPARK:
				state->at_park = false;
				break;
			case GOAL_FLIP:
				state->pier_flip = state->flip_target;
				break;
			default:
				state->pier_flip = false;
				break;
		}
		state->goal = GOAL_NONE;
		alpaca_event("STATE", "telescope/%d slew done ra=%.6f dec=%.6f at_park=%d at_home=%d", device->number, state->right_ascension.position, state->declination.position, state->at_park, state->at_home);
	}
	if (state->pending_goal != GOAL_NONE && alpaca_reached(state->pending_until)) {
		int goal = state->pending_goal;
		state->pending_goal = GOAL_NONE;
		state->last_update = now;
		alpaca_event("STATE", "telescope/%d delayed start goal=%d", device->number, goal);
		if (goal == GOAL_PARK) {
			telescope_start_slew(device, telescope_wrap(telescope_sidereal_time(state) - state->park_hour_angle, 24), state->park_declination, GOAL_PARK, false);
		} else {
			telescope_start_slew(device, telescope_wrap(telescope_sidereal_time(state) - state->home_hour_angle, 24), state->home_declination, GOAL_HOME, false);
		}
		return;
	}
	state->slewing = telescope_slewing(state);
	state->is_pulse_guiding = !alpaca_reached(state->pulse_until[0]) || !alpaca_reached(state->pulse_until[1]);
	state->last_update = now;
}

// Answers NotImplemented and returns false when the capability is switched off.
static bool telescope_can(alpaca_request *request, bool capability) {
	if (!capability) {
		alpaca_reply_error(request, ALPACA_ERROR_NOT_IMPLEMENTED, "%s is not implemented", request->member->name);
	}
	return capability;
}

// The conditions every method that moves the mount has to meet; answers the error itself.
static bool telescope_ready(alpaca_device *device, alpaca_request *request, bool capability, int tracking) {
	telescope_state *state = device->state;
	if (!telescope_can(request, capability)) {
		return false;
	}
	if (state->at_park) {
		alpaca_reply_error(request, ALPACA_ERROR_INVALID_WHILE_PARKED, "%s is not allowed while the telescope is parked", request->member->name);
		return false;
	}
	if ((tracking == TRACKING_ON && !state->tracking) || (tracking == TRACKING_OFF && state->tracking)) {
		alpaca_reply_error(request, ALPACA_ERROR_INVALID_OPERATION, "%s needs Tracking to be %s", request->member->name, tracking == TRACKING_ON ? "true" : "false");
		return false;
	}
	return true;
}

static bool telescope_in_range(alpaca_request *request, const char *name, double value, double min, double max) {
	if (value < min || value > max) {
		alpaca_reply_error(request, ALPACA_ERROR_INVALID_VALUE, "%s %g is out of range %g..%g", name, value, min, max);
		return false;
	}
	return true;
}

static bool telescope_equatorial_params(alpaca_request *request, double *right_ascension, double *declination) {
	return alpaca_param_double(request, "RightAscension", right_ascension) && alpaca_param_double(request, "Declination", declination) && telescope_in_range(request, "RightAscension", *right_ascension, 0, 24) && telescope_in_range(request, "Declination", *declination, -90, 90);
}

static bool telescope_horizontal_params(alpaca_request *request, double *azimuth, double *altitude) {
	return alpaca_param_double(request, "Azimuth", azimuth) && alpaca_param_double(request, "Altitude", altitude) && telescope_in_range(request, "Azimuth", *azimuth, 0, 360) && telescope_in_range(request, "Altitude", *altitude, -90, 90);
}

static void telescope_stop(telescope_state *state) {
	alpaca_motion_stop(&state->right_ascension);
	alpaca_motion_stop(&state->declination);
	state->slew_active = false;
	state->goal = GOAL_NONE;
	state->pending_goal = GOAL_NONE;
	state->axis_rate[0] = state->axis_rate[1] = 0;
}

static void telescope_start_slew(alpaca_device *device, double right_ascension, double declination, int goal, bool immediate) {
	telescope_state *state = device->state;
	telescope_stop(state);
	state->pulse_until[0] = state->pulse_until[1] = 0;
	double origin = state->right_ascension.position;
	double delta = telescope_wrap_signed(right_ascension - origin, 24);
	double duration = immediate || state->slew_rate <= 0 ? 0 : fmax(fabs(delta) * 15, fabs(declination - state->declination.position)) / state->slew_rate;
	state->at_home = false;
	state->goal = goal;
	alpaca_motion_start_timed(&state->right_ascension, origin + delta, duration);
	alpaca_motion_start_timed(&state->declination, declination, duration);
	state->slew_active = true;
	state->slew_until = alpaca_now() + (immediate ? 0 : duration + state->slew_settle_time);
	alpaca_event("MOVE", "telescope/%d slew ra=%.6f dec=%.6f duration=%.3f settle=%d goal=%d", device->number, right_ascension, declination, duration, state->slew_settle_time, goal);
	telescope_update(device);
	state->slewing = telescope_slewing(state);
}

// IgnoreAfterSlew: a motion command that comes too soon after the end of a slew is accepted and ignored. True when it was.
static bool telescope_ignored(alpaca_device *device, alpaca_request *request) {
	telescope_state *state = device->state;
	if (state->ignore_after_slew <= 0 || state->slew_ended <= 0 || alpaca_reached(state->slew_ended + state->ignore_after_slew)) {
		return false;
	}
	alpaca_event("STATE", "telescope/%d motion command ignored %.3f s after the end of a slew", device->number, alpaca_now() - state->slew_ended);
	alpaca_reply_void(request);
	return true;
}

static void telescope_slew(alpaca_device *device, alpaca_request *request, double right_ascension, double declination, int goal, bool immediate) {
	if (telescope_ignored(device, request)) {
		return;
	}
	telescope_start_slew(device, right_ascension, declination, goal, immediate);
	alpaca_reply_void(request);
}

// StartDelay: Park and FindHome are accepted and start later; until then nothing moves and Slewing, AtPark and AtHome are false.
static void telescope_delay_start(alpaca_device *device, alpaca_request *request, int goal) {
	telescope_state *state = device->state;
	if (telescope_ignored(device, request)) {
		return;
	}
	telescope_stop(state);
	state->pulse_until[0] = state->pulse_until[1] = 0;
	state->at_home = false;
	state->pending_goal = goal;
	state->pending_until = alpaca_now() + state->start_delay;
	state->slewing = false;
	alpaca_event("MOVE", "telescope/%d delayed goal=%d delay=%.3f", device->number, goal, state->start_delay);
	alpaca_reply_void(request);
}

static void telescope_set_target(telescope_state *state, double right_ascension, double declination) {
	state->target_right_ascension = right_ascension;
	state->target_declination = declination;
	state->target_right_ascension_set = state->target_declination_set = true;
}

static void telescope_sync(alpaca_device *device, alpaca_request *request, double right_ascension, double declination) {
	telescope_state *state = device->state;
	alpaca_motion_set(&state->right_ascension, right_ascension);
	alpaca_motion_set(&state->declination, declination);
	alpaca_event("STATE", "telescope/%d sync ra=%.6f dec=%.6f", device->number, right_ascension, declination);
	alpaca_reply_void(request);
}

static void telescope_get_altitude(alpaca_device *device, alpaca_request *request) {
	double altitude = 0;
	double azimuth = 0;
	telescope_horizontal(device->state, &altitude, &azimuth);
	alpaca_reply_double(request, altitude);
}

static void telescope_get_azimuth(alpaca_device *device, alpaca_request *request) {
	double altitude = 0;
	double azimuth = 0;
	telescope_horizontal(device->state, &altitude, &azimuth);
	alpaca_reply_double(request, azimuth);
}

static void telescope_get_rightascension(alpaca_device *device, alpaca_request *request) {
	telescope_state *state = device->state;
	alpaca_reply_double(request, telescope_wrap(state->right_ascension.position, 24));
}

static void telescope_get_siderealtime(alpaca_device *device, alpaca_request *request) {
	alpaca_reply_double(request, telescope_sidereal_time(device->state));
}

static void telescope_get_ispulseguiding(alpaca_device *device, alpaca_request *request) {
	telescope_state *state = device->state;
	if (telescope_can(request, state->can_pulse_guide)) {
		alpaca_reply_member(device, request);
	}
}

static void telescope_get_sideofpier(alpaca_device *device, alpaca_request *request) {
	telescope_state *state = device->state;
	alpaca_reply_int(request, telescope_side_of_pier(state, state->right_ascension.position) ^ (state->pier_flip ? 1 : 0));
}

static void telescope_put_sideofpier(alpaca_device *device, alpaca_request *request) {
	telescope_state *state = device->state;
	int side = 0;
	if (!alpaca_param_int(request, "SideOfPier", &side) || !telescope_ready(device, request, state->can_set_pier_side, TRACKING_ANY)) {
		return;
	}
	if (side != 0 && side != 1) {
		alpaca_reply_error(request, ALPACA_ERROR_INVALID_VALUE, "SideOfPier %d is not 0 or 1", side);
		return;
	}
	bool flip = side != telescope_side_of_pier(state, state->right_ascension.position);
	if (flip != state->pier_flip || state->slew_active) {
		telescope_stop(state);
		state->pulse_until[0] = state->pulse_until[1] = 0;
		state->at_home = false;
		state->flip_target = flip;
		state->goal = GOAL_FLIP;
		state->slew_active = true;
		state->slew_until = alpaca_now() + state->flip_time;
		alpaca_event("MOVE", "telescope/%d flip side=%d duration=%.3f", device->number, side, state->flip_time);
		telescope_update(device);
	}
	alpaca_reply_void(request);
}

static void telescope_get_destinationsideofpier(alpaca_device *device, alpaca_request *request) {
	double right_ascension = 0;
	double declination = 0;
	if (telescope_equatorial_params(request, &right_ascension, &declination)) {
		alpaca_reply_int(request, telescope_side_of_pier(device->state, right_ascension));
	}
}

static void telescope_get_target(alpaca_device *device, alpaca_request *request) {
	telescope_state *state = device->state;
	bool declination = request->member->offset == offsetof(telescope_state, target_declination);
	if (declination ? !state->target_declination_set : !state->target_right_ascension_set) {
		alpaca_reply_error(request, ALPACA_ERROR_VALUE_NOT_SET, "%s has not been set", request->member->name);
		return;
	}
	alpaca_reply_member(device, request);
}

static void telescope_put_target(alpaca_device *device, alpaca_request *request) {
	telescope_state *state = device->state;
	if (alpaca_store_member(device, request)) {
		if (request->member->offset == offsetof(telescope_state, target_declination)) {
			state->target_declination_set = true;
		} else {
			state->target_right_ascension_set = true;
		}
		alpaca_reply_void(request);
	}
}

static void telescope_put_tracking(alpaca_device *device, alpaca_request *request) {
	telescope_state *state = device->state;
	bool tracking = false;
	if (!alpaca_param_bool(request, "Tracking", &tracking) || !telescope_can(request, state->can_set_tracking)) {
		return;
	}
	if (tracking && state->at_park) {
		alpaca_reply_error(request, ALPACA_ERROR_INVALID_WHILE_PARKED, "Tracking can not be switched on while the telescope is parked");
		return;
	}
	state->tracking = tracking;
	alpaca_event("STATE", "telescope/%d tracking=%d", device->number, tracking);
	alpaca_reply_void(request);
}

// The rate setters differ only in the capability that guards them.
static void telescope_put_rate(alpaca_device *device, alpaca_request *request) {
	telescope_state *state = device->state;
	size_t offset = request->member->offset;
	bool capability = offset == offsetof(telescope_state, declination_rate) ? state->can_set_declination_rate : offset == offsetof(telescope_state, right_ascension_rate) ? state->can_set_right_ascension_rate : state->can_set_guide_rates;
	bool offset_rate = offset == offsetof(telescope_state, declination_rate) || offset == offsetof(telescope_state, right_ascension_rate);
	double rate = 0;
	if (!alpaca_param_double(request, request->member->name, &rate) || !telescope_can(request, capability)) {
		return;
	}
	if (offset_rate && state->tracking_rate != 0) {
		alpaca_reply_error(request, ALPACA_ERROR_INVALID_OPERATION, "%s needs TrackingRate to be driveSidereal", request->member->name);
		return;
	}
	if (!offset_rate && (rate <= 0 || rate > 1)) {
		alpaca_reply_error(request, ALPACA_ERROR_INVALID_VALUE, "%s %g is out of range", request->member->name, rate);
		return;
	}
	*(double *)((char *)state + offset) = rate;
	if (!offset_rate && state->linked_guide_rates) {
		state->guide_rate_declination = state->guide_rate_right_ascension = rate;
	}
	alpaca_reply_void(request);
}

// RightAscensionRate and DeclinationRate read 0 unless the mount tracks at the sidereal rate.
static void telescope_get_offset_rate(alpaca_device *device, alpaca_request *request) {
	telescope_state *state = device->state;
	if (state->tracking_rate != 0) {
		alpaca_reply_double(request, 0);
	} else {
		alpaca_reply_member(device, request);
	}
}

static void telescope_get_trackingrates(alpaca_device *device, alpaca_request *request) {
	telescope_state *state = device->state;
	char list[16] = { 0 };
	for (int rate = 0, length = 0; rate < 4; rate++) {
		if (telescope_tracks_rate(state, rate)) {
			length += snprintf(list + length, sizeof(list) - (size_t)length, "%s%d", length > 0 ? "," : "", rate);
		}
	}
	alpaca_reply_json(request, "[%s]", list);
}

static void telescope_put_trackingrate(alpaca_device *device, alpaca_request *request) {
	telescope_state *state = device->state;
	int rate = 0;
	if (!alpaca_param_int(request, "TrackingRate", &rate)) {
		return;
	}
	if (rate < 0 || rate > 3 || !telescope_tracks_rate(state, rate)) {
		alpaca_reply_error(request, ALPACA_ERROR_INVALID_VALUE, "TrackingRate %d is not supported", rate);
		return;
	}
	state->tracking_rate = rate;
	alpaca_event("STATE", "telescope/%d tracking_rate=%d", device->number, rate);
	alpaca_reply_void(request);
}

static void telescope_get_utcdate(alpaca_device *device, alpaca_request *request) {
	telescope_state *state = device->state;
	char text[64];
	alpaca_format_utc(alpaca_utc() + state->utc_offset, text, sizeof(text));
	alpaca_reply_string(request, text);
}

static void telescope_put_utcdate(alpaca_device *device, alpaca_request *request) {
	telescope_state *state = device->state;
	const char *text = NULL;
	double utc = 0;
	if (!alpaca_param_string(request, "UTCDate", &text)) {
		return;
	}
	if (!alpaca_parse_utc(text, &utc)) {
		alpaca_reply_error(request, ALPACA_ERROR_INVALID_VALUE, "UTCDate '%s' is not an ISO 8601 date", text);
		return;
	}
	state->utc_offset = utc - alpaca_utc();
	alpaca_reply_void(request);
}

static bool telescope_axis(alpaca_request *request, int *axis) {
	if (!alpaca_param_int(request, "Axis", axis)) {
		return false;
	}
	if (*axis < 0 || *axis > 2) {
		alpaca_reply_error(request, ALPACA_ERROR_INVALID_VALUE, "Axis %d is not 0, 1 or 2", *axis);
		return false;
	}
	return true;
}

static void telescope_get_axisrates(alpaca_device *device, alpaca_request *request) {
	telescope_state *state = device->state;
	int axis = 0;
	if (!telescope_axis(request, &axis)) {
		return;
	}
	if (axis == 2 || !state->can_move_axis) {
		alpaca_reply_json(request, "[]");
	} else {
		double minimum[MAX_RATE_RANGES];
		double maximum[MAX_RATE_RANGES];
		int count = telescope_rate_ranges(state, minimum, maximum);
		alpaca_buffer_printf(&request->value, "[");
		for (int i = 0; i < count; i++) {
			if (state->split_axis_rates) {
				alpaca_buffer_printf(&request->value, "%s{\"Maximum\":%.15g},{\"Minimum\":%.15g}", i > 0 ? "," : "", maximum[i], minimum[i]);
			} else {
				alpaca_buffer_printf(&request->value, "%s{\"Maximum\":%.15g,\"Minimum\":%.15g}", i > 0 ? "," : "", maximum[i], minimum[i]);
			}
		}
		alpaca_buffer_printf(&request->value, "]");
		alpaca_reply_void(request);
	}
}

static void telescope_get_canmoveaxis(alpaca_device *device, alpaca_request *request) {
	telescope_state *state = device->state;
	int axis = 0;
	if (telescope_axis(request, &axis)) {
		alpaca_reply_bool(request, axis != 2 && state->can_move_axis);
	}
}

static void telescope_put_moveaxis(alpaca_device *device, alpaca_request *request) {
	telescope_state *state = device->state;
	int axis = 0;
	double rate = 0;
	if (!telescope_axis(request, &axis) || !alpaca_param_double(request, "Rate", &rate) || !telescope_ready(device, request, state->can_move_axis && axis != 2, TRACKING_ANY)) {
		return;
	}
	double minimum[MAX_RATE_RANGES];
	double maximum[MAX_RATE_RANGES];
	int count = telescope_rate_ranges(state, minimum, maximum);
	bool valid = rate == 0;
	for (int i = 0; i < count && !valid; i++) {
		valid = fabs(rate) >= minimum[i] - 1e-9 && fabs(rate) <= maximum[i] + 1e-9;
	}
	if (!valid) {
		alpaca_reply_error(request, ALPACA_ERROR_INVALID_VALUE, "Rate %g is not in AxisRates", rate);
		return;
	}
	if (rate != 0 && telescope_ignored(device, request)) {
		return;
	}
	if (state->slew_active) {
		telescope_stop(state);
	}
	state->axis_rate[axis] = rate;
	state->at_home = state->at_home && rate == 0;
	state->slewing = state->axis_rate[0] != 0 || state->axis_rate[1] != 0;
	alpaca_event("MOVE", "telescope/%d axis=%d rate=%g", device->number, axis, rate);
	alpaca_reply_void(request);
}

static void telescope_put_pulseguide(alpaca_device *device, alpaca_request *request) {
	telescope_state *state = device->state;
	int direction = 0;
	int duration = 0;
	if (!alpaca_param_int(request, "Direction", &direction) || !alpaca_param_int(request, "Duration", &duration) || !telescope_ready(device, request, state->can_pulse_guide, TRACKING_ANY)) {
		return;
	}
	if (direction < 0 || direction > 3 || duration < 0) {
		alpaca_reply_error(request, ALPACA_ERROR_INVALID_VALUE, "Direction %d or Duration %d is out of range", direction, duration);
		return;
	}
	if (state->slewing) {
		alpaca_reply_error(request, ALPACA_ERROR_INVALID_OPERATION, "PulseGuide is not allowed while slewing");
		return;
	}
	if (state->pulse_guide_needs_tracking && !state->tracking) {
		alpaca_reply_error(request, ALPACA_ERROR_INVALID_OPERATION, "PulseGuide needs Tracking to be true");
		return;
	}
	int axis = direction < 2 ? 1 : 0;
	if (!state->dual_axis_pulse_guide && duration > 0 && !alpaca_reached(state->pulse_until[1 - axis])) {
		alpaca_reply_error(request, ALPACA_ERROR_INVALID_OPERATION, "PulseGuide in both axes at the same time is not supported");
		return;
	}
	double rate = axis == 1 ? state->guide_rate_declination : state->guide_rate_right_ascension;
	state->pulse_rate[axis] = direction == 0 || direction == 2 ? rate : -rate;
	state->pulse_until[axis] = alpaca_now() + duration / 1000.0;
	state->is_pulse_guiding = !alpaca_reached(state->pulse_until[0]) || !alpaca_reached(state->pulse_until[1]);
	alpaca_event("STATE", "telescope/%d pulse direction=%d duration=%d", device->number, direction, duration);
	alpaca_reply_void(request);
}

static void telescope_put_abortslew(alpaca_device *device, alpaca_request *request) {
	telescope_state *state = device->state;
	if (!telescope_ready(device, request, true, TRACKING_ANY)) {
		return;
	}
	bool moving = state->slew_active || state->axis_rate[0] != 0 || state->axis_rate[1] != 0;
	telescope_stop(state);
	if (moving && state->stop_time > 0) {
		state->slew_active = true;
		state->slew_until = alpaca_now() + state->stop_time;
	}
	state->slewing = telescope_slewing(state);
	alpaca_event("STATE", "telescope/%d abort ra=%.6f dec=%.6f", device->number, state->right_ascension.position, state->declination.position);
	alpaca_reply_void(request);
}

static void telescope_put_findhome(alpaca_device *device, alpaca_request *request) {
	telescope_state *state = device->state;
	if (!telescope_ready(device, request, state->can_find_home, TRACKING_ANY)) {
		return;
	}
	if (state->start_delay > 0) {
		telescope_delay_start(device, request, GOAL_HOME);
	} else {
		telescope_slew(device, request, telescope_wrap(telescope_sidereal_time(state) - state->home_hour_angle, 24), state->home_declination, GOAL_HOME, false);
	}
}

static void telescope_put_park(alpaca_device *device, alpaca_request *request) {
	telescope_state *state = device->state;
	if (!telescope_can(request, state->can_park)) {
		return;
	}
	if (state->at_park) {
		alpaca_reply_void(request);
		return;
	}
	if (state->start_delay > 0) {
		telescope_delay_start(device, request, GOAL_PARK);
	} else {
		telescope_slew(device, request, telescope_wrap(telescope_sidereal_time(state) - state->park_hour_angle, 24), state->park_declination, GOAL_PARK, false);
	}
}

static void telescope_put_unpark(alpaca_device *device, alpaca_request *request) {
	telescope_state *state = device->state;
	if (telescope_can(request, state->can_unpark)) {
		if (state->at_park && state->unpark_time > 0 && state->start_delay <= 0) {
			state->goal = GOAL_UNPARK;
			state->slew_active = state->slewing = true;
			state->slew_until = alpaca_now() + state->unpark_time;
		} else if (state->goal != GOAL_UNPARK) {
			state->at_park = false;
		}
		alpaca_event("STATE", "telescope/%d unpark duration=%.3f", device->number, state->at_park ? state->unpark_time : 0);
		alpaca_reply_void(request);
	}
}

static void telescope_put_setpark(alpaca_device *device, alpaca_request *request) {
	telescope_state *state = device->state;
	if (telescope_can(request, state->can_set_park)) {
		if (state->slewing) {
			alpaca_reply_error(request, ALPACA_ERROR_INVALID_OPERATION, "SetPark is not allowed while slewing");
			return;
		}
		state->park_hour_angle = telescope_hour_angle(state);
		state->park_declination = state->declination.position;
		alpaca_reply_void(request);
	}
}

static void telescope_slew_to_coordinates(alpaca_device *device, alpaca_request *request, bool capability, bool immediate) {
	telescope_state *state = device->state;
	double right_ascension = 0;
	double declination = 0;
	if (telescope_equatorial_params(request, &right_ascension, &declination) && telescope_ready(device, request, capability, TRACKING_ON)) {
		telescope_set_target(state, right_ascension, declination);
		telescope_slew(device, request, right_ascension, declination, GOAL_NONE, immediate);
	}
}

static void telescope_put_slewtocoordinates(alpaca_device *device, alpaca_request *request) {
	telescope_state *state = device->state;
	telescope_slew_to_coordinates(device, request, state->can_slew, true);
}

static void telescope_put_slewtocoordinatesasync(alpaca_device *device, alpaca_request *request) {
	telescope_state *state = device->state;
	telescope_slew_to_coordinates(device, request, state->can_slew_async, false);
}

static void telescope_slew_to_target(alpaca_device *device, alpaca_request *request, bool capability, bool immediate) {
	telescope_state *state = device->state;
	if (!telescope_ready(device, request, capability, TRACKING_ON)) {
		return;
	}
	if (!state->target_right_ascension_set || !state->target_declination_set) {
		alpaca_reply_error(request, ALPACA_ERROR_VALUE_NOT_SET, "TargetRightAscension and TargetDeclination have not been set");
		return;
	}
	telescope_slew(device, request, state->target_right_ascension, state->target_declination, GOAL_NONE, immediate);
}

static void telescope_put_slewtotarget(alpaca_device *device, alpaca_request *request) {
	telescope_state *state = device->state;
	telescope_slew_to_target(device, request, state->can_slew, true);
}

static void telescope_put_slewtotargetasync(alpaca_device *device, alpaca_request *request) {
	telescope_state *state = device->state;
	telescope_slew_to_target(device, request, state->can_slew_async, false);
}

static void telescope_slew_to_altaz(alpaca_device *device, alpaca_request *request, bool capability, bool immediate) {
	double azimuth = 0;
	double altitude = 0;
	double right_ascension = 0;
	double declination = 0;
	if (telescope_horizontal_params(request, &azimuth, &altitude) && telescope_ready(device, request, capability, TRACKING_OFF)) {
		telescope_equatorial(device->state, altitude, azimuth, &right_ascension, &declination);
		telescope_slew(device, request, right_ascension, declination, GOAL_NONE, immediate);
	}
}

static void telescope_put_slewtoaltaz(alpaca_device *device, alpaca_request *request) {
	telescope_state *state = device->state;
	telescope_slew_to_altaz(device, request, state->can_slew_alt_az, true);
}

static void telescope_put_slewtoaltazasync(alpaca_device *device, alpaca_request *request) {
	telescope_state *state = device->state;
	telescope_slew_to_altaz(device, request, state->can_slew_alt_az_async, false);
}

static void telescope_put_synctocoordinates(alpaca_device *device, alpaca_request *request) {
	telescope_state *state = device->state;
	double right_ascension = 0;
	double declination = 0;
	if (telescope_equatorial_params(request, &right_ascension, &declination) && telescope_ready(device, request, state->can_sync, TRACKING_ON)) {
		telescope_set_target(state, right_ascension, declination);
		telescope_sync(device, request, right_ascension, declination);
	}
}

static void telescope_put_synctotarget(alpaca_device *device, alpaca_request *request) {
	telescope_state *state = device->state;
	if (!telescope_ready(device, request, state->can_sync, TRACKING_ON)) {
		return;
	}
	if (!state->target_right_ascension_set || !state->target_declination_set) {
		alpaca_reply_error(request, ALPACA_ERROR_VALUE_NOT_SET, "TargetRightAscension and TargetDeclination have not been set");
		return;
	}
	telescope_sync(device, request, state->target_right_ascension, state->target_declination);
}

static void telescope_put_synctoaltaz(alpaca_device *device, alpaca_request *request) {
	telescope_state *state = device->state;
	double azimuth = 0;
	double altitude = 0;
	double right_ascension = 0;
	double declination = 0;
	if (telescope_horizontal_params(request, &azimuth, &altitude) && telescope_ready(device, request, state->can_sync_alt_az, TRACKING_OFF)) {
		telescope_equatorial(state, altitude, azimuth, &right_ascension, &declination);
		telescope_sync(device, request, right_ascension, declination);
	}
}

static void telescope_report(alpaca_device *device, alpaca_buffer *buffer) {
	telescope_state *state = device->state;
	double altitude = 0;
	double azimuth = 0;
	telescope_horizontal(state, &altitude, &azimuth);
	alpaca_buffer_field(buffer, "SiderealTime", "%.15g", telescope_sidereal_time(state));
	alpaca_buffer_field(buffer, "HourAngle", "%.15g", telescope_hour_angle(state));
	alpaca_buffer_field(buffer, "Altitude", "%.15g", altitude);
	alpaca_buffer_field(buffer, "Azimuth", "%.15g", azimuth);
	alpaca_buffer_field(buffer, "AxisRate0", "%.15g", state->axis_rate[0]);
	alpaca_buffer_field(buffer, "AxisRate1", "%.15g", state->axis_rate[1]);
	alpaca_buffer_field(buffer, "PendingGoal", "%d", state->pending_goal);
}

#define TELESCOPE_CAN(member, field) { .name = member, .kind = ALPACA_BOOL, .offset = offsetof(telescope_state, field), .flags = ALPACA_R }
#define TELESCOPE_INFO(member, type, field) { .name = member, .kind = type, .offset = offsetof(telescope_state, field), .flags = ALPACA_R }
#define TELESCOPE_RATE(member, field) { .name = member, .kind = ALPACA_DOUBLE, .offset = offsetof(telescope_state, field), .flags = ALPACA_R, .put = telescope_put_rate }
#define TELESCOPE_CONFIG(member, type, field) { .name = member, .kind = type, .offset = offsetof(telescope_state, field), .flags = ALPACA_CONFIG }

static const alpaca_member telescope_members[] = {
	TELESCOPE_INFO("AlignmentMode", ALPACA_INT, alignment_mode),
	{ .name = "Altitude", .flags = ALPACA_STATE, .get = telescope_get_altitude },
	TELESCOPE_INFO("ApertureArea", ALPACA_DOUBLE, aperture_area),
	TELESCOPE_INFO("ApertureDiameter", ALPACA_DOUBLE, aperture_diameter),
	{ .name = "AtHome", .kind = ALPACA_BOOL, .offset = offsetof(telescope_state, at_home), .flags = ALPACA_R | ALPACA_STATE },
	{ .name = "AtPark", .kind = ALPACA_BOOL, .offset = offsetof(telescope_state, at_park), .flags = ALPACA_R | ALPACA_STATE },
	{ .name = "Azimuth", .flags = ALPACA_STATE, .get = telescope_get_azimuth },
	TELESCOPE_CAN("CanFindHome", can_find_home),
	TELESCOPE_CAN("CanPark", can_park),
	TELESCOPE_CAN("CanPulseGuide", can_pulse_guide),
	TELESCOPE_CAN("CanSetDeclinationRate", can_set_declination_rate),
	TELESCOPE_CAN("CanSetGuideRates", can_set_guide_rates),
	TELESCOPE_CAN("CanSetPark", can_set_park),
	TELESCOPE_CAN("CanSetPierSide", can_set_pier_side),
	TELESCOPE_CAN("CanSetRightAscensionRate", can_set_right_ascension_rate),
	TELESCOPE_CAN("CanSetTracking", can_set_tracking),
	TELESCOPE_CAN("CanSlew", can_slew),
	TELESCOPE_CAN("CanSlewAltAz", can_slew_alt_az),
	TELESCOPE_CAN("CanSlewAltAzAsync", can_slew_alt_az_async),
	TELESCOPE_CAN("CanSlewAsync", can_slew_async),
	TELESCOPE_CAN("CanSync", can_sync),
	TELESCOPE_CAN("CanSyncAltAz", can_sync_alt_az),
	TELESCOPE_CAN("CanUnpark", can_unpark),
	{ .name = "Declination", .kind = ALPACA_MOTION, .offset = offsetof(telescope_state, declination), .flags = ALPACA_R | ALPACA_STATE },
	{ .name = "DeclinationRate", .kind = ALPACA_DOUBLE, .offset = offsetof(telescope_state, declination_rate), .get = telescope_get_offset_rate, .put = telescope_put_rate },
	{ .name = "DoesRefraction", .kind = ALPACA_BOOL, .offset = offsetof(telescope_state, does_refraction), .flags = ALPACA_RW },
	TELESCOPE_INFO("EquatorialSystem", ALPACA_INT, equatorial_system),
	TELESCOPE_INFO("FocalLength", ALPACA_DOUBLE, focal_length),
	TELESCOPE_RATE("GuideRateDeclination", guide_rate_declination),
	TELESCOPE_RATE("GuideRateRightAscension", guide_rate_right_ascension),
	{ .name = "IsPulseGuiding", .kind = ALPACA_BOOL, .offset = offsetof(telescope_state, is_pulse_guiding), .flags = ALPACA_STATE, .get = telescope_get_ispulseguiding },
	{ .name = "RightAscension", .kind = ALPACA_MOTION, .offset = offsetof(telescope_state, right_ascension), .flags = ALPACA_STATE, .get = telescope_get_rightascension },
	{ .name = "RightAscensionRate", .kind = ALPACA_DOUBLE, .offset = offsetof(telescope_state, right_ascension_rate), .get = telescope_get_offset_rate, .put = telescope_put_rate },
	{ .name = "SideOfPier", .flags = ALPACA_STATE, .get = telescope_get_sideofpier, .put = telescope_put_sideofpier },
	{ .name = "SiderealTime", .flags = ALPACA_STATE, .get = telescope_get_siderealtime },
	{ .name = "SiteElevation", .kind = ALPACA_DOUBLE, .offset = offsetof(telescope_state, site_elevation), .flags = ALPACA_RW, .min = -300, .max = 10000 },
	{ .name = "SiteLatitude", .kind = ALPACA_DOUBLE, .offset = offsetof(telescope_state, site_latitude), .flags = ALPACA_RW, .min = -90, .max = 90 },
	{ .name = "SiteLongitude", .kind = ALPACA_DOUBLE, .offset = offsetof(telescope_state, site_longitude), .flags = ALPACA_RW, .min = -180, .max = 180 },
	{ .name = "Slewing", .kind = ALPACA_BOOL, .offset = offsetof(telescope_state, slewing), .flags = ALPACA_R | ALPACA_STATE },
	{ .name = "SlewSettleTime", .kind = ALPACA_INT, .offset = offsetof(telescope_state, slew_settle_time), .flags = ALPACA_RW, .min = 0, .max = 3600 },
	{ .name = "TargetDeclination", .kind = ALPACA_DOUBLE, .offset = offsetof(telescope_state, target_declination), .min = -90, .max = 90, .get = telescope_get_target, .put = telescope_put_target },
	{ .name = "TargetRightAscension", .kind = ALPACA_DOUBLE, .offset = offsetof(telescope_state, target_right_ascension), .min = 0, .max = 24, .get = telescope_get_target, .put = telescope_put_target },
	{ .name = "Tracking", .kind = ALPACA_BOOL, .offset = offsetof(telescope_state, tracking), .flags = ALPACA_R | ALPACA_STATE, .put = telescope_put_tracking },
	{ .name = "TrackingRate", .kind = ALPACA_INT, .offset = offsetof(telescope_state, tracking_rate), .flags = ALPACA_R, .put = telescope_put_trackingrate },
	{ .name = "TrackingRates", .get = telescope_get_trackingrates },
	{ .name = "UTCDate", .flags = ALPACA_STATE, .get = telescope_get_utcdate, .put = telescope_put_utcdate },
	{ .name = "AbortSlew", .put = telescope_put_abortslew },
	{ .name = "AxisRates", .get = telescope_get_axisrates },
	{ .name = "CanMoveAxis", .kind = ALPACA_BOOL, .offset = offsetof(telescope_state, can_move_axis), .get = telescope_get_canmoveaxis },
	{ .name = "DestinationSideOfPier", .get = telescope_get_destinationsideofpier },
	{ .name = "FindHome", .put = telescope_put_findhome },
	{ .name = "MoveAxis", .put = telescope_put_moveaxis },
	{ .name = "Park", .put = telescope_put_park },
	{ .name = "PulseGuide", .put = telescope_put_pulseguide },
	{ .name = "SetPark", .put = telescope_put_setpark },
	{ .name = "SlewToAltAz", .put = telescope_put_slewtoaltaz },
	{ .name = "SlewToAltAzAsync", .put = telescope_put_slewtoaltazasync },
	{ .name = "SlewToCoordinates", .put = telescope_put_slewtocoordinates },
	{ .name = "SlewToCoordinatesAsync", .put = telescope_put_slewtocoordinatesasync },
	{ .name = "SlewToTarget", .put = telescope_put_slewtotarget },
	{ .name = "SlewToTargetAsync", .put = telescope_put_slewtotargetasync },
	{ .name = "SyncToAltAz", .put = telescope_put_synctoaltaz },
	{ .name = "SyncToCoordinates", .put = telescope_put_synctocoordinates },
	{ .name = "SyncToTarget", .put = telescope_put_synctotarget },
	{ .name = "Unpark", .put = telescope_put_unpark },
	TELESCOPE_CONFIG("SlewRate", ALPACA_DOUBLE, slew_rate),
	TELESCOPE_CONFIG("MaxAxisRate", ALPACA_DOUBLE, max_axis_rate),
	TELESCOPE_CONFIG("ParkHourAngle", ALPACA_DOUBLE, park_hour_angle),
	TELESCOPE_CONFIG("ParkDeclination", ALPACA_DOUBLE, park_declination),
	TELESCOPE_CONFIG("HomeHourAngle", ALPACA_DOUBLE, home_hour_angle),
	TELESCOPE_CONFIG("HomeDeclination", ALPACA_DOUBLE, home_declination),
	TELESCOPE_CONFIG("FlipTime", ALPACA_DOUBLE, flip_time),
	TELESCOPE_CONFIG("UnparkTime", ALPACA_DOUBLE, unpark_time),
	TELESCOPE_CONFIG("StopTime", ALPACA_DOUBLE, stop_time),
	TELESCOPE_CONFIG("StartDelay", ALPACA_DOUBLE, start_delay),
	TELESCOPE_CONFIG("QuietParkSlew", ALPACA_BOOL, quiet_park_slew),
	TELESCOPE_CONFIG("SplitAxisRates", ALPACA_BOOL, split_axis_rates),
	TELESCOPE_CONFIG("LateSlewing", ALPACA_DOUBLE, late_slewing),
	TELESCOPE_CONFIG("SkyAxes", ALPACA_BOOL, sky_axes),
	TELESCOPE_CONFIG("IgnoreAfterSlew", ALPACA_DOUBLE, ignore_after_slew),
	TELESCOPE_CONFIG("TrackingRates", ALPACA_STRING, tracking_rates),
	TELESCOPE_CONFIG("AxisRates", ALPACA_STRING, axis_rates),
	TELESCOPE_CONFIG("PulseGuideNeedsTracking", ALPACA_BOOL, pulse_guide_needs_tracking),
	TELESCOPE_CONFIG("DualAxisPulseGuide", ALPACA_BOOL, dual_axis_pulse_guide),
	TELESCOPE_CONFIG("LinkedGuideRates", ALPACA_BOOL, linked_guide_rates)
};

const alpaca_type alpaca_telescope_type = {
	.name = "Telescope",
	.interface_version = 4,
	.legacy_interface_version = 3,
	.state_size = sizeof(telescope_state),
	.members = telescope_members,
	.member_count = sizeof(telescope_members) / sizeof(telescope_members[0]),
	.reset = telescope_reset,
	.update = telescope_update,
	.report = telescope_report
};
