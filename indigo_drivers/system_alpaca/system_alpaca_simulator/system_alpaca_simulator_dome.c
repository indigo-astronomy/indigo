// ASCOM Alpaca server simulator, Dome
//
// Copyright (c) 2026 CloudMakers, s. r. o.
// All rights reserved.
//
// You can use this software under the terms of 'INDIGO Astronomy
// open-source license' (see LICENSE.md).
//
// THIS SOFTWARE IS PROVIDED BY THE AUTHORS 'AS IS' AND ANY EXPRESS
// OR IMPLIED WARRANTIES, INCLUDING, BUT NOT LIMITED TO, THE IMPLIED
// WARRANTIES OF MERCHANTABILITY AND FITNESS FOR A PARTICULAR PURPOSE
// ARE DISCLAIMED. IN NO EVENT SHALL THE AUTHOR BE LIABLE FOR ANY
// DIRECT, INDIRECT, INCIDENTAL, SPECIAL, EXEMPLARY, OR CONSEQUENTIAL
// DAMAGES (INCLUDING, BUT NOT LIMITED TO, PROCUREMENT OF SUBSTITUTE
// GOODS OR SERVICES; LOSS OF USE, DATA, OR PROFITS; OR BUSINESS
// INTERRUPTION) HOWEVER CAUSED AND ON ANY THEORY OF LIABILITY,
// WHETHER IN CONTRACT, STRICT LIABILITY, OR TORT (INCLUDING
// NEGLIGENCE OR OTHERWISE) ARISING IN ANY WAY OUT OF THE USE OF THIS
// SOFTWARE, EVEN IF ADVISED OF THE POSSIBILITY OF SUCH DAMAGE.

// Code is generated by AI

// This source file was generated by a Claude agent.

// IDomeV3 (Platform 7), IDomeV2 with interface=legacy.
// ShutterStatus: 0 Open, 1 Closed, 2 Opening, 3 Closing, 4 Error.
// A capability that is switched off (Can*=false) makes its members answer
// NotImplemented; a roll-off roof is CanSetAzimuth=false,CanSetAltitude=false.
// The model follows the ASCOM IDomeV3 documentation and, where the documentation
// leaves a choice, the default behaviour of the ASCOM OmniSim dome simulator:
// - The dome turns the shorter way at AzimuthRate, the shutter needs ShutterTime.
// - Slewing is true while the azimuth or the altitude moves. A moving shutter
//   is reported by ShutterStatus only; SlewingWithShutter=true selects the
//   devices that report it in Slewing as well (OmniSim "SlewingTrueWhenOpenOrClose").
// - AbortSlew stops everything, leaves a moving shutter in Error and switches
//   the hardware slaving off ("Slaved will become False").
// - OpenShutter of a shutter in Error is InvalidOperation; CloseShutter recovers it.
// - FindHome ends at HomeAzimuth with AtHome, Park ends at ParkAzimuth with
//   AtPark; any other slew and SyncToAzimuth clear both. Park of a parked dome
//   and FindHome of a dome at home do nothing. SetPark only stores the position.
// - A slaved dome (Slaved=true) refuses slews, Park and FindHome with
//   InvalidWhileSlaved and follows the telescope instead: whenever its azimuth
//   differs from TelescopeAzimuth (a simulator setting standing in for the
//   telescope the dome hardware is wired to) it slews there.

#include <math.h>

#include "system_alpaca_simulator.h"

#define SHUTTER_OPEN			0
#define SHUTTER_CLOSED		1
#define SHUTTER_OPENING		2
#define SHUTTER_CLOSING		3
#define SHUTTER_ERROR			4

#define DOME_GOAL_NONE		0
#define DOME_GOAL_HOME		1
#define DOME_GOAL_PARK		2

typedef struct {
	bool can_find_home;
	bool can_park;
	bool can_set_altitude;
	bool can_set_azimuth;
	bool can_set_park;
	bool can_set_shutter;
	bool can_slave;
	bool can_sync_azimuth;
	alpaca_motion azimuth;
	alpaca_motion altitude;
	bool at_home;
	bool at_park;
	bool slewing;
	bool slaved;
	int shutter_status;
	double shutter_until;
	int goal;
	double home_azimuth;
	double park_azimuth;
	double azimuth_rate;
	double altitude_rate;
	double shutter_time;
	double telescope_azimuth;
	bool slewing_with_shutter;
} dome_state;

static double dome_wrap(double angle) {
	angle = fmod(angle, 360);
	return angle < 0 ? angle + 360 : angle;
}

static void dome_reset(alpaca_device *device) {
	dome_state *state = device->state;
	state->can_find_home = state->can_park = state->can_set_altitude = state->can_set_azimuth = state->can_set_park = state->can_set_shutter = state->can_slave = state->can_sync_azimuth = true;
	state->shutter_status = SHUTTER_CLOSED;
	state->park_azimuth = 180;
	state->azimuth_rate = 10;
	state->altitude_rate = 10;
	state->shutter_time = 5;
	state->at_home = true;
}

static bool dome_shutter_moving(const dome_state *state) {
	return state->shutter_status == SHUTTER_OPENING || state->shutter_status == SHUTTER_CLOSING;
}

static void dome_start_slew(alpaca_device *device, double azimuth, int goal) {
	dome_state *state = device->state;
	double origin = alpaca_motion_update(&state->azimuth);
	double delta = dome_wrap(azimuth - origin);
	state->at_home = state->at_park = false;
	state->goal = goal;
	alpaca_motion_start(&state->azimuth, origin + (delta > 180 ? delta - 360 : delta), state->azimuth_rate);
	alpaca_event("MOVE", "dome/%d azimuth from=%.3f to=%.3f duration=%.3f goal=%d", device->number, origin, azimuth, state->azimuth.duration, goal);
}

static void dome_update(alpaca_device *device) {
	dome_state *state = device->state;
	alpaca_motion_update(&state->azimuth);
	alpaca_motion_update(&state->altitude);
	if (!state->azimuth.moving) {
		alpaca_motion_set(&state->azimuth, dome_wrap(state->azimuth.position));
		if (state->goal != DOME_GOAL_NONE) {
			state->at_home = state->goal == DOME_GOAL_HOME;
			state->at_park = state->goal == DOME_GOAL_PARK;
			state->goal = DOME_GOAL_NONE;
			alpaca_event("STATE", "dome/%d azimuth=%.3f at_home=%d at_park=%d", device->number, state->azimuth.position, state->at_home, state->at_park);
		}
	}
	if (state->slaved && state->can_set_azimuth && !state->azimuth.moving && fabs(dome_wrap(state->azimuth.position) - dome_wrap(state->telescope_azimuth)) > 1e-9) {
		dome_start_slew(device, dome_wrap(state->telescope_azimuth), DOME_GOAL_NONE);
	}
	if (dome_shutter_moving(state) && alpaca_reached(state->shutter_until)) {
		state->shutter_status = state->shutter_status == SHUTTER_OPENING ? SHUTTER_OPEN : SHUTTER_CLOSED;
		alpaca_event("STATE", "dome/%d shutter=%d", device->number, state->shutter_status);
	}
	state->slewing = state->azimuth.moving || state->altitude.moving || (state->slewing_with_shutter && dome_shutter_moving(state));
}

// Answers NotImplemented and returns false when the capability is switched off.
static bool dome_can(alpaca_request *request, bool capability) {
	if (!capability) {
		alpaca_reply_error(request, ALPACA_ERROR_NOT_IMPLEMENTED, "%s is not implemented", request->member->name);
	}
	return capability;
}

static bool dome_not_slaved(alpaca_device *device, alpaca_request *request) {
	dome_state *state = device->state;
	if (state->slaved) {
		alpaca_reply_error(request, ALPACA_ERROR_INVALID_WHILE_SLAVED, "%s is not allowed while the dome is slaved", request->member->name);
	}
	return !state->slaved;
}

static void dome_get_altitude(alpaca_device *device, alpaca_request *request) {
	dome_state *state = device->state;
	if (dome_can(request, state->can_set_altitude)) {
		alpaca_reply_double(request, state->altitude.position);
	}
}

static void dome_get_azimuth(alpaca_device *device, alpaca_request *request) {
	dome_state *state = device->state;
	if (dome_can(request, state->can_set_azimuth)) {
		alpaca_reply_double(request, dome_wrap(state->azimuth.position));
	}
}

static void dome_get_shutterstatus(alpaca_device *device, alpaca_request *request) {
	dome_state *state = device->state;
	if (dome_can(request, state->can_set_shutter)) {
		alpaca_reply_int(request, state->shutter_status);
	}
}

static void dome_put_slaved(alpaca_device *device, alpaca_request *request) {
	dome_state *state = device->state;
	bool slaved = false;
	if (!alpaca_param_bool(request, "Slaved", &slaved)) {
		return;
	}
	if (slaved && !dome_can(request, state->can_slave)) {
		return;
	}
	state->slaved = slaved;
	alpaca_event("STATE", "dome/%d slaved=%d", device->number, slaved);
	dome_update(device);
	alpaca_reply_void(request);
}

static void dome_slew(alpaca_device *device, alpaca_request *request, double azimuth, int goal) {
	dome_start_slew(device, azimuth, goal);
	dome_update(device);
	alpaca_reply_void(request);
}

static void dome_put_slewtoazimuth(alpaca_device *device, alpaca_request *request) {
	dome_state *state = device->state;
	double azimuth = 0;
	if (!alpaca_param_double(request, "Azimuth", &azimuth) || !dome_can(request, state->can_set_azimuth) || !dome_not_slaved(device, request)) {
		return;
	}
	if (azimuth < 0 || azimuth >= 360) {
		alpaca_reply_error(request, ALPACA_ERROR_INVALID_VALUE, "Azimuth %g is out of range 0 <= azimuth < 360", azimuth);
		return;
	}
	dome_slew(device, request, azimuth, DOME_GOAL_NONE);
}

static void dome_put_synctoazimuth(alpaca_device *device, alpaca_request *request) {
	dome_state *state = device->state;
	double azimuth = 0;
	if (!alpaca_param_double(request, "Azimuth", &azimuth) || !dome_can(request, state->can_sync_azimuth)) {
		return;
	}
	if (azimuth < 0 || azimuth >= 360) {
		alpaca_reply_error(request, ALPACA_ERROR_INVALID_VALUE, "Azimuth %g is out of range 0 <= azimuth < 360", azimuth);
		return;
	}
	alpaca_motion_set(&state->azimuth, azimuth);
	state->goal = DOME_GOAL_NONE;
	state->at_home = state->at_park = false;
	alpaca_event("STATE", "dome/%d sync azimuth=%.3f", device->number, azimuth);
	alpaca_reply_void(request);
}

static void dome_put_slewtoaltitude(alpaca_device *device, alpaca_request *request) {
	dome_state *state = device->state;
	double altitude = 0;
	if (!alpaca_param_double(request, "Altitude", &altitude) || !dome_can(request, state->can_set_altitude) || !dome_not_slaved(device, request)) {
		return;
	}
	if (altitude < 0 || altitude > 90) {
		alpaca_reply_error(request, ALPACA_ERROR_INVALID_VALUE, "Altitude %g is out of range 0..90", altitude);
		return;
	}
	alpaca_motion_start(&state->altitude, altitude, state->altitude_rate);
	dome_update(device);
	alpaca_event("MOVE", "dome/%d altitude to=%.3f duration=%.3f", device->number, altitude, state->altitude.duration);
	alpaca_reply_void(request);
}

static void dome_put_findhome(alpaca_device *device, alpaca_request *request) {
	dome_state *state = device->state;
	if (dome_can(request, state->can_find_home) && dome_not_slaved(device, request)) {
		if (state->at_home) {
			alpaca_reply_void(request);
		} else {
			dome_slew(device, request, state->home_azimuth, DOME_GOAL_HOME);
		}
	}
}

static void dome_put_park(alpaca_device *device, alpaca_request *request) {
	dome_state *state = device->state;
	if (dome_can(request, state->can_park) && dome_not_slaved(device, request)) {
		if (state->at_park) {
			alpaca_reply_void(request);
		} else {
			dome_slew(device, request, state->park_azimuth, DOME_GOAL_PARK);
		}
	}
}

static void dome_put_setpark(alpaca_device *device, alpaca_request *request) {
	dome_state *state = device->state;
	if (dome_can(request, state->can_set_park)) {
		state->park_azimuth = dome_wrap(state->azimuth.position);
		alpaca_event("STATE", "dome/%d park azimuth=%.3f", device->number, state->park_azimuth);
		alpaca_reply_void(request);
	}
}

static void dome_shutter(alpaca_device *device, alpaca_request *request, int moving, int target) {
	dome_state *state = device->state;
	if (!dome_can(request, state->can_set_shutter)) {
		return;
	}
	if (target == SHUTTER_OPEN && state->shutter_status == SHUTTER_ERROR) {
		alpaca_reply_error(request, ALPACA_ERROR_INVALID_OPERATION, "Shutter failed to open");
		return;
	}
	if (state->shutter_status != target && state->shutter_status != moving) {
		state->shutter_until = alpaca_now() + state->shutter_time;
		state->shutter_status = state->shutter_time > 0 ? moving : target;
		alpaca_event("MOVE", "dome/%d shutter to=%d duration=%.3f", device->number, target, state->shutter_time);
		dome_update(device);
	}
	alpaca_reply_void(request);
}

static void dome_put_openshutter(alpaca_device *device, alpaca_request *request) {
	dome_shutter(device, request, SHUTTER_OPENING, SHUTTER_OPEN);
}

static void dome_put_closeshutter(alpaca_device *device, alpaca_request *request) {
	dome_shutter(device, request, SHUTTER_CLOSING, SHUTTER_CLOSED);
}

static void dome_put_abortslew(alpaca_device *device, alpaca_request *request) {
	dome_state *state = device->state;
	alpaca_motion_stop(&state->azimuth);
	alpaca_motion_stop(&state->altitude);
	state->goal = DOME_GOAL_NONE;
	state->slaved = false;
	if (dome_shutter_moving(state)) {
		state->shutter_status = SHUTTER_ERROR;
	}
	state->slewing = false;
	alpaca_event("STATE", "dome/%d abort azimuth=%.3f shutter=%d", device->number, dome_wrap(state->azimuth.position), state->shutter_status);
	alpaca_reply_void(request);
}

static const alpaca_member dome_members[] = {
	{ .name = "Altitude", .kind = ALPACA_MOTION, .offset = offsetof(dome_state, altitude), .flags = ALPACA_STATE, .get = dome_get_altitude },
	{ .name = "AtHome", .kind = ALPACA_BOOL, .offset = offsetof(dome_state, at_home), .flags = ALPACA_R | ALPACA_STATE },
	{ .name = "AtPark", .kind = ALPACA_BOOL, .offset = offsetof(dome_state, at_park), .flags = ALPACA_R | ALPACA_STATE },
	{ .name = "Azimuth", .kind = ALPACA_MOTION, .offset = offsetof(dome_state, azimuth), .flags = ALPACA_STATE, .get = dome_get_azimuth },
	{ .name = "CanFindHome", .kind = ALPACA_BOOL, .offset = offsetof(dome_state, can_find_home), .flags = ALPACA_R },
	{ .name = "CanPark", .kind = ALPACA_BOOL, .offset = offsetof(dome_state, can_park), .flags = ALPACA_R },
	{ .name = "CanSetAltitude", .kind = ALPACA_BOOL, .offset = offsetof(dome_state, can_set_altitude), .flags = ALPACA_R },
	{ .name = "CanSetAzimuth", .kind = ALPACA_BOOL, .offset = offsetof(dome_state, can_set_azimuth), .flags = ALPACA_R },
	{ .name = "CanSetPark", .kind = ALPACA_BOOL, .offset = offsetof(dome_state, can_set_park), .flags = ALPACA_R },
	{ .name = "CanSetShutter", .kind = ALPACA_BOOL, .offset = offsetof(dome_state, can_set_shutter), .flags = ALPACA_R },
	{ .name = "CanSlave", .kind = ALPACA_BOOL, .offset = offsetof(dome_state, can_slave), .flags = ALPACA_R },
	{ .name = "CanSyncAzimuth", .kind = ALPACA_BOOL, .offset = offsetof(dome_state, can_sync_azimuth), .flags = ALPACA_R },
	{ .name = "ShutterStatus", .kind = ALPACA_INT, .offset = offsetof(dome_state, shutter_status), .flags = ALPACA_STATE, .get = dome_get_shutterstatus },
	{ .name = "Slaved", .kind = ALPACA_BOOL, .offset = offsetof(dome_state, slaved), .flags = ALPACA_R, .put = dome_put_slaved },
	{ .name = "Slewing", .kind = ALPACA_BOOL, .offset = offsetof(dome_state, slewing), .flags = ALPACA_R | ALPACA_STATE },
	{ .name = "AbortSlew", .put = dome_put_abortslew },
	{ .name = "CloseShutter", .put = dome_put_closeshutter },
	{ .name = "FindHome", .put = dome_put_findhome },
	{ .name = "OpenShutter", .put = dome_put_openshutter },
	{ .name = "Park", .put = dome_put_park },
	{ .name = "SetPark", .put = dome_put_setpark },
	{ .name = "SlewToAltitude", .put = dome_put_slewtoaltitude },
	{ .name = "SlewToAzimuth", .put = dome_put_slewtoazimuth },
	{ .name = "SyncToAzimuth", .put = dome_put_synctoazimuth },
	{ .name = "HomeAzimuth", .kind = ALPACA_DOUBLE, .offset = offsetof(dome_state, home_azimuth), .flags = ALPACA_CONFIG },
	{ .name = "ParkAzimuth", .kind = ALPACA_DOUBLE, .offset = offsetof(dome_state, park_azimuth), .flags = ALPACA_CONFIG },
	{ .name = "AzimuthRate", .kind = ALPACA_DOUBLE, .offset = offsetof(dome_state, azimuth_rate), .flags = ALPACA_CONFIG },
	{ .name = "AltitudeRate", .kind = ALPACA_DOUBLE, .offset = offsetof(dome_state, altitude_rate), .flags = ALPACA_CONFIG },
	{ .name = "ShutterTime", .kind = ALPACA_DOUBLE, .offset = offsetof(dome_state, shutter_time), .flags = ALPACA_CONFIG },
	{ .name = "TelescopeAzimuth", .kind = ALPACA_DOUBLE, .offset = offsetof(dome_state, telescope_azimuth), .flags = ALPACA_CONFIG },
	{ .name = "SlewingWithShutter", .kind = ALPACA_BOOL, .offset = offsetof(dome_state, slewing_with_shutter), .flags = ALPACA_CONFIG }
};

const alpaca_type alpaca_dome_type = {
	.name = "Dome",
	.interface_version = 3,
	.legacy_interface_version = 2,
	.state_size = sizeof(dome_state),
	.members = dome_members,
	.member_count = sizeof(dome_members) / sizeof(dome_members[0]),
	.reset = dome_reset,
	.update = dome_update
};
