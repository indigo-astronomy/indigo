// ASCOM Alpaca server simulator, Camera
//
// Copyright (c) 2026 CloudMakers, s. r. o.
// All rights reserved.
//
// You can use this software under the terms of 'INDIGO Astronomy
// open-source license' (see LICENSE.md).
//
// THIS SOFTWARE IS PROVIDED BY THE AUTHORS 'AS IS' AND ANY EXPRESS
// OR IMPLIED WARRANTIES, INCLUDING, BUT NOT LIMITED TO, THE IMPLIED
// WARRANTIES OF MERCHANTABILITY AND FITNESS FOR A PARTICULAR PURPOSE
// ARE DISCLAIMED. IN NO EVENT SHALL THE AUTHOR BE LIABLE FOR ANY
// DIRECT, INDIRECT, INCIDENTAL, SPECIAL, EXEMPLARY, OR CONSEQUENTIAL
// DAMAGES (INCLUDING, BUT NOT LIMITED TO, PROCUREMENT OF SUBSTITUTE
// GOODS OR SERVICES; LOSS OF USE, DATA, OR PROFITS; OR BUSINESS
// INTERRUPTION) HOWEVER CAUSED AND ON ANY THEORY OF LIABILITY,
// WHETHER IN CONTRACT, STRICT LIABILITY, OR TORT (INCLUDING
// NEGLIGENCE OR OTHERWISE) ARISING IN ANY WAY OUT OF THE USE OF THIS
// SOFTWARE, EVEN IF ADVISED OF THE POSSIBILITY OF SUCH DAMAGE.

// Code is generated by AI

// This source file was generated by a Claude agent.

// ICameraV4 (Platform 7), ICameraV3 with interface=legacy.
// CameraState: 0 Idle, 1 Waiting, 2 Exposing, 3 Reading, 4 Download, 5 Error.
// SensorType: 0 Monochrome, 1 Color (three planes), 2 RGGB and higher: a colour
// filter array on a single plane.
//
// Test pattern. The image is no picture, every pixel is a function of where it
// is on the sensor, so a client that swaps the axes, flips the image, reads
// the wrong subframe or mixes up the colour planes gets wrong values:
//
//   value = (3 * sensor_x + 7 * sensor_y + 31 * colour) % (MaxADU + 1)
//
// sensor_x = (StartX + x) * BinX and sensor_y = (StartY + y) * BinY are the
// unbinned coordinates of the top left corner of the binned pixel (x, y),
// origin top left. colour is the plane (0 R, 1 G, 2 B) of a Color sensor, the
// colour of the filter over the pixel of a colour filter array sensor
// ((sensor_x + BayerOffsetX) % 2 + (sensor_y + BayerOffsetY) % 2, so RGGB gives
// 0 R, 1 G, 2 B) and 0 for a monochrome sensor. A dark frame (Light=false)
// holds value % 16.
//
// The pixels are handed to the framework in Alpaca order (x outer, y inner,
// plane innermost), which serves them as JSON or as ImageBytes.
// ImageElementType selects the element type of the array (1 Int16, 2 Int32,
// 3 Double). TransmissionElementType selects the type on the wire of
// ImageBytes; 0 picks the narrowest one that holds MaxADU, like the reference
// servers do (6 Byte, 8 UInt16, 2 Int32). ImageBytes=false makes the camera
// answer ImageArray with JSON whatever the client accepts, like a server
// that is older than ImageBytes.
//
// Gain and Offset: GainMode / OffsetMode 0 = not implemented, 1 = index into
// the list Gains / Offsets (GainMin and GainMax are then not implemented),
// 2 = value in GainMin..GainMax (Gains is then not implemented).
//
// Readout: a camera has either FastReadout (CanFastReadout=true) or a list of
// readout modes, never both: ReadoutMode and ReadoutModes are not implemented
// while CanFastReadout is true (ICameraV2). ReadoutModeCount (1..4) is the
// length of the list.
//
// Simulator assumptions: an exposure takes Duration, then ReadoutTime in state
// Reading; StopExposure ends the exposure early and keeps the image,
// AbortExposure discards it; the sensor temperature moves at CoolingRate
// degrees per second towards SetCCDTemperature while the cooler is on and
// towards HeatSinkTemperature while it is off. ImageArrayVariant and
// SubExposureDuration are not implemented.

#include <math.h>
#include <stdio.h>
#include <stdlib.h>
#include <string.h>

#include "system_alpaca_simulator.h"

#define CAMERA_IDLE				0
#define CAMERA_EXPOSING		2
#define CAMERA_READING		3
#define SENSOR_MONOCHROME	0
#define SENSOR_COLOR			1
#define LEVEL_NONE				0
#define LEVEL_LIST				1
#define LEVEL_RANGE				2
#define LEVEL_LIST_SIZE		4

typedef struct {
	int mode;
	int value;
	int min;
	int max;
} camera_level;

typedef struct {
	int camera_x_size;
	int camera_y_size;
	int bin_x;
	int bin_y;
	int max_bin_x;
	int max_bin_y;
	int num_x;
	int num_y;
	int start_x;
	int start_y;
	bool can_abort_exposure;
	bool can_asymmetric_bin;
	bool can_fast_readout;
	bool can_get_cooler_power;
	bool can_pulse_guide;
	bool can_set_ccd_temperature;
	bool can_stop_exposure;
	int camera_state;
	alpaca_motion ccd_temperature;
	bool cooler_on;
	double cooler_power;
	double set_ccd_temperature;
	double heat_sink_temperature;
	double cooling_rate;
	double electrons_per_adu;
	double full_well_capacity;
	double exposure_min;
	double exposure_max;
	double exposure_resolution;
	bool fast_readout;
	camera_level gain;
	camera_level offset;
	bool has_shutter;
	bool image_ready;
	bool is_pulse_guiding;
	bool has_last_exposure;
	double last_exposure_duration;
	char last_exposure_start_time[ALPACA_TEXT_SIZE];
	int max_adu;
	int percent_completed;
	double pixel_size_x;
	double pixel_size_y;
	int readout_mode;
	int readout_mode_count;
	char sensor_name[ALPACA_TEXT_SIZE];
	int sensor_type;
	int bayer_offset_x;
	int bayer_offset_y;
	int image_element_type;
	int transmission_element_type;
	bool image_bytes;
	double readout_time;
	double exposure_start;
	double exposure_duration;
	double readout_until;
	double pulse_until;
	bool frame_light;
	int frame_start_x;
	int frame_start_y;
	int frame_num_x;
	int frame_num_y;
	int frame_bin_x;
	int frame_bin_y;
} camera_state;

static const char *camera_gains[LEVEL_LIST_SIZE] = { "Low noise", "Unity gain", "High gain", "Extended" };
static const char *camera_offsets[LEVEL_LIST_SIZE] = { "Offset 0", "Offset 50", "Offset 100", "Offset 200" };
static const char *camera_readout_modes[] = { "High quality", "Fast", "Low noise", "High dynamic range" };

#define CAMERA_MAX_READOUT_MODES ((int)(sizeof(camera_readout_modes) / sizeof(camera_readout_modes[0])))

static void camera_reset(alpaca_device *device) {
	camera_state *state = device->state;
	state->camera_x_size = 320;
	state->camera_y_size = 240;
	state->bin_x = state->bin_y = 1;
	state->max_bin_x = state->max_bin_y = 4;
	state->num_x = state->camera_x_size;
	state->num_y = state->camera_y_size;
	state->can_abort_exposure = state->can_asymmetric_bin = state->can_get_cooler_power = state->can_pulse_guide = state->can_set_ccd_temperature = state->can_stop_exposure = true;
	state->readout_mode_count = 2;
	state->heat_sink_temperature = 18.5;
	alpaca_motion_set(&state->ccd_temperature, state->heat_sink_temperature);
	state->set_ccd_temperature = -10;
	state->cooling_rate = 1;
	state->electrons_per_adu = 0.25;
	state->full_well_capacity = 51000;
	state->exposure_min = 0.0001;
	state->exposure_max = 3600;
	state->exposure_resolution = 0.0001;
	state->gain = (camera_level){ .mode = LEVEL_RANGE, .value = 100, .min = 0, .max = 300 };
	state->offset = (camera_level){ .mode = LEVEL_RANGE, .value = 10, .min = 0, .max = 255 };
	state->has_shutter = true;
	state->max_adu = 65535;
	state->pixel_size_x = state->pixel_size_y = 3.76;
	snprintf(state->sensor_name, sizeof(state->sensor_name), "SIM571");
	state->image_element_type = ALPACA_ELEMENT_INT32;
	state->image_bytes = true;
}

static void camera_finish_exposure(alpaca_device *device) {
	camera_state *state = device->state;
	state->camera_state = CAMERA_IDLE;
	state->image_ready = true;
	state->percent_completed = 100;
	alpaca_event("STATE", "camera/%d image ready duration=%.6f", device->number, state->last_exposure_duration);
}

static void camera_end_exposure(alpaca_device *device, double end) {
	camera_state *state = device->state;
	state->last_exposure_duration = end - state->exposure_start;
	state->has_last_exposure = true;
	state->readout_until = end + state->readout_time;
	state->camera_state = CAMERA_READING;
}

static int camera_readout_mode_count(const camera_state *state);

// A level or a readout mode that is the index of a name never points outside its list, whatever the settings of the simulator were changed to.
static void camera_limit_indices(camera_state *state) {
	if (state->gain.mode == LEVEL_LIST && (state->gain.value < 0 || state->gain.value >= LEVEL_LIST_SIZE)) {
		state->gain.value = 0;
	}
	if (state->offset.mode == LEVEL_LIST && (state->offset.value < 0 || state->offset.value >= LEVEL_LIST_SIZE)) {
		state->offset.value = 0;
	}
	if (state->readout_mode < 0 || state->readout_mode >= camera_readout_mode_count(state)) {
		state->readout_mode = 0;
	}
}

static void camera_update(alpaca_device *device) {
	camera_state *state = device->state;
	double now = alpaca_now();
	camera_limit_indices(state);
	if (state->camera_state == CAMERA_EXPOSING && alpaca_reached(state->exposure_start + state->exposure_duration)) {
		camera_end_exposure(device, state->exposure_start + state->exposure_duration);
	} else if (state->camera_state == CAMERA_EXPOSING) {
		state->percent_completed = (int)(100 * (now - state->exposure_start) / state->exposure_duration);
	}
	if (state->camera_state == CAMERA_READING && alpaca_reached(state->readout_until)) {
		camera_finish_exposure(device);
	}
	state->is_pulse_guiding = !alpaca_reached(state->pulse_until);
	double temperature = alpaca_motion_update(&state->ccd_temperature);
	if (!state->cooler_on) {
		state->cooler_power = 0;
	} else if (state->ccd_temperature.moving) {
		state->cooler_power = 100;
	} else {
		state->cooler_power = fmax(0, fmin(100, (state->heat_sink_temperature - temperature) * 2.5));
	}
}

static void camera_regulate(camera_state *state) {
	alpaca_motion_start(&state->ccd_temperature, state->cooler_on ? state->set_ccd_temperature : state->heat_sink_temperature, state->cooling_rate);
}

// Answers NotImplemented and returns false when the capability is switched off.
static bool camera_can(alpaca_request *request, bool capability) {
	if (!capability) {
		alpaca_reply_error(request, ALPACA_ERROR_NOT_IMPLEMENTED, "%s is not implemented", request->member->name);
	}
	return capability;
}

static void camera_get_bayeroffset(alpaca_device *device, alpaca_request *request) {
	camera_state *state = device->state;
	if (camera_can(request, state->sensor_type != SENSOR_MONOCHROME)) {
		alpaca_reply_member(device, request);
	}
}

static void camera_put_bin(alpaca_device *device, alpaca_request *request) {
	camera_state *state = device->state;
	bool horizontal = request->member->offset == offsetof(camera_state, bin_x);
	int max = horizontal ? state->max_bin_x : state->max_bin_y;
	int bin = 0;
	if (!alpaca_param_int(request, request->member->name, &bin)) {
		return;
	}
	if (bin < 1 || bin > max) {
		alpaca_reply_error(request, ALPACA_ERROR_INVALID_VALUE, "%s %d is out of range 1..%d", request->member->name, bin, max);
		return;
	}
	if (horizontal || !state->can_asymmetric_bin) {
		state->bin_x = bin;
	}
	if (!horizontal || !state->can_asymmetric_bin) {
		state->bin_y = bin;
	}
	alpaca_reply_void(request);
}

static void camera_put_cooleron(alpaca_device *device, alpaca_request *request) {
	camera_state *state = device->state;
	if (alpaca_store_member(device, request)) {
		camera_regulate(state);
		alpaca_reply_void(request);
	}
}

static void camera_get_coolerpower(alpaca_device *device, alpaca_request *request) {
	camera_state *state = device->state;
	if (camera_can(request, state->can_get_cooler_power)) {
		alpaca_reply_member(device, request);
	}
}

static void camera_get_setccdtemperature(alpaca_device *device, alpaca_request *request) {
	camera_state *state = device->state;
	if (camera_can(request, state->can_set_ccd_temperature)) {
		alpaca_reply_member(device, request);
	}
}

static void camera_put_setccdtemperature(alpaca_device *device, alpaca_request *request) {
	camera_state *state = device->state;
	double temperature = 0;
	if (!alpaca_param_double(request, "SetCCDTemperature", &temperature) || !camera_can(request, state->can_set_ccd_temperature)) {
		return;
	}
	if (temperature < -273.15 || temperature > 100) {
		alpaca_reply_error(request, ALPACA_ERROR_INVALID_VALUE, "SetCCDTemperature %g is out of range", temperature);
		return;
	}
	state->set_ccd_temperature = temperature;
	camera_regulate(state);
	alpaca_reply_void(request);
}

static void camera_get_fastreadout(alpaca_device *device, alpaca_request *request) {
	camera_state *state = device->state;
	if (camera_can(request, state->can_fast_readout)) {
		alpaca_reply_member(device, request);
	}
}

static void camera_put_fastreadout(alpaca_device *device, alpaca_request *request) {
	camera_state *state = device->state;
	bool fast_readout = false;
	if (alpaca_param_bool(request, "FastReadout", &fast_readout) && camera_can(request, state->can_fast_readout)) {
		state->fast_readout = fast_readout;
		alpaca_reply_void(request);
	}
}

// Gain and Offset share their handlers: the member name tells which one is meant.
static camera_level *camera_level_of(alpaca_device *device, alpaca_request *request) {
	camera_state *state = device->state;
	return request->member->name[0] == 'G' ? &state->gain : &state->offset;
}

static void camera_get_level(alpaca_device *device, alpaca_request *request) {
	camera_level *level = camera_level_of(device, request);
	if (camera_can(request, level->mode != LEVEL_NONE)) {
		alpaca_reply_int(request, level->value);
	}
}

static void camera_put_level(alpaca_device *device, alpaca_request *request) {
	camera_level *level = camera_level_of(device, request);
	int min = level->mode == LEVEL_LIST ? 0 : level->min;
	int max = level->mode == LEVEL_LIST ? LEVEL_LIST_SIZE - 1 : level->max;
	int value = 0;
	if (!alpaca_param_int(request, request->member->name, &value) || !camera_can(request, level->mode != LEVEL_NONE)) {
		return;
	}
	if (value < min || value > max) {
		alpaca_reply_error(request, ALPACA_ERROR_INVALID_VALUE, "%s %d is out of range %d..%d", request->member->name, value, min, max);
		return;
	}
	level->value = value;
	alpaca_reply_void(request);
}

static void camera_get_level_min(alpaca_device *device, alpaca_request *request) {
	camera_level *level = camera_level_of(device, request);
	if (camera_can(request, level->mode == LEVEL_RANGE)) {
		alpaca_reply_int(request, level->min);
	}
}

static void camera_get_level_max(alpaca_device *device, alpaca_request *request) {
	camera_level *level = camera_level_of(device, request);
	if (camera_can(request, level->mode == LEVEL_RANGE)) {
		alpaca_reply_int(request, level->max);
	}
}

static void camera_reply_names(alpaca_request *request, const char **names, int count) {
	alpaca_buffer_append(&request->value, "[", 1);
	for (int i = 0; i < count; i++) {
		alpaca_buffer_append(&request->value, ",", i ? 1 : 0);
		alpaca_buffer_json_string(&request->value, names[i]);
	}
	alpaca_buffer_append(&request->value, "]", 1);
	alpaca_reply_void(request);
}

static void camera_get_level_list(alpaca_device *device, alpaca_request *request) {
	camera_level *level = camera_level_of(device, request);
	if (camera_can(request, level->mode == LEVEL_LIST)) {
		camera_reply_names(request, request->member->name[0] == 'G' ? camera_gains : camera_offsets, LEVEL_LIST_SIZE);
	}
}

static int camera_readout_mode_count(const camera_state *state) {
	return state->readout_mode_count < 1 ? 1 : state->readout_mode_count > CAMERA_MAX_READOUT_MODES ? CAMERA_MAX_READOUT_MODES : state->readout_mode_count;
}

static void camera_get_readoutmodes(alpaca_device *device, alpaca_request *request) {
	camera_state *state = device->state;
	if (camera_can(request, !state->can_fast_readout)) {
		camera_reply_names(request, camera_readout_modes, camera_readout_mode_count(state));
	}
}

static void camera_get_readoutmode(alpaca_device *device, alpaca_request *request) {
	camera_state *state = device->state;
	if (camera_can(request, !state->can_fast_readout)) {
		alpaca_reply_member(device, request);
	}
}

static void camera_put_readoutmode(alpaca_device *device, alpaca_request *request) {
	camera_state *state = device->state;
	int mode = 0;
	if (!alpaca_param_int(request, "ReadoutMode", &mode) || !camera_can(request, !state->can_fast_readout)) {
		return;
	}
	if (mode < 0 || mode >= camera_readout_mode_count(state)) {
		alpaca_reply_error(request, ALPACA_ERROR_INVALID_VALUE, "ReadoutMode %d is out of range 0..%d", mode, camera_readout_mode_count(state) - 1);
		return;
	}
	state->readout_mode = mode;
	alpaca_reply_void(request);
}

static void camera_get_ispulseguiding(alpaca_device *device, alpaca_request *request) {
	camera_state *state = device->state;
	if (camera_can(request, state->can_pulse_guide)) {
		alpaca_reply_member(device, request);
	}
}

static void camera_get_lastexposure(alpaca_device *device, alpaca_request *request) {
	camera_state *state = device->state;
	if (!state->has_last_exposure) {
		alpaca_reply_error(request, ALPACA_ERROR_INVALID_OPERATION, "%s is not available before the first exposure", request->member->name);
		return;
	}
	alpaca_reply_member(device, request);
}

static void camera_get_notimplemented(alpaca_device *device, alpaca_request *request) {
	(void)device;
	alpaca_reply_error(request, ALPACA_ERROR_NOT_IMPLEMENTED, "%s is not implemented", request->member->name);
}

static void camera_put_notimplemented(alpaca_device *device, alpaca_request *request) {
	const char *value = NULL;
	(void)device;
	if (alpaca_param_string(request, request->member->name, &value)) {
		alpaca_reply_error(request, ALPACA_ERROR_NOT_IMPLEMENTED, "%s is not implemented", request->member->name);
	}
}

static void camera_put_startexposure(alpaca_device *device, alpaca_request *request) {
	camera_state *state = device->state;
	double duration = 0;
	bool light = false;
	if (!alpaca_param_double(request, "Duration", &duration) || !alpaca_param_bool(request, "Light", &light)) {
		return;
	}
	if (state->camera_state != CAMERA_IDLE) {
		alpaca_reply_error(request, ALPACA_ERROR_INVALID_OPERATION, "An exposure is already in progress");
		return;
	}
	if (duration < 0 || duration > state->exposure_max || (light && duration < state->exposure_min)) {
		alpaca_reply_error(request, ALPACA_ERROR_INVALID_VALUE, "Duration %g is out of range %g..%g", duration, state->exposure_min, state->exposure_max);
		return;
	}
	if (state->num_x < 1 || state->start_x < 0 || state->start_x + state->num_x > state->camera_x_size / state->bin_x) {
		alpaca_reply_error(request, ALPACA_ERROR_INVALID_VALUE, "StartX %d and NumX %d do not fit %d binned pixels", state->start_x, state->num_x, state->camera_x_size / state->bin_x);
		return;
	}
	if (state->num_y < 1 || state->start_y < 0 || state->start_y + state->num_y > state->camera_y_size / state->bin_y) {
		alpaca_reply_error(request, ALPACA_ERROR_INVALID_VALUE, "StartY %d and NumY %d do not fit %d binned pixels", state->start_y, state->num_y, state->camera_y_size / state->bin_y);
		return;
	}
	alpaca_format_utc(alpaca_utc(), state->last_exposure_start_time, sizeof(state->last_exposure_start_time));
	state->last_exposure_start_time[23] = '\0';
	state->image_ready = false;
	state->percent_completed = 0;
	state->exposure_start = alpaca_now();
	state->exposure_duration = duration;
	state->frame_light = light;
	state->frame_start_x = state->start_x;
	state->frame_start_y = state->start_y;
	state->frame_num_x = state->num_x;
	state->frame_num_y = state->num_y;
	state->frame_bin_x = state->bin_x;
	state->frame_bin_y = state->bin_y;
	state->camera_state = CAMERA_EXPOSING;
	alpaca_event("STATE", "camera/%d exposure duration=%.6f light=%d frame=%d,%d %dx%d bin=%dx%d", device->number, duration, light, state->start_x, state->start_y, state->num_x, state->num_y, state->bin_x, state->bin_y);
	if (duration == 0) {
		camera_update(device);
	}
	alpaca_reply_void(request);
}

static void camera_put_stopexposure(alpaca_device *device, alpaca_request *request) {
	camera_state *state = device->state;
	if (!camera_can(request, state->can_stop_exposure)) {
		return;
	}
	if (state->camera_state == CAMERA_EXPOSING) {
		camera_end_exposure(device, alpaca_now());
		alpaca_event("STATE", "camera/%d exposure stopped after %.6f", device->number, state->last_exposure_duration);
		camera_update(device);
	}
	alpaca_reply_void(request);
}

static void camera_put_abortexposure(alpaca_device *device, alpaca_request *request) {
	camera_state *state = device->state;
	if (!camera_can(request, state->can_abort_exposure)) {
		return;
	}
	if (state->camera_state != CAMERA_IDLE) {
		state->camera_state = CAMERA_IDLE;
		state->image_ready = false;
		state->percent_completed = 0;
		alpaca_event("STATE", "camera/%d exposure aborted", device->number);
	}
	alpaca_reply_void(request);
}

static void camera_put_pulseguide(alpaca_device *device, alpaca_request *request) {
	camera_state *state = device->state;
	int direction = 0;
	int duration = 0;
	if (!alpaca_param_int(request, "Direction", &direction) || !alpaca_param_int(request, "Duration", &duration) || !camera_can(request, state->can_pulse_guide)) {
		return;
	}
	if (direction < 0 || direction > 3 || duration < 0) {
		alpaca_reply_error(request, ALPACA_ERROR_INVALID_VALUE, "Direction %d or Duration %d is out of range", direction, duration);
		return;
	}
	state->pulse_until = alpaca_now() + duration / 1000.0;
	state->is_pulse_guiding = duration > 0;
	alpaca_event("STATE", "camera/%d pulse direction=%d duration=%d", device->number, direction, duration);
	alpaca_reply_void(request);
}

static int camera_transmission_type(const camera_state *state) {
	if (state->transmission_element_type != 0) {
		return state->transmission_element_type;
	}
	if (state->image_element_type == ALPACA_ELEMENT_DOUBLE) {
		return ALPACA_ELEMENT_DOUBLE;
	}
	if (state->max_adu <= 255) {
		return ALPACA_ELEMENT_BYTE;
	}
	if (state->image_element_type == ALPACA_ELEMENT_INT16) {
		return ALPACA_ELEMENT_INT16;
	}
	return state->max_adu <= 65535 ? ALPACA_ELEMENT_UINT16 : ALPACA_ELEMENT_INT32;
}

static void camera_get_imagearray(alpaca_device *device, alpaca_request *request) {
	camera_state *state = device->state;
	int planes = state->sensor_type == SENSOR_COLOR ? 3 : 1;
	unsigned modulus = (unsigned)state->max_adu + 1;
	if (!state->image_bytes) {
		request->accepts_imagebytes = false;
	}
	if (!state->image_ready) {
		alpaca_reply_error(request, ALPACA_ERROR_INVALID_OPERATION, "There is no image, ImageReady is false");
		return;
	}
	int32_t *pixels = malloc((size_t)state->frame_num_x * (size_t)state->frame_num_y * (size_t)planes * sizeof(int32_t));
	if (pixels == NULL) {
		alpaca_reply_error(request, ALPACA_ERROR_UNSPECIFIED, "Out of memory");
		return;
	}
	int32_t *pixel = pixels;
	for (int x = 0; x < state->frame_num_x; x++) {
		unsigned sensor_x = (unsigned)((state->frame_start_x + x) * state->frame_bin_x);
		for (int y = 0; y < state->frame_num_y; y++) {
			unsigned sensor_y = (unsigned)((state->frame_start_y + y) * state->frame_bin_y);
			unsigned filter = state->sensor_type > SENSOR_COLOR ? ((sensor_x + (unsigned)state->bayer_offset_x) & 1) + ((sensor_y + (unsigned)state->bayer_offset_y) & 1) : 0;
			for (int plane = 0; plane < planes; plane++) {
				unsigned value = (3 * sensor_x + 7 * sensor_y + 31 * (planes > 1 ? (unsigned)plane : filter)) % modulus;
				*pixel++ = (int32_t)(state->frame_light ? value : value % 16);
			}
		}
	}
	alpaca_image image = { .pixels = pixels, .width = state->frame_num_x, .height = state->frame_num_y, .planes = planes, .element_type = state->image_element_type, .transmission_type = camera_transmission_type(state) };
	alpaca_reply_image(request, &image);
}

static bool camera_control(alpaca_device *device, const char *key, const char *value) {
	camera_state *state = device->state;
	double temperature = 0;
	// a sensor size given at start also sets the default frame, as a camera with that sensor would report it
	if (!strcmp(key, "CameraXSize") && alpaca_parse_int(value, &state->camera_x_size)) {
		state->num_x = state->camera_x_size / state->bin_x;
		state->start_x = 0;
		return true;
	}
	if (!strcmp(key, "CameraYSize") && alpaca_parse_int(value, &state->camera_y_size)) {
		state->num_y = state->camera_y_size / state->bin_y;
		state->start_y = 0;
		return true;
	}
	if (!strcmp(key, "HeatSinkTemperature") && alpaca_parse_double(value, &temperature)) {
		state->heat_sink_temperature = temperature;
		if (!state->cooler_on) {
			alpaca_motion_set(&state->ccd_temperature, temperature);
		}
		return true;
	}
	return false;
}

#define CAMERA_BOOL(member, field) { .name = member, .kind = ALPACA_BOOL, .offset = offsetof(camera_state, field), .flags = ALPACA_R }
#define CAMERA_INT(member, field) { .name = member, .kind = ALPACA_INT, .offset = offsetof(camera_state, field), .flags = ALPACA_R }
#define CAMERA_DOUBLE(member, field) { .name = member, .kind = ALPACA_DOUBLE, .offset = offsetof(camera_state, field), .flags = ALPACA_R }
#define CAMERA_FRAME(member, field) { .name = member, .kind = ALPACA_INT, .offset = offsetof(camera_state, field), .flags = ALPACA_RW }
#define CAMERA_CONFIG(member, type, field) { .name = member, .kind = type, .offset = offsetof(camera_state, field), .flags = ALPACA_CONFIG }

static const alpaca_member camera_members[] = {
	{ .name = "BayerOffsetX", .kind = ALPACA_INT, .offset = offsetof(camera_state, bayer_offset_x), .get = camera_get_bayeroffset },
	{ .name = "BayerOffsetY", .kind = ALPACA_INT, .offset = offsetof(camera_state, bayer_offset_y), .get = camera_get_bayeroffset },
	{ .name = "BinX", .kind = ALPACA_INT, .offset = offsetof(camera_state, bin_x), .flags = ALPACA_R, .put = camera_put_bin },
	{ .name = "BinY", .kind = ALPACA_INT, .offset = offsetof(camera_state, bin_y), .flags = ALPACA_R, .put = camera_put_bin },
	{ .name = "CameraState", .kind = ALPACA_INT, .offset = offsetof(camera_state, camera_state), .flags = ALPACA_R | ALPACA_STATE },
	CAMERA_INT("CameraXSize", camera_x_size),
	CAMERA_INT("CameraYSize", camera_y_size),
	CAMERA_BOOL("CanAbortExposure", can_abort_exposure),
	CAMERA_BOOL("CanAsymmetricBin", can_asymmetric_bin),
	CAMERA_BOOL("CanFastReadout", can_fast_readout),
	CAMERA_BOOL("CanGetCoolerPower", can_get_cooler_power),
	CAMERA_BOOL("CanPulseGuide", can_pulse_guide),
	CAMERA_BOOL("CanSetCCDTemperature", can_set_ccd_temperature),
	CAMERA_BOOL("CanStopExposure", can_stop_exposure),
	{ .name = "CCDTemperature", .kind = ALPACA_MOTION, .offset = offsetof(camera_state, ccd_temperature), .flags = ALPACA_R | ALPACA_STATE },
	{ .name = "CoolerOn", .kind = ALPACA_BOOL, .offset = offsetof(camera_state, cooler_on), .flags = ALPACA_R, .put = camera_put_cooleron },
	{ .name = "CoolerPower", .kind = ALPACA_DOUBLE, .offset = offsetof(camera_state, cooler_power), .flags = ALPACA_STATE, .get = camera_get_coolerpower },
	CAMERA_DOUBLE("ElectronsPerADU", electrons_per_adu),
	CAMERA_DOUBLE("ExposureMax", exposure_max),
	CAMERA_DOUBLE("ExposureMin", exposure_min),
	CAMERA_DOUBLE("ExposureResolution", exposure_resolution),
	{ .name = "FastReadout", .kind = ALPACA_BOOL, .offset = offsetof(camera_state, fast_readout), .get = camera_get_fastreadout, .put = camera_put_fastreadout },
	CAMERA_DOUBLE("FullWellCapacity", full_well_capacity),
	{ .name = "Gain", .kind = ALPACA_INT, .offset = offsetof(camera_state, gain.value), .get = camera_get_level, .put = camera_put_level },
	{ .name = "GainMax", .kind = ALPACA_INT, .offset = offsetof(camera_state, gain.max), .get = camera_get_level_max },
	{ .name = "GainMin", .kind = ALPACA_INT, .offset = offsetof(camera_state, gain.min), .get = camera_get_level_min },
	{ .name = "Gains", .get = camera_get_level_list },
	CAMERA_BOOL("HasShutter", has_shutter),
	{ .name = "HeatSinkTemperature", .kind = ALPACA_DOUBLE, .offset = offsetof(camera_state, heat_sink_temperature), .flags = ALPACA_R | ALPACA_STATE },
	{ .name = "ImageArray", .flags = ALPACA_IMAGE, .get = camera_get_imagearray },
	{ .name = "ImageArrayVariant", .get = camera_get_notimplemented },
	{ .name = "ImageReady", .kind = ALPACA_BOOL, .offset = offsetof(camera_state, image_ready), .flags = ALPACA_R | ALPACA_STATE },
	{ .name = "IsPulseGuiding", .kind = ALPACA_BOOL, .offset = offsetof(camera_state, is_pulse_guiding), .flags = ALPACA_STATE, .get = camera_get_ispulseguiding },
	{ .name = "LastExposureDuration", .kind = ALPACA_DOUBLE, .offset = offsetof(camera_state, last_exposure_duration), .get = camera_get_lastexposure },
	{ .name = "LastExposureStartTime", .kind = ALPACA_STRING, .offset = offsetof(camera_state, last_exposure_start_time), .get = camera_get_lastexposure },
	CAMERA_INT("MaxADU", max_adu),
	CAMERA_INT("MaxBinX", max_bin_x),
	CAMERA_INT("MaxBinY", max_bin_y),
	CAMERA_FRAME("NumX", num_x),
	CAMERA_FRAME("NumY", num_y),
	{ .name = "Offset", .kind = ALPACA_INT, .offset = offsetof(camera_state, offset.value), .get = camera_get_level, .put = camera_put_level },
	{ .name = "OffsetMax", .kind = ALPACA_INT, .offset = offsetof(camera_state, offset.max), .get = camera_get_level_max },
	{ .name = "OffsetMin", .kind = ALPACA_INT, .offset = offsetof(camera_state, offset.min), .get = camera_get_level_min },
	{ .name = "Offsets", .get = camera_get_level_list },
	{ .name = "PercentCompleted", .kind = ALPACA_INT, .offset = offsetof(camera_state, percent_completed), .flags = ALPACA_R | ALPACA_STATE },
	CAMERA_DOUBLE("PixelSizeX", pixel_size_x),
	CAMERA_DOUBLE("PixelSizeY", pixel_size_y),
	{ .name = "ReadoutMode", .kind = ALPACA_INT, .offset = offsetof(camera_state, readout_mode), .get = camera_get_readoutmode, .put = camera_put_readoutmode },
	{ .name = "ReadoutModes", .get = camera_get_readoutmodes },
	{ .name = "SensorName", .kind = ALPACA_STRING, .offset = offsetof(camera_state, sensor_name), .flags = ALPACA_R },
	CAMERA_INT("SensorType", sensor_type),
	{ .name = "SetCCDTemperature", .kind = ALPACA_DOUBLE, .offset = offsetof(camera_state, set_ccd_temperature), .get = camera_get_setccdtemperature, .put = camera_put_setccdtemperature },
	CAMERA_FRAME("StartX", start_x),
	CAMERA_FRAME("StartY", start_y),
	{ .name = "SubExposureDuration", .get = camera_get_notimplemented, .put = camera_put_notimplemented },
	{ .name = "AbortExposure", .put = camera_put_abortexposure },
	{ .name = "PulseGuide", .put = camera_put_pulseguide },
	{ .name = "StartExposure", .put = camera_put_startexposure },
	{ .name = "StopExposure", .put = camera_put_stopexposure },
	CAMERA_CONFIG("GainMode", ALPACA_INT, gain.mode),
	CAMERA_CONFIG("OffsetMode", ALPACA_INT, offset.mode),
	CAMERA_CONFIG("ImageElementType", ALPACA_INT, image_element_type),
	CAMERA_CONFIG("TransmissionElementType", ALPACA_INT, transmission_element_type),
	CAMERA_CONFIG("ImageBytes", ALPACA_BOOL, image_bytes),
	CAMERA_CONFIG("ReadoutModeCount", ALPACA_INT, readout_mode_count),
	CAMERA_CONFIG("ReadoutTime", ALPACA_DOUBLE, readout_time),
	CAMERA_CONFIG("CoolingRate", ALPACA_DOUBLE, cooling_rate)
};

const alpaca_type alpaca_camera_type = {
	.name = "Camera",
	.interface_version = 4,
	.legacy_interface_version = 3,
	.state_size = sizeof(camera_state),
	.members = camera_members,
	.member_count = sizeof(camera_members) / sizeof(camera_members[0]),
	.reset = camera_reset,
	.update = camera_update,
	.control = camera_control
};
