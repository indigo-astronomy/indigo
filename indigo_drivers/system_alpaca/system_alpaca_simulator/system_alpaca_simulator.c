// ASCOM Alpaca server simulator
//
// Copyright (c) 2026 CloudMakers, s. r. o.
// All rights reserved.
//
// You can use this software under the terms of 'INDIGO Astronomy
// open-source license' (see LICENSE.md).
//
// THIS SOFTWARE IS PROVIDED BY THE AUTHORS 'AS IS' AND ANY EXPRESS
// OR IMPLIED WARRANTIES, INCLUDING, BUT NOT LIMITED TO, THE IMPLIED
// WARRANTIES OF MERCHANTABILITY AND FITNESS FOR A PARTICULAR PURPOSE
// ARE DISCLAIMED. IN NO EVENT SHALL THE AUTHOR BE LIABLE FOR ANY
// DIRECT, INDIRECT, INCIDENTAL, SPECIAL, EXEMPLARY, OR CONSEQUENTIAL
// DAMAGES (INCLUDING, BUT NOT LIMITED TO, PROCUREMENT OF SUBSTITUTE
// GOODS OR SERVICES; LOSS OF USE, DATA, OR PROFITS; OR BUSINESS
// INTERRUPTION) HOWEVER CAUSED AND ON ANY THEORY OF LIABILITY,
// WHETHER IN CONTRACT, STRICT LIABILITY, OR TORT (INCLUDING
// NEGLIGENCE OR OTHERWISE) ARISING IN ANY WAY OUT OF THE USE OF THIS
// SOFTWARE, EVEN IF ADVISED OF THE POSSIBILITY OF SUCH DAMAGE.

// Code is generated by AI

// This source file was generated by a Claude agent.

// Deterministic host-side Alpaca server for the system_alpaca driver tests:
// HTTP/1.1 device and management API, UDP discovery responder, simulated
// clock, scripted fault injection and request recording. The device types
// live in system_alpaca_simulator_<type>.c, see system_alpaca_simulator.h.
//
// Protocol behaviour follows the ASCOM Alpaca API (AlpacaDeviceAPI_v1.yaml,
// AlpacaManagementAPI_v1.yaml, Alpaca API Reference) in its strict form:
// - path elements are lower case, anything else is HTTP 400,
// - GET parameter names are case insensitive, PUT form field names are case
//   sensitive and a wrongly cased or missing one is HTTP 400,
// - ClientID and ClientTransactionID that are missing, wrongly cased in a
//   form or not an unsigned 32 bit number are treated as not supplied (0),
// - the parameters of a PUT are an application/x-www-form-urlencoded body, a body
//   of another type is HTTP 400 (--any-content-type takes any),
// - ASCOM errors are HTTP 200 with ErrorNumber and ErrorMessage and without Value
//   (--error-value adds the default of the type, as the ASCOM .NET servers do),
// - ServerTransactionID grows by one with every Alpaca response.
//
// The control API lives under /simulator/v1 on the same port. It takes
// form-encoded PUT bodies and query parameters, and answers in text/plain with
// "Key=value" fields separated by '&' or a new line, values percent-encoded.
// Run with --help for the options and the list of control endpoints.
//
// Event log ("<monotonic time> KIND text", as in the serial simulators):
// OPEN, CLOSE, RX, TX, FAULT, CONTROL, STATE, MOVE, DISCOVERY. RX and TX carry
// the sequence number of the recorded request, RX also the connection number.

#ifndef _GNU_SOURCE
#define _GNU_SOURCE
#endif

#include <arpa/inet.h>
#include <ctype.h>
#include <errno.h>
#include <fcntl.h>
#include <limits.h>
#include <math.h>
#include <netinet/in.h>
#include <netinet/tcp.h>
#include <poll.h>
#include <pthread.h>
#include <signal.h>
#include <stdarg.h>
#include <stdatomic.h>
#include <stdbool.h>
#include <stdint.h>
#include <stdio.h>
#include <stdlib.h>
#include <string.h>
#include <strings.h>
#include <sys/socket.h>
#include <sys/time.h>
#include <time.h>
#include <unistd.h>

#include "system_alpaca_simulator.h"

#define SIMULATOR_NAME						"system_alpaca"
#define SIMULATOR_VERSION					"1.0"
#define MAX_DEVICES								64
#define MAX_DEVICE_OPTIONS				64
#define MAX_CONNECTIONS						64
#define MAX_FAULTS								64
#define MAX_RECORDS								65536
#define MAX_PENDING_REPLIES				64
#define MAX_DISCOVERY_PORTS				8
#define MAX_HEADER_SIZE						65536
#define MAX_BODY_SIZE							1048576
#define MAX_WRITE_SIZE						65536
#define DISCOVERY_REQUEST					"alpacadiscovery1"
#define IMAGEBYTES_HEADER_SIZE		44
#define MANUAL_CLOCK_UTC					1767225600.0

typedef struct {
	bool headless;
	bool trace;
	const char *ready_file;
	const char *event_file;
	const char *bind_address;
	int port;
	bool discovery;
	int discovery_port;
	const char *discovery_bind;
	bool real_clock;
	double tick_per_request;
	char server_name[ALPACA_TEXT_SIZE];
	char manufacturer[ALPACA_TEXT_SIZE];
	char manufacturer_version[ALPACA_TEXT_SIZE];
	char location[ALPACA_TEXT_SIZE];
	char uid_prefix[16];
	bool legacy_interface;
	double connect_delay;
	bool default_devices;
	bool parent_watch;
	bool error_value;						// an error reply of a GET carries Value as well, as the ASCOM .NET servers do
	bool any_content_type;			// a PUT of the device API is taken whatever its Content-Type is
} simulator_options;

typedef enum {
	FAULT_NONE = 0,
	FAULT_HTTP_STATUS,
	FAULT_ASCOM_ERROR,
	FAULT_MALFORMED_JSON,
	FAULT_TRUNCATED_JSON,
	FAULT_MISSING_VALUE,
	FAULT_NULL_VALUE,
	FAULT_WRONG_TRANSACTION_ID,
	FAULT_MISSING_TRANSACTION_ID,
	FAULT_CHUNKED,
	FAULT_CONNECTION_CLOSE,
	FAULT_SILENT_CLOSE,
	FAULT_STALL_BEFORE,
	FAULT_STALL_WITHIN,
	FAULT_TRUNCATED_BODY,
	FAULT_DROP,
	FAULT_RESET,
	FAULT_IMAGEBYTES_VERSION,
	FAULT_IMAGEBYTES_DATASTART,
	FAULT_IMAGEBYTES_TYPE,
	FAULT_IMAGEBYTES_RANK,
	FAULT_IMAGEBYTES_DIMENSIONS,
	FAULT_IMAGEBYTES_SHORT,
	FAULT_IMAGEBYTES_ERROR,
	FAULT_IMAGEBYTES_JSON,
	FAULT_ACTION_COUNT
} fault_action;

typedef struct {
	int id;
	char method[8];
	char path[256];
	fault_action action;
	int skip;
	int count;
	int hits;
	bool has_value;
	int value;
	int delay;
	int bytes;
	bool dispatch;
	char message[ALPACA_TEXT_SIZE];
} fault_rule;

typedef struct {
	int sequence;
	double real_time;
	double simulated_time;
	int connection;
	char method[16];
	char *path;
	char *query;
	char *body;
	char accept[ALPACA_TEXT_SIZE];
	char content_type[ALPACA_TEXT_SIZE];
	char connection_header[64];
	char host[ALPACA_TEXT_SIZE];
	char user_agent[ALPACA_TEXT_SIZE];
	long content_length;
	int status;
	int error_number;
	char fault[32];
} recorded_request;

typedef struct {
	char method[16];
	char *path;
	char *query;
	char *body;
	size_t body_length;
	long content_length;
	char accept[ALPACA_TEXT_SIZE];
	char content_type[ALPACA_TEXT_SIZE];
	char connection_header[64];
	char host[ALPACA_TEXT_SIZE];
	char user_agent[ALPACA_TEXT_SIZE];
	bool keep_alive;
	int connection;
	bool has_fault;
	fault_rule fault;
	int status;
	const char *response_type;
	alpaca_buffer response;
	int error_number;
	bool shutdown;
} http_exchange;

typedef struct {
	int fd;
	int id;
	pthread_t thread;
	bool active;
	bool finished;
} http_connection;

typedef enum {
	DISCOVERY_NORMAL = 0,
	DISCOVERY_SILENT,
	DISCOVERY_MALFORMED
} discovery_mode;

typedef struct {
	discovery_mode mode;
	int copies;
	int delay;
	int count;
	int alpaca_ports[MAX_DISCOVERY_PORTS];
	int alpaca_port_count;
	char reply[256];
	long requests;
	long replies;
} discovery_state;

typedef struct {
	double due;
	struct sockaddr_in address;
	char payload[256];
	size_t length;
} pending_reply;

static simulator_options options = {
	.bind_address = "127.0.0.1",
	.discovery_bind = "0.0.0.0",
	.server_name = "INDIGO Alpaca Simulator",
	.manufacturer = "The INDIGO Initiative Test Suite",
	.manufacturer_version = SIMULATOR_VERSION,
	.location = "Test bench",
	.uid_prefix = "a1baca00",
	.default_devices = true,
	.parent_watch = true
};

static const alpaca_type *alpaca_types[] = {
	&alpaca_camera_type,
	&alpaca_covercalibrator_type,
	&alpaca_dome_type,
	&alpaca_filterwheel_type,
	&alpaca_focuser_type,
	&alpaca_observingconditions_type,
	&alpaca_rotator_type,
	&alpaca_safetymonitor_type,
	&alpaca_switch_type,
	&alpaca_telescope_type
};

#define ALPACA_TYPE_COUNT ((int)(sizeof(alpaca_types) / sizeof(alpaca_types[0])))

static const char *fault_names[FAULT_ACTION_COUNT] = {
	"none",
	"http-status",
	"ascom-error",
	"malformed-json",
	"truncated-json",
	"missing-value",
	"null-value",
	"wrong-transaction-id",
	"missing-transaction-id",
	"chunked",
	"connection-close",
	"silent-close",
	"stall-before",
	"stall-within",
	"truncated-body",
	"drop",
	"reset",
	"imagebytes-version",
	"imagebytes-datastart",
	"imagebytes-type",
	"imagebytes-rank",
	"imagebytes-dimensions",
	"imagebytes-short",
	"imagebytes-error",
	"imagebytes-json"
};

// written by the signal handler, by the main loop and by the connection that serves PUT /simulator/v1/shutdown
static atomic_int running = 1;
static int wake_pipe[2] = { -1, -1 };
static int http_fd = -1;
static int discovery_fd = -1;
static int http_port;
static int discovery_port;
static pthread_mutex_t simulator_lock = PTHREAD_MUTEX_INITIALIZER;
static pthread_mutex_t connection_lock = PTHREAD_MUTEX_INITIALIZER;
static pthread_mutex_t event_lock = PTHREAD_MUTEX_INITIALIZER;
static FILE *events;
static http_connection connections[MAX_CONNECTIONS];
static int connection_sequence;
static alpaca_device *devices[MAX_DEVICES];
static int device_count;
static fault_rule faults[MAX_FAULTS];
static int fault_count;
static int fault_sequence;
static recorded_request *records;
static int record_count;
static int record_sequence;
static unsigned server_transaction_id;
static int64_t clock_microseconds;
static double clock_real_start;
static double utc_base;
static discovery_state discovery = { .copies = 1, .count = -1 };
static pending_reply pending_replies[MAX_PENDING_REPLIES];
static int pending_reply_count;

#pragma mark - time and event log

static double monotonic_time(void) {
	struct timespec now;
	clock_gettime(CLOCK_MONOTONIC, &now);
	return now.tv_sec + now.tv_nsec / 1e9;
}

// The manual clock counts whole microseconds, so the same steps always add up to the same time.
double alpaca_now(void) {
	double now = (double)clock_microseconds / 1e6;
	return options.real_clock ? now + monotonic_time() - clock_real_start : now;
}

bool alpaca_reached(double time) {
	return alpaca_now() + 5e-7 >= time;
}

double alpaca_utc(void) {
	return utc_base + alpaca_now();
}

void alpaca_format_utc(double utc, char *text, size_t size) {
	time_t seconds = (time_t)floor(utc);
	int fraction = (int)((utc - floor(utc)) * 1e7);
	struct tm parts = { 0 };
	gmtime_r(&seconds, &parts);
	snprintf(text, size, "%04d-%02d-%02dT%02d:%02d:%02d.%07dZ", parts.tm_year + 1900, parts.tm_mon + 1, parts.tm_mday, parts.tm_hour, parts.tm_min, parts.tm_sec, fraction);
}

bool alpaca_parse_utc(const char *text, double *utc) {
	struct tm parts = { 0 };
	double seconds = 0;
	int consumed = 0;
	if (sscanf(text, "%d-%d-%dT%d:%d:%lf%n", &parts.tm_year, &parts.tm_mon, &parts.tm_mday, &parts.tm_hour, &parts.tm_min, &seconds, &consumed) != 6) {
		return false;
	}
	if (strcmp(text + consumed, "Z") && text[consumed] != '\0') {
		return false;
	}
	if (parts.tm_mon < 1 || parts.tm_mon > 12 || parts.tm_mday < 1 || parts.tm_mday > 31 || parts.tm_hour < 0 || parts.tm_hour > 23 || parts.tm_min < 0 || parts.tm_min > 59 || seconds < 0 || seconds >= 61) {
		return false;
	}
	parts.tm_year -= 1900;
	parts.tm_mon -= 1;
	*utc = (double)timegm(&parts) + seconds;
	return true;
}

void alpaca_event(const char *kind, const char *format, ...) {
	if (events == NULL && !options.trace) {
		return;
	}
	char text[1024];
	va_list args;
	va_start(args, format);
	vsnprintf(text, sizeof(text), format, args);
	va_end(args);
	pthread_mutex_lock(&event_lock);
	if (events != NULL) {
		fprintf(events, "%.6f %s %s\n", monotonic_time(), kind, text);
		fflush(events);
	}
	if (options.trace) {
		fprintf(stderr, "%s %s\n", kind, text);
	}
	pthread_mutex_unlock(&event_lock);
}

// Sleeps in real time, but returns early (false) when the simulator shuts down.
static bool interruptible_sleep(int milliseconds) {
	double deadline = monotonic_time() + milliseconds / 1000.0;
	while (running) {
		int remaining = (int)ceil((deadline - monotonic_time()) * 1000);
		if (remaining <= 0) {
			return true;
		}
		struct pollfd wake = { .fd = wake_pipe[0], .events = POLLIN };
		if (poll(&wake, 1, remaining) > 0) {
			return false;
		}
	}
	return false;
}

#pragma mark - text helpers

static void buffer_reserve(alpaca_buffer *buffer, size_t extra) {
	if (buffer->length + extra + 1 > buffer->capacity) {
		size_t capacity = buffer->capacity ? buffer->capacity * 2 : 256;
		while (capacity < buffer->length + extra + 1) {
			capacity *= 2;
		}
		char *data = realloc(buffer->data, capacity);
		if (data == NULL) {
			perror("realloc");
			abort();
		}
		buffer->data = data;
		buffer->capacity = capacity;
	}
}

void alpaca_buffer_append(alpaca_buffer *buffer, const void *data, size_t length) {
	buffer_reserve(buffer, length);
	memcpy(buffer->data + buffer->length, data, length);
	buffer->length += length;
	buffer->data[buffer->length] = '\0';
}

void alpaca_buffer_printf(alpaca_buffer *buffer, const char *format, ...) {
	va_list args;
	va_start(args, format);
	int length = vsnprintf(NULL, 0, format, args);
	va_end(args);
	if (length < 0) {
		return;
	}
	buffer_reserve(buffer, (size_t)length);
	va_start(args, format);
	vsnprintf(buffer->data + buffer->length, (size_t)length + 1, format, args);
	va_end(args);
	buffer->length += (size_t)length;
}

void alpaca_buffer_json_string(alpaca_buffer *buffer, const char *text) {
	alpaca_buffer_append(buffer, "\"", 1);
	for (const unsigned char *cursor = (const unsigned char *)text; *cursor; cursor++) {
		if (*cursor == '"' || *cursor == '\\') {
			alpaca_buffer_printf(buffer, "\\%c", *cursor);
		} else if (*cursor < 0x20) {
			alpaca_buffer_printf(buffer, "\\u%04x", *cursor);
		} else {
			alpaca_buffer_append(buffer, cursor, 1);
		}
	}
	alpaca_buffer_append(buffer, "\"", 1);
}

static void buffer_url_encoded(alpaca_buffer *buffer, const char *text) {
	for (const unsigned char *cursor = (const unsigned char *)text; *cursor; cursor++) {
		if (isalnum(*cursor) || *cursor == '-' || *cursor == '_' || *cursor == '.' || *cursor == '~' || *cursor == '/' || *cursor == ':' || *cursor == ',') {
			alpaca_buffer_append(buffer, cursor, 1);
		} else {
			alpaca_buffer_printf(buffer, "%%%02X", *cursor);
		}
	}
}

static void buffer_pair(alpaca_buffer *buffer, const char *key, char separator, const char *format, ...) {
	char text[4096];
	va_list args;
	va_start(args, format);
	vsnprintf(text, sizeof(text), format, args);
	va_end(args);
	alpaca_buffer_printf(buffer, "%s=", key);
	buffer_url_encoded(buffer, text);
	alpaca_buffer_append(buffer, &separator, 1);
}

void alpaca_buffer_field(alpaca_buffer *buffer, const char *key, const char *format, ...) {
	char text[4096];
	va_list args;
	va_start(args, format);
	vsnprintf(text, sizeof(text), format, args);
	va_end(args);
	buffer_pair(buffer, key, '\n', "%s", text);
}

static int hex_digit(int c) {
	return isdigit(c) ? c - '0' : tolower(c) - 'a' + 10;
}

static void url_decode(char *text) {
	char *target = text;
	for (char *cursor = text; *cursor; cursor++) {
		if (*cursor == '+') {
			*target++ = ' ';
		} else if (*cursor == '%' && isxdigit((unsigned char)cursor[1]) && isxdigit((unsigned char)cursor[2])) {
			*target++ = (char)(hex_digit((unsigned char)cursor[1]) * 16 + hex_digit((unsigned char)cursor[2]));
			cursor += 2;
		} else {
			*target++ = *cursor;
		}
	}
	*target = '\0';
}

// Splits "a=1&b=2" in place and decodes names and values.
static int parse_params(char *text, alpaca_param *params, int max) {
	int count = 0;
	char *cursor = text;
	while (cursor != NULL && *cursor && count < max) {
		char *next = strchr(cursor, '&');
		if (next != NULL) {
			*next++ = '\0';
		}
		if (*cursor) {
			char *value = strchr(cursor, '=');
			if (value != NULL) {
				*value++ = '\0';
			} else {
				value = cursor + strlen(cursor);
			}
			url_decode(cursor);
			url_decode(value);
			params[count].name = cursor;
			params[count].value = value;
			count++;
		}
		cursor = next;
	}
	return count;
}

static const char *plain_param(const alpaca_param *params, int count, const char *name) {
	for (int i = 0; i < count; i++) {
		if (!strcmp(params[i].name, name)) {
			return params[i].value;
		}
	}
	return NULL;
}

static bool glob_match(const char *pattern, const char *text) {
	if (*pattern == '\0') {
		return *text == '\0';
	}
	if (*pattern == '*') {
		return glob_match(pattern + 1, text) || (*text != '\0' && glob_match(pattern, text + 1));
	}
	return *text != '\0' && (*pattern == '?' || *pattern == *text) && glob_match(pattern + 1, text + 1);
}

static void copy_text(char *target, size_t size, const char *source) {
	snprintf(target, size, "%s", source);
}

static bool matches_lower(const char *name, const char *lower) {
	while (*name && *lower) {
		if (tolower((unsigned char)*name) != *lower) {
			return false;
		}
		name++;
		lower++;
	}
	return *name == '\0' && *lower == '\0';
}

bool alpaca_parse_bool(const char *text, bool *value) {
	if (!strcasecmp(text, "true")) {
		*value = true;
		return true;
	}
	if (!strcasecmp(text, "false")) {
		*value = false;
		return true;
	}
	return false;
}

bool alpaca_parse_int(const char *text, int *value) {
	char *end = NULL;
	if (*text == '\0' || isspace((unsigned char)*text)) {
		return false;
	}
	errno = 0;
	long parsed = strtol(text, &end, 10);
	if (errno != 0 || *end != '\0' || parsed < INT_MIN || parsed > INT_MAX) {
		return false;
	}
	*value = (int)parsed;
	return true;
}

bool alpaca_parse_double(const char *text, double *value) {
	char *end = NULL;
	if (*text == '\0' || isspace((unsigned char)*text) || strpbrk(text, "xXnNiI") != NULL) {
		return false;
	}
	errno = 0;
	double parsed = strtod(text, &end);
	if (errno != 0 || *end != '\0' || !isfinite(parsed)) {
		return false;
	}
	*value = parsed;
	return true;
}

// ClientID and ClientTransactionID: anything that is not an unsigned 32 bit number counts as not supplied.
static unsigned parse_transaction_id(const char *text) {
	char *end = NULL;
	if (text == NULL || !isdigit((unsigned char)*text)) {
		return 0;
	}
	errno = 0;
	unsigned long long parsed = strtoull(text, &end, 10);
	if (errno != 0 || *end != '\0' || parsed > UINT32_MAX) {
		return 0;
	}
	return (unsigned)parsed;
}

#pragma mark - motion

void alpaca_motion_set(alpaca_motion *motion, double position) {
	motion->position = motion->origin = motion->target = position;
	motion->duration = 0;
	motion->moving = false;
}

double alpaca_motion_update(alpaca_motion *motion) {
	if (motion->moving) {
		double fraction = (alpaca_now() - motion->started) / motion->duration;
		if (alpaca_reached(motion->started + motion->duration)) {
			motion->position = motion->target;
			motion->moving = false;
		} else {
			motion->position = motion->origin + (motion->target - motion->origin) * fraction;
		}
	}
	return motion->position;
}

void alpaca_motion_start_timed(alpaca_motion *motion, double target, double duration) {
	alpaca_motion_update(motion);
	motion->origin = motion->position;
	motion->target = target;
	motion->started = alpaca_now();
	motion->duration = duration;
	motion->moving = duration > 0;
	if (!motion->moving) {
		motion->position = target;
	}
}

void alpaca_motion_start(alpaca_motion *motion, double target, double rate) {
	alpaca_motion_update(motion);
	alpaca_motion_start_timed(motion, target, rate > 0 ? fabs(target - motion->position) / rate : 0);
}

void alpaca_motion_stop(alpaca_motion *motion) {
	alpaca_motion_set(motion, alpaca_motion_update(motion));
}

#pragma mark - request parameters and replies

static const char *find_param(alpaca_request *request, const char *name, bool *wrong_case) {
	for (int i = 0; i < request->param_count; i++) {
		if (!strcmp(request->params[i].name, name)) {
			return request->params[i].value;
		}
	}
	for (int i = 0; i < request->param_count; i++) {
		if (!strcasecmp(request->params[i].name, name)) {
			if (request->method == ALPACA_GET) {
				return request->params[i].value;
			}
			*wrong_case = true;
		}
	}
	return NULL;
}

static const char *required_param(alpaca_request *request, const char *name) {
	bool wrong_case = false;
	const char *value = find_param(request, name, &wrong_case);
	if (value == NULL && wrong_case) {
		alpaca_reply_bad_request(request, "Parameter '%s' has wrong casing", name);
	} else if (value == NULL) {
		alpaca_reply_bad_request(request, "Missing parameter '%s'", name);
	}
	return value;
}

bool alpaca_param_string(alpaca_request *request, const char *name, const char **value) {
	*value = required_param(request, name);
	return *value != NULL;
}

bool alpaca_param_bool(alpaca_request *request, const char *name, bool *value) {
	const char *text = required_param(request, name);
	if (text == NULL) {
		return false;
	}
	if (!alpaca_parse_bool(text, value)) {
		alpaca_reply_bad_request(request, "Parameter '%s' is not a boolean: '%s'", name, text);
		return false;
	}
	return true;
}

bool alpaca_param_int(alpaca_request *request, const char *name, int *value) {
	const char *text = required_param(request, name);
	if (text == NULL) {
		return false;
	}
	if (!alpaca_parse_int(text, value)) {
		alpaca_reply_bad_request(request, "Parameter '%s' is not an integer: '%s'", name, text);
		return false;
	}
	return true;
}

bool alpaca_param_double(alpaca_request *request, const char *name, double *value) {
	const char *text = required_param(request, name);
	if (text == NULL) {
		return false;
	}
	if (!alpaca_parse_double(text, value)) {
		alpaca_reply_bad_request(request, "Parameter '%s' is not a number: '%s'", name, text);
		return false;
	}
	return true;
}

void alpaca_reply_void(alpaca_request *request) {
	request->replied = true;
}

void alpaca_reply_bool(alpaca_request *request, bool value) {
	alpaca_buffer_printf(&request->value, "%s", value ? "true" : "false");
	request->replied = true;
}

void alpaca_reply_int(alpaca_request *request, long value) {
	alpaca_buffer_printf(&request->value, "%ld", value);
	request->replied = true;
}

void alpaca_reply_double(alpaca_request *request, double value) {
	alpaca_buffer_printf(&request->value, "%.15g", value);
	request->replied = true;
}

void alpaca_reply_string(alpaca_request *request, const char *value) {
	alpaca_buffer_json_string(&request->value, value);
	request->replied = true;
}

void alpaca_reply_json(alpaca_request *request, const char *format, ...) {
	char text[4096];
	va_list args;
	va_start(args, format);
	vsnprintf(text, sizeof(text), format, args);
	va_end(args);
	alpaca_buffer_append(&request->value, text, strlen(text));
	request->replied = true;
}

void alpaca_reply_image(alpaca_request *request, const alpaca_image *image) {
	free(request->image.pixels);
	request->image = *image;
	request->replied = true;
}

void alpaca_reply_error(alpaca_request *request, int error_number, const char *format, ...) {
	va_list args;
	va_start(args, format);
	vsnprintf(request->error_message, sizeof(request->error_message), format, args);
	va_end(args);
	request->error_number = error_number;
	request->replied = true;
}

void alpaca_reply_bad_request(alpaca_request *request, const char *format, ...) {
	va_list args;
	va_start(args, format);
	vsnprintf(request->status_text, sizeof(request->status_text), format, args);
	va_end(args);
	request->status = 400;
	request->replied = true;
}

static void format_field(alpaca_device *device, const alpaca_member *member, char *text, size_t size) {
	void *field = (char *)device->state + member->offset;
	switch (member->kind) {
		case ALPACA_BOOL:
			snprintf(text, size, "%s", *(bool *)field ? "true" : "false");
			break;
		case ALPACA_INT:
			snprintf(text, size, "%d", *(int *)field);
			break;
		case ALPACA_DOUBLE:
			snprintf(text, size, "%.15g", *(double *)field);
			break;
		case ALPACA_STRING:
			snprintf(text, size, "%s", (char *)field);
			break;
		case ALPACA_MOTION:
			snprintf(text, size, "%.15g", alpaca_motion_update((alpaca_motion *)field));
			break;
		case ALPACA_MOTION_INT:
			snprintf(text, size, "%ld", lround(alpaca_motion_update((alpaca_motion *)field)));
			break;
		default:
			*text = '\0';
			break;
	}
}

// Returns 0 when stored, 1 when the text can not be parsed and 2 when the value is out of the range of the member.
static int store_field(alpaca_device *device, const alpaca_member *member, const char *text, bool check_range) {
	void *field = (char *)device->state + member->offset;
	bool has_range = check_range && member->min != member->max;
	bool flag = false;
	int integer = 0;
	double number = 0;
	switch (member->kind) {
		case ALPACA_BOOL:
			if (!alpaca_parse_bool(text, &flag)) {
				return 1;
			}
			*(bool *)field = flag;
			return 0;
		case ALPACA_INT:
			if (!alpaca_parse_int(text, &integer)) {
				return 1;
			}
			if (has_range && (integer < member->min || integer > member->max)) {
				return 2;
			}
			*(int *)field = integer;
			return 0;
		case ALPACA_DOUBLE:
		case ALPACA_MOTION:
		case ALPACA_MOTION_INT:
			if (!alpaca_parse_double(text, &number)) {
				return 1;
			}
			if (has_range && (number < member->min || number > member->max)) {
				return 2;
			}
			if (member->kind == ALPACA_DOUBLE) {
				*(double *)field = number;
			} else {
				alpaca_motion_set((alpaca_motion *)field, number);
			}
			return 0;
		case ALPACA_STRING:
			snprintf((char *)field, ALPACA_TEXT_SIZE, "%s", text);
			return 0;
		default:
			return 1;
	}
}

void alpaca_reply_member(alpaca_device *device, alpaca_request *request) {
	char text[ALPACA_TEXT_SIZE];
	format_field(device, request->member, text, sizeof(text));
	if (request->member->kind == ALPACA_STRING) {
		alpaca_reply_string(request, text);
	} else {
		alpaca_reply_json(request, "%s", text);
	}
}

bool alpaca_store_member(alpaca_device *device, alpaca_request *request) {
	const char *text = required_param(request, request->member->name);
	if (text == NULL) {
		return false;
	}
	switch (store_field(device, request->member, text, true)) {
		case 0:
			return true;
		case 2:
			alpaca_reply_error(request, ALPACA_ERROR_INVALID_VALUE, "%s=%s is out of range %g..%g", request->member->name, text, request->member->min, request->member->max);
			return false;
		default:
			alpaca_reply_bad_request(request, "Parameter '%s' has an invalid value: '%s'", request->member->name, text);
			return false;
	}
}

#pragma mark - devices

static const alpaca_type *find_type(const char *name, bool lower_case_only) {
	for (int i = 0; i < ALPACA_TYPE_COUNT; i++) {
		if (lower_case_only ? matches_lower(alpaca_types[i]->name, name) : !strcasecmp(alpaca_types[i]->name, name)) {
			return alpaca_types[i];
		}
	}
	return NULL;
}

static int type_index(const alpaca_type *type) {
	for (int i = 0; i < ALPACA_TYPE_COUNT; i++) {
		if (alpaca_types[i] == type) {
			return i;
		}
	}
	return -1;
}

static alpaca_device *find_device(const alpaca_type *type, int number) {
	for (int i = 0; i < device_count; i++) {
		if (devices[i]->type == type && devices[i]->number == number) {
			return devices[i];
		}
	}
	return NULL;
}

static bool is_platform7(const alpaca_device *device) {
	return device->interface_version >= device->type->interface_version;
}

static const alpaca_member *find_field(const alpaca_device *device, const char *name) {
	for (int i = 0; i < device->type->member_count; i++) {
		if (device->type->members[i].kind != ALPACA_NONE && !strcmp(device->type->members[i].name, name)) {
			return device->type->members + i;
		}
	}
	return NULL;
}

// Sets one setting of a device: used by --device, by PUT .../state and by PUT /simulator/v1/devices.
static bool device_set(alpaca_device *device, const char *key, const char *value) {
	bool flag = false;
	int integer = 0;
	double number = 0;
	if (!strcmp(key, "Number") || !strcmp(key, "number")) {
		if (!alpaca_parse_int(value, &integer) || integer < 0) {
			return false;
		}
		device->number = integer;
	} else if (!strcmp(key, "Name") || !strcmp(key, "name")) {
		copy_text(device->name, sizeof(device->name), value);
	} else if (!strcmp(key, "UniqueID") || !strcmp(key, "uid")) {
		copy_text(device->unique_id, sizeof(device->unique_id), value);
	} else if (!strcmp(key, "InterfaceVersion") || !strcmp(key, "interface")) {
		if (!strcasecmp(value, "p7")) {
			device->interface_version = device->type->interface_version;
		} else if (!strcasecmp(value, "legacy")) {
			device->interface_version = device->type->legacy_interface_version;
		} else if (alpaca_parse_int(value, &integer) && integer > 0) {
			device->interface_version = integer;
		} else {
			return false;
		}
	} else if (!strcmp(key, "Description")) {
		copy_text(device->description, sizeof(device->description), value);
	} else if (!strcmp(key, "DriverInfo")) {
		copy_text(device->driver_info, sizeof(device->driver_info), value);
	} else if (!strcmp(key, "DriverVersion")) {
		copy_text(device->driver_version, sizeof(device->driver_version), value);
	} else if (!strcmp(key, "SupportedActions")) {
		copy_text(device->supported_actions, sizeof(device->supported_actions), value);
	} else if (!strcmp(key, "Commands")) {
		if (!alpaca_parse_bool(value, &flag)) {
			return false;
		}
		device->commands = flag;
	} else if (!strcmp(key, "MissingMember")) {
		if (!alpaca_parse_int(value, &integer) || (integer != 400 && integer != 404 && integer != ALPACA_ERROR_NOT_IMPLEMENTED)) {
			return false;
		}
		device->missing_member = integer;
	} else if (!strcmp(key, "Connected")) {
		if (!alpaca_parse_bool(value, &flag)) {
			return false;
		}
		device->connected = flag;
		device->connecting = false;
	} else if (!strcmp(key, "ConnectDelay")) {
		if (!alpaca_parse_double(value, &number) || number < 0) {
			return false;
		}
		device->connect_delay = number;
	} else if (device->type->control != NULL && device->type->control(device, key, value)) {
		return true;
	} else {
		const alpaca_member *member = find_field(device, key);
		return member != NULL && store_field(device, member, value, false) == 0;
	}
	return true;
}

// Applies "key=value,key=value"; a failure names the offending setting in error.
static bool device_configure(alpaca_device *device, const char *settings, char *error, size_t error_size) {
	char text[sizeof(device->options)];
	copy_text(text, sizeof(text), settings);
	char *cursor = text;
	while (cursor != NULL && *cursor) {
		char *next = strchr(cursor, ',');
		if (next != NULL) {
			*next++ = '\0';
		}
		char *value = strchr(cursor, '=');
		if (value == NULL) {
			snprintf(error, error_size, "'%s' is not key=value", cursor);
			return false;
		}
		*value++ = '\0';
		if (!device_set(device, cursor, value)) {
			snprintf(error, error_size, "%s does not accept %s=%s", device->type->name, cursor, value);
			return false;
		}
		cursor = next;
	}
	return true;
}

// Defaults, then the settings the device was created with: this is the state a reset returns to.
static bool device_init(alpaca_device *device, char *error, size_t error_size) {
	const alpaca_type *type = device->type;
	memset(device->state, 0, type->state_size);
	memset(device->overrides, 0, sizeof(device->overrides));
	if (device->number == 0) {
		snprintf(device->name, sizeof(device->name), "%s Simulator", type->name);
	} else {
		snprintf(device->name, sizeof(device->name), "%s Simulator %d", type->name, device->number);
	}
	snprintf(device->unique_id, sizeof(device->unique_id), "%s-%04x-4000-8000-%012x", options.uid_prefix, type_index(type) + 1, (unsigned)device->number);
	snprintf(device->description, sizeof(device->description), "INDIGO Alpaca %s simulator", type->name);
	snprintf(device->driver_info, sizeof(device->driver_info), "system_alpaca_simulator %s device", type->name);
	copy_text(device->driver_version, sizeof(device->driver_version), SIMULATOR_VERSION);
	*device->supported_actions = '\0';
	device->commands = false;
	device->interface_version = options.legacy_interface ? type->legacy_interface_version : type->interface_version;
	device->missing_member = 400;
	device->connected = false;
	device->connecting = false;
	device->connect_delay = options.connect_delay;
	type->reset(device);
	return device_configure(device, device->options, error, error_size);
}

static void device_free(alpaca_device *device) {
	free(device->state);
	free(device);
}

static alpaca_device *device_create(const alpaca_type *type, const char *settings, char *error, size_t error_size) {
	if (device_count == MAX_DEVICES) {
		snprintf(error, error_size, "too many devices");
		return NULL;
	}
	if (strlen(settings) >= sizeof(((alpaca_device *)NULL)->options)) {
		snprintf(error, error_size, "device settings are too long");
		return NULL;
	}
	alpaca_device *device = calloc(1, sizeof(alpaca_device));
	void *state = calloc(1, type->state_size ? type->state_size : 1);
	if (device == NULL || state == NULL) {
		perror("calloc");
		abort();
	}
	device->type = type;
	device->state = state;
	while (find_device(type, device->number) != NULL) {
		device->number++;
	}
	copy_text(device->options, sizeof(device->options), settings);
	int number = device->number;
	if (!device_init(device, error, error_size)) {
		device_free(device);
		return NULL;
	}
	if (device->number != number) {
		// the number is part of the default name and UniqueID, so the defaults are built again around it
		if (find_device(type, device->number) != NULL) {
			snprintf(error, error_size, "%s %d already exists", type->name, device->number);
			device_free(device);
			return NULL;
		}
		device_init(device, error, error_size);
	}
	devices[device_count++] = device;
	alpaca_event("STATE", "device %s/%d name='%s' uid=%s interface=%d", type->name, device->number, device->name, device->unique_id, device->interface_version);
	return device;
}

static void device_update(alpaca_device *device) {
	if (device->connecting && alpaca_reached(device->connect_deadline)) {
		device->connecting = false;
		device->connected = device->connect_target;
		alpaca_event("STATE", "%s/%d connected=%d", device->type->name, device->number, device->connected);
	}
	if (device->type->update != NULL) {
		device->type->update(device);
	}
}

#pragma mark - common members

static void common_get_connected(alpaca_device *device, alpaca_request *request) {
	alpaca_reply_bool(request, device->connected);
}

static void common_put_connected(alpaca_device *device, alpaca_request *request) {
	bool connected = false;
	if (!alpaca_param_bool(request, "Connected", &connected)) {
		return;
	}
	device->connected = connected;
	device->connecting = false;
	alpaca_event("STATE", "%s/%d connected=%d", device->type->name, device->number, device->connected);
	alpaca_reply_void(request);
}

static void common_start_connection(alpaca_device *device, alpaca_request *request, bool target) {
	if (device->connect_delay > 0 && device->connected != target) {
		device->connecting = true;
		device->connect_target = target;
		device->connect_deadline = alpaca_now() + device->connect_delay;
	} else {
		device->connecting = false;
		device->connected = target;
	}
	alpaca_event("STATE", "%s/%d connecting=%d connected=%d", device->type->name, device->number, device->connecting, device->connected);
	alpaca_reply_void(request);
}

static void common_put_connect(alpaca_device *device, alpaca_request *request) {
	common_start_connection(device, request, true);
}

static void common_put_disconnect(alpaca_device *device, alpaca_request *request) {
	common_start_connection(device, request, false);
}

static void common_get_connecting(alpaca_device *device, alpaca_request *request) {
	alpaca_reply_bool(request, device->connecting);
}

static void common_get_description(alpaca_device *device, alpaca_request *request) {
	alpaca_reply_string(request, device->description);
}

static void common_get_driverinfo(alpaca_device *device, alpaca_request *request) {
	alpaca_reply_string(request, device->driver_info);
}

static void common_get_driverversion(alpaca_device *device, alpaca_request *request) {
	alpaca_reply_string(request, device->driver_version);
}

static void common_get_interfaceversion(alpaca_device *device, alpaca_request *request) {
	alpaca_reply_int(request, device->interface_version);
}

static void common_get_name(alpaca_device *device, alpaca_request *request) {
	alpaca_reply_string(request, device->name);
}

static bool has_action(const alpaca_device *device, const char *action) {
	size_t length = strlen(action);
	const char *cursor = device->supported_actions;
	while (length > 0 && *cursor) {
		size_t item = strcspn(cursor, ",");
		if (item == length && !strncasecmp(cursor, action, length)) {
			return true;
		}
		cursor += item;
		cursor += *cursor == ',';
	}
	return false;
}

static void common_get_supportedactions(alpaca_device *device, alpaca_request *request) {
	const char *cursor = device->supported_actions;
	alpaca_buffer_append(&request->value, "[", 1);
	while (*cursor) {
		char item[ALPACA_TEXT_SIZE];
		size_t length = strcspn(cursor, ",");
		snprintf(item, sizeof(item), "%.*s", (int)length, cursor);
		if (request->value.length > 1) {
			alpaca_buffer_append(&request->value, ",", 1);
		}
		alpaca_buffer_json_string(&request->value, item);
		cursor += length;
		cursor += *cursor == ',';
	}
	alpaca_buffer_append(&request->value, "]", 1);
	alpaca_reply_void(request);
}

static void common_put_action(alpaca_device *device, alpaca_request *request) {
	const char *action = NULL;
	const char *parameters = NULL;
	char result[ALPACA_TEXT_SIZE];
	if (!alpaca_param_string(request, "Action", &action) || !alpaca_param_string(request, "Parameters", &parameters)) {
		return;
	}
	if (!has_action(device, action)) {
		alpaca_reply_error(request, ALPACA_ERROR_ACTION_NOT_IMPLEMENTED, "Action '%s' is not implemented", action);
		return;
	}
	snprintf(result, sizeof(result), "%s(%s)", action, parameters);
	alpaca_reply_string(request, result);
}

static bool common_command(alpaca_device *device, alpaca_request *request, const char **command) {
	bool raw = false;
	if (!alpaca_param_string(request, "Command", command) || !alpaca_param_bool(request, "Raw", &raw)) {
		return false;
	}
	if (!device->commands) {
		alpaca_reply_error(request, ALPACA_ERROR_NOT_IMPLEMENTED, "%s is not implemented", request->member->name);
		return false;
	}
	return true;
}

static void common_put_commandblind(alpaca_device *device, alpaca_request *request) {
	const char *command = NULL;
	if (common_command(device, request, &command)) {
		alpaca_reply_void(request);
	}
}

static void common_put_commandbool(alpaca_device *device, alpaca_request *request) {
	const char *command = NULL;
	if (common_command(device, request, &command)) {
		alpaca_reply_bool(request, *command != '\0');
	}
}

static void common_put_commandstring(alpaca_device *device, alpaca_request *request) {
	const char *command = NULL;
	if (common_command(device, request, &command)) {
		alpaca_reply_string(request, command);
	}
}

static void common_get_devicestate(alpaca_device *device, alpaca_request *request);

// since = -1 marks the Platform 7 members, which exist from the Platform 7 interface version of each type
static const alpaca_member common_members[] = {
	{ .name = "Action", .put = common_put_action },
	{ .name = "CommandBlind", .put = common_put_commandblind },
	{ .name = "CommandBool", .put = common_put_commandbool },
	{ .name = "CommandString", .put = common_put_commandstring },
	{ .name = "Connect", .flags = ALPACA_OFFLINE, .since = -1, .put = common_put_connect },
	{ .name = "Connected", .flags = ALPACA_OFFLINE, .get = common_get_connected, .put = common_put_connected },
	{ .name = "Connecting", .flags = ALPACA_OFFLINE, .since = -1, .get = common_get_connecting },
	{ .name = "Description", .flags = ALPACA_OFFLINE, .get = common_get_description },
	{ .name = "DeviceState", .since = -1, .get = common_get_devicestate },
	{ .name = "Disconnect", .flags = ALPACA_OFFLINE, .since = -1, .put = common_put_disconnect },
	{ .name = "DriverInfo", .flags = ALPACA_OFFLINE, .get = common_get_driverinfo },
	{ .name = "DriverVersion", .flags = ALPACA_OFFLINE, .get = common_get_driverversion },
	{ .name = "InterfaceVersion", .flags = ALPACA_OFFLINE, .get = common_get_interfaceversion },
	{ .name = "Name", .flags = ALPACA_OFFLINE, .get = common_get_name },
	{ .name = "SupportedActions", .flags = ALPACA_OFFLINE, .get = common_get_supportedactions }
};

#define COMMON_MEMBER_COUNT ((int)(sizeof(common_members) / sizeof(common_members[0])))

static bool member_available(const alpaca_device *device, const alpaca_member *member) {
	if (member->flags & ALPACA_CONFIG) {
		return false;
	}
	return member->since < 0 ? is_platform7(device) : device->interface_version >= member->since;
}

static const alpaca_member *find_member(const alpaca_device *device, const char *element) {
	for (int i = 0; i < COMMON_MEMBER_COUNT; i++) {
		if (matches_lower(common_members[i].name, element)) {
			return member_available(device, common_members + i) ? common_members + i : NULL;
		}
	}
	for (int i = 0; i < device->type->member_count; i++) {
		if (matches_lower(device->type->members[i].name, element)) {
			return member_available(device, device->type->members + i) ? device->type->members + i : NULL;
		}
	}
	return NULL;
}

// The error armed for a member through PUT /simulator/v1/<type>/<n>/error, if any.
static alpaca_override *find_override(alpaca_device *device, const alpaca_member *member) {
	for (int i = 0; i < ALPACA_MAX_OVERRIDES; i++) {
		if (device->overrides[i].count != 0 && matches_lower(member->name, device->overrides[i].member)) {
			return device->overrides + i;
		}
	}
	return NULL;
}

static void call_getter(alpaca_device *device, alpaca_request *request) {
	if (request->member->get != NULL) {
		request->member->get(device, request);
	} else {
		alpaca_reply_member(device, request);
	}
}

// DeviceState is built from the getters of the ALPACA_STATE members, so it can never disagree with them.
static void common_get_devicestate(alpaca_device *device, alpaca_request *request) {
	char timestamp[64];
	bool first = true;
	alpaca_buffer_append(&request->value, "[", 1);
	for (int i = 0; i < device->type->member_count; i++) {
		const alpaca_member *member = device->type->members + i;
		if ((member->flags & ALPACA_STATE) && member_available(device, member) && find_override(device, member) == NULL) {
			alpaca_request probe = { .method = ALPACA_GET, .member = member, .status = 200 };
			call_getter(device, &probe);
			if (probe.status == 200 && probe.error_number == 0 && probe.value.length > 0) {
				alpaca_buffer_printf(&request->value, "%s{\"Name\":\"%s\",\"Value\":%s}", first ? "" : ",", member->name, probe.value.data);
				first = false;
			}
			free(probe.value.data);
		}
	}
	if (device->type->device_state != NULL) {
		device->type->device_state(device, &request->value, &first);
	}
	alpaca_format_utc(alpaca_utc(), timestamp, sizeof(timestamp));
	alpaca_buffer_printf(&request->value, "%s{\"Name\":\"TimeStamp\",\"Value\":\"%s\"}]", first ? "" : ",", timestamp);
	alpaca_reply_void(request);
}

#pragma mark - faults

static bool match_fault(const char *method, const char *path, fault_rule *fault) {
	for (int i = 0; i < fault_count; i++) {
		fault_rule *rule = faults + i;
		if (rule->count == 0 || (strcmp(rule->method, "*") && strcmp(rule->method, method)) || !glob_match(rule->path, path)) {
			continue;
		}
		if (rule->skip > 0) {
			rule->skip--;
			continue;
		}
		rule->hits++;
		if (rule->count > 0) {
			rule->count--;
		}
		*fault = *rule;
		return true;
	}
	return false;
}

static bool has_fault(const http_exchange *exchange, fault_action action) {
	return exchange->has_fault && exchange->fault.action == action;
}

#pragma mark - responses

static void respond_text(http_exchange *exchange, int status, const char *format, ...) {
	char text[1024];
	va_list args;
	va_start(args, format);
	vsnprintf(text, sizeof(text), format, args);
	va_end(args);
	exchange->status = status;
	exchange->response_type = "text/plain; charset=utf-8";
	exchange->response.length = 0;
	alpaca_buffer_append(&exchange->response, text, strlen(text));
}

static void append_transaction_ids(http_exchange *exchange, unsigned client_transaction_id, unsigned transaction_id) {
	if (has_fault(exchange, FAULT_WRONG_TRANSACTION_ID)) {
		client_transaction_id = exchange->fault.has_value ? (unsigned)exchange->fault.value : client_transaction_id + 1000;
	}
	if (has_fault(exchange, FAULT_MISSING_TRANSACTION_ID)) {
		// a server that does not implement the echo at all
		alpaca_buffer_printf(&exchange->response, "\"ServerTransactionID\":%u", transaction_id);
		return;
	}
	alpaca_buffer_printf(&exchange->response, "\"ClientTransactionID\":%u,\"ServerTransactionID\":%u", client_transaction_id, transaction_id);
}

// The value the ASCOM .NET servers put next to a non-zero ErrorNumber: the default of the type of the member.
static void append_error_value(alpaca_buffer *buffer, const alpaca_member *member) {
	switch (member != NULL ? member->kind : ALPACA_NONE) {
		case ALPACA_BOOL:
			alpaca_buffer_printf(buffer, "\"Value\":false,");
			break;
		case ALPACA_STRING:
			alpaca_buffer_printf(buffer, "\"Value\":\"\",");
			break;
		default:
			alpaca_buffer_printf(buffer, "\"Value\":0,");
			break;
	}
}

static void append_element(alpaca_buffer *buffer, int element_type, int32_t value) {
	unsigned char bytes[8] = { 0 };
	uint64_t bits = (uint64_t)(int64_t)value;
	size_t size = 4;
	float single = (float)value;
	double real = (double)value;
	uint32_t single_bits = 0;
	switch (element_type) {
		case ALPACA_ELEMENT_BYTE:
			size = 1;
			break;
		case ALPACA_ELEMENT_INT16:
		case ALPACA_ELEMENT_UINT16:
			size = 2;
			break;
		case ALPACA_ELEMENT_INT64:
		case ALPACA_ELEMENT_UINT64:
			size = 8;
			break;
		case ALPACA_ELEMENT_SINGLE:
			memcpy(&single_bits, &single, sizeof(single_bits));
			bits = single_bits;
			break;
		case ALPACA_ELEMENT_DOUBLE:
			memcpy(&bits, &real, sizeof(bits));
			size = 8;
			break;
		default:
			break;
	}
	for (size_t i = 0; i < size; i++) {
		bytes[i] = (unsigned char)(bits >> (8 * i));
	}
	alpaca_buffer_append(buffer, bytes, size);
}

static void append_int32(alpaca_buffer *buffer, int32_t value) {
	append_element(buffer, ALPACA_ELEMENT_INT32, value);
}

// ImageBytes: 44 byte little-endian header, then the pixels or, on error, the UTF-8 message.
static void respond_imagebytes(http_exchange *exchange, alpaca_request *request, unsigned client_transaction_id, unsigned transaction_id) {
	const alpaca_image *image = &request->image;
	const fault_rule *fault = &exchange->fault;
	int error_number = request->error_number;
	const char *error_message = request->error_message;
	int version = 1;
	int data_start = IMAGEBYTES_HEADER_SIZE;
	int transmission_type = image->transmission_type;
	int rank = image->planes > 1 ? 3 : 2;
	int width = image->width;
	size_t count = (size_t)image->width * (size_t)image->height * (size_t)(image->planes > 1 ? image->planes : 1);
	if (has_fault(exchange, FAULT_IMAGEBYTES_ERROR)) {
		error_number = fault->has_value ? fault->value : ALPACA_ERROR_INVALID_OPERATION;
		error_message = *fault->message ? fault->message : "Injected ImageBytes error";
	} else if (has_fault(exchange, FAULT_IMAGEBYTES_VERSION)) {
		version = fault->has_value ? fault->value : 2;
	} else if (has_fault(exchange, FAULT_IMAGEBYTES_DATASTART)) {
		data_start = fault->has_value ? fault->value : 8;
	} else if (has_fault(exchange, FAULT_IMAGEBYTES_TYPE)) {
		transmission_type = fault->has_value ? fault->value : 99;
	} else if (has_fault(exchange, FAULT_IMAGEBYTES_RANK)) {
		rank = fault->has_value ? fault->value : 5;
	} else if (has_fault(exchange, FAULT_IMAGEBYTES_DIMENSIONS)) {
		width += fault->has_value ? fault->value : 1;
	} else if (has_fault(exchange, FAULT_IMAGEBYTES_SHORT)) {
		count /= 2;
	}
	if (has_fault(exchange, FAULT_WRONG_TRANSACTION_ID)) {
		client_transaction_id = fault->has_value ? (unsigned)fault->value : client_transaction_id + 1000;
	}
	exchange->status = 200;
	exchange->response_type = "application/imagebytes";
	exchange->error_number = error_number;
	append_int32(&exchange->response, version);
	append_int32(&exchange->response, error_number);
	append_int32(&exchange->response, (int32_t)client_transaction_id);
	append_int32(&exchange->response, (int32_t)transaction_id);
	append_int32(&exchange->response, data_start);
	if (error_number != 0 || image->pixels == NULL) {
		for (int i = 0; i < 6; i++) {
			append_int32(&exchange->response, 0);
		}
	} else {
		append_int32(&exchange->response, image->element_type);
		append_int32(&exchange->response, transmission_type);
		append_int32(&exchange->response, rank);
		append_int32(&exchange->response, width);
		append_int32(&exchange->response, image->height);
		append_int32(&exchange->response, image->planes > 1 ? image->planes : 0);
	}
	for (int i = IMAGEBYTES_HEADER_SIZE; i < data_start; i++) {
		alpaca_buffer_append(&exchange->response, "", 1);
	}
	if (error_number != 0 || image->pixels == NULL) {
		alpaca_buffer_append(&exchange->response, error_message, strlen(error_message));
		return;
	}
	buffer_reserve(&exchange->response, count * 8);
	for (size_t i = 0; i < count; i++) {
		append_element(&exchange->response, image->transmission_type, image->pixels[i]);
	}
}

static void append_json_image(alpaca_buffer *buffer, const alpaca_image *image) {
	char text[16];
	const int32_t *pixel = image->pixels;
	const char *suffix = image->element_type == ALPACA_ELEMENT_DOUBLE ? ".0" : "";
	int planes = image->planes > 1 ? image->planes : 1;
	buffer_reserve(buffer, (size_t)image->width * (size_t)image->height * (size_t)planes * 8);
	alpaca_buffer_append(buffer, "[", 1);
	for (int x = 0; x < image->width; x++) {
		alpaca_buffer_append(buffer, x ? ",[" : "[", x ? 2 : 1);
		for (int y = 0; y < image->height; y++) {
			if (y) {
				alpaca_buffer_append(buffer, ",", 1);
			}
			if (image->planes > 1) {
				alpaca_buffer_append(buffer, "[", 1);
			}
			for (int plane = 0; plane < planes; plane++) {
				int length = snprintf(text, sizeof(text), "%s%d%s", plane ? "," : "", (int)*pixel++, suffix);
				alpaca_buffer_append(buffer, text, (size_t)length);
			}
			if (image->planes > 1) {
				alpaca_buffer_append(buffer, "]", 1);
			}
		}
		alpaca_buffer_append(buffer, "]", 1);
	}
	alpaca_buffer_append(buffer, "]", 1);
}

static void respond_alpaca(http_exchange *exchange, alpaca_request *request, unsigned client_transaction_id) {
	if (request->status != 200) {
		respond_text(exchange, request->status, "%s", request->status_text);
		return;
	}
	unsigned transaction_id = ++server_transaction_id;
	bool image_member = request->member != NULL && (request->member->flags & ALPACA_IMAGE);
	bool has_image = request->image.pixels != NULL && request->error_number == 0;
	if (image_member && request->accepts_imagebytes && !has_fault(exchange, FAULT_IMAGEBYTES_JSON)) {
		respond_imagebytes(exchange, request, client_transaction_id, transaction_id);
		return;
	}
	exchange->status = 200;
	exchange->response_type = "application/json; charset=utf-8";
	exchange->error_number = request->error_number;
	alpaca_buffer_append(&exchange->response, "{", 1);
	if (has_image) {
		alpaca_buffer_printf(&exchange->response, "\"Type\":%d,\"Rank\":%d,", request->image.element_type, request->image.planes > 1 ? 3 : 2);
	}
	if (has_fault(exchange, FAULT_NULL_VALUE)) {
		alpaca_buffer_printf(&exchange->response, "\"Value\":null,");
	} else if (request->error_number != 0 && options.error_value && request->method == ALPACA_GET && !has_fault(exchange, FAULT_MISSING_VALUE)) {
		append_error_value(&exchange->response, request->member);
	} else if (request->error_number == 0 && !has_fault(exchange, FAULT_MISSING_VALUE)) {
		if (has_image) {
			alpaca_buffer_printf(&exchange->response, "\"Value\":");
			append_json_image(&exchange->response, &request->image);
			alpaca_buffer_append(&exchange->response, ",", 1);
		} else if (request->value.length > 0) {
			alpaca_buffer_printf(&exchange->response, "\"Value\":%s,", request->value.data);
		}
	}
	append_transaction_ids(exchange, client_transaction_id, transaction_id);
	alpaca_buffer_printf(&exchange->response, ",\"ErrorNumber\":%d,\"ErrorMessage\":", request->error_number);
	alpaca_buffer_json_string(&exchange->response, request->error_number ? request->error_message : "");
	alpaca_buffer_append(&exchange->response, "}", 1);
}

#pragma mark - device API

static void dispatch_member(alpaca_device *device, alpaca_request *request) {
	const alpaca_member *member = request->member;
	alpaca_override *override = find_override(device, member);
	if (override != NULL) {
		if (override->count > 0) {
			override->count--;
		}
		alpaca_reply_error(request, override->error_number, "%s", override->error_message);
		return;
	}
	if (!device->connected && !(member->flags & ALPACA_OFFLINE)) {
		alpaca_reply_error(request, ALPACA_ERROR_NOT_CONNECTED, "%s is not connected", device->name);
		return;
	}
	if (request->method == ALPACA_GET) {
		call_getter(device, request);
	} else if (member->put != NULL) {
		member->put(device, request);
	} else if (alpaca_store_member(device, request)) {
		alpaca_reply_void(request);
	}
	if (!request->replied) {
		alpaca_reply_error(request, ALPACA_ERROR_UNSPECIFIED, "%s did not answer", member->name);
	}
}

// rest is "<type>/<number>/<member>" of /api/v1/<type>/<number>/<member>
static void handle_device_api(http_exchange *exchange, char *rest) {
	alpaca_request request = { .status = 200 };
	char *number_text = strchr(rest, '/');
	char *member_text = number_text ? strchr(number_text + 1, '/') : NULL;
	int number = 0;
	if (number_text == NULL || member_text == NULL || strchr(member_text + 1, '/') != NULL) {
		respond_text(exchange, 400, "Bad path, expected /api/v1/{device_type}/{device_number}/{member}");
		return;
	}
	*number_text++ = '\0';
	*member_text++ = '\0';
	const alpaca_type *type = find_type(rest, true);
	if (type == NULL) {
		respond_text(exchange, 400, "Unknown device type '%s'", rest);
		return;
	}
	if (!isdigit((unsigned char)*number_text) || !alpaca_parse_int(number_text, &number)) {
		respond_text(exchange, 400, "Invalid device number '%s'", number_text);
		return;
	}
	alpaca_device *device = find_device(type, number);
	if (device == NULL) {
		respond_text(exchange, 400, "No %s device number %d", type->name, number);
		return;
	}
	if (!strcmp(exchange->method, "GET")) {
		request.method = ALPACA_GET;
		request.param_count = parse_params(exchange->query, request.params, ALPACA_MAX_PARAMS);
	} else if (!strcmp(exchange->method, "PUT")) {
		request.method = ALPACA_PUT;
		request.param_count = parse_params(exchange->body, request.params, ALPACA_MAX_PARAMS);
	} else {
		respond_text(exchange, 400, "Invalid method %s", exchange->method);
		return;
	}
	bool wrong_case = false;
	unsigned client_transaction_id = parse_transaction_id(find_param(&request, "ClientTransactionID", &wrong_case));
	request.accepts_imagebytes = strcasestr(exchange->accept, "application/imagebytes") != NULL;
	request.member = find_member(device, member_text);
	device_update(device);
	if (request.member == NULL && device->missing_member == ALPACA_ERROR_NOT_IMPLEMENTED) {
		alpaca_reply_error(&request, ALPACA_ERROR_NOT_IMPLEMENTED, "%s is not implemented", member_text);
	} else if (request.member == NULL) {
		respond_text(exchange, device->missing_member, "Unknown %s member '%s'", type->name, member_text);
		return;
	} else if (request.method == ALPACA_GET ? request.member->get == NULL && !(request.member->flags & ALPACA_R) : request.member->put == NULL && !(request.member->flags & ALPACA_W)) {
		respond_text(exchange, 400, "Invalid method %s for %s", exchange->method, member_text);
		return;
	} else if (has_fault(exchange, FAULT_ASCOM_ERROR)) {
		alpaca_reply_error(&request, exchange->fault.has_value ? exchange->fault.value : ALPACA_ERROR_UNSPECIFIED, "%s", *exchange->fault.message ? exchange->fault.message : "Injected error");
	} else {
		dispatch_member(device, &request);
	}
	respond_alpaca(exchange, &request, client_transaction_id);
	clock_microseconds += llround(options.tick_per_request * 1e6);
	free(request.value.data);
	free(request.image.pixels);
}

#pragma mark - management API

static void handle_management(http_exchange *exchange) {
	alpaca_request request = { .method = ALPACA_GET, .status = 200 };
	if (strcmp(exchange->method, "GET")) {
		respond_text(exchange, 400, "Invalid method %s", exchange->method);
		return;
	}
	alpaca_buffer value = { 0 };
	if (!strcmp(exchange->path, "/management/apiversions")) {
		alpaca_buffer_printf(&value, "[1]");
	} else if (!strcmp(exchange->path, "/management/v1/description")) {
		alpaca_buffer_printf(&value, "{\"ServerName\":");
		alpaca_buffer_json_string(&value, options.server_name);
		alpaca_buffer_printf(&value, ",\"Manufacturer\":");
		alpaca_buffer_json_string(&value, options.manufacturer);
		alpaca_buffer_printf(&value, ",\"ManufacturerVersion\":");
		alpaca_buffer_json_string(&value, options.manufacturer_version);
		alpaca_buffer_printf(&value, ",\"Location\":");
		alpaca_buffer_json_string(&value, options.location);
		alpaca_buffer_printf(&value, "}");
	} else if (!strcmp(exchange->path, "/management/v1/configureddevices")) {
		alpaca_buffer_printf(&value, "[");
		for (int i = 0; i < device_count; i++) {
			alpaca_buffer_printf(&value, "%s{\"DeviceName\":", i ? "," : "");
			alpaca_buffer_json_string(&value, devices[i]->name);
			alpaca_buffer_printf(&value, ",\"DeviceType\":\"%s\",\"DeviceNumber\":%d,\"UniqueID\":", devices[i]->type->name, devices[i]->number);
			alpaca_buffer_json_string(&value, devices[i]->unique_id);
			alpaca_buffer_printf(&value, "}");
		}
		alpaca_buffer_printf(&value, "]");
	} else {
		respond_text(exchange, 400, "Unknown management path %s", exchange->path);
		return;
	}
	request.param_count = parse_params(exchange->query, request.params, ALPACA_MAX_PARAMS);
	bool wrong_case = false;
	unsigned client_transaction_id = parse_transaction_id(find_param(&request, "ClientTransactionID", &wrong_case));
	exchange->status = 200;
	exchange->response_type = "application/json; charset=utf-8";
	alpaca_buffer_append(&exchange->response, "{", 1);
	if (has_fault(exchange, FAULT_NULL_VALUE)) {
		alpaca_buffer_printf(&exchange->response, "\"Value\":null,");
	} else if (!has_fault(exchange, FAULT_MISSING_VALUE)) {
		alpaca_buffer_printf(&exchange->response, "\"Value\":%s,", value.data);
	}
	append_transaction_ids(exchange, client_transaction_id, ++server_transaction_id);
	alpaca_buffer_append(&exchange->response, "}", 1);
	free(value.data);
}

static void handle_setup(http_exchange *exchange) {
	exchange->status = 200;
	exchange->response_type = "text/html; charset=utf-8";
	alpaca_buffer_printf(&exchange->response, "<html><head><title>%s</title></head><body><h1>%s</h1><p>%s has no settings here, use the control API under /simulator/v1.</p></body></html>", options.server_name, options.server_name, exchange->path);
}

#pragma mark - request recording

static recorded_request *record_request(const http_exchange *exchange) {
	if (records == NULL) {
		records = calloc(MAX_RECORDS, sizeof(recorded_request));
		if (records == NULL) {
			perror("calloc");
			abort();
		}
	}
	if (record_count == MAX_RECORDS) {
		// keep the newer half, the sequence numbers keep counting
		for (int i = 0; i < MAX_RECORDS / 2; i++) {
			free(records[i].path);
			free(records[i].query);
			free(records[i].body);
		}
		memmove(records, records + MAX_RECORDS / 2, (MAX_RECORDS / 2) * sizeof(recorded_request));
		record_count = MAX_RECORDS / 2;
	}
	recorded_request *record = records + record_count++;
	memset(record, 0, sizeof(*record));
	record->sequence = ++record_sequence;
	record->real_time = monotonic_time();
	record->simulated_time = alpaca_now();
	record->connection = exchange->connection;
	copy_text(record->method, sizeof(record->method), exchange->method);
	record->path = strdup(exchange->path);
	record->query = strdup(exchange->query);
	record->body = strdup(exchange->body);
	copy_text(record->accept, sizeof(record->accept), exchange->accept);
	copy_text(record->content_type, sizeof(record->content_type), exchange->content_type);
	copy_text(record->connection_header, sizeof(record->connection_header), exchange->connection_header);
	copy_text(record->host, sizeof(record->host), exchange->host);
	copy_text(record->user_agent, sizeof(record->user_agent), exchange->user_agent);
	record->content_length = exchange->content_length;
	if (record->path == NULL || record->query == NULL || record->body == NULL) {
		perror("strdup");
		abort();
	}
	return record;
}

static void clear_records(void) {
	for (int i = 0; i < record_count; i++) {
		free(records[i].path);
		free(records[i].query);
		free(records[i].body);
	}
	record_count = 0;
}

#pragma mark - control API

static void control_error(http_exchange *exchange, const char *format, ...) {
	char text[1024];
	va_list args;
	va_start(args, format);
	vsnprintf(text, sizeof(text), format, args);
	va_end(args);
	exchange->status = 400;
	exchange->response.length = 0;
	alpaca_buffer_field(&exchange->response, "Error", "%s", text);
}

static void control_ok(http_exchange *exchange) {
	alpaca_buffer_field(&exchange->response, "Result", "OK");
}

static bool control_int(http_exchange *exchange, const alpaca_param *params, int count, const char *name, int *value) {
	const char *text = plain_param(params, count, name);
	if (text != NULL && !alpaca_parse_int(text, value)) {
		control_error(exchange, "%s=%s is not an integer", name, text);
		return false;
	}
	return true;
}

static void control_status(http_exchange *exchange) {
	int active = 0;
	pthread_mutex_lock(&connection_lock);
	for (int i = 0; i < MAX_CONNECTIONS; i++) {
		active += connections[i].active && !connections[i].finished;
	}
	pthread_mutex_unlock(&connection_lock);
	alpaca_buffer_field(&exchange->response, "Simulator", "%s", SIMULATOR_NAME);
	alpaca_buffer_field(&exchange->response, "Version", "%s", SIMULATOR_VERSION);
	alpaca_buffer_field(&exchange->response, "PID", "%ld", (long)getpid());
	alpaca_buffer_field(&exchange->response, "Port", "%d", http_port);
	alpaca_buffer_field(&exchange->response, "DiscoveryPort", "%d", discovery_port);
	alpaca_buffer_field(&exchange->response, "Clock", "%s", options.real_clock ? "real" : "manual");
	alpaca_buffer_field(&exchange->response, "Time", "%.6f", alpaca_now());
	alpaca_buffer_field(&exchange->response, "Devices", "%d", device_count);
	alpaca_buffer_field(&exchange->response, "Requests", "%d", record_sequence);
	alpaca_buffer_field(&exchange->response, "ServerTransactionID", "%u", server_transaction_id);
	alpaca_buffer_field(&exchange->response, "Connections", "%d", active);
	alpaca_buffer_field(&exchange->response, "ConnectionsAccepted", "%d", connection_sequence);
	alpaca_buffer_field(&exchange->response, "Faults", "%d", fault_count);
}

static void set_clock_mode(bool real) {
	clock_microseconds = llround(alpaca_now() * 1e6);
	clock_real_start = monotonic_time();
	options.real_clock = real;
}

static void control_clock(http_exchange *exchange, const alpaca_param *params, int count, bool put) {
	char timestamp[64];
	if (put) {
		const char *mode = plain_param(params, count, "Mode");
		const char *advance = plain_param(params, count, "Advance");
		const char *step = plain_param(params, count, "TickPerRequest");
		const char *utc = plain_param(params, count, "UTC");
		double seconds = 0;
		double tick = options.tick_per_request;
		double base = 0;
		if (mode != NULL && strcmp(mode, "manual") && strcmp(mode, "real")) {
			control_error(exchange, "Mode=%s is not manual or real", mode);
			return;
		}
		if (advance != NULL && (!alpaca_parse_double(advance, &seconds) || seconds < 0)) {
			control_error(exchange, "Advance=%s is not a positive number of seconds", advance);
			return;
		}
		if (step != NULL && (!alpaca_parse_double(step, &tick) || tick < 0)) {
			control_error(exchange, "TickPerRequest=%s is not a positive number of seconds", step);
			return;
		}
		if (utc != NULL && !alpaca_parse_utc(utc, &base)) {
			control_error(exchange, "UTC=%s is not an ISO 8601 date", utc);
			return;
		}
		if (mode != NULL) {
			set_clock_mode(!strcmp(mode, "real"));
		}
		if (utc != NULL) {
			utc_base = base - alpaca_now();
		}
		clock_microseconds += llround(seconds * 1e6);
		options.tick_per_request = tick;
		alpaca_event("CONTROL", "clock mode=%s advance=%.6f time=%.6f tick_per_request=%.6f", options.real_clock ? "real" : "manual", seconds, alpaca_now(), options.tick_per_request);
		for (int i = 0; i < device_count; i++) {
			device_update(devices[i]);
		}
	}
	alpaca_format_utc(alpaca_utc(), timestamp, sizeof(timestamp));
	alpaca_buffer_field(&exchange->response, "Mode", "%s", options.real_clock ? "real" : "manual");
	alpaca_buffer_field(&exchange->response, "Time", "%.6f", alpaca_now());
	alpaca_buffer_field(&exchange->response, "UTC", "%s", timestamp);
	alpaca_buffer_field(&exchange->response, "TickPerRequest", "%.6f", options.tick_per_request);
}

static void reset_discovery(void) {
	long requests = discovery.requests;
	long replies = discovery.replies;
	memset(&discovery, 0, sizeof(discovery));
	discovery.copies = 1;
	discovery.count = -1;
	discovery.requests = requests;
	discovery.replies = replies;
}

static void control_reset(http_exchange *exchange, const alpaca_param *params, int count) {
	char error[256] = { 0 };
	const char *scope = plain_param(params, count, "Scope");
	bool all = scope == NULL || !strcmp(scope, "all");
	if (!all && strcmp(scope, "devices") && strcmp(scope, "faults") && strcmp(scope, "requests") && strcmp(scope, "discovery") && strcmp(scope, "clock")) {
		control_error(exchange, "Scope=%s is not all, devices, faults, requests, discovery or clock", scope);
		return;
	}
	if (all || !strcmp(scope, "clock")) {
		clock_microseconds = 0;
		clock_real_start = monotonic_time();
		utc_base = options.real_clock ? (double)time(NULL) : MANUAL_CLOCK_UTC;
	}
	if (all || !strcmp(scope, "devices")) {
		for (int i = 0; i < device_count; i++) {
			device_init(devices[i], error, sizeof(error));
		}
	}
	if (all || !strcmp(scope, "faults")) {
		fault_count = 0;
	}
	if (all || !strcmp(scope, "requests")) {
		clear_records();
	}
	if (all || !strcmp(scope, "discovery")) {
		reset_discovery();
		pending_reply_count = 0;
	}
	alpaca_event("CONTROL", "reset scope=%s", all ? "all" : scope);
	control_ok(exchange);
}

static void control_requests(http_exchange *exchange, const alpaca_param *params, int count) {
	const char *method = plain_param(params, count, "Method");
	const char *path = plain_param(params, count, "Path");
	int since = 0;
	int limit = INT_MAX;
	if (!control_int(exchange, params, count, "Since", &since) || !control_int(exchange, params, count, "Limit", &limit)) {
		return;
	}
	for (int i = 0; i < record_count && limit > 0; i++) {
		const recorded_request *record = records + i;
		if (record->sequence <= since || (method != NULL && strcmp(method, record->method)) || (path != NULL && !glob_match(path, record->path))) {
			continue;
		}
		alpaca_buffer *line = &exchange->response;
		buffer_pair(line, "Sequence", '&', "%d", record->sequence);
		buffer_pair(line, "Time", '&', "%.6f", record->simulated_time);
		buffer_pair(line, "RealTime", '&', "%.6f", record->real_time);
		buffer_pair(line, "Connection", '&', "%d", record->connection);
		buffer_pair(line, "Method", '&', "%s", record->method);
		buffer_pair(line, "Path", '&', "%s", record->path);
		buffer_pair(line, "Query", '&', "%s", record->query);
		buffer_pair(line, "Body", '&', "%s", record->body);
		buffer_pair(line, "ContentType", '&', "%s", record->content_type);
		buffer_pair(line, "ContentLength", '&', "%ld", record->content_length);
		buffer_pair(line, "Accept", '&', "%s", record->accept);
		buffer_pair(line, "ConnectionHeader", '&', "%s", record->connection_header);
		buffer_pair(line, "Host", '&', "%s", record->host);
		buffer_pair(line, "UserAgent", '&', "%s", record->user_agent);
		buffer_pair(line, "Status", '&', "%d", record->status);
		buffer_pair(line, "ErrorNumber", '&', "%d", record->error_number);
		buffer_pair(line, "Fault", '\n', "%s", record->fault);
		limit--;
	}
}

static void control_list_faults(http_exchange *exchange) {
	for (int i = 0; i < fault_count; i++) {
		const fault_rule *rule = faults + i;
		alpaca_buffer *line = &exchange->response;
		buffer_pair(line, "Id", '&', "%d", rule->id);
		buffer_pair(line, "Method", '&', "%s", rule->method);
		buffer_pair(line, "Path", '&', "%s", rule->path);
		buffer_pair(line, "Action", '&', "%s", fault_names[rule->action]);
		buffer_pair(line, "Skip", '&', "%d", rule->skip);
		buffer_pair(line, "Count", '&', "%d", rule->count);
		buffer_pair(line, "Hits", '&', "%d", rule->hits);
		buffer_pair(line, "Value", '&', "%d", rule->value);
		buffer_pair(line, "Delay", '&', "%d", rule->delay);
		buffer_pair(line, "Bytes", '&', "%d", rule->bytes);
		buffer_pair(line, "Message", '\n', "%s", rule->message);
	}
}

static void control_add_fault(http_exchange *exchange, const alpaca_param *params, int count) {
	fault_rule rule = { .method = "*", .count = 1, .bytes = -1, .dispatch = true };
	const char *method = plain_param(params, count, "Method");
	const char *path = plain_param(params, count, "Path");
	const char *action = plain_param(params, count, "Action");
	const char *message = plain_param(params, count, "Message");
	const char *dispatch = plain_param(params, count, "Dispatch");
	if (path == NULL || action == NULL) {
		control_error(exchange, "Path and Action are required");
		return;
	}
	if (fault_count == MAX_FAULTS) {
		control_error(exchange, "Too many fault rules, clear them first");
		return;
	}
	for (int i = 1; i < FAULT_ACTION_COUNT; i++) {
		if (!strcmp(action, fault_names[i])) {
			rule.action = (fault_action)i;
		}
	}
	if (rule.action == FAULT_NONE) {
		control_error(exchange, "Unknown Action=%s", action);
		return;
	}
	if (method != NULL && strcmp(method, "*") && strcmp(method, "GET") && strcmp(method, "PUT")) {
		control_error(exchange, "Method=%s is not GET, PUT or *", method);
		return;
	}
	rule.has_value = plain_param(params, count, "Value") != NULL;
	rule.dispatch = rule.action != FAULT_HTTP_STATUS && rule.action != FAULT_ASCOM_ERROR;
	if (dispatch != NULL && !alpaca_parse_bool(dispatch, &rule.dispatch)) {
		control_error(exchange, "Dispatch=%s is not a boolean", dispatch);
		return;
	}
	if (!control_int(exchange, params, count, "Skip", &rule.skip) || !control_int(exchange, params, count, "Count", &rule.count) || !control_int(exchange, params, count, "Value", &rule.value) || !control_int(exchange, params, count, "Delay", &rule.delay) || !control_int(exchange, params, count, "Bytes", &rule.bytes)) {
		return;
	}
	if (rule.skip < 0 || rule.delay < 0 || rule.count == 0) {
		control_error(exchange, "Skip and Delay can not be negative and Count can not be 0");
		return;
	}
	if ((rule.action == FAULT_STALL_BEFORE || rule.action == FAULT_STALL_WITHIN) && rule.delay == 0) {
		control_error(exchange, "%s needs Delay in milliseconds", action);
		return;
	}
	if (rule.action == FAULT_HTTP_STATUS && rule.has_value && (rule.value < 100 || rule.value > 599)) {
		control_error(exchange, "Value=%d is not an HTTP status", rule.value);
		return;
	}
	copy_text(rule.method, sizeof(rule.method), method ? method : "*");
	copy_text(rule.path, sizeof(rule.path), path);
	copy_text(rule.message, sizeof(rule.message), message ? message : "");
	rule.id = ++fault_sequence;
	faults[fault_count++] = rule;
	alpaca_event("CONTROL", "fault id=%d method=%s path=%s action=%s skip=%d count=%d value=%d delay=%d bytes=%d", rule.id, rule.method, rule.path, action, rule.skip, rule.count, rule.value, rule.delay, rule.bytes);
	alpaca_buffer_field(&exchange->response, "Id", "%d", rule.id);
}

// AlpacaPort is a list separated by '|': one reply is sent for every port, as if that many servers shared the host.
static bool parse_discovery_ports(const char *text, discovery_state *state) {
	char list[128];
	copy_text(list, sizeof(list), text);
	char *cursor = list;
	while (cursor != NULL && *cursor) {
		char *next = strchr(cursor, '|');
		if (next != NULL) {
			*next++ = '\0';
		}
		if (state->alpaca_port_count == MAX_DISCOVERY_PORTS || !alpaca_parse_int(cursor, state->alpaca_ports + state->alpaca_port_count) || state->alpaca_ports[state->alpaca_port_count] < 0 || state->alpaca_ports[state->alpaca_port_count] > 65535) {
			return false;
		}
		state->alpaca_port_count++;
		cursor = next;
	}
	return true;
}

static void control_discovery(http_exchange *exchange, const alpaca_param *params, int count, bool put) {
	static const char *modes[] = { "normal", "silent", "malformed" };
	alpaca_buffer ports = { 0 };
	if (put) {
		discovery_state next = { .copies = 1, .count = -1, .requests = discovery.requests, .replies = discovery.replies };
		const char *mode = plain_param(params, count, "Mode");
		const char *reply = plain_param(params, count, "Reply");
		const char *port_list = plain_param(params, count, "AlpacaPort");
		if (mode == NULL || !strcmp(mode, "normal")) {
			next.mode = DISCOVERY_NORMAL;
		} else if (!strcmp(mode, "silent")) {
			next.mode = DISCOVERY_SILENT;
		} else if (!strcmp(mode, "malformed")) {
			next.mode = DISCOVERY_MALFORMED;
		} else if (!strcmp(mode, "duplicate")) {
			next.copies = 2;
		} else if (!strcmp(mode, "delayed")) {
			next.delay = 500;
		} else {
			control_error(exchange, "Mode=%s is not normal, silent, malformed, duplicate or delayed", mode);
			return;
		}
		if (!control_int(exchange, params, count, "Copies", &next.copies) || !control_int(exchange, params, count, "Delay", &next.delay) || !control_int(exchange, params, count, "Count", &next.count)) {
			return;
		}
		if (port_list != NULL && !parse_discovery_ports(port_list, &next)) {
			control_error(exchange, "AlpacaPort=%s is not a list of at most %d ports separated by '|'", port_list, MAX_DISCOVERY_PORTS);
			return;
		}
		if (next.copies < 1 || next.copies > 16 || next.delay < 0 || next.count == 0) {
			control_error(exchange, "Copies must be 1..16, Delay can not be negative and Count can not be 0");
			return;
		}
		copy_text(next.reply, sizeof(next.reply), reply ? reply : "");
		discovery = next;
		alpaca_event("CONTROL", "discovery mode=%s copies=%d delay=%d count=%d alpaca_port=%s reply='%s'", modes[discovery.mode], discovery.copies, discovery.delay, discovery.count, port_list ? port_list : "", discovery.reply);
	}
	for (int i = 0; i < discovery.alpaca_port_count; i++) {
		alpaca_buffer_printf(&ports, "%s%d", i ? "|" : "", discovery.alpaca_ports[i]);
	}
	if (discovery.alpaca_port_count == 0) {
		alpaca_buffer_printf(&ports, "%d", http_port);
	}
	alpaca_buffer_field(&exchange->response, "Port", "%d", discovery_port);
	alpaca_buffer_field(&exchange->response, "Mode", "%s", modes[discovery.mode]);
	alpaca_buffer_field(&exchange->response, "Copies", "%d", discovery.copies);
	alpaca_buffer_field(&exchange->response, "Delay", "%d", discovery.delay);
	alpaca_buffer_field(&exchange->response, "Count", "%d", discovery.count);
	alpaca_buffer_field(&exchange->response, "AlpacaPort", "%s", ports.data);
	free(ports.data);
	alpaca_buffer_field(&exchange->response, "Reply", "%s", discovery.reply);
	alpaca_buffer_field(&exchange->response, "Requests", "%ld", discovery.requests);
	alpaca_buffer_field(&exchange->response, "Replies", "%ld", discovery.replies);
}

static void control_server(http_exchange *exchange, const alpaca_param *params, int count, bool put) {
	if (put) {
		for (int i = 0; i < count; i++) {
			if (!strcmp(params[i].name, "ServerName")) {
				copy_text(options.server_name, sizeof(options.server_name), params[i].value);
			} else if (!strcmp(params[i].name, "Manufacturer")) {
				copy_text(options.manufacturer, sizeof(options.manufacturer), params[i].value);
			} else if (!strcmp(params[i].name, "ManufacturerVersion")) {
				copy_text(options.manufacturer_version, sizeof(options.manufacturer_version), params[i].value);
			} else if (!strcmp(params[i].name, "Location")) {
				copy_text(options.location, sizeof(options.location), params[i].value);
			} else {
				control_error(exchange, "Unknown setting %s", params[i].name);
				return;
			}
		}
		alpaca_event("CONTROL", "server name='%s' manufacturer='%s'", options.server_name, options.manufacturer);
	}
	alpaca_buffer_field(&exchange->response, "ServerName", "%s", options.server_name);
	alpaca_buffer_field(&exchange->response, "Manufacturer", "%s", options.manufacturer);
	alpaca_buffer_field(&exchange->response, "ManufacturerVersion", "%s", options.manufacturer_version);
	alpaca_buffer_field(&exchange->response, "Location", "%s", options.location);
}

static void control_list_devices(http_exchange *exchange) {
	for (int i = 0; i < device_count; i++) {
		const alpaca_device *device = devices[i];
		alpaca_buffer *line = &exchange->response;
		buffer_pair(line, "Type", '&', "%s", device->type->name);
		buffer_pair(line, "Number", '&', "%d", device->number);
		buffer_pair(line, "Name", '&', "%s", device->name);
		buffer_pair(line, "UniqueID", '&', "%s", device->unique_id);
		buffer_pair(line, "InterfaceVersion", '&', "%d", device->interface_version);
		buffer_pair(line, "Connected", '\n', "%s", device->connected ? "true" : "false");
	}
}

static void control_add_device(http_exchange *exchange, const alpaca_param *params, int count) {
	char settings[1024] = { 0 };
	char error[256] = { 0 };
	size_t used = 0;
	const char *type_name = plain_param(params, count, "Type");
	const alpaca_type *type = type_name ? find_type(type_name, false) : NULL;
	if (type == NULL) {
		control_error(exchange, "Type is required and must be an Alpaca device type");
		return;
	}
	for (int i = 0; i < count; i++) {
		if (strcmp(params[i].name, "Type")) {
			int written = snprintf(settings + used, sizeof(settings) - used, "%s%s=%s", used ? "," : "", params[i].name, params[i].value);
			if (written < 0 || (size_t)written >= sizeof(settings) - used || strchr(params[i].value, ',') != NULL) {
				control_error(exchange, "Settings are too long or contain a comma");
				return;
			}
			used += (size_t)written;
		}
	}
	alpaca_device *device = device_create(type, settings, error, sizeof(error));
	if (device == NULL) {
		control_error(exchange, "%s", error);
		return;
	}
	alpaca_buffer_field(&exchange->response, "Type", "%s", device->type->name);
	alpaca_buffer_field(&exchange->response, "Number", "%d", device->number);
	alpaca_buffer_field(&exchange->response, "UniqueID", "%s", device->unique_id);
}

static alpaca_device *control_find_device(http_exchange *exchange, const char *type_name, const char *number_text) {
	int number = 0;
	const alpaca_type *type = type_name ? find_type(type_name, false) : NULL;
	if (type == NULL || number_text == NULL || !alpaca_parse_int(number_text, &number) || find_device(type, number) == NULL) {
		control_error(exchange, "No device %s/%s", type_name ? type_name : "?", number_text ? number_text : "?");
		return NULL;
	}
	return find_device(type, number);
}

static void control_remove_device(http_exchange *exchange, const alpaca_param *params, int count) {
	alpaca_device *device = control_find_device(exchange, plain_param(params, count, "Type"), plain_param(params, count, "Number"));
	if (device == NULL) {
		return;
	}
	for (int i = 0; i < device_count; i++) {
		if (devices[i] == device) {
			memmove(devices + i, devices + i + 1, (size_t)(device_count - i - 1) * sizeof(devices[0]));
			device_count--;
			break;
		}
	}
	alpaca_event("CONTROL", "removed %s/%d", device->type->name, device->number);
	device_free(device);
	control_ok(exchange);
}

static void control_report_state(http_exchange *exchange, alpaca_device *device) {
	char text[ALPACA_TEXT_SIZE];
	alpaca_buffer *buffer = &exchange->response;
	alpaca_buffer_field(buffer, "Type", "%s", device->type->name);
	alpaca_buffer_field(buffer, "Number", "%d", device->number);
	alpaca_buffer_field(buffer, "Name", "%s", device->name);
	alpaca_buffer_field(buffer, "UniqueID", "%s", device->unique_id);
	alpaca_buffer_field(buffer, "InterfaceVersion", "%d", device->interface_version);
	alpaca_buffer_field(buffer, "Description", "%s", device->description);
	alpaca_buffer_field(buffer, "DriverInfo", "%s", device->driver_info);
	alpaca_buffer_field(buffer, "DriverVersion", "%s", device->driver_version);
	alpaca_buffer_field(buffer, "SupportedActions", "%s", device->supported_actions);
	alpaca_buffer_field(buffer, "Commands", "%s", device->commands ? "true" : "false");
	alpaca_buffer_field(buffer, "MissingMember", "%d", device->missing_member);
	alpaca_buffer_field(buffer, "Connected", "%s", device->connected ? "true" : "false");
	alpaca_buffer_field(buffer, "Connecting", "%s", device->connecting ? "true" : "false");
	alpaca_buffer_field(buffer, "ConnectDelay", "%.15g", device->connect_delay);
	for (int i = 0; i < device->type->member_count; i++) {
		const alpaca_member *member = device->type->members + i;
		if (member->kind != ALPACA_NONE) {
			format_field(device, member, text, sizeof(text));
			alpaca_buffer_field(buffer, member->name, "%s", text);
		}
	}
	if (device->type->report != NULL) {
		device->type->report(device, buffer);
	}
}

static void control_set_state(http_exchange *exchange, alpaca_device *device, const alpaca_param *params, int count) {
	for (int i = 0; i < count; i++) {
		if (!strcmp(params[i].name, "Number") || !strcmp(params[i].name, "number")) {
			control_error(exchange, "The device number can not be changed");
			return;
		}
		if (!device_set(device, params[i].name, params[i].value)) {
			control_error(exchange, "%s does not accept %s=%s", device->type->name, params[i].name, params[i].value);
			return;
		}
		alpaca_event("CONTROL", "%s/%d %s=%s", device->type->name, device->number, params[i].name, params[i].value);
	}
	device_update(device);
	control_ok(exchange);
}

static void control_set_error(http_exchange *exchange, alpaca_device *device, const alpaca_param *params, int count) {
	const char *member = plain_param(params, count, "Member");
	const char *message = plain_param(params, count, "ErrorMessage");
	int error_number = ALPACA_ERROR_NOT_IMPLEMENTED;
	int repeat = -1;
	alpaca_override *slot = NULL;
	if (member == NULL || strlen(member) >= sizeof(slot->member) || !control_int(exchange, params, count, "ErrorNumber", &error_number) || !control_int(exchange, params, count, "Count", &repeat)) {
		if (exchange->status != 400) {
			control_error(exchange, "Member is required");
		}
		return;
	}
	for (int i = 0; i < ALPACA_MAX_OVERRIDES; i++) {
		if (!strcasecmp(device->overrides[i].member, member)) {
			slot = device->overrides + i;
			break;
		}
		if (slot == NULL && device->overrides[i].count == 0) {
			slot = device->overrides + i;
		}
	}
	if (slot == NULL) {
		control_error(exchange, "Too many member errors on one device");
		return;
	}
	memset(slot, 0, sizeof(*slot));
	if (error_number != 0) {
		copy_text(slot->member, sizeof(slot->member), member);
		for (char *cursor = slot->member; *cursor; cursor++) {
			*cursor = (char)tolower((unsigned char)*cursor);
		}
		copy_text(slot->error_message, sizeof(slot->error_message), message ? message : "Injected error");
		slot->error_number = error_number;
		slot->count = repeat;
	}
	alpaca_event("CONTROL", "%s/%d member=%s error=%d count=%d", device->type->name, device->number, member, error_number, repeat);
	control_ok(exchange);
}

static void control_device(http_exchange *exchange, char *rest, const alpaca_param *params, int count, bool put) {
	char error[256] = { 0 };
	char *number_text = strchr(rest, '/');
	char *action = number_text ? strchr(number_text + 1, '/') : NULL;
	if (action == NULL) {
		control_error(exchange, "Unknown control path %s", exchange->path);
		return;
	}
	*number_text++ = '\0';
	*action++ = '\0';
	alpaca_device *device = control_find_device(exchange, rest, number_text);
	if (device == NULL) {
		return;
	}
	device_update(device);
	if (!strcmp(action, "state") && put) {
		control_set_state(exchange, device, params, count);
	} else if (!strcmp(action, "state")) {
		control_report_state(exchange, device);
	} else if (!strcmp(action, "reset") && put) {
		device_init(device, error, sizeof(error));
		alpaca_event("CONTROL", "reset %s/%d", device->type->name, device->number);
		control_ok(exchange);
	} else if (!strcmp(action, "error") && put) {
		control_set_error(exchange, device, params, count);
	} else {
		control_error(exchange, "Unknown control path %s %s", exchange->method, exchange->path);
	}
}

// path is everything after /simulator/v1/
static void handle_control(http_exchange *exchange) {
	alpaca_param params[ALPACA_MAX_PARAMS];
	char path[256];
	bool put = !strcmp(exchange->method, "PUT");
	exchange->status = 200;
	exchange->response_type = "text/plain; charset=utf-8";
	if (!put && strcmp(exchange->method, "GET")) {
		control_error(exchange, "Invalid method %s", exchange->method);
		return;
	}
	copy_text(path, sizeof(path), strlen(exchange->path) > 14 ? exchange->path + 14 : "");
	int count = parse_params(put ? exchange->body : exchange->query, params, ALPACA_MAX_PARAMS);
	if (!strcmp(path, "status") && !put) {
		control_status(exchange);
	} else if (!strcmp(path, "clock")) {
		control_clock(exchange, params, count, put);
	} else if (!strcmp(path, "reset") && put) {
		control_reset(exchange, params, count);
	} else if (!strcmp(path, "requests") && !put) {
		control_requests(exchange, params, count);
	} else if (!strcmp(path, "requests/clear") && put) {
		clear_records();
		control_ok(exchange);
	} else if (!strcmp(path, "faults") && put) {
		control_add_fault(exchange, params, count);
	} else if (!strcmp(path, "faults")) {
		control_list_faults(exchange);
	} else if (!strcmp(path, "faults/clear") && put) {
		fault_count = 0;
		alpaca_event("CONTROL", "faults cleared");
		control_ok(exchange);
	} else if (!strcmp(path, "discovery")) {
		control_discovery(exchange, params, count, put);
	} else if (!strcmp(path, "server")) {
		control_server(exchange, params, count, put);
	} else if (!strcmp(path, "devices") && put) {
		control_add_device(exchange, params, count);
	} else if (!strcmp(path, "devices")) {
		control_list_devices(exchange);
	} else if (!strcmp(path, "devices/remove") && put) {
		control_remove_device(exchange, params, count);
	} else if (!strcmp(path, "shutdown") && put) {
		exchange->shutdown = true;
		alpaca_event("CONTROL", "shutdown");
		control_ok(exchange);
	} else {
		control_device(exchange, path, params, count, put);
	}
}

#pragma mark - HTTP

static const char *status_reason(int status) {
	switch (status) {
		case 200:
			return "OK";
		case 400:
			return "Bad Request";
		case 401:
			return "Unauthorized";
		case 403:
			return "Forbidden";
		case 404:
			return "Not Found";
		case 411:
			return "Length Required";
		case 413:
			return "Payload Too Large";
		case 431:
			return "Request Header Fields Too Large";
		case 500:
			return "Internal Server Error";
		case 503:
			return "Service Unavailable";
		default:
			return "Status";
	}
}

static void corrupt_json(http_exchange *exchange) {
	if (strncmp(exchange->response_type, "application/json", 16)) {
		return;
	}
	if (has_fault(exchange, FAULT_TRUNCATED_JSON)) {
		exchange->response.length /= 2;
		exchange->response.data[exchange->response.length] = '\0';
	} else if (has_fault(exchange, FAULT_MALFORMED_JSON) && exchange->response.length > 1) {
		alpaca_buffer corrupted = { 0 };
		alpaca_buffer_printf(&corrupted, "{]%s", exchange->response.data + 1);
		free(exchange->response.data);
		exchange->response = corrupted;
	}
}

// The Alpaca API reference requires the parameters of a PUT in a form body, application/x-www-form-urlencoded. A body of another type is
// refused like the ASP.NET servers refuse it; a PUT without a body (a method without parameters, no ClientID) needs no type.
// --any-content-type turns the check off for servers that read any body as a form.
static bool put_content_type_accepted(const http_exchange *exchange) {
	if (strcmp(exchange->method, "PUT") || options.any_content_type || (exchange->body_length == 0 && !*exchange->content_type)) {
		return true;
	}
	size_t length = strcspn(exchange->content_type, "; \t");
	return length == 33 && !strncasecmp(exchange->content_type, "application/x-www-form-urlencoded", length);
}

// Runs with the simulator lock held: turns a parsed request into a response and picks the fault to apply to it.
static void process_exchange(http_exchange *exchange) {
	char path[1024];
	if (!strcmp(exchange->path, "/simulator/v1") || !strncmp(exchange->path, "/simulator/v1/", 14)) {
		handle_control(exchange);
		return;
	}
	recorded_request *record = record_request(exchange);
	alpaca_event("RX", "#%d c%d %s %s%s%s %s", record->sequence, exchange->connection, exchange->method, exchange->path, *exchange->query ? "?" : "", exchange->query, exchange->body);
	exchange->has_fault = match_fault(exchange->method, exchange->path, &exchange->fault);
	if (exchange->has_fault) {
		copy_text(record->fault, sizeof(record->fault), fault_names[exchange->fault.action]);
		alpaca_event("FAULT", "#%d id=%d %s value=%d delay=%d bytes=%d", record->sequence, exchange->fault.id, fault_names[exchange->fault.action], exchange->fault.value, exchange->fault.delay, exchange->fault.bytes);
	}
	copy_text(path, sizeof(path), exchange->path);
	if (has_fault(exchange, FAULT_HTTP_STATUS)) {
		respond_text(exchange, exchange->fault.has_value ? exchange->fault.value : 500, "%s", *exchange->fault.message ? exchange->fault.message : "Injected HTTP error");
	} else if (exchange->has_fault && !exchange->fault.dispatch && exchange->fault.action != FAULT_ASCOM_ERROR) {
		respond_text(exchange, 200, "%s", "");
	} else if (!strncmp(path, "/api/v1/", 8) && !put_content_type_accepted(exchange)) {
		respond_text(exchange, 400, "PUT parameters have to be sent as application/x-www-form-urlencoded, not '%s'", exchange->content_type);
	} else if (!strncmp(path, "/api/v1/", 8)) {
		handle_device_api(exchange, path + 8);
	} else if (!strncmp(path, "/api/", 5) || !strcmp(path, "/api")) {
		respond_text(exchange, 400, "Unknown API version in %s", exchange->path);
	} else if (!strncmp(path, "/management/", 12)) {
		handle_management(exchange);
	} else if (!strcmp(path, "/setup") || !strncmp(path, "/setup/", 7)) {
		handle_setup(exchange);
	} else {
		respond_text(exchange, 404, "Not found: %s", exchange->path);
	}
	corrupt_json(exchange);
	record->status = exchange->status;
	record->error_number = exchange->error_number;
	if (!strncmp(exchange->response_type, "application/imagebytes", 22) || exchange->response.length > 200) {
		alpaca_event("TX", "#%d %d %s %zu bytes", record->sequence, exchange->status, exchange->response_type, exchange->response.length);
	} else {
		alpaca_event("TX", "#%d %d %s", record->sequence, exchange->status, exchange->response.data ? exchange->response.data : "");
	}
}

// Writes in pieces and carries on after a partial write. A loopback socket under load can also refuse a
// write for a moment (ENOBUFS on macOS); that is waited out, it is no reason to cut the body.
static bool send_all(int fd, const char *data, size_t length) {
	while (length > 0) {
		ssize_t written = write(fd, data, length < MAX_WRITE_SIZE ? length : MAX_WRITE_SIZE);
		if (written > 0) {
			data += written;
			length -= (size_t)written;
		} else if (written < 0 && errno == EINTR) {
			continue;
		} else if (written < 0 && (errno == ENOBUFS || errno == EAGAIN || errno == EWOULDBLOCK)) {
			if (!interruptible_sleep(1)) {
				return false;
			}
		} else {
			return false;
		}
	}
	return true;
}

static bool send_chunked(int fd, const char *data, size_t length, size_t chunk_size) {
	char header[32];
	while (length > 0) {
		size_t size = length < chunk_size ? length : chunk_size;
		int header_length = snprintf(header, sizeof(header), "%zx\r\n", size);
		if (!send_all(fd, header, (size_t)header_length) || !send_all(fd, data, size) || !send_all(fd, "\r\n", 2)) {
			return false;
		}
		data += size;
		length -= size;
	}
	return send_all(fd, "0\r\n\r\n", 5);
}

// Sends the response the way the selected fault asks for. Returns false when the connection has to be closed.
static bool send_exchange(int fd, http_exchange *exchange) {
	char header[512];
	const fault_rule *fault = &exchange->fault;
	fault_action action = exchange->has_fault ? fault->action : FAULT_NONE;
	const char *body = exchange->response.data ? exchange->response.data : "";
	size_t body_length = exchange->response.length;
	size_t partial = fault->bytes >= 0 && (size_t)fault->bytes < body_length ? (size_t)fault->bytes : body_length / 2;
	bool keep = exchange->keep_alive && action != FAULT_CONNECTION_CLOSE && action != FAULT_SILENT_CLOSE && !exchange->shutdown;
	bool announce_close = !exchange->keep_alive || action == FAULT_CONNECTION_CLOSE || exchange->shutdown;
	int header_length = snprintf(header, sizeof(header), "HTTP/1.1 %d %s\r\nServer: system_alpaca_simulator/%s\r\nContent-Type: %s\r\n", exchange->status, status_reason(exchange->status), SIMULATOR_VERSION, exchange->response_type);
	if (action == FAULT_CHUNKED) {
		header_length += snprintf(header + header_length, sizeof(header) - (size_t)header_length, "Transfer-Encoding: chunked\r\n");
	} else {
		header_length += snprintf(header + header_length, sizeof(header) - (size_t)header_length, "Content-Length: %zu\r\n", body_length);
	}
	header_length += snprintf(header + header_length, sizeof(header) - (size_t)header_length, "%s\r\n", announce_close ? "Connection: close\r\n" : "");
	switch (action) {
		case FAULT_DROP:
			return false;
		case FAULT_RESET: {
			struct linger linger = { .l_onoff = 1, .l_linger = 0 };
			if (fault->bytes > 0) {
				size_t from_header = (size_t)fault->bytes < (size_t)header_length ? (size_t)fault->bytes : (size_t)header_length;
				size_t from_body = (size_t)fault->bytes - from_header < body_length ? (size_t)fault->bytes - from_header : body_length;
				send_all(fd, header, from_header);
				send_all(fd, body, from_body);
				interruptible_sleep(50);
			}
			setsockopt(fd, SOL_SOCKET, SO_LINGER, &linger, sizeof(linger));
			return false;
		}
		case FAULT_STALL_BEFORE:
			if (!interruptible_sleep(fault->delay)) {
				return false;
			}
			break;
		case FAULT_STALL_WITHIN:
			if (!send_all(fd, header, (size_t)header_length) || !send_all(fd, body, partial) || !interruptible_sleep(fault->delay)) {
				return false;
			}
			return send_all(fd, body + partial, body_length - partial) && keep;
		case FAULT_TRUNCATED_BODY:
			send_all(fd, header, (size_t)header_length);
			send_all(fd, body, partial);
			return false;
		case FAULT_CHUNKED:
			return send_all(fd, header, (size_t)header_length) && send_chunked(fd, body, body_length, fault->bytes > 0 ? (size_t)fault->bytes : 1024) && keep;
		default:
			break;
	}
	return send_all(fd, header, (size_t)header_length) && send_all(fd, body, body_length) && keep;
}

static void send_simple(int fd, int status, const char *text) {
	char response[512];
	int length = snprintf(response, sizeof(response), "HTTP/1.1 %d %s\r\nContent-Type: text/plain; charset=utf-8\r\nContent-Length: %zu\r\nConnection: close\r\n\r\n%s", status, status_reason(status), strlen(text), text);
	send_all(fd, response, (size_t)length);
}

static bool read_more(int fd, alpaca_buffer *input) {
	char chunk[8192];
	for (;;) {
		ssize_t count = read(fd, chunk, sizeof(chunk));
		if (count > 0) {
			alpaca_buffer_append(input, chunk, (size_t)count);
			return true;
		}
		if (count < 0 && errno == EINTR && running) {
			continue;
		}
		return false;
	}
}

static void copy_header(char *target, size_t size, const char *value) {
	while (*value == ' ' || *value == '\t') {
		value++;
	}
	snprintf(target, size, "%s", value);
}

// Reads one request from the connection. Returns false when the connection is finished; *status is then
// either 0 (closed by the client) or the HTTP status to answer with before closing.
static bool read_exchange(int fd, alpaca_buffer *input, http_exchange *exchange, int *status) {
	char *end = NULL;
	char target[2048] = { 0 };
	char version[16] = { 0 };
	char transfer_encoding[64] = { 0 };
	char expect[64] = { 0 };
	*status = 0;
	while (input->data == NULL || (end = strstr(input->data, "\r\n\r\n")) == NULL) {
		if (input->length > MAX_HEADER_SIZE) {
			*status = 431;
			return false;
		}
		if (!read_more(fd, input)) {
			return false;
		}
	}
	size_t header_length = (size_t)(end - input->data) + 4;
	*end = '\0';
	char *line = strstr(input->data, "\r\n");
	if (line != NULL) {
		*line = '\0';
		line += 2;
	}
	if (sscanf(input->data, "%15s %2047s %15s", exchange->method, target, version) != 3 || strncmp(version, "HTTP/1.", 7) || *target != '/') {
		*status = 400;
		return false;
	}
	exchange->keep_alive = strcmp(version, "HTTP/1.0") != 0;
	while (line != NULL && *line) {
		char *next = strstr(line, "\r\n");
		if (next != NULL) {
			*next = '\0';
			next += 2;
		}
		char *value = strchr(line, ':');
		if (value != NULL) {
			*value++ = '\0';
			if (!strcasecmp(line, "Content-Length")) {
				exchange->content_length = strtol(value, NULL, 10);
			} else if (!strcasecmp(line, "Accept")) {
				copy_header(exchange->accept, sizeof(exchange->accept), value);
			} else if (!strcasecmp(line, "Content-Type")) {
				copy_header(exchange->content_type, sizeof(exchange->content_type), value);
			} else if (!strcasecmp(line, "Connection")) {
				copy_header(exchange->connection_header, sizeof(exchange->connection_header), value);
			} else if (!strcasecmp(line, "Host")) {
				copy_header(exchange->host, sizeof(exchange->host), value);
			} else if (!strcasecmp(line, "User-Agent")) {
				copy_header(exchange->user_agent, sizeof(exchange->user_agent), value);
			} else if (!strcasecmp(line, "Transfer-Encoding")) {
				copy_header(transfer_encoding, sizeof(transfer_encoding), value);
			} else if (!strcasecmp(line, "Expect")) {
				copy_header(expect, sizeof(expect), value);
			}
		}
		line = next;
	}
	if (strcasestr(exchange->connection_header, "close") != NULL) {
		exchange->keep_alive = false;
	} else if (strcasestr(exchange->connection_header, "keep-alive") != NULL) {
		exchange->keep_alive = true;
	}
	if (*transfer_encoding && strcasecmp(transfer_encoding, "identity")) {
		*status = 411;
		return false;
	}
	if (exchange->content_length < 0 || exchange->content_length > MAX_BODY_SIZE) {
		*status = 413;
		return false;
	}
	if (strcasestr(expect, "100-continue") != NULL && !send_all(fd, "HTTP/1.1 100 Continue\r\n\r\n", 25)) {
		return false;
	}
	char *query = strchr(target, '?');
	if (query != NULL) {
		*query++ = '\0';
	}
	exchange->path = strdup(target);
	exchange->query = strdup(query ? query : "");
	exchange->body_length = (size_t)exchange->content_length;
	while (input->length < header_length + exchange->body_length) {
		if (!read_more(fd, input)) {
			return false;
		}
	}
	exchange->body = calloc(1, exchange->body_length + 1);
	if (exchange->path == NULL || exchange->query == NULL || exchange->body == NULL) {
		perror("malloc");
		abort();
	}
	memcpy(exchange->body, input->data + header_length, exchange->body_length);
	size_t consumed = header_length + exchange->body_length;
	memmove(input->data, input->data + consumed, input->length - consumed);
	input->length -= consumed;
	input->data[input->length] = '\0';
	return true;
}

static void free_exchange(http_exchange *exchange) {
	free(exchange->path);
	free(exchange->query);
	free(exchange->body);
	free(exchange->response.data);
}

static void request_shutdown(void) {
	running = 0;
	if (wake_pipe[1] >= 0 && write(wake_pipe[1], "x", 1) < 0) {
		return;
	}
}

static void *connection_thread(void *argument) {
	http_connection *connection = argument;
	alpaca_buffer input = { 0 };
	bool keep = true;
	while (keep && running) {
		http_exchange exchange = { .connection = connection->id, .response_type = "text/plain; charset=utf-8", .status = 200 };
		int status = 0;
		if (!read_exchange(connection->fd, &input, &exchange, &status)) {
			if (status != 0) {
				send_simple(connection->fd, status, status_reason(status));
			}
			free_exchange(&exchange);
			break;
		}
		pthread_mutex_lock(&simulator_lock);
		process_exchange(&exchange);
		pthread_mutex_unlock(&simulator_lock);
		keep = send_exchange(connection->fd, &exchange);
		if (exchange.shutdown) {
			request_shutdown();
		}
		free_exchange(&exchange);
	}
	free(input.data);
	pthread_mutex_lock(&connection_lock);
	close(connection->fd);
	connection->fd = -1;
	connection->finished = true;
	pthread_mutex_unlock(&connection_lock);
	return NULL;
}

// Joins the threads of closed connections. With all set it first unblocks and then joins every connection.
static void reap_connections(bool all) {
	for (int i = 0; i < MAX_CONNECTIONS; i++) {
		pthread_mutex_lock(&connection_lock);
		bool join = connections[i].active && (connections[i].finished || all);
		if (join && !connections[i].finished) {
			shutdown(connections[i].fd, SHUT_RDWR);
		}
		pthread_mutex_unlock(&connection_lock);
		if (join) {
			pthread_join(connections[i].thread, NULL);
			pthread_mutex_lock(&connection_lock);
			connections[i].active = false;
			pthread_mutex_unlock(&connection_lock);
		}
	}
}

static void accept_connection(void) {
	int one = 1;
	int fd = accept(http_fd, NULL, NULL);
	if (fd < 0) {
		return;
	}
	fcntl(fd, F_SETFL, fcntl(fd, F_GETFL, 0) & ~O_NONBLOCK);
	setsockopt(fd, IPPROTO_TCP, TCP_NODELAY, &one, sizeof(one));
	reap_connections(false);
	for (int i = 0; i < MAX_CONNECTIONS; i++) {
		if (!connections[i].active) {
			pthread_mutex_lock(&connection_lock);
			connections[i].fd = fd;
			connections[i].id = ++connection_sequence;
			connections[i].finished = false;
			connections[i].active = true;
			pthread_mutex_unlock(&connection_lock);
			if (pthread_create(&connections[i].thread, NULL, connection_thread, connections + i) != 0) {
				perror("pthread_create");
				connections[i].active = false;
				close(fd);
			}
			return;
		}
	}
	send_simple(fd, 503, "Too many connections");
	close(fd);
}

#pragma mark - discovery

static void send_discovery_reply(const pending_reply *reply) {
	char address[INET_ADDRSTRLEN] = { 0 };
	inet_ntop(AF_INET, &reply->address.sin_addr, address, sizeof(address));
	sendto(discovery_fd, reply->payload, reply->length, 0, (const struct sockaddr *)&reply->address, sizeof(reply->address));
	alpaca_event("DISCOVERY", "reply to=%s:%d %.*s", address, ntohs(reply->address.sin_port), (int)reply->length, reply->payload);
}

static void handle_discovery(void) {
	char request[64] = { 0 };
	char address[INET_ADDRSTRLEN] = { 0 };
	pending_reply reply = { 0 };
	socklen_t length = sizeof(reply.address);
	ssize_t count = recvfrom(discovery_fd, request, sizeof(request) - 1, 0, (struct sockaddr *)&reply.address, &length);
	if (count < 0) {
		return;
	}
	inet_ntop(AF_INET, &reply.address.sin_addr, address, sizeof(address));
	pthread_mutex_lock(&simulator_lock);
	if ((size_t)count < strlen(DISCOVERY_REQUEST) || memcmp(request, DISCOVERY_REQUEST, strlen(DISCOVERY_REQUEST))) {
		alpaca_event("DISCOVERY", "ignored from=%s:%d %zd bytes", address, ntohs(reply.address.sin_port), count);
		pthread_mutex_unlock(&simulator_lock);
		return;
	}
	discovery.requests++;
	alpaca_event("DISCOVERY", "request from=%s:%d", address, ntohs(reply.address.sin_port));
	for (int port = 0; discovery.mode != DISCOVERY_SILENT && port < (discovery.alpaca_port_count ? discovery.alpaca_port_count : 1); port++) {
		if (*discovery.reply) {
			copy_text(reply.payload, sizeof(reply.payload), discovery.reply);
		} else if (discovery.mode == DISCOVERY_MALFORMED) {
			copy_text(reply.payload, sizeof(reply.payload), "{\"AlpacaPort\":");
		} else {
			snprintf(reply.payload, sizeof(reply.payload), "{\"AlpacaPort\":%d}", discovery.alpaca_port_count ? discovery.alpaca_ports[port] : http_port);
		}
		reply.length = strlen(reply.payload);
		reply.due = monotonic_time() + discovery.delay / 1000.0;
		for (int i = 0; i < discovery.copies; i++) {
			discovery.replies++;
			if (discovery.delay == 0) {
				send_discovery_reply(&reply);
			} else if (pending_reply_count < MAX_PENDING_REPLIES) {
				pending_replies[pending_reply_count++] = reply;
			}
		}
	}
	if (discovery.count > 0 && --discovery.count == 0) {
		reset_discovery();
	}
	pthread_mutex_unlock(&simulator_lock);
}

// Sends the delayed replies that are due and returns the poll timeout until the next one.
static int flush_pending_replies(void) {
	int timeout = 500;
	double now = monotonic_time();
	pthread_mutex_lock(&simulator_lock);
	for (int i = 0; i < pending_reply_count;) {
		if (pending_replies[i].due <= now) {
			send_discovery_reply(pending_replies + i);
			memmove(pending_replies + i, pending_replies + i + 1, (size_t)(pending_reply_count - i - 1) * sizeof(pending_reply));
			pending_reply_count--;
		} else {
			int remaining = (int)ceil((pending_replies[i].due - now) * 1000);
			timeout = remaining < timeout ? remaining : timeout;
			i++;
		}
	}
	pthread_mutex_unlock(&simulator_lock);
	return timeout < 1 ? 1 : timeout;
}

#pragma mark - runtime

static void signal_handler(int signal_number) {
	(void)signal_number;
	running = 0;
	if (wake_pipe[1] >= 0 && write(wake_pipe[1], "x", 1) < 0) {
		return;
	}
}

static int open_socket(int type, const char *address_text, int port, int *bound_port) {
	struct sockaddr_in address = { 0 };
	socklen_t length = sizeof(address);
	int one = 1;
	int fd = socket(AF_INET, type, 0);
	if (fd < 0) {
		perror("socket");
		return -1;
	}
	setsockopt(fd, SOL_SOCKET, SO_REUSEADDR, &one, sizeof(one));
	if (type == SOCK_DGRAM) {
		// several simulators may answer discovery on one port, like several Alpaca servers on one host
		setsockopt(fd, SOL_SOCKET, SO_REUSEPORT, &one, sizeof(one));
		setsockopt(fd, SOL_SOCKET, SO_BROADCAST, &one, sizeof(one));
	}
	address.sin_family = AF_INET;
	address.sin_port = htons((uint16_t)port);
	if (inet_pton(AF_INET, address_text, &address.sin_addr) != 1) {
		fprintf(stderr, "'%s' is not an IPv4 address\n", address_text);
		close(fd);
		return -1;
	}
	if (bind(fd, (struct sockaddr *)&address, sizeof(address)) < 0 || (type == SOCK_STREAM && listen(fd, 32) < 0) || getsockname(fd, (struct sockaddr *)&address, &length) < 0) {
		fprintf(stderr, "%s %s:%d: %s\n", type == SOCK_STREAM ? "tcp" : "udp", address_text, port, strerror(errno));
		close(fd);
		return -1;
	}
	fcntl(fd, F_SETFL, fcntl(fd, F_GETFL, 0) | O_NONBLOCK);
	*bound_port = ntohs(address.sin_port);
	return fd;
}

// Same convention as serial_simulator_write_ready_file(): written to a temporary file and renamed, so a reader never sees half of it.
static bool write_ready_file(void) {
	char temporary[PATH_MAX];
	snprintf(temporary, sizeof(temporary), "%s.tmp.%ld", options.ready_file, (long)getpid());
	FILE *file = fopen(temporary, "w");
	if (file == NULL) {
		perror("fopen ready file");
		return false;
	}
	fprintf(file, "INDIGO_SIMULATOR=%s\n", SIMULATOR_NAME);
	fprintf(file, "INDIGO_SIMULATOR_PORT=%s:%d\n", options.bind_address, http_port);
	fprintf(file, "INDIGO_SIMULATOR_HOST=%s\n", options.bind_address);
	fprintf(file, "INDIGO_SIMULATOR_TCP_PORT=%d\n", http_port);
	fprintf(file, "INDIGO_SIMULATOR_TCP_URL=http://%s:%d\n", options.bind_address, http_port);
	if (options.discovery) {
		fprintf(file, "INDIGO_SIMULATOR_UDP_PORT=%d\n", discovery_port);
		fprintf(file, "INDIGO_SIMULATOR_UDP_URL=udp://%s:%d\n", options.discovery_bind, discovery_port);
	}
	fprintf(file, "INDIGO_SIMULATOR_PID=%ld\n", (long)getpid());
	if (fclose(file) != 0 || rename(temporary, options.ready_file) != 0) {
		perror("ready file");
		unlink(temporary);
		return false;
	}
	return true;
}

static void usage(const char *name) {
	printf("ASCOM Alpaca server simulator\n");
	printf("Usage: %s [OPTIONS]\n", name);
	printf("  --headless                    Disable terminal-oriented output\n");
	printf("  --ready-file <path>           Write INDIGO_SIMULATOR_HOST / INDIGO_SIMULATOR_TCP_PORT once HTTP and discovery listen\n");
	printf("  --event-file <path>           Event log (default <ready-file>.events or $INDIGO_SYSTEM_ALPACA_EVENTS)\n");
	printf("  --trace                       Log events to stderr\n");
	printf("  --bind <address>              HTTP bind address (default 127.0.0.1)\n");
	printf("  --port <port>                 HTTP port (default 0 = any free port)\n");
	printf("  --discovery-port <port>       Answer Alpaca discovery on this UDP port (0 = any free port, default: no discovery)\n");
	printf("  --discovery-bind <address>    Discovery bind address (default 0.0.0.0, needed to receive broadcasts)\n");
	printf("  --clock manual|real           Device time moves by PUT /simulator/v1/clock only (default) or follows wall time\n");
	printf("  --tick-per-request <seconds>  Advance device time after every device API request (default 0)\n");
	printf("  --server-name <text>          ServerName of /management/v1/description\n");
	printf("  --manufacturer <text>         Manufacturer of /management/v1/description\n");
	printf("  --manufacturer-version <text> ManufacturerVersion of /management/v1/description\n");
	printf("  --location <text>             Location of /management/v1/description\n");
	printf("  --indigo-bridge               Describe the server like the INDIGO agent_alpaca bridge\n");
	printf("  --interface p7|legacy         Default interface version of the devices (default p7)\n");
	printf("  --connect-delay <seconds>     Device time a Platform 7 connect / disconnect takes (default 0)\n");
	printf("  --uid-prefix <8 hex digits>   First group of the default UniqueIDs (default a1baca00)\n");
	printf("  --device <type>[:<settings>]  Add a device; repeatable. Without it one device of every type is created.\n");
	printf("                                <settings> is key=value[,key=value...]: number, name, uid, interface and\n");
	printf("                                every key of GET /simulator/v1/<type>/<number>/state\n");
	printf("  --no-devices                  Start without devices\n");
	printf("  --no-parent-watch             Keep running when the parent process exits\n");
	printf("  --error-value                 An error reply of a GET carries Value (the default of its type) next to ErrorNumber,\n");
	printf("                                as the ASCOM .NET servers do (default: no Value with an error)\n");
	printf("  --any-content-type            Take the body of a PUT as a form whatever its Content-Type is (default: HTTP 400\n");
	printf("                                unless it is application/x-www-form-urlencoded)\n");
	printf("  -h, --help                    Show this help and exit\n");
	printf("Device types:");
	for (int i = 0; i < ALPACA_TYPE_COUNT; i++) {
		printf(" %s", alpaca_types[i]->name);
	}
	printf("\nControl API (form-encoded, text/plain answers):\n");
	printf("  GET  /simulator/v1/status\n");
	printf("  GET  /simulator/v1/clock\n");
	printf("  PUT  /simulator/v1/clock                    Advance=<s> Mode=manual|real TickPerRequest=<s> UTC=<ISO 8601>\n");
	printf("  PUT  /simulator/v1/reset                    Scope=all|devices|faults|requests|discovery|clock\n");
	printf("  GET  /simulator/v1/requests                 Since=<sequence> Method=<GET|PUT> Path=<glob> Limit=<n>\n");
	printf("  PUT  /simulator/v1/requests/clear\n");
	printf("  GET  /simulator/v1/faults\n");
	printf("  PUT  /simulator/v1/faults                   Path=<glob> Action=<name> Method= Skip= Count= Value= Delay=<ms> Bytes= Message= Dispatch=\n");
	printf("  PUT  /simulator/v1/faults/clear\n");
	printf("  GET  /simulator/v1/discovery\n");
	printf("  PUT  /simulator/v1/discovery                Mode=normal|silent|malformed|duplicate|delayed Copies= Delay=<ms> Count= AlpacaPort=<port>[|<port>...] Reply=\n");
	printf("  GET  /simulator/v1/server\n");
	printf("  PUT  /simulator/v1/server                   ServerName= Manufacturer= ManufacturerVersion= Location=\n");
	printf("  GET  /simulator/v1/devices\n");
	printf("  PUT  /simulator/v1/devices                  Type=<type> and device settings\n");
	printf("  PUT  /simulator/v1/devices/remove           Type=<type> Number=<n>\n");
	printf("  GET  /simulator/v1/<type>/<n>/state\n");
	printf("  PUT  /simulator/v1/<type>/<n>/state         <Key>=<value> ...\n");
	printf("  PUT  /simulator/v1/<type>/<n>/reset\n");
	printf("  PUT  /simulator/v1/<type>/<n>/error         Member=<member> ErrorNumber=<n> ErrorMessage= Count=\n");
	printf("  PUT  /simulator/v1/shutdown\n");
	printf("Fault actions:");
	for (int i = 1; i < FAULT_ACTION_COUNT; i++) {
		printf(" %s", fault_names[i]);
	}
	printf("\n");
}

// Accepts "--name value" and "--name=value".
static bool option_value(int argc, char *argv[], int *index, const char *name, const char **value) {
	size_t length = strlen(name);
	if (strncmp(argv[*index], name, length)) {
		return false;
	}
	if (argv[*index][length] == '=') {
		*value = argv[*index] + length + 1;
		return true;
	}
	if (argv[*index][length] != '\0') {
		return false;
	}
	if (*index + 1 == argc) {
		fprintf(stderr, "%s requires a value\n", name);
		exit(2);
	}
	*value = argv[++*index];
	return true;
}

static bool parse_args(int argc, char *argv[], const char **device_options, int *device_option_count) {
	const char *value = NULL;
	for (int i = 1; i < argc; i++) {
		if (!strcmp(argv[i], "-h") || !strcmp(argv[i], "--help")) {
			usage(argv[0]);
			exit(0);
		} else if (!strcmp(argv[i], "--headless")) {
			options.headless = true;
		} else if (!strcmp(argv[i], "--trace")) {
			options.trace = true;
		} else if (!strcmp(argv[i], "--indigo-bridge")) {
			copy_text(options.server_name, sizeof(options.server_name), "INDIGO-Alpaca Bridge");
			copy_text(options.manufacturer, sizeof(options.manufacturer), "The INDIGO Initiative");
			copy_text(options.manufacturer_version, sizeof(options.manufacturer_version), "3.0-8");
			copy_text(options.location, sizeof(options.location), "");
		} else if (!strcmp(argv[i], "--no-devices")) {
			options.default_devices = false;
		} else if (!strcmp(argv[i], "--no-parent-watch")) {
			options.parent_watch = false;
		} else if (!strcmp(argv[i], "--error-value")) {
			options.error_value = true;
		} else if (!strcmp(argv[i], "--any-content-type")) {
			options.any_content_type = true;
		} else if (option_value(argc, argv, &i, "--ready-file", &value)) {
			options.ready_file = value;
		} else if (option_value(argc, argv, &i, "--event-file", &value)) {
			options.event_file = value;
		} else if (option_value(argc, argv, &i, "--bind", &value)) {
			options.bind_address = value;
		} else if (option_value(argc, argv, &i, "--port", &value)) {
			if (!alpaca_parse_int(value, &options.port) || options.port < 0 || options.port > 65535) {
				fprintf(stderr, "--port %s is not a port\n", value);
				return false;
			}
		} else if (option_value(argc, argv, &i, "--discovery-port", &value)) {
			options.discovery = true;
			if (!alpaca_parse_int(value, &options.discovery_port) || options.discovery_port < 0 || options.discovery_port > 65535) {
				fprintf(stderr, "--discovery-port %s is not a port\n", value);
				return false;
			}
		} else if (option_value(argc, argv, &i, "--discovery-bind", &value)) {
			options.discovery_bind = value;
		} else if (option_value(argc, argv, &i, "--clock", &value)) {
			if (strcmp(value, "manual") && strcmp(value, "real")) {
				fprintf(stderr, "--clock %s is not manual or real\n", value);
				return false;
			}
			options.real_clock = !strcmp(value, "real");
		} else if (option_value(argc, argv, &i, "--tick-per-request", &value)) {
			if (!alpaca_parse_double(value, &options.tick_per_request) || options.tick_per_request < 0) {
				fprintf(stderr, "--tick-per-request %s is not a positive number\n", value);
				return false;
			}
		} else if (option_value(argc, argv, &i, "--connect-delay", &value)) {
			if (!alpaca_parse_double(value, &options.connect_delay) || options.connect_delay < 0) {
				fprintf(stderr, "--connect-delay %s is not a positive number\n", value);
				return false;
			}
		} else if (option_value(argc, argv, &i, "--server-name", &value)) {
			copy_text(options.server_name, sizeof(options.server_name), value);
		} else if (option_value(argc, argv, &i, "--manufacturer-version", &value)) {
			copy_text(options.manufacturer_version, sizeof(options.manufacturer_version), value);
		} else if (option_value(argc, argv, &i, "--manufacturer", &value)) {
			copy_text(options.manufacturer, sizeof(options.manufacturer), value);
		} else if (option_value(argc, argv, &i, "--location", &value)) {
			copy_text(options.location, sizeof(options.location), value);
		} else if (option_value(argc, argv, &i, "--uid-prefix", &value)) {
			copy_text(options.uid_prefix, sizeof(options.uid_prefix), value);
		} else if (option_value(argc, argv, &i, "--interface", &value)) {
			if (strcmp(value, "p7") && strcmp(value, "legacy")) {
				fprintf(stderr, "--interface %s is not p7 or legacy\n", value);
				return false;
			}
			options.legacy_interface = !strcmp(value, "legacy");
		} else if (option_value(argc, argv, &i, "--device", &value)) {
			if (*device_option_count == MAX_DEVICE_OPTIONS) {
				fprintf(stderr, "Too many --device options\n");
				return false;
			}
			device_options[(*device_option_count)++] = value;
		} else {
			fprintf(stderr, "Unknown option '%s'\n", argv[i]);
			return false;
		}
	}
	return true;
}

static bool create_devices(const char **device_options, int device_option_count) {
	char error[256] = { 0 };
	if (device_option_count == 0 && options.default_devices) {
		for (int i = 0; i < ALPACA_TYPE_COUNT; i++) {
			if (device_create(alpaca_types[i], "", error, sizeof(error)) == NULL) {
				fprintf(stderr, "%s: %s\n", alpaca_types[i]->name, error);
				return false;
			}
		}
	}
	for (int i = 0; i < device_option_count; i++) {
		char type_name[64];
		const char *settings = strchr(device_options[i], ':');
		snprintf(type_name, sizeof(type_name), "%.*s", settings ? (int)(settings - device_options[i]) : (int)strlen(device_options[i]), device_options[i]);
		const alpaca_type *type = find_type(type_name, false);
		if (type == NULL) {
			fprintf(stderr, "--device %s: unknown device type '%s'\n", device_options[i], type_name);
			return false;
		}
		if (device_create(type, settings ? settings + 1 : "", error, sizeof(error)) == NULL) {
			fprintf(stderr, "--device %s: %s\n", device_options[i], error);
			return false;
		}
	}
	return true;
}

static void close_all(void) {
	reap_connections(true);
	if (http_fd >= 0) {
		close(http_fd);
	}
	if (discovery_fd >= 0) {
		close(discovery_fd);
	}
	close(wake_pipe[0]);
	close(wake_pipe[1]);
	clear_records();
	free(records);
	for (int i = 0; i < device_count; i++) {
		device_free(devices[i]);
	}
	device_count = 0;
	alpaca_event("CLOSE", "simulator");
	if (events != NULL) {
		fclose(events);
		events = NULL;
	}
}

int main(int argc, char *argv[]) {
	const char *device_options[MAX_DEVICE_OPTIONS];
	char event_file[PATH_MAX] = { 0 };
	int device_option_count = 0;
	pid_t parent = getppid();
	if (!parse_args(argc, argv, device_options, &device_option_count)) {
		return 2;
	}
	if (options.event_file != NULL) {
		copy_text(event_file, sizeof(event_file), options.event_file);
	} else if (getenv("INDIGO_SYSTEM_ALPACA_EVENTS") != NULL) {
		copy_text(event_file, sizeof(event_file), getenv("INDIGO_SYSTEM_ALPACA_EVENTS"));
	} else if (options.ready_file != NULL) {
		snprintf(event_file, sizeof(event_file), "%s.events", options.ready_file);
	}
	events = *event_file ? fopen(event_file, "a") : NULL;
	clock_real_start = monotonic_time();
	utc_base = options.real_clock ? (double)time(NULL) : MANUAL_CLOCK_UTC;
	if (pipe(wake_pipe) != 0) {
		perror("pipe");
		return 1;
	}
	signal(SIGPIPE, SIG_IGN);
	signal(SIGINT, signal_handler);
	signal(SIGTERM, signal_handler);
	if (!create_devices(device_options, device_option_count)) {
		close_all();
		return 2;
	}
	http_fd = open_socket(SOCK_STREAM, options.bind_address, options.port, &http_port);
	if (http_fd >= 0 && options.discovery) {
		discovery_fd = open_socket(SOCK_DGRAM, options.discovery_bind, options.discovery_port, &discovery_port);
	}
	if (http_fd < 0 || (options.discovery && discovery_fd < 0)) {
		close_all();
		return 1;
	}
	alpaca_event("OPEN", "http=%s:%d discovery=%d clock=%s devices=%d", options.bind_address, http_port, discovery_port, options.real_clock ? "real" : "manual", device_count);
	if (options.ready_file != NULL && !write_ready_file()) {
		close_all();
		return 1;
	}
	if (!options.headless) {
		printf("Alpaca simulator ready on http://%s:%d, discovery port %d, %d devices\n", options.bind_address, http_port, discovery_port, device_count);
		fflush(stdout);
	}
	while (running) {
		struct pollfd fds[3] = { { .fd = wake_pipe[0], .events = POLLIN }, { .fd = http_fd, .events = POLLIN }, { .fd = discovery_fd, .events = POLLIN } };
		int timeout = flush_pending_replies();
		int ready = poll(fds, discovery_fd >= 0 ? 3 : 2, timeout);
		if (ready < 0 && errno != EINTR) {
			break;
		}
		if (options.parent_watch && getppid() != parent) {
			// the test that started the simulator is gone, nobody is left to stop it
			alpaca_event("STATE", "parent process exited");
			break;
		}
		if (ready <= 0) {
			reap_connections(false);
			continue;
		}
		if (fds[0].revents) {
			break;
		}
		if (fds[1].revents & POLLIN) {
			accept_connection();
		}
		if (discovery_fd >= 0 && (fds[2].revents & POLLIN)) {
			handle_discovery();
		}
	}
	request_shutdown();
	close_all();
	return 0;
}
