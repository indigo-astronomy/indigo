// ASCOM Alpaca server simulator, Focuser
//
// Copyright (c) 2026 CloudMakers, s. r. o.
// All rights reserved.
//
// You can use this software under the terms of 'INDIGO Astronomy
// open-source license' (see LICENSE.md).
//
// THIS SOFTWARE IS PROVIDED BY THE AUTHORS 'AS IS' AND ANY EXPRESS
// OR IMPLIED WARRANTIES, INCLUDING, BUT NOT LIMITED TO, THE IMPLIED
// WARRANTIES OF MERCHANTABILITY AND FITNESS FOR A PARTICULAR PURPOSE
// ARE DISCLAIMED. IN NO EVENT SHALL THE AUTHOR BE LIABLE FOR ANY
// DIRECT, INDIRECT, INCIDENTAL, SPECIAL, EXEMPLARY, OR CONSEQUENTIAL
// DAMAGES (INCLUDING, BUT NOT LIMITED TO, PROCUREMENT OF SUBSTITUTE
// GOODS OR SERVICES; LOSS OF USE, DATA, OR PROFITS; OR BUSINESS
// INTERRUPTION) HOWEVER CAUSED AND ON ANY THEORY OF LIABILITY,
// WHETHER IN CONTRACT, STRICT LIABILITY, OR TORT (INCLUDING
// NEGLIGENCE OR OTHERWISE) ARISING IN ANY WAY OUT OF THE USE OF THIS
// SOFTWARE, EVEN IF ADVISED OF THE POSSIBILITY OF SUCH DAMAGE.

// Code is generated by AI

// This source file was generated by a Claude agent.

// IFocuserV4 (Platform 7), IFocuserV3 with interface=legacy.
// Absolute=true: Move takes a target of 0..MaxStep. Absolute=false: Move takes
// signed steps of at most MaxIncrement and Position is not implemented.
// The focuser moves at StepsPerSecond and IsMoving stays true for SettleTime
// after the last step, also after Halt (the motor stops at once and settles,
// as in the ASCOM OmniSim focuser).
// Behaviour the standard leaves to the device, selectable per device:
// - ClampMoves=false (default): a target outside 0..MaxStep, or more relative
//   steps than MaxIncrement, is InvalidValue. ClampMoves=true: the request is
//   accepted and limited to the range, like the ASCOM OmniSim focuser does
//   (Focuser.Move truncates its target).
// - CanHalt=false: Halt is NotImplemented ("some focusers may not support this
//   function", IFocuser.Halt; OmniSim has the same switch).
// - StepSizeAvailable=false: StepSize is NotImplemented (a focuser that does
//   not know its step size, IFocuser.StepSize; OmniSim CanStepSize).
// - TemperatureAvailable=false: Temperature is NotImplemented.
// - LateSettle=<seconds> (default 0, off): an absolute Move ends LateOvershoot
//   steps (default 2) beyond its target with IsMoving false, and Position
//   reaches the target only LateSettle seconds later, without IsMoving being
//   true again. The Askar-WAF focuser (Alpaca server 1.0.7) does this: IsMoving
//   is false at 986 and Position is 984, the target, a moment later (HW-5).
//   Halt and a new Move cancel the pending correction.
// Temperature compensation follows the OmniSim model: while TempComp is true
// and the focuser is idle, a change of Temperature moves the focuser by
// (int)((Temperature - reference) * TempSteps) steps, the reference being the
// temperature of the last compensation. The reference is taken when TempComp
// is switched on (OmniSim does not say when; this is an assumption). The
// compensating move is an ordinary move: IsMoving is true while it lasts.

#include <math.h>
#include <stdlib.h>

#include "system_alpaca_simulator.h"

typedef struct {
	bool absolute;
	bool is_moving;
	int max_increment;
	int max_step;
	alpaca_motion position;
	double step_size;
	bool temp_comp;
	bool temp_comp_available;
	bool temperature_available;
	double temperature;
	double steps_per_second;
	double settle_time;
	double settle_until;
	bool clamp_moves;
	bool can_halt;
	bool step_size_available;
	double temp_steps;
	double compensated_temperature;
	bool compensation_valid;
	double late_settle;
	int late_overshoot;
	bool late_pending;					// Position goes to late_target at late_until
	double late_target;
	double late_until;
} focuser_state;

static void focuser_reset(alpaca_device *device) {
	focuser_state *state = device->state;
	state->absolute = true;
	state->max_increment = 10000;
	state->max_step = 100000;
	alpaca_motion_set(&state->position, 50000);
	state->step_size = 1.5;
	state->temp_comp_available = true;
	state->temperature_available = true;
	state->temperature = 11.4;
	state->steps_per_second = 1000;
	state->can_halt = true;
	state->step_size_available = true;
	state->temp_steps = 10;
	state->late_overshoot = 2;
}

// Starts a move of the motor to target and keeps IsMoving true for the settle time after it.
static void focuser_start(alpaca_device *device, double target) {
	focuser_state *state = device->state;
	state->late_pending = false;
	alpaca_motion_start(&state->position, target, state->steps_per_second);
	state->settle_until = state->position.started + state->position.duration + state->settle_time;
	state->is_moving = state->position.moving || state->settle_time > 0;
	alpaca_event("MOVE", "focuser/%d from=%ld to=%ld duration=%.3f", device->number, lround(state->position.origin), lround(target), state->position.duration);
}

static void focuser_update(alpaca_device *device) {
	focuser_state *state = device->state;
	alpaca_motion_update(&state->position);
	if (state->late_pending && !state->position.moving && alpaca_reached(state->late_until)) {
		// the late correction of LateSettle: the position changes while IsMoving stays false
		state->late_pending = false;
		alpaca_motion_set(&state->position, state->late_target);
		alpaca_event("STATE", "focuser/%d late settle position=%ld", device->number, lround(state->late_target));
	}
	state->is_moving = state->position.moving || !alpaca_reached(state->settle_until);
	if (!state->temp_comp) {
		state->compensation_valid = false;
	} else if (!state->compensation_valid) {
		state->compensated_temperature = state->temperature;
		state->compensation_valid = true;
	} else if (!state->is_moving) {
		int steps = (int)((state->temperature - state->compensated_temperature) * state->temp_steps);
		if (steps != 0) {
			double target = state->position.position + steps;
			if (state->absolute) {
				target = target < 0 ? 0 : target > state->max_step ? state->max_step : target;
			}
			state->compensated_temperature = state->temperature;
			alpaca_event("STATE", "focuser/%d compensation steps=%d", device->number, steps);
			focuser_start(device, target);
		}
	}
}

static void focuser_get_position(alpaca_device *device, alpaca_request *request) {
	focuser_state *state = device->state;
	if (!state->absolute) {
		alpaca_reply_error(request, ALPACA_ERROR_NOT_IMPLEMENTED, "Position is not implemented by a relative focuser");
		return;
	}
	alpaca_reply_member(device, request);
}

static void focuser_get_temperature(alpaca_device *device, alpaca_request *request) {
	focuser_state *state = device->state;
	if (!state->temperature_available) {
		alpaca_reply_error(request, ALPACA_ERROR_NOT_IMPLEMENTED, "Temperature is not implemented");
		return;
	}
	alpaca_reply_member(device, request);
}

static void focuser_get_stepsize(alpaca_device *device, alpaca_request *request) {
	focuser_state *state = device->state;
	if (!state->step_size_available) {
		alpaca_reply_error(request, ALPACA_ERROR_NOT_IMPLEMENTED, "StepSize is not implemented");
		return;
	}
	alpaca_reply_member(device, request);
}

static void focuser_put_tempcomp(alpaca_device *device, alpaca_request *request) {
	focuser_state *state = device->state;
	bool temp_comp = false;
	if (!alpaca_param_bool(request, "TempComp", &temp_comp)) {
		return;
	}
	if (!state->temp_comp_available) {
		alpaca_reply_error(request, ALPACA_ERROR_NOT_IMPLEMENTED, "TempComp is not implemented");
		return;
	}
	state->temp_comp = temp_comp;
	alpaca_reply_void(request);
}

static void focuser_put_halt(alpaca_device *device, alpaca_request *request) {
	focuser_state *state = device->state;
	if (!state->can_halt) {
		alpaca_reply_error(request, ALPACA_ERROR_NOT_IMPLEMENTED, "Halt is not implemented");
		return;
	}
	state->late_pending = false;
	alpaca_motion_stop(&state->position);
	// the motor stops at once and settles like after a move: OmniSim 0.5.0 reports IsMoving for its settle time after Halt as well
	state->settle_until = state->settle_time > 0 ? alpaca_now() + state->settle_time : 0;
	state->is_moving = state->settle_time > 0;
	alpaca_event("STATE", "focuser/%d halt position=%ld", device->number, lround(state->position.position));
	alpaca_reply_void(request);
}

static void focuser_put_move(alpaca_device *device, alpaca_request *request) {
	focuser_state *state = device->state;
	int position = 0;
	if (!alpaca_param_int(request, "Position", &position)) {
		return;
	}
	if (state->temp_comp && device->interface_version < 3) {
		alpaca_reply_error(request, ALPACA_ERROR_INVALID_OPERATION, "Move is not allowed while TempComp is true");
		return;
	}
	if (state->clamp_moves) {
		int limit = state->absolute ? state->max_step : state->max_increment;
		int lowest = state->absolute ? 0 : -state->max_increment;
		position = position < lowest ? lowest : position > limit ? limit : position;
	}
	double target = position;
	if (state->absolute && (position < 0 || position > state->max_step)) {
		alpaca_reply_error(request, ALPACA_ERROR_INVALID_VALUE, "Position %d is out of range 0..%d", position, state->max_step);
		return;
	}
	if (!state->absolute && abs(position) > state->max_increment) {
		alpaca_reply_error(request, ALPACA_ERROR_INVALID_VALUE, "Move of %d steps exceeds MaxIncrement %d", position, state->max_increment);
		return;
	}
	if (!state->absolute) {
		target = alpaca_motion_update(&state->position) + position;
	}
	double current = alpaca_motion_update(&state->position);
	if (state->absolute && state->late_settle > 0 && target != current) {
		// LateSettle: the motor stops beyond the target in the direction of the move (or short of it at the end of the range)
		double overshoot = target > current ? state->late_overshoot : -state->late_overshoot;
		double stop = target + overshoot;
		if (stop < 0 || stop > state->max_step) {
			stop = target - overshoot;
		}
		focuser_start(device, stop);
		state->late_pending = true;
		state->late_target = target;
		state->late_until = state->position.started + state->position.duration + state->late_settle;
	} else {
		focuser_start(device, target);
	}
	alpaca_reply_void(request);
}

static const alpaca_member focuser_members[] = {
	{ .name = "Absolute", .kind = ALPACA_BOOL, .offset = offsetof(focuser_state, absolute), .flags = ALPACA_R },
	{ .name = "IsMoving", .kind = ALPACA_BOOL, .offset = offsetof(focuser_state, is_moving), .flags = ALPACA_R | ALPACA_STATE },
	{ .name = "MaxIncrement", .kind = ALPACA_INT, .offset = offsetof(focuser_state, max_increment), .flags = ALPACA_R },
	{ .name = "MaxStep", .kind = ALPACA_INT, .offset = offsetof(focuser_state, max_step), .flags = ALPACA_R },
	{ .name = "Position", .kind = ALPACA_MOTION_INT, .offset = offsetof(focuser_state, position), .flags = ALPACA_STATE, .get = focuser_get_position },
	{ .name = "StepSize", .kind = ALPACA_DOUBLE, .offset = offsetof(focuser_state, step_size), .get = focuser_get_stepsize },
	{ .name = "TempComp", .kind = ALPACA_BOOL, .offset = offsetof(focuser_state, temp_comp), .flags = ALPACA_R, .put = focuser_put_tempcomp },
	{ .name = "TempCompAvailable", .kind = ALPACA_BOOL, .offset = offsetof(focuser_state, temp_comp_available), .flags = ALPACA_R },
	{ .name = "Temperature", .kind = ALPACA_DOUBLE, .offset = offsetof(focuser_state, temperature), .flags = ALPACA_STATE, .get = focuser_get_temperature },
	{ .name = "Halt", .put = focuser_put_halt },
	{ .name = "Move", .put = focuser_put_move },
	{ .name = "TemperatureAvailable", .kind = ALPACA_BOOL, .offset = offsetof(focuser_state, temperature_available), .flags = ALPACA_CONFIG },
	{ .name = "StepsPerSecond", .kind = ALPACA_DOUBLE, .offset = offsetof(focuser_state, steps_per_second), .flags = ALPACA_CONFIG },
	{ .name = "SettleTime", .kind = ALPACA_DOUBLE, .offset = offsetof(focuser_state, settle_time), .flags = ALPACA_CONFIG },
	{ .name = "ClampMoves", .kind = ALPACA_BOOL, .offset = offsetof(focuser_state, clamp_moves), .flags = ALPACA_CONFIG },
	{ .name = "CanHalt", .kind = ALPACA_BOOL, .offset = offsetof(focuser_state, can_halt), .flags = ALPACA_CONFIG },
	{ .name = "StepSizeAvailable", .kind = ALPACA_BOOL, .offset = offsetof(focuser_state, step_size_available), .flags = ALPACA_CONFIG },
	{ .name = "TempSteps", .kind = ALPACA_DOUBLE, .offset = offsetof(focuser_state, temp_steps), .flags = ALPACA_CONFIG },
	{ .name = "LateSettle", .kind = ALPACA_DOUBLE, .offset = offsetof(focuser_state, late_settle), .flags = ALPACA_CONFIG },
	{ .name = "LateOvershoot", .kind = ALPACA_INT, .offset = offsetof(focuser_state, late_overshoot), .flags = ALPACA_CONFIG }
};

const alpaca_type alpaca_focuser_type = {
	.name = "Focuser",
	.interface_version = 4,
	.legacy_interface_version = 3,
	.state_size = sizeof(focuser_state),
	.members = focuser_members,
	.member_count = sizeof(focuser_members) / sizeof(focuser_members[0]),
	.reset = focuser_reset,
	.update = focuser_update
};
