// ASCOM Alpaca server simulator, Switch
//
// Copyright (c) 2026 CloudMakers, s. r. o.
// All rights reserved.
//
// You can use this software under the terms of 'INDIGO Astronomy
// open-source license' (see LICENSE.md).
//
// THIS SOFTWARE IS PROVIDED BY THE AUTHORS 'AS IS' AND ANY EXPRESS
// OR IMPLIED WARRANTIES, INCLUDING, BUT NOT LIMITED TO, THE IMPLIED
// WARRANTIES OF MERCHANTABILITY AND FITNESS FOR A PARTICULAR PURPOSE
// ARE DISCLAIMED. IN NO EVENT SHALL THE AUTHOR BE LIABLE FOR ANY
// DIRECT, INDIRECT, INCIDENTAL, SPECIAL, EXEMPLARY, OR CONSEQUENTIAL
// DAMAGES (INCLUDING, BUT NOT LIMITED TO, PROCUREMENT OF SUBSTITUTE
// GOODS OR SERVICES; LOSS OF USE, DATA, OR PROFITS; OR BUSINESS
// INTERRUPTION) HOWEVER CAUSED AND ON ANY THEORY OF LIABILITY,
// WHETHER IN CONTRACT, STRICT LIABILITY, OR TORT (INCLUDING
// NEGLIGENCE OR OTHERWISE) ARISING IN ANY WAY OUT OF THE USE OF THIS
// SOFTWARE, EVEN IF ADVISED OF THE POSSIBILITY OF SUCH DAMAGE.

// Code is generated by AI

// This source file was generated by a Claude agent.

// ISwitchV3 (Platform 7), ISwitchV2 with interface=legacy: CanAsync, SetAsync,
// SetAsyncValue, StateChangeComplete and CancelAsync exist from V3 only.
// The default device has eight switches that cover the cases a client has to
// tell apart: writable boolean (0..3), writable analog with asynchronous set
// (4, 5), read-only analog sensor (6) and read-only boolean (7).
// Control keys beyond the table: Switch<n>.Name, .Description, .Min, .Max,
// .Step, .Value, .CanWrite, .CanAsync, .FixedName and .Stuck, e.g. Switch4.Value=35.
// A device can only have the values MinSwitchValue + n * SwitchStep (ISwitchV2:
// SwitchStep is "the difference between successive values of the device"), so a
// value that is set is rounded to the nearest of them; Switch<n>.Value of the
// control API is the raw state of the device and is stored as it is.
// SetSwitchName is NotImplemented for the whole device (CanSetName=false) or for
// single switches (Switch<n>.FixedName=true): ISwitchV2 documents the exception
// for a "device name [that] cannot be set", and drivers fix the names of some of
// their switches only.
// Switch<n>.Stuck=true models an output that accepts a change without an error
// and stays as it is (a tripped or interlocked outlet).
// Simulator assumptions: an asynchronous set takes AsyncTime and changes the
// value at its end; after CancelAsync the value is unchanged and
// StateChangeComplete answers OperationCancelled until the next set.

#include <math.h>
#include <stdio.h>
#include <string.h>
#include <strings.h>

#include "system_alpaca_simulator.h"

#define SWITCH_MAX 160

typedef struct {
	char name[ALPACA_TEXT_SIZE];
	char description[ALPACA_TEXT_SIZE];
	double min;
	double max;
	double step;
	double value;
	bool can_write;
	bool can_async;
	bool fixed_name;
	bool stuck;
	bool pending;
	bool cancelled;
	double pending_value;
	double pending_until;
} switch_item;

typedef struct {
	int max_switch;
	bool can_set_name;
	double async_time;
	switch_item items[SWITCH_MAX];
} switch_state;

static void switch_define(switch_item *item, const char *name, const char *description, double min, double max, double step, double value, bool can_write, bool can_async) {
	snprintf(item->name, sizeof(item->name), "%s", name);
	snprintf(item->description, sizeof(item->description), "%s", description);
	item->min = min;
	item->max = max;
	item->step = step;
	item->value = value;
	item->can_write = can_write;
	item->can_async = can_async;
}

static void switch_reset(alpaca_device *device) {
	switch_state *state = device->state;
	state->max_switch = 8;
	state->can_set_name = true;
	state->async_time = 2;
	switch_define(state->items + 0, "Power 1", "12 V power outlet 1", 0, 1, 1, 0, true, false);
	switch_define(state->items + 1, "Power 2", "12 V power outlet 2", 0, 1, 1, 0, true, false);
	switch_define(state->items + 2, "Power 3", "12 V power outlet 3", 0, 1, 1, 1, true, false);
	switch_define(state->items + 3, "USB hub", "USB hub power", 0, 1, 1, 1, true, false);
	switch_define(state->items + 4, "Dew heater A", "Dew heater A power in percent", 0, 100, 1, 0, true, true);
	switch_define(state->items + 5, "Dew heater B", "Dew heater B power in percent", 0, 100, 1, 25, true, true);
	switch_define(state->items + 6, "Input voltage", "Supply voltage in volts", 0, 30, 0.1, 12.3, false, false);
	switch_define(state->items + 7, "Limit switch", "Roof limit switch", 0, 1, 1, 1, false, false);
	for (int i = 8; i < SWITCH_MAX; i++) {
		char name[ALPACA_TEXT_SIZE];
		snprintf(name, sizeof(name), "Switch %d", i);
		switch_define(state->items + i, name, "Spare switch", 0, 1, 1, 0, true, false);
	}
}

static void switch_update(alpaca_device *device) {
	switch_state *state = device->state;
	for (int i = 0; i < state->max_switch; i++) {
		switch_item *item = state->items + i;
		if (item->pending && alpaca_reached(item->pending_until)) {
			item->pending = false;
			item->value = item->pending_value;
			alpaca_event("STATE", "switch/%d id=%d value=%g", device->number, i, item->value);
		}
	}
}

// Reads Id and answers InvalidValue itself when there is no such switch.
static switch_item *switch_lookup(alpaca_device *device, alpaca_request *request) {
	switch_state *state = device->state;
	int id = 0;
	if (!alpaca_param_int(request, "Id", &id)) {
		return NULL;
	}
	if (id < 0 || id >= state->max_switch) {
		alpaca_reply_error(request, ALPACA_ERROR_INVALID_VALUE, "Id %d is out of range 0..%d", id, state->max_switch - 1);
		return NULL;
	}
	return state->items + id;
}

static void switch_get_canwrite(alpaca_device *device, alpaca_request *request) {
	switch_item *item = switch_lookup(device, request);
	if (item != NULL) {
		alpaca_reply_bool(request, item->can_write);
	}
}

static void switch_get_canasync(alpaca_device *device, alpaca_request *request) {
	switch_item *item = switch_lookup(device, request);
	if (item != NULL) {
		alpaca_reply_bool(request, item->can_async);
	}
}

static void switch_get_getswitch(alpaca_device *device, alpaca_request *request) {
	switch_item *item = switch_lookup(device, request);
	if (item != NULL) {
		alpaca_reply_bool(request, item->value > item->min);
	}
}

static void switch_get_getswitchdescription(alpaca_device *device, alpaca_request *request) {
	switch_item *item = switch_lookup(device, request);
	if (item != NULL) {
		alpaca_reply_string(request, item->description);
	}
}

static void switch_get_getswitchname(alpaca_device *device, alpaca_request *request) {
	switch_item *item = switch_lookup(device, request);
	if (item != NULL) {
		alpaca_reply_string(request, item->name);
	}
}

static void switch_get_getswitchvalue(alpaca_device *device, alpaca_request *request) {
	switch_item *item = switch_lookup(device, request);
	if (item != NULL) {
		alpaca_reply_double(request, item->value);
	}
}

static void switch_get_minswitchvalue(alpaca_device *device, alpaca_request *request) {
	switch_item *item = switch_lookup(device, request);
	if (item != NULL) {
		alpaca_reply_double(request, item->min);
	}
}

static void switch_get_maxswitchvalue(alpaca_device *device, alpaca_request *request) {
	switch_item *item = switch_lookup(device, request);
	if (item != NULL) {
		alpaca_reply_double(request, item->max);
	}
}

static void switch_get_switchstep(alpaca_device *device, alpaca_request *request) {
	switch_item *item = switch_lookup(device, request);
	if (item != NULL) {
		alpaca_reply_double(request, item->step);
	}
}

static void switch_get_statechangecomplete(alpaca_device *device, alpaca_request *request) {
	switch_item *item = switch_lookup(device, request);
	if (item == NULL) {
		return;
	}
	if (item->cancelled) {
		alpaca_reply_error(request, ALPACA_ERROR_OPERATION_CANCELLED, "The asynchronous change of '%s' was cancelled", item->name);
		return;
	}
	alpaca_reply_bool(request, !item->pending);
}

// Applies a new value, at once or after AsyncTime. The parameters have been read by the caller.
static void switch_set(alpaca_device *device, alpaca_request *request, switch_item *item, double value, bool async) {
	switch_state *state = device->state;
	if (!item->can_write || (async && !item->can_async)) {
		alpaca_reply_error(request, ALPACA_ERROR_NOT_IMPLEMENTED, "%s is not implemented for '%s'", request->member->name, item->name);
		return;
	}
	if (value < item->min || value > item->max) {
		alpaca_reply_error(request, ALPACA_ERROR_INVALID_VALUE, "Value %g is out of range %g..%g", value, item->min, item->max);
		return;
	}
	if (item->step > 0) {
		value = item->min + round((value - item->min) / item->step) * item->step;
		if (value > item->max) {
			value = item->max;
		}
	}
	if (item->stuck) {
		value = item->value;
	}
	item->cancelled = false;
	item->pending = async && state->async_time > 0;
	item->pending_value = value;
	item->pending_until = alpaca_now() + state->async_time;
	if (!item->pending) {
		item->value = value;
	}
	alpaca_event("STATE", "switch/%d id=%d value=%g async=%d", device->number, (int)(item - state->items), value, item->pending);
	alpaca_reply_void(request);
}

static void switch_put_state(alpaca_device *device, alpaca_request *request, bool async) {
	bool value = false;
	switch_item *item = switch_lookup(device, request);
	if (item != NULL && alpaca_param_bool(request, "State", &value)) {
		switch_set(device, request, item, value ? item->max : item->min, async);
	}
}

static void switch_put_value(alpaca_device *device, alpaca_request *request, bool async) {
	double value = 0;
	switch_item *item = switch_lookup(device, request);
	if (item != NULL && alpaca_param_double(request, "Value", &value)) {
		switch_set(device, request, item, value, async);
	}
}

static void switch_put_setswitch(alpaca_device *device, alpaca_request *request) {
	switch_put_state(device, request, false);
}

static void switch_put_setswitchvalue(alpaca_device *device, alpaca_request *request) {
	switch_put_value(device, request, false);
}

static void switch_put_setasync(alpaca_device *device, alpaca_request *request) {
	switch_put_state(device, request, true);
}

static void switch_put_setasyncvalue(alpaca_device *device, alpaca_request *request) {
	switch_put_value(device, request, true);
}

static void switch_put_setswitchname(alpaca_device *device, alpaca_request *request) {
	switch_state *state = device->state;
	const char *name = NULL;
	switch_item *item = switch_lookup(device, request);
	if (item == NULL || !alpaca_param_string(request, "Name", &name)) {
		return;
	}
	if (!state->can_set_name || item->fixed_name) {
		alpaca_reply_error(request, ALPACA_ERROR_NOT_IMPLEMENTED, "SetSwitchName is not implemented");
		return;
	}
	snprintf(item->name, sizeof(item->name), "%s", name);
	alpaca_reply_void(request);
}

static void switch_put_cancelasync(alpaca_device *device, alpaca_request *request) {
	switch_item *item = switch_lookup(device, request);
	if (item == NULL) {
		return;
	}
	if (!item->can_async) {
		alpaca_reply_error(request, ALPACA_ERROR_NOT_IMPLEMENTED, "CancelAsync is not implemented for '%s'", item->name);
		return;
	}
	if (item->pending) {
		item->pending = false;
		item->cancelled = true;
		alpaca_event("STATE", "switch/%d cancelled '%s'", device->number, item->name);
	}
	alpaca_reply_void(request);
}

// An error is armed for the member through the control API (PUT .../error).
static bool switch_member_fails(alpaca_device *device, const char *member) {
	for (int i = 0; i < ALPACA_MAX_OVERRIDES; i++) {
		if (device->overrides[i].count != 0 && !strcasecmp(device->overrides[i].member, member)) {
			return true;
		}
	}
	return false;
}

// ISwitchV3: GetSwitch<n>, GetSwitchValue<n> and StateChangeComplete<n> for every switch. DeviceState never fails; a value whose
// member would answer with an error is left out.
static void switch_device_state(alpaca_device *device, alpaca_buffer *buffer, bool *first) {
	switch_state *state = device->state;
	bool has_state = !switch_member_fails(device, "getswitch"), has_value = !switch_member_fails(device, "getswitchvalue"), has_complete = !switch_member_fails(device, "statechangecomplete");
	for (int i = 0; i < state->max_switch; i++) {
		const switch_item *item = state->items + i;
		if (has_state) {
			alpaca_buffer_printf(buffer, "%s{\"Name\":\"GetSwitch%d\",\"Value\":%s}", *first ? "" : ",", i, item->value > item->min ? "true" : "false");
			*first = false;
		}
		if (has_value) {
			alpaca_buffer_printf(buffer, "%s{\"Name\":\"GetSwitchValue%d\",\"Value\":%.15g}", *first ? "" : ",", i, item->value);
			*first = false;
		}
		if (has_complete && !item->cancelled) {
			alpaca_buffer_printf(buffer, "%s{\"Name\":\"StateChangeComplete%d\",\"Value\":%s}", *first ? "" : ",", i, item->pending ? "false" : "true");
			*first = false;
		}
	}
}

static bool switch_control(alpaca_device *device, const char *key, const char *value) {
	switch_state *state = device->state;
	char field[32] = { 0 };
	int id = 0;
	int count = 0;
	if (!strcmp(key, "MaxSwitch")) {
		if (!alpaca_parse_int(value, &count) || count < 0 || count > SWITCH_MAX) {
			return false;
		}
		state->max_switch = count;
		return true;
	}
	if (sscanf(key, "Switch%d.%31s", &id, field) != 2 || id < 0 || id >= SWITCH_MAX) {
		return false;
	}
	switch_item *item = state->items + id;
	if (!strcmp(field, "Name")) {
		snprintf(item->name, sizeof(item->name), "%s", value);
		return true;
	}
	if (!strcmp(field, "Description")) {
		snprintf(item->description, sizeof(item->description), "%s", value);
		return true;
	}
	if (!strcmp(field, "Min")) {
		return alpaca_parse_double(value, &item->min);
	}
	if (!strcmp(field, "Max")) {
		return alpaca_parse_double(value, &item->max);
	}
	if (!strcmp(field, "Step")) {
		return alpaca_parse_double(value, &item->step);
	}
	if (!strcmp(field, "Value")) {
		item->pending = false;
		return alpaca_parse_double(value, &item->value);
	}
	if (!strcmp(field, "CanWrite")) {
		return alpaca_parse_bool(value, &item->can_write);
	}
	if (!strcmp(field, "CanAsync")) {
		return alpaca_parse_bool(value, &item->can_async);
	}
	if (!strcmp(field, "FixedName")) {
		return alpaca_parse_bool(value, &item->fixed_name);
	}
	if (!strcmp(field, "Stuck")) {
		return alpaca_parse_bool(value, &item->stuck);
	}
	return false;
}

static void switch_report(alpaca_device *device, alpaca_buffer *buffer) {
	switch_state *state = device->state;
	char key[64];
	for (int i = 0; i < state->max_switch; i++) {
		const switch_item *item = state->items + i;
		snprintf(key, sizeof(key), "Switch%d.Name", i);
		alpaca_buffer_field(buffer, key, "%s", item->name);
		snprintf(key, sizeof(key), "Switch%d.Description", i);
		alpaca_buffer_field(buffer, key, "%s", item->description);
		snprintf(key, sizeof(key), "Switch%d.Min", i);
		alpaca_buffer_field(buffer, key, "%.15g", item->min);
		snprintf(key, sizeof(key), "Switch%d.Max", i);
		alpaca_buffer_field(buffer, key, "%.15g", item->max);
		snprintf(key, sizeof(key), "Switch%d.Step", i);
		alpaca_buffer_field(buffer, key, "%.15g", item->step);
		snprintf(key, sizeof(key), "Switch%d.Value", i);
		alpaca_buffer_field(buffer, key, "%.15g", item->value);
		snprintf(key, sizeof(key), "Switch%d.CanWrite", i);
		alpaca_buffer_field(buffer, key, "%s", item->can_write ? "true" : "false");
		snprintf(key, sizeof(key), "Switch%d.CanAsync", i);
		alpaca_buffer_field(buffer, key, "%s", item->can_async ? "true" : "false");
		snprintf(key, sizeof(key), "Switch%d.FixedName", i);
		alpaca_buffer_field(buffer, key, "%s", item->fixed_name ? "true" : "false");
		snprintf(key, sizeof(key), "Switch%d.Stuck", i);
		alpaca_buffer_field(buffer, key, "%s", item->stuck ? "true" : "false");
		snprintf(key, sizeof(key), "Switch%d.Pending", i);
		alpaca_buffer_field(buffer, key, "%s", item->pending ? "true" : "false");
	}
}

static const alpaca_member switch_members[] = {
	{ .name = "MaxSwitch", .kind = ALPACA_INT, .offset = offsetof(switch_state, max_switch), .flags = ALPACA_R },
	{ .name = "CanAsync", .since = 3, .get = switch_get_canasync },
	{ .name = "CanWrite", .get = switch_get_canwrite },
	{ .name = "GetSwitch", .get = switch_get_getswitch },
	{ .name = "GetSwitchDescription", .get = switch_get_getswitchdescription },
	{ .name = "GetSwitchName", .get = switch_get_getswitchname },
	{ .name = "GetSwitchValue", .get = switch_get_getswitchvalue },
	{ .name = "MinSwitchValue", .get = switch_get_minswitchvalue },
	{ .name = "MaxSwitchValue", .get = switch_get_maxswitchvalue },
	{ .name = "StateChangeComplete", .since = 3, .get = switch_get_statechangecomplete },
	{ .name = "SwitchStep", .get = switch_get_switchstep },
	{ .name = "CancelAsync", .since = 3, .put = switch_put_cancelasync },
	{ .name = "SetAsync", .since = 3, .put = switch_put_setasync },
	{ .name = "SetAsyncValue", .since = 3, .put = switch_put_setasyncvalue },
	{ .name = "SetSwitch", .put = switch_put_setswitch },
	{ .name = "SetSwitchName", .put = switch_put_setswitchname },
	{ .name = "SetSwitchValue", .put = switch_put_setswitchvalue },
	{ .name = "CanSetName", .kind = ALPACA_BOOL, .offset = offsetof(switch_state, can_set_name), .flags = ALPACA_CONFIG },
	{ .name = "AsyncTime", .kind = ALPACA_DOUBLE, .offset = offsetof(switch_state, async_time), .flags = ALPACA_CONFIG }
};

const alpaca_type alpaca_switch_type = {
	.name = "Switch",
	.interface_version = 3,
	.legacy_interface_version = 2,
	.state_size = sizeof(switch_state),
	.members = switch_members,
	.member_count = sizeof(switch_members) / sizeof(switch_members[0]),
	.reset = switch_reset,
	.update = switch_update,
	.control = switch_control,
	.report = switch_report,
	.device_state = switch_device_state
};
