// ASCOM Alpaca server simulator, ObservingConditions
//
// Copyright (c) 2026 CloudMakers, s. r. o.
// All rights reserved.
//
// You can use this software under the terms of 'INDIGO Astronomy
// open-source license' (see LICENSE.md).
//
// THIS SOFTWARE IS PROVIDED BY THE AUTHORS 'AS IS' AND ANY EXPRESS
// OR IMPLIED WARRANTIES, INCLUDING, BUT NOT LIMITED TO, THE IMPLIED
// WARRANTIES OF MERCHANTABILITY AND FITNESS FOR A PARTICULAR PURPOSE
// ARE DISCLAIMED. IN NO EVENT SHALL THE AUTHOR BE LIABLE FOR ANY
// DIRECT, INDIRECT, INCIDENTAL, SPECIAL, EXEMPLARY, OR CONSEQUENTIAL
// DAMAGES (INCLUDING, BUT NOT LIMITED TO, PROCUREMENT OF SUBSTITUTE
// GOODS OR SERVICES; LOSS OF USE, DATA, OR PROFITS; OR BUSINESS
// INTERRUPTION) HOWEVER CAUSED AND ON ANY THEORY OF LIABILITY,
// WHETHER IN CONTRACT, STRICT LIABILITY, OR TORT (INCLUDING
// NEGLIGENCE OR OTHERWISE) ARISING IN ANY WAY OUT OF THE USE OF THIS
// SOFTWARE, EVEN IF ADVISED OF THE POSSIBILITY OF SUCH DAMAGE.

// Code is generated by AI

// This source file was generated by a Claude agent.

// IObservingConditionsV2 (Platform 7), IObservingConditions with interface=legacy.
// Every sensor is optional: the control key Sensors lists the implemented ones,
// separated by '|' (default: all). A sensor that is not listed answers
// NotImplemented, also to SensorDescription and TimeSinceLastUpdate.
// Units follow the standard: CloudCover and Humidity in percent, temperatures
// in degrees Celsius, Pressure in hPa, RainRate in mm/h, SkyBrightness in lux,
// SkyQuality in mag/arcsec^2, StarFWHM in arcsec, WindDirection in degrees,
// wind speeds in m/s, AveragePeriod in hours.
// AveragePeriod: "All drivers must accept 0.0 to specify that an instantaneous
// value is available" and answer InvalidValue to a value that "is not available
// for this driver" (IObservingConditions). MaxAveragePeriod (default 24) is the
// longest period the device averages over; 0 models a device without averaging.
// Refresh is optional (NotImplemented "if this method is not available"):
// CanRefresh=false.
// TimeSinceLastUpdate is kept for every sensor: a sensor is updated when its
// value is set through the control API and by Refresh; an empty SensorName
// answers for the sensor that was updated last.
// Simulator assumption: the values change only through the control API.

#include <stdio.h>
#include <stdlib.h>
#include <string.h>
#include <strings.h>

#include "system_alpaca_simulator.h"

#define SENSOR_COUNT 13

typedef struct {
	double average_period;
	double max_average_period;
	bool can_refresh;
	double values[SENSOR_COUNT];
	bool implemented[SENSOR_COUNT];
	double last_update[SENSOR_COUNT];
} observingconditions_state;

static const char *sensor_names[SENSOR_COUNT] = { "CloudCover", "DewPoint", "Humidity", "Pressure", "RainRate", "SkyBrightness", "SkyQuality", "SkyTemperature", "StarFWHM", "Temperature", "WindDirection", "WindGust", "WindSpeed" };

static void observingconditions_reset(alpaca_device *device) {
	static const double values[SENSOR_COUNT] = { 12.5, 6.3, 58.0, 1013.2, 0.0, 0.02, 20.6, -18.4, 2.3, 14.7, 245.0, 4.8, 2.6 };
	observingconditions_state *state = device->state;
	for (int i = 0; i < SENSOR_COUNT; i++) {
		state->values[i] = values[i];
		state->implemented[i] = true;
	}
	state->max_average_period = 24;
	state->can_refresh = true;
}

static int sensor_index(const char *name) {
	for (int i = 0; i < SENSOR_COUNT; i++) {
		if (!strcasecmp(sensor_names[i], name)) {
			return i;
		}
	}
	return -1;
}

static void observingconditions_get_sensor(alpaca_device *device, alpaca_request *request) {
	observingconditions_state *state = device->state;
	int index = sensor_index(request->member->name);
	if (index < 0 || !state->implemented[index]) {
		alpaca_reply_error(request, ALPACA_ERROR_NOT_IMPLEMENTED, "%s is not implemented", request->member->name);
		return;
	}
	alpaca_reply_member(device, request);
}

static void observingconditions_put_refresh(alpaca_device *device, alpaca_request *request) {
	observingconditions_state *state = device->state;
	if (!state->can_refresh) {
		alpaca_reply_error(request, ALPACA_ERROR_NOT_IMPLEMENTED, "Refresh is not implemented");
		return;
	}
	for (int i = 0; i < SENSOR_COUNT; i++) {
		state->last_update[i] = alpaca_now();
	}
	alpaca_reply_void(request);
}

static void observingconditions_put_averageperiod(alpaca_device *device, alpaca_request *request) {
	observingconditions_state *state = device->state;
	double period = 0;
	if (!alpaca_param_double(request, "AveragePeriod", &period)) {
		return;
	}
	if (period < 0 || period > state->max_average_period) {
		alpaca_reply_error(request, ALPACA_ERROR_INVALID_VALUE, "AveragePeriod=%g is out of range 0..%g", period, state->max_average_period);
		return;
	}
	state->average_period = period;
	alpaca_reply_void(request);
}

// Reads SensorName and answers the error itself when it does not name an implemented sensor.
static bool observingconditions_sensor(alpaca_device *device, alpaca_request *request, bool allow_empty, int *index) {
	observingconditions_state *state = device->state;
	const char *name = NULL;
	if (!alpaca_param_string(request, "SensorName", &name)) {
		return false;
	}
	*index = sensor_index(name);
	if (*name == '\0' && allow_empty) {
		return true;
	}
	if (*index < 0) {
		alpaca_reply_error(request, ALPACA_ERROR_INVALID_VALUE, "'%s' is not a sensor name", name);
		return false;
	}
	if (!state->implemented[*index]) {
		alpaca_reply_error(request, ALPACA_ERROR_NOT_IMPLEMENTED, "%s is not implemented", sensor_names[*index]);
		return false;
	}
	return true;
}

static void observingconditions_get_sensordescription(alpaca_device *device, alpaca_request *request) {
	char description[ALPACA_TEXT_SIZE];
	int index = -1;
	if (observingconditions_sensor(device, request, false, &index)) {
		snprintf(description, sizeof(description), "Simulated %s sensor", sensor_names[index]);
		alpaca_reply_string(request, description);
	}
}

static void observingconditions_get_timesincelastupdate(alpaca_device *device, alpaca_request *request) {
	observingconditions_state *state = device->state;
	int index = -1;
	if (observingconditions_sensor(device, request, true, &index)) {
		double last_update = index >= 0 ? state->last_update[index] : 0;
		for (int i = 0; index < 0 && i < SENSOR_COUNT; i++) {
			if (state->implemented[i] && state->last_update[i] > last_update) {
				last_update = state->last_update[i];
			}
		}
		alpaca_reply_double(request, alpaca_now() - last_update);
	}
}

static bool observingconditions_control(alpaca_device *device, const char *key, const char *value) {
	observingconditions_state *state = device->state;
	bool implemented[SENSOR_COUNT] = { 0 };
	char text[512];
	int sensor = sensor_index(key);
	if (sensor >= 0) {
		// a new reading of the sensor
		if (!alpaca_parse_double(value, state->values + sensor)) {
			return false;
		}
		state->last_update[sensor] = alpaca_now();
		return true;
	}
	if (strcmp(key, "Sensors")) {
		return false;
	}
	snprintf(text, sizeof(text), "%s", value);
	char *cursor = text;
	while (cursor != NULL && *cursor) {
		char *next = strchr(cursor, '|');
		if (next != NULL) {
			*next++ = '\0';
		}
		int index = sensor_index(cursor);
		if (index < 0) {
			return false;
		}
		implemented[index] = true;
		cursor = next;
	}
	memcpy(state->implemented, implemented, sizeof(implemented));
	return true;
}

static void observingconditions_report(alpaca_device *device, alpaca_buffer *buffer) {
	observingconditions_state *state = device->state;
	alpaca_buffer sensors = { 0 };
	for (int i = 0; i < SENSOR_COUNT; i++) {
		if (state->implemented[i]) {
			alpaca_buffer_printf(&sensors, "%s%s", sensors.length ? "|" : "", sensor_names[i]);
		}
	}
	alpaca_buffer_field(buffer, "Sensors", "%s", sensors.data ? sensors.data : "");
	free(sensors.data);
}

#define SENSOR(sensor, index) { .name = sensor, .kind = ALPACA_DOUBLE, .offset = offsetof(observingconditions_state, values) + (index) * sizeof(double), .flags = ALPACA_STATE, .get = observingconditions_get_sensor }

static const alpaca_member observingconditions_members[] = {
	{ .name = "AveragePeriod", .kind = ALPACA_DOUBLE, .offset = offsetof(observingconditions_state, average_period), .flags = ALPACA_RW, .put = observingconditions_put_averageperiod },
	SENSOR("CloudCover", 0),
	SENSOR("DewPoint", 1),
	SENSOR("Humidity", 2),
	SENSOR("Pressure", 3),
	SENSOR("RainRate", 4),
	SENSOR("SkyBrightness", 5),
	SENSOR("SkyQuality", 6),
	SENSOR("SkyTemperature", 7),
	SENSOR("StarFWHM", 8),
	SENSOR("Temperature", 9),
	SENSOR("WindDirection", 10),
	SENSOR("WindGust", 11),
	SENSOR("WindSpeed", 12),
	{ .name = "Refresh", .put = observingconditions_put_refresh },
	{ .name = "SensorDescription", .get = observingconditions_get_sensordescription },
	{ .name = "TimeSinceLastUpdate", .get = observingconditions_get_timesincelastupdate },
	{ .name = "MaxAveragePeriod", .kind = ALPACA_DOUBLE, .offset = offsetof(observingconditions_state, max_average_period), .flags = ALPACA_CONFIG },
	{ .name = "CanRefresh", .kind = ALPACA_BOOL, .offset = offsetof(observingconditions_state, can_refresh), .flags = ALPACA_CONFIG }
};

const alpaca_type alpaca_observingconditions_type = {
	.name = "ObservingConditions",
	.interface_version = 2,
	.legacy_interface_version = 1,
	.state_size = sizeof(observingconditions_state),
	.members = observingconditions_members,
	.member_count = sizeof(observingconditions_members) / sizeof(observingconditions_members[0]),
	.reset = observingconditions_reset,
	.control = observingconditions_control,
	.report = observingconditions_report
};
