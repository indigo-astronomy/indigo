// ASCOM Alpaca server simulator, FilterWheel
//
// Copyright (c) 2026 CloudMakers, s. r. o.
// All rights reserved.
//
// You can use this software under the terms of 'INDIGO Astronomy
// open-source license' (see LICENSE.md).
//
// THIS SOFTWARE IS PROVIDED BY THE AUTHORS 'AS IS' AND ANY EXPRESS
// OR IMPLIED WARRANTIES, INCLUDING, BUT NOT LIMITED TO, THE IMPLIED
// WARRANTIES OF MERCHANTABILITY AND FITNESS FOR A PARTICULAR PURPOSE
// ARE DISCLAIMED. IN NO EVENT SHALL THE AUTHOR BE LIABLE FOR ANY
// DIRECT, INDIRECT, INCIDENTAL, SPECIAL, EXEMPLARY, OR CONSEQUENTIAL
// DAMAGES (INCLUDING, BUT NOT LIMITED TO, PROCUREMENT OF SUBSTITUTE
// GOODS OR SERVICES; LOSS OF USE, DATA, OR PROFITS; OR BUSINESS
// INTERRUPTION) HOWEVER CAUSED AND ON ANY THEORY OF LIABILITY,
// WHETHER IN CONTRACT, STRICT LIABILITY, OR TORT (INCLUDING
// NEGLIGENCE OR OTHERWISE) ARISING IN ANY WAY OUT OF THE USE OF THIS
// SOFTWARE, EVEN IF ADVISED OF THE POSSIBILITY OF SUCH DAMAGE.

// Code is generated by AI

// This source file was generated by a Claude agent.

// IFilterWheelV3 (Platform 7), IFilterWheelV2 with interface=legacy.
// Position is 0-based and reads -1 while the wheel turns. The wheel needs
// SecondsPerSlot for every slot it passes.
// Behaviour the standard leaves to the device, selectable per device:
// - Bidirectional=false (default): the wheel turns in one direction only, so a
//   move to the previous slot goes all the way round. Bidirectional=true: it
//   takes the shorter way, like the ASCOM OmniSim filter wheel does.
// - PreemptMoves=true (default): a Position written while the wheel turns
//   replaces the target. PreemptMoves=false: it is refused with
//   InvalidOperation (the OmniSim setting of the same name).
// Control keys beyond the table: Names and FocusOffsets, lists separated by
// '|' whose length sets the number of slots, e.g. Names=L|R|G|B.

#include <stdio.h>
#include <stdlib.h>
#include <string.h>

#include "system_alpaca_simulator.h"

#define WHEEL_MAX_SLOTS 32

typedef struct {
	int slots;
	int position;
	int target;
	bool moving;
	double move_until;
	double seconds_per_slot;
	bool bidirectional;
	bool preempt_moves;
	char names[WHEEL_MAX_SLOTS][ALPACA_TEXT_SIZE];
	int focus_offsets[WHEEL_MAX_SLOTS];
} filterwheel_state;

static void filterwheel_reset(alpaca_device *device) {
	static const char *names[] = { "Luminance", "Red", "Green", "Blue", "H-Alpha", "OIII", "SII", "Dark" };
	static const int focus_offsets[] = { 0, 35, 12, -18, 140, 122, 151, 0 };
	filterwheel_state *state = device->state;
	state->slots = 8;
	state->seconds_per_slot = 1;
	state->preempt_moves = true;
	for (int i = 0; i < state->slots; i++) {
		snprintf(state->names[i], sizeof(state->names[i]), "%s", names[i]);
		state->focus_offsets[i] = focus_offsets[i];
	}
}

static void filterwheel_update(alpaca_device *device) {
	filterwheel_state *state = device->state;
	if (state->moving && alpaca_reached(state->move_until)) {
		state->moving = false;
		state->position = state->target;
		alpaca_event("STATE", "filterwheel/%d position=%d", device->number, state->position);
	}
}

static void filterwheel_get_names(alpaca_device *device, alpaca_request *request) {
	filterwheel_state *state = device->state;
	alpaca_buffer_append(&request->value, "[", 1);
	for (int i = 0; i < state->slots; i++) {
		alpaca_buffer_append(&request->value, ",", i ? 1 : 0);
		alpaca_buffer_json_string(&request->value, state->names[i]);
	}
	alpaca_buffer_append(&request->value, "]", 1);
	alpaca_reply_void(request);
}

static void filterwheel_get_focusoffsets(alpaca_device *device, alpaca_request *request) {
	filterwheel_state *state = device->state;
	alpaca_buffer_append(&request->value, "[", 1);
	for (int i = 0; i < state->slots; i++) {
		alpaca_buffer_printf(&request->value, "%s%d", i ? "," : "", state->focus_offsets[i]);
	}
	alpaca_buffer_append(&request->value, "]", 1);
	alpaca_reply_void(request);
}

static void filterwheel_get_position(alpaca_device *device, alpaca_request *request) {
	filterwheel_state *state = device->state;
	alpaca_reply_int(request, state->moving ? -1 : state->position);
}

static void filterwheel_put_position(alpaca_device *device, alpaca_request *request) {
	filterwheel_state *state = device->state;
	int position = 0;
	if (!alpaca_param_int(request, "Position", &position)) {
		return;
	}
	if (position < 0 || position >= state->slots) {
		alpaca_reply_error(request, ALPACA_ERROR_INVALID_VALUE, "Position %d is out of range 0..%d", position, state->slots - 1);
		return;
	}
	if (state->moving && !state->preempt_moves) {
		alpaca_reply_error(request, ALPACA_ERROR_INVALID_OPERATION, "The filter wheel is already moving");
		return;
	}
	int origin = state->moving ? state->target : state->position;
	int distance = (position - origin + state->slots) % state->slots;
	if (state->bidirectional && distance > state->slots - distance) {
		distance = state->slots - distance;
	}
	state->target = position;
	state->move_until = alpaca_now() + distance * state->seconds_per_slot;
	state->moving = !alpaca_reached(state->move_until);
	if (!state->moving) {
		state->position = position;
	}
	alpaca_event("MOVE", "filterwheel/%d from=%d to=%d duration=%.3f", device->number, origin, position, distance * state->seconds_per_slot);
	alpaca_reply_void(request);
}

static bool filterwheel_control(alpaca_device *device, const char *key, const char *value) {
	filterwheel_state *state = device->state;
	bool names = !strcmp(key, "Names");
	if (!names && strcmp(key, "FocusOffsets")) {
		return false;
	}
	char text[WHEEL_MAX_SLOTS * ALPACA_TEXT_SIZE];
	snprintf(text, sizeof(text), "%s", value);
	int count = 0;
	char *cursor = text;
	while (cursor != NULL && count < WHEEL_MAX_SLOTS) {
		char *next = strchr(cursor, '|');
		if (next != NULL) {
			*next++ = '\0';
		}
		if (names) {
			snprintf(state->names[count], sizeof(state->names[count]), "%s", cursor);
		} else if (!alpaca_parse_int(cursor, state->focus_offsets + count)) {
			return false;
		}
		count++;
		cursor = next;
	}
	for (int i = state->slots; i < count; i++) {
		if (names) {
			state->focus_offsets[i] = 0;
		} else {
			snprintf(state->names[i], sizeof(state->names[i]), "Filter %d", i + 1);
		}
	}
	state->slots = count;
	if (state->position >= count) {
		state->position = 0;
	}
	return true;
}

static void filterwheel_report(alpaca_device *device, alpaca_buffer *buffer) {
	filterwheel_state *state = device->state;
	alpaca_buffer names = { 0 };
	alpaca_buffer focus_offsets = { 0 };
	for (int i = 0; i < state->slots; i++) {
		alpaca_buffer_printf(&names, "%s%s", i ? "|" : "", state->names[i]);
		alpaca_buffer_printf(&focus_offsets, "%s%d", i ? "|" : "", state->focus_offsets[i]);
	}
	alpaca_buffer_field(buffer, "Names", "%s", names.data ? names.data : "");
	alpaca_buffer_field(buffer, "FocusOffsets", "%s", focus_offsets.data ? focus_offsets.data : "");
	alpaca_buffer_field(buffer, "Moving", "%s", state->moving ? "true" : "false");
	free(names.data);
	free(focus_offsets.data);
}

static const alpaca_member filterwheel_members[] = {
	{ .name = "FocusOffsets", .get = filterwheel_get_focusoffsets },
	{ .name = "Names", .get = filterwheel_get_names },
	{ .name = "Position", .kind = ALPACA_INT, .offset = offsetof(filterwheel_state, position), .flags = ALPACA_STATE, .get = filterwheel_get_position, .put = filterwheel_put_position },
	{ .name = "SecondsPerSlot", .kind = ALPACA_DOUBLE, .offset = offsetof(filterwheel_state, seconds_per_slot), .flags = ALPACA_CONFIG },
	{ .name = "Bidirectional", .kind = ALPACA_BOOL, .offset = offsetof(filterwheel_state, bidirectional), .flags = ALPACA_CONFIG },
	{ .name = "PreemptMoves", .kind = ALPACA_BOOL, .offset = offsetof(filterwheel_state, preempt_moves), .flags = ALPACA_CONFIG }
};

const alpaca_type alpaca_filterwheel_type = {
	.name = "FilterWheel",
	.interface_version = 3,
	.legacy_interface_version = 2,
	.state_size = sizeof(filterwheel_state),
	.members = filterwheel_members,
	.member_count = sizeof(filterwheel_members) / sizeof(filterwheel_members[0]),
	.reset = filterwheel_reset,
	.update = filterwheel_update,
	.control = filterwheel_control,
	.report = filterwheel_report
};
