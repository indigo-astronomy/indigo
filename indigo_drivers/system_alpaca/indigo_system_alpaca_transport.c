// Copyright (c) 2026 CloudMakers, s. r. o.
// All rights reserved.
//
// You can use this software under the terms of 'INDIGO Astronomy
// open-source license' (see LICENSE.md).
//
// THIS SOFTWARE IS PROVIDED BY THE AUTHORS 'AS IS' AND ANY EXPRESS
// OR IMPLIED WARRANTIES, INCLUDING, BUT NOT LIMITED TO, THE IMPLIED
// WARRANTIES OF MERCHANTABILITY AND FITNESS FOR A PARTICULAR PURPOSE
// ARE DISCLAIMED. IN NO EVENT SHALL THE AUTHOR BE LIABLE FOR ANY
// DIRECT, INDIRECT, INCIDENTAL, SPECIAL, EXEMPLARY, OR CONSEQUENTIAL
// DAMAGES (INCLUDING, BUT NOT LIMITED TO, PROCUREMENT OF SUBSTITUTE
// GOODS OR SERVICES; LOSS OF USE, DATA, OR PROFITS; OR BUSINESS
// INTERRUPTION) HOWEVER CAUSED AND ON ANY THEORY OF LIABILITY,
// WHETHER IN CONTRACT, STRICT LIABILITY, OR TORT (INCLUDING
// NEGLIGENCE OR OTHERWISE) ARISING IN ANY WAY OUT OF THE USE OF THIS
// SOFTWARE, EVEN IF ADVISED OF THE POSSIBILITY OF SUCH DAMAGE.

// version history
// 3.0 by Peter Polakovic <peter.polakovic@cloudmakers.eu>

// Code is generated by AI

/** INDIGO ASCOM Alpaca client driver, Alpaca transport layer
 \file indigo_system_alpaca_transport.c
 */

#include <stdarg.h>
#include <stdio.h>
#include <stdlib.h>
#include <string.h>
#include <time.h>

#include <indigo/indigo_driver.h>

#include "indigo_system_alpaca_transport.h"

#ifndef DRIVER_NAME
#define DRIVER_NAME												"indigo_system_alpaca"
#endif

#define ALPACA_PATH_SIZE									256
#define ALPACA_PARAMS_MAX_SIZE						65536
#define ALPACA_RETRY_DELAY								100000
#define ALPACA_NO_KEEP_ALIVE_LIMIT				3
#define ALPACA_ID_MISMATCH_LIMIT					3
#define ALPACA_MESSAGE_EXCERPT						160

struct alpaca_channel {
	alpaca_server *server;
	bool management;
	char device_type[ALPACA_TYPE_SIZE];
	int device_number;
	pthread_mutex_t mutex;
	alpaca_http_connection *connection;
	alpaca_http_response response;
	alpaca_http_buffer params;
	char path[ALPACA_PATH_SIZE];
	alpaca_json_value *document;
	const alpaca_json_value *value;
	int error_number;
	char error_message[ALPACA_TEXT_SIZE];
	int http_status;
	uint32_t transaction_id;
	int reconnects;
	bool no_keep_alive;
};

#pragma mark - helpers

static char alpaca_lower(char c) {
	return c >= 'A' && c <= 'Z' ? (char)(c - 'A' + 'a') : c;
}

static bool alpaca_same_name(const char *name, const char *other) {
	while (*name && alpaca_lower(*name) == alpaca_lower(*other)) {
		name++;
		other++;
	}
	return *name == 0 && *other == 0;
}

// Copy text into a buffer of size bytes; text that does not fit is cut at a UTF-8 character boundary.
static void alpaca_copy_text(char *target, size_t size, const char *source) {
	size_t length = source == NULL ? 0 : strlen(source);
	if (length >= size) {
		length = size - 1;
		while (length > 0 && ((unsigned char)source[length] & 0xC0) == 0x80) {
			length--;
		}
	}
	if (length > 0) {
		memcpy(target, source, length);
	}
	target[length] = 0;
}

// ClientID: random and never 0. The range 1 - 65535 is the one used by ASCOMLibrary, so it is safe for servers that parse the value as a 16 or signed 32 bit integer.
static uint32_t alpaca_random_client_id(const void *seed) {
	static uint32_t counter = 0;
	uint64_t value = (uint64_t)time(NULL) ^ (uint64_t)(indigo_monotonic_time() * 1e9) ^ (uint64_t)(uintptr_t)seed ^ ((uint64_t)++counter << 32);
	value ^= value >> 33;
	value *= 0xFF51AFD7ED558CCDULL;
	value ^= value >> 33;
	value *= 0xC4CEB9FE1A85EC53ULL;
	value ^= value >> 33;
	return (uint32_t)(value % 65535) + 1;
}

static alpaca_result alpaca_fail(alpaca_channel *channel, alpaca_result result, const char *format, ...) {
	va_list args;
	va_start(args, format);
	vsnprintf(channel->error_message, sizeof(channel->error_message), format, args);
	va_end(args);
	INDIGO_DRIVER_DEBUG(DRIVER_NAME, "%s:%d%s failed: %s (%s)", channel->server != NULL ? channel->server->host : "?", channel->server != NULL ? channel->server->port : 0, channel->path, alpaca_result_text(result), channel->error_message);
	return result;
}

static void alpaca_release(alpaca_channel *channel) {
	alpaca_json_free(channel->document);
	channel->document = NULL;
	channel->value = NULL;
	pthread_mutex_unlock(&channel->mutex);
}

#pragma mark - results

alpaca_result alpaca_error_result(int error_number) {
	switch (error_number) {
		case 0:
			return ALPACA_OK;
		case 0x400:
		case 0x40C:
			return ALPACA_UNSUPPORTED;
		case 0x401:
			return ALPACA_INVALID_VALUE;
		case 0x402:
			return ALPACA_VALUE_NOT_SET;
		case 0x407:
			return ALPACA_NOT_CONNECTED;
		case 0x408:
			return ALPACA_PARKED;
		case 0x409:
			return ALPACA_SLAVED;
		case 0x40B:
			return ALPACA_INVALID_OPERATION;
		case 0x40E:
			return ALPACA_CANCELLED;
		default:
			return ALPACA_DEVICE_ERROR;
	}
}

const char *alpaca_result_text(alpaca_result result) {
	switch (result) {
		case ALPACA_OK:
			return "OK";
		case ALPACA_UNSUPPORTED:
			return "not implemented by the device";
		case ALPACA_INVALID_VALUE:
			return "invalid value";
		case ALPACA_VALUE_NOT_SET:
			return "value not set";
		case ALPACA_NOT_CONNECTED:
			return "device is not connected";
		case ALPACA_PARKED:
			return "invalid while parked";
		case ALPACA_SLAVED:
			return "invalid while slaved";
		case ALPACA_INVALID_OPERATION:
			return "invalid operation";
		case ALPACA_CANCELLED:
			return "operation cancelled";
		case ALPACA_DEVICE_ERROR:
			return "device error";
		case ALPACA_REJECTED:
			return "request rejected by the server";
		case ALPACA_SERVER_ERROR:
			return "server error";
		case ALPACA_PROTOCOL_ERROR:
			return "invalid reply";
		case ALPACA_TIMED_OUT:
			return "timeout";
		case ALPACA_CONNECTION_LOST:
			return "connection lost";
		case ALPACA_UNREACHABLE:
			return "server is not reachable";
		case ALPACA_FAILED:
			return "request failed";
	}
	return "unknown result";
}

bool alpaca_is_unsupported(alpaca_result result) {
	return result == ALPACA_UNSUPPORTED || result == ALPACA_REJECTED;
}

bool alpaca_is_transport_error(alpaca_result result) {
	return result == ALPACA_TIMED_OUT || result == ALPACA_CONNECTION_LOST || result == ALPACA_UNREACHABLE;
}

bool alpaca_may_have_executed(alpaca_result result) {
	return result == ALPACA_TIMED_OUT || result == ALPACA_CONNECTION_LOST || result == ALPACA_PROTOCOL_ERROR || result == ALPACA_SERVER_ERROR;
}

static alpaca_result alpaca_http_result_to_result(alpaca_http_result result) {
	switch (result) {
		case ALPACA_HTTP_OK:
			return ALPACA_OK;
		case ALPACA_HTTP_INVALID_REQUEST:
			return ALPACA_FAILED;
		case ALPACA_HTTP_CONNECT_FAILED:
		case ALPACA_HTTP_CONNECT_TIMEOUT:
			return ALPACA_UNREACHABLE;
		case ALPACA_HTTP_FIRST_BYTE_TIMEOUT:
		case ALPACA_HTTP_TRANSFER_TIMEOUT:
			return ALPACA_TIMED_OUT;
		case ALPACA_HTTP_RESET:
		case ALPACA_HTTP_TRUNCATED:
			return ALPACA_CONNECTION_LOST;
		case ALPACA_HTTP_MALFORMED:
		case ALPACA_HTTP_TOO_LARGE:
			return ALPACA_PROTOCOL_ERROR;
	}
	return ALPACA_FAILED;
}

#pragma mark - servers and channels

alpaca_server *alpaca_server_create(const char *host, int port) {
	if (host == NULL || *host == 0 || strlen(host) >= ALPACA_HOST_SIZE || port < 1 || port > 65535) {
		return NULL;
	}
	alpaca_server *server = indigo_safe_malloc(sizeof(alpaca_server));
	alpaca_copy_text(server->host, sizeof(server->host), host);
	server->port = port;
	server->client_id = alpaca_random_client_id(server);
	server->transaction_id = 0;
	server->establish_timeout = ALPACA_ESTABLISH_TIMEOUT;
	server->standard_timeout = ALPACA_STANDARD_TIMEOUT;
	server->long_timeout = ALPACA_LONG_TIMEOUT;
	pthread_mutex_init(&server->mutex, NULL);
	return server;
}

void alpaca_server_free(alpaca_server *server) {
	if (server != NULL) {
		pthread_mutex_destroy(&server->mutex);
		indigo_safe_free(server);
	}
}

void alpaca_server_set_timeouts(alpaca_server *server, int establish_timeout, int standard_timeout, int long_timeout) {
	if (server != NULL) {
		pthread_mutex_lock(&server->mutex);
		if (establish_timeout > 0) {
			server->establish_timeout = establish_timeout;
		}
		if (standard_timeout > 0) {
			server->standard_timeout = standard_timeout;
		}
		if (long_timeout > 0) {
			server->long_timeout = long_timeout;
		}
		pthread_mutex_unlock(&server->mutex);
	}
}

static void alpaca_channel_set_target(alpaca_channel *channel, alpaca_server *server, const char *device_type, int device_number) {
	channel->server = server;
	channel->management = device_type == NULL;
	channel->device_number = device_number;
	alpaca_copy_text(channel->device_type, sizeof(channel->device_type), device_type);
	for (char *c = channel->device_type; *c; c++) {
		*c = alpaca_lower(*c);
	}
	channel->path[0] = 0;
	channel->reconnects = 0;
	channel->no_keep_alive = false;
}

alpaca_channel *alpaca_channel_create(alpaca_server *server, const char *device_type, int device_number, size_t max_body_size) {
	if (server == NULL) {
		return NULL;
	}
	alpaca_channel *channel = indigo_safe_malloc(sizeof(alpaca_channel));
	pthread_mutexattr_t attributes;
	pthread_mutexattr_init(&attributes);
	pthread_mutexattr_settype(&attributes, PTHREAD_MUTEX_RECURSIVE);
	pthread_mutex_init(&channel->mutex, &attributes);
	pthread_mutexattr_destroy(&attributes);
	alpaca_http_response_init(&channel->response, max_body_size);
	alpaca_http_buffer_init(&channel->params, ALPACA_PARAMS_MAX_SIZE);
	alpaca_channel_set_target(channel, server, device_type, device_number);
	return channel;
}

void alpaca_channel_bind(alpaca_channel *channel, alpaca_server *server, const char *device_type, int device_number) {
	if (channel != NULL && server != NULL) {
		pthread_mutex_lock(&channel->mutex);
		alpaca_http_connection_free(channel->connection);
		channel->connection = NULL;
		alpaca_channel_set_target(channel, server, device_type, device_number);
		pthread_mutex_unlock(&channel->mutex);
	}
}

void alpaca_channel_close(alpaca_channel *channel) {
	if (channel != NULL) {
		pthread_mutex_lock(&channel->mutex);
		if (channel->connection != NULL) {
			alpaca_http_connection_close(channel->connection);
		}
		pthread_mutex_unlock(&channel->mutex);
	}
}

void alpaca_channel_free(alpaca_channel *channel) {
	if (channel != NULL) {
		alpaca_http_connection_free(channel->connection);
		alpaca_http_response_free(&channel->response);
		alpaca_http_buffer_free(&channel->params);
		alpaca_json_free(channel->document);
		pthread_mutex_destroy(&channel->mutex);
		indigo_safe_free(channel);
	}
}

int alpaca_last_error_number(alpaca_channel *channel) {
	return channel != NULL ? channel->error_number : 0;
}

const char *alpaca_last_error_message(alpaca_channel *channel) {
	return channel != NULL ? channel->error_message : "";
}

int alpaca_last_http_status(alpaca_channel *channel) {
	return channel != NULL ? channel->http_status : 0;
}

uint32_t alpaca_last_transaction_id(alpaca_channel *channel) {
	return channel != NULL ? channel->transaction_id : 0;
}

#pragma mark - requests

static uint32_t alpaca_next_transaction_id(alpaca_server *server) {
	pthread_mutex_lock(&server->mutex);
	if (++server->transaction_id == 0) {
		server->transaction_id = 1;
	}
	uint32_t transaction_id = server->transaction_id;
	pthread_mutex_unlock(&server->mutex);
	return transaction_id;
}

// The ClientTransactionID policy is tolerant towards servers that do not implement the echo and strict towards replies that belong to another request:
// - A reply without ClientTransactionID, or with 0 or a value that is not an integer, is accepted. The specification tells a server to answer 0 when it
//   did not understand the value, and small embedded servers leave the member out.
// - A reply with the ClientTransactionID of the request is accepted.
// - A reply with any other value is rejected, because it is the answer to another request. Only one request is in flight on a channel, so this means a
//   confused server or proxy; the socket is closed to resynchronise.
// - A server that answers with a wrong value ALPACA_ID_MISMATCH_LIMIT times in a row, with no right one in between, does not implement the echo
//   (e.g. it always answers 1, or counts on its own). The reply that reaches the limit is accepted and from then on the values of that server
//   are ignored, so that such a server stays usable.
bool alpaca_accept_transaction_id(alpaca_channel *channel, uint32_t echo) {
	alpaca_server *server = channel->server;
	bool accept = true;
	if (echo == 0) {
		return true;
	}
	pthread_mutex_lock(&server->mutex);
	if (echo == channel->transaction_id) {
		server->id_matches++;
		server->id_mismatches = 0;
	} else if (!server->id_check_disabled) {
		if (++server->id_mismatches >= ALPACA_ID_MISMATCH_LIMIT) {
			server->id_check_disabled = true;
			INDIGO_DRIVER_ERROR(DRIVER_NAME, "%s:%d does not echo ClientTransactionID, the check is disabled for this server", server->host, server->port);
		} else {
			accept = false;
		}
	}
	pthread_mutex_unlock(&server->mutex);
	return accept;
}

static bool alpaca_build_path(alpaca_channel *channel, const char *member) {
	int length = channel->management ? snprintf(channel->path, sizeof(channel->path), "%s", member) : snprintf(channel->path, sizeof(channel->path), "/api/v1/%s/%d/%s", channel->device_type, channel->device_number, member);
	if (length < 0 || length >= (int)sizeof(channel->path) || *member == 0) {
		return false;
	}
	// all path elements are lower case
	for (char *c = channel->path; *c; c++) {
		*c = alpaca_lower(*c);
	}
	return true;
}

static bool alpaca_build_params(alpaca_channel *channel, const alpaca_param *params, int count) {
	alpaca_http_buffer *buffer = &channel->params;
	bool result = true;
	alpaca_http_buffer_clear(buffer);
	for (int i = 0; result && i < count; i++) {
		switch (params[i].type) {
			case ALPACA_PARAM_BOOL:
				result = alpaca_http_form_add_bool(buffer, params[i].name, params[i].boolean);
				break;
			case ALPACA_PARAM_INT:
				result = alpaca_http_form_add_int(buffer, params[i].name, params[i].integer);
				break;
			case ALPACA_PARAM_DOUBLE:
				result = alpaca_http_form_add_double(buffer, params[i].name, params[i].number);
				break;
			case ALPACA_PARAM_STRING:
				result = alpaca_http_form_add_string(buffer, params[i].name, params[i].text != NULL ? params[i].text : "");
				break;
		}
	}
	return result && alpaca_http_form_add_int(buffer, "ClientID", channel->server->client_id) && alpaca_http_form_add_int(buffer, "ClientTransactionID", channel->transaction_id);
}

// First line of an error body, for messages and logs, cut at a UTF-8 character boundary.
static void alpaca_copy_excerpt(char *target, size_t size, const alpaca_http_buffer *body) {
	size_t length = 0;
	while (body->data != NULL && length < body->size && length < size - 1 && length < ALPACA_MESSAGE_EXCERPT && (unsigned char)body->data[length] >= ' ') {
		length++;
	}
	while (length > 0 && length < body->size && ((unsigned char)body->data[length] & 0xC0) == 0x80) {
		length--;
	}
	if (length > 0) {
		memcpy(target, body->data, length);
	}
	target[length] = 0;
}

// Send one request and receive the HTTP response. The caller holds the lock of the channel.
//
// Retry policy (REFACTOR.md 2.3 and 7.1):
// - The HTTP client itself replaces a kept-alive socket that went stale and sends a replayable request once more when a reused socket fails
//   before the first byte of the response.
// - On top of that the request is sent a second time, 100 ms later, after a socket error: always when the connection was refused (nothing was sent),
//   and for a GET or a replayable PUT also when the connection was reset or closed in the middle of the reply.
// - A timeout is never retried: the caller already waited for the whole timeout and the device may still be executing the request.
// - A PUT that is not replayable is never sent twice once it may have reached the server. A server that was seen to close the connection after
//   every reply without announcing it gets such a PUT over a new connection, so that it can not be lost in a socket that is just being closed.
static alpaca_result alpaca_exchange(alpaca_channel *channel, bool put, const char *member, const alpaca_param *params, int count, int options, const char *accept) {
	alpaca_server *server = channel->server;
	alpaca_http_options http_options = { 0 };
	alpaca_http_result http_result = ALPACA_HTTP_OK;
	char headers[ALPACA_TEXT_SIZE];
	char excerpt[ALPACA_TEXT_SIZE];
	bool replayable = !put || (options & ALPACA_REPLAYABLE) != 0;
	int wait = options & ALPACA_WAIT_MASK;
	alpaca_json_free(channel->document);
	channel->document = NULL;
	channel->value = NULL;
	channel->error_number = 0;
	channel->error_message[0] = 0;
	channel->http_status = 0;
	channel->transaction_id = 0;
	if (member == NULL || (count > 0 && params == NULL) || !alpaca_build_path(channel, member)) {
		return alpaca_fail(channel, ALPACA_FAILED, "Invalid request");
	}
	if (channel->connection == NULL) {
		channel->connection = alpaca_http_connection_create(server->host, server->port);
		if (channel->connection == NULL) {
			return alpaca_fail(channel, ALPACA_FAILED, "Invalid server address");
		}
	}
	pthread_mutex_lock(&server->mutex);
	int first_byte_timeout = wait == ALPACA_WAIT_ESTABLISH ? server->establish_timeout : wait == ALPACA_WAIT_LONG ? server->long_timeout : server->standard_timeout;
	http_options.timeouts.connect = server->establish_timeout;
	http_options.timeouts.first_byte = first_byte_timeout;
	http_options.timeouts.inter_byte = server->standard_timeout;
	http_options.timeouts.total = server->establish_timeout + first_byte_timeout + (wait == ALPACA_WAIT_LONG ? server->long_timeout : server->standard_timeout);
	pthread_mutex_unlock(&server->mutex);
	http_options.replayable = replayable;
	if (accept != NULL) {
		snprintf(headers, sizeof(headers), "Accept: %s\r\n", accept);
		http_options.headers = headers;
	}
	if (!replayable && channel->no_keep_alive) {
		alpaca_http_connection_close(channel->connection);
	}
	for (int attempt = 0; attempt < 2; attempt++) {
		if (attempt > 0) {
			INDIGO_DRIVER_DEBUG(DRIVER_NAME, "%s:%d%s: %s, retrying", server->host, server->port, channel->path, alpaca_http_result_text(http_result));
			indigo_usleep(ALPACA_RETRY_DELAY);
		}
		channel->transaction_id = alpaca_next_transaction_id(server);
		if (!alpaca_build_params(channel, params, count)) {
			return alpaca_fail(channel, ALPACA_FAILED, "Invalid parameters");
		}
		unsigned connects = alpaca_http_connection_connects(channel->connection);
		http_result = put ? alpaca_http_put(channel->connection, channel->path, NULL, channel->params.data, &http_options, &channel->response) : alpaca_http_get(channel->connection, channel->path, channel->params.data, &http_options, &channel->response);
		if (http_result == ALPACA_HTTP_OK) {
			channel->reconnects = alpaca_http_connection_connects(channel->connection) != connects ? channel->reconnects + 1 : 0;
			channel->no_keep_alive = channel->reconnects >= ALPACA_NO_KEEP_ALIVE_LIMIT;
			break;
		}
		if (http_result != ALPACA_HTTP_CONNECT_FAILED && !(replayable && (http_result == ALPACA_HTTP_RESET || http_result == ALPACA_HTTP_TRUNCATED))) {
			break;
		}
	}
	channel->http_status = channel->response.status;
	if (http_result != ALPACA_HTTP_OK) {
		return alpaca_fail(channel, alpaca_http_result_to_result(http_result), "%s", alpaca_http_result_text(http_result));
	}
	if (channel->http_status == 200) {
		return ALPACA_OK;
	}
	alpaca_copy_excerpt(excerpt, sizeof(excerpt), &channel->response.body);
	return alpaca_fail(channel, channel->http_status == 400 || channel->http_status == 404 || channel->http_status == 405 ? ALPACA_REJECTED : ALPACA_SERVER_ERROR, "HTTP %d%s%s", channel->http_status, *excerpt ? ": " : "", excerpt);
}

// Parse the envelope of a reply with HTTP status 200: the echo of ClientTransactionID first, then ErrorNumber, and Value only if there is no error.
static alpaca_result alpaca_parse_envelope(alpaca_channel *channel) {
	char error[ALPACA_TEXT_SIZE] = { 0 };
	int64_t echo = 0;
	int64_t error_number = 0;
	const char *error_message = NULL;
	char message[ALPACA_MESSAGE_EXCERPT];
	if (channel->response.body.data == NULL || channel->response.body.size == 0) {
		return alpaca_fail(channel, ALPACA_PROTOCOL_ERROR, "Empty reply");
	}
	channel->document = alpaca_json_parse(channel->response.body.data, channel->response.body.size, error, sizeof(error));
	if (channel->document == NULL) {
		return alpaca_fail(channel, ALPACA_PROTOCOL_ERROR, "Malformed JSON (%s)", error);
	}
	if (alpaca_json_get_type(channel->document) != ALPACA_JSON_OBJECT) {
		return alpaca_fail(channel, ALPACA_PROTOCOL_ERROR, "Reply is not a JSON object");
	}
	if (alpaca_json_get_int(alpaca_json_get(channel->document, "ClientTransactionID"), &echo) && echo > 0 && echo <= UINT32_MAX && !alpaca_accept_transaction_id(channel, (uint32_t)echo)) {
		alpaca_http_connection_close(channel->connection);
		return alpaca_fail(channel, ALPACA_PROTOCOL_ERROR, "ClientTransactionID %u of the reply does not match %u of the request", (unsigned)echo, (unsigned)channel->transaction_id);
	}
	if (alpaca_json_get_int(alpaca_json_get(channel->document, "ErrorNumber"), &error_number) && error_number != 0) {
		alpaca_json_get_string(alpaca_json_get(channel->document, "ErrorMessage"), &error_message);
		channel->error_number = error_number > INT32_MAX || error_number < INT32_MIN ? 0x4FF : (int)error_number;
		alpaca_copy_text(message, sizeof(message), error_message != NULL && *error_message ? error_message : "No error message");
		return alpaca_fail(channel, alpaca_error_result(channel->error_number), "%s (0x%X)", message, (unsigned)channel->error_number);
	}
	channel->value = alpaca_json_get(channel->document, "Value");
	return ALPACA_OK;
}

// Complete request with an envelope. The caller holds the lock of the channel.
static alpaca_result alpaca_request(alpaca_channel *channel, bool put, const char *member, const alpaca_param *params, int count, int options, bool need_value) {
	alpaca_result result = alpaca_exchange(channel, put, member, params, count, options, NULL);
	if (result == ALPACA_OK) {
		result = alpaca_parse_envelope(channel);
	}
	if (result == ALPACA_OK && need_value && (channel->value == NULL || alpaca_json_is_null(channel->value))) {
		result = alpaca_fail(channel, ALPACA_PROTOCOL_ERROR, "Value is missing");
	}
	return result;
}

alpaca_result alpaca_get_bool(alpaca_channel *channel, const char *member, const alpaca_param *params, int count, int options, bool *value) {
	if (channel == NULL) {
		return ALPACA_UNREACHABLE;
	}
	pthread_mutex_lock(&channel->mutex);
	alpaca_result result = alpaca_request(channel, false, member, params, count, options, true);
	if (result == ALPACA_OK && !alpaca_json_get_bool(channel->value, value)) {
		result = alpaca_fail(channel, ALPACA_PROTOCOL_ERROR, "Value is not a boolean");
	}
	alpaca_release(channel);
	return result;
}

alpaca_result alpaca_get_int(alpaca_channel *channel, const char *member, const alpaca_param *params, int count, int options, int *value) {
	int64_t integer = 0;
	if (channel == NULL) {
		return ALPACA_UNREACHABLE;
	}
	pthread_mutex_lock(&channel->mutex);
	alpaca_result result = alpaca_request(channel, false, member, params, count, options, true);
	if (result == ALPACA_OK) {
		if (!alpaca_json_get_int(channel->value, &integer) || integer < INT32_MIN || integer > INT32_MAX) {
			result = alpaca_fail(channel, ALPACA_PROTOCOL_ERROR, "Value is not an integer");
		} else if (value != NULL) {
			*value = (int)integer;
		}
	}
	alpaca_release(channel);
	return result;
}

alpaca_result alpaca_get_double(alpaca_channel *channel, const char *member, const alpaca_param *params, int count, int options, double *value) {
	if (channel == NULL) {
		return ALPACA_UNREACHABLE;
	}
	pthread_mutex_lock(&channel->mutex);
	alpaca_result result = alpaca_request(channel, false, member, params, count, options, true);
	if (result == ALPACA_OK && !alpaca_json_get_double(channel->value, value)) {
		result = alpaca_fail(channel, ALPACA_PROTOCOL_ERROR, "Value is not a number");
	}
	alpaca_release(channel);
	return result;
}

alpaca_result alpaca_get_string(alpaca_channel *channel, const char *member, const alpaca_param *params, int count, int options, char *value, size_t size) {
	const char *text = NULL;
	if (channel == NULL) {
		return ALPACA_UNREACHABLE;
	}
	pthread_mutex_lock(&channel->mutex);
	alpaca_result result = alpaca_request(channel, false, member, params, count, options, true);
	if (result == ALPACA_OK) {
		if (!alpaca_json_get_string(channel->value, &text)) {
			result = alpaca_fail(channel, ALPACA_PROTOCOL_ERROR, "Value is not a string");
		} else if (value != NULL && size > 0) {
			alpaca_copy_text(value, size, text);
		}
	}
	alpaca_release(channel);
	return result;
}

alpaca_result alpaca_get_int_array(alpaca_channel *channel, const char *member, const alpaca_param *params, int count, int options, int *values, int max, int *item_count) {
	int stored = 0;
	if (channel == NULL) {
		return ALPACA_UNREACHABLE;
	}
	if (values == NULL || item_count == NULL) {
		return ALPACA_FAILED;
	}
	pthread_mutex_lock(&channel->mutex);
	alpaca_result result = alpaca_request(channel, false, member, params, count, options, true);
	if (result == ALPACA_OK && alpaca_json_get_type(channel->value) != ALPACA_JSON_ARRAY) {
		result = alpaca_fail(channel, ALPACA_PROTOCOL_ERROR, "Value is not an array");
	}
	for (const alpaca_json_value *item = alpaca_json_first(channel->value); result == ALPACA_OK && item != NULL; item = alpaca_json_next(item)) {
		int64_t integer = 0;
		if (!alpaca_json_get_int(item, &integer) || integer < INT32_MIN || integer > INT32_MAX) {
			result = alpaca_fail(channel, ALPACA_PROTOCOL_ERROR, "Value is not an array of integers");
		} else if (stored >= max) {
			result = alpaca_fail(channel, ALPACA_FAILED, "Value has more than %d items", max);
		} else {
			values[stored++] = (int)integer;
		}
	}
	*item_count = result == ALPACA_OK ? stored : 0;
	alpaca_release(channel);
	return result;
}

alpaca_result alpaca_get_double_array(alpaca_channel *channel, const char *member, const alpaca_param *params, int count, int options, double *values, int max, int *item_count) {
	int stored = 0;
	if (channel == NULL) {
		return ALPACA_UNREACHABLE;
	}
	if (values == NULL || item_count == NULL) {
		return ALPACA_FAILED;
	}
	pthread_mutex_lock(&channel->mutex);
	alpaca_result result = alpaca_request(channel, false, member, params, count, options, true);
	if (result == ALPACA_OK && alpaca_json_get_type(channel->value) != ALPACA_JSON_ARRAY) {
		result = alpaca_fail(channel, ALPACA_PROTOCOL_ERROR, "Value is not an array");
	}
	for (const alpaca_json_value *item = alpaca_json_first(channel->value); result == ALPACA_OK && item != NULL; item = alpaca_json_next(item)) {
		double number = 0;
		if (!alpaca_json_get_double(item, &number)) {
			result = alpaca_fail(channel, ALPACA_PROTOCOL_ERROR, "Value is not an array of numbers");
		} else if (stored >= max) {
			result = alpaca_fail(channel, ALPACA_FAILED, "Value has more than %d items", max);
		} else {
			values[stored++] = number;
		}
	}
	*item_count = result == ALPACA_OK ? stored : 0;
	alpaca_release(channel);
	return result;
}

alpaca_result alpaca_get_string_array(alpaca_channel *channel, const char *member, const alpaca_param *params, int count, int options, char *values, size_t item_size, int max, int *item_count) {
	int stored = 0;
	if (channel == NULL) {
		return ALPACA_UNREACHABLE;
	}
	if (values == NULL || item_size == 0 || item_count == NULL) {
		return ALPACA_FAILED;
	}
	pthread_mutex_lock(&channel->mutex);
	alpaca_result result = alpaca_request(channel, false, member, params, count, options, true);
	if (result == ALPACA_OK && alpaca_json_get_type(channel->value) != ALPACA_JSON_ARRAY) {
		result = alpaca_fail(channel, ALPACA_PROTOCOL_ERROR, "Value is not an array");
	}
	for (const alpaca_json_value *item = alpaca_json_first(channel->value); result == ALPACA_OK && item != NULL; item = alpaca_json_next(item)) {
		const char *text = NULL;
		if (!alpaca_json_get_string(item, &text)) {
			result = alpaca_fail(channel, ALPACA_PROTOCOL_ERROR, "Value is not an array of strings");
		} else if (stored >= max) {
			result = alpaca_fail(channel, ALPACA_FAILED, "Value has more than %d items", max);
		} else {
			alpaca_copy_text(values + (size_t)stored++ * item_size, item_size, text);
		}
	}
	*item_count = result == ALPACA_OK ? stored : 0;
	alpaca_release(channel);
	return result;
}

alpaca_result alpaca_get_value(alpaca_channel *channel, const char *member, const alpaca_param *params, int count, int options, const alpaca_json_value **value) {
	if (channel == NULL) {
		return ALPACA_UNREACHABLE;
	}
	pthread_mutex_lock(&channel->mutex);
	alpaca_result result = alpaca_request(channel, false, member, params, count, options, false);
	if (result != ALPACA_OK) {
		alpaca_release(channel);
		return result;
	}
	if (value != NULL) {
		*value = channel->value;
	}
	return ALPACA_OK;
}

alpaca_result alpaca_get_raw(alpaca_channel *channel, const char *member, const alpaca_param *params, int count, int options, const char *accept, const alpaca_http_response **response, uint32_t *transaction_id) {
	if (channel == NULL) {
		return ALPACA_UNREACHABLE;
	}
	if (response == NULL) {
		return ALPACA_FAILED;
	}
	pthread_mutex_lock(&channel->mutex);
	alpaca_result result = alpaca_exchange(channel, false, member, params, count, options, accept);
	if (result != ALPACA_OK) {
		alpaca_release(channel);
		return result;
	}
	*response = &channel->response;
	if (transaction_id != NULL) {
		*transaction_id = channel->transaction_id;
	}
	return ALPACA_OK;
}

alpaca_result alpaca_put(alpaca_channel *channel, const char *member, const alpaca_param *params, int count, int options) {
	if (channel == NULL) {
		return ALPACA_UNREACHABLE;
	}
	pthread_mutex_lock(&channel->mutex);
	alpaca_result result = alpaca_request(channel, true, member, params, count, options, false);
	alpaca_release(channel);
	return result;
}

alpaca_result alpaca_put_value(alpaca_channel *channel, const char *member, const alpaca_param *params, int count, int options, const alpaca_json_value **value) {
	if (channel == NULL) {
		return ALPACA_UNREACHABLE;
	}
	pthread_mutex_lock(&channel->mutex);
	alpaca_result result = alpaca_request(channel, true, member, params, count, options, false);
	if (result != ALPACA_OK) {
		alpaca_release(channel);
		return result;
	}
	if (value != NULL) {
		*value = channel->value;
	}
	return ALPACA_OK;
}

void alpaca_end(alpaca_channel *channel) {
	if (channel != NULL) {
		alpaca_release(channel);
	}
}

#pragma mark - common members

alpaca_result alpaca_put_connected(alpaca_channel *channel, bool connected) {
	alpaca_param params[] = { ALPACA_BOOL_PARAM("Connected", connected) };
	return alpaca_put(channel, "connected", params, 1, ALPACA_WAIT_ESTABLISH | ALPACA_REPLAYABLE);
}

alpaca_result alpaca_put_connect(alpaca_channel *channel) {
	return alpaca_put(channel, "connect", NULL, 0, ALPACA_WAIT_ESTABLISH | ALPACA_REPLAYABLE);
}

alpaca_result alpaca_put_disconnect(alpaca_channel *channel) {
	return alpaca_put(channel, "disconnect", NULL, 0, ALPACA_WAIT_ESTABLISH | ALPACA_REPLAYABLE);
}

alpaca_result alpaca_get_device_state(alpaca_channel *channel, alpaca_device_state *state) {
	if (state == NULL) {
		return ALPACA_FAILED;
	}
	state->count = 0;
	if (channel == NULL) {
		return ALPACA_UNREACHABLE;
	}
	pthread_mutex_lock(&channel->mutex);
	alpaca_result result = alpaca_request(channel, false, "devicestate", NULL, 0, ALPACA_WAIT_STANDARD, true);
	if (result == ALPACA_OK && alpaca_json_get_type(channel->value) != ALPACA_JSON_ARRAY) {
		result = alpaca_fail(channel, ALPACA_PROTOCOL_ERROR, "Value is not an array");
	}
	for (const alpaca_json_value *entry = alpaca_json_first(channel->value); result == ALPACA_OK && entry != NULL && state->count < ALPACA_MAX_STATE_ITEMS; entry = alpaca_json_next(entry)) {
		alpaca_state_item *item = state->items + state->count;
		const alpaca_json_value *value = alpaca_json_get(entry, "Value");
		const char *name = NULL;
		const char *text = NULL;
		if (!alpaca_json_get_string(alpaca_json_get(entry, "Name"), &name) || *name == 0) {
			continue;
		}
		item->type = alpaca_json_get_type(value);
		if (item->type == ALPACA_JSON_BOOL) {
			alpaca_json_get_bool(value, &item->boolean);
		} else if (item->type == ALPACA_JSON_NUMBER) {
			alpaca_json_get_double(value, &item->number);
		} else if (item->type == ALPACA_JSON_STRING) {
			alpaca_json_get_string(value, &text);
			alpaca_copy_text(item->text, sizeof(item->text), text);
		} else {
			continue;
		}
		alpaca_copy_text(item->name, sizeof(item->name), name);
		state->count++;
	}
	alpaca_release(channel);
	return result;
}

static const alpaca_state_item *alpaca_state_find(const alpaca_device_state *state, const char *name, alpaca_json_type type) {
	for (int i = 0; state != NULL && name != NULL && i < state->count; i++) {
		if (state->items[i].type == type && alpaca_same_name(state->items[i].name, name)) {
			return state->items + i;
		}
	}
	return NULL;
}

bool alpaca_state_bool(const alpaca_device_state *state, const char *name, bool *value) {
	const alpaca_state_item *item = alpaca_state_find(state, name, ALPACA_JSON_BOOL);
	if (item != NULL && value != NULL) {
		*value = item->boolean;
	}
	return item != NULL;
}

bool alpaca_state_int(const alpaca_device_state *state, const char *name, int *value) {
	const alpaca_state_item *item = alpaca_state_find(state, name, ALPACA_JSON_NUMBER);
	if (item == NULL || item->number < INT32_MIN || item->number > INT32_MAX || item->number != (double)(int)item->number) {
		return false;
	}
	if (value != NULL) {
		*value = (int)item->number;
	}
	return true;
}

bool alpaca_state_double(const alpaca_device_state *state, const char *name, double *value) {
	const alpaca_state_item *item = alpaca_state_find(state, name, ALPACA_JSON_NUMBER);
	if (item != NULL && value != NULL) {
		*value = item->number;
	}
	return item != NULL;
}

bool alpaca_state_string(const alpaca_device_state *state, const char *name, const char **value) {
	const alpaca_state_item *item = alpaca_state_find(state, name, ALPACA_JSON_STRING);
	if (item != NULL && value != NULL) {
		*value = item->text;
	}
	return item != NULL;
}

#pragma mark - management API

alpaca_result alpaca_get_api_versions(alpaca_channel *channel, int *versions, int max, int *item_count) {
	int stored = 0;
	if (channel == NULL || !channel->management || versions == NULL || item_count == NULL) {
		return ALPACA_FAILED;
	}
	pthread_mutex_lock(&channel->mutex);
	alpaca_result result = alpaca_request(channel, false, "/management/apiversions", NULL, 0, ALPACA_WAIT_ESTABLISH, true);
	if (result == ALPACA_OK && alpaca_json_get_type(channel->value) != ALPACA_JSON_ARRAY) {
		result = alpaca_fail(channel, ALPACA_PROTOCOL_ERROR, "Value is not an array");
	}
	for (const alpaca_json_value *item = alpaca_json_first(channel->value); result == ALPACA_OK && item != NULL && stored < max; item = alpaca_json_next(item)) {
		int64_t integer = 0;
		if (alpaca_json_get_int(item, &integer) && integer > 0 && integer <= INT32_MAX) {
			versions[stored++] = (int)integer;
		}
	}
	*item_count = result == ALPACA_OK ? stored : 0;
	alpaca_release(channel);
	return result;
}

static void alpaca_copy_member(const alpaca_json_value *object, const char *name, char *target, size_t size) {
	const char *text = NULL;
	alpaca_json_get_string(alpaca_json_get(object, name), &text);
	alpaca_copy_text(target, size, text);
}

alpaca_result alpaca_get_description(alpaca_channel *channel, alpaca_description *description) {
	if (channel == NULL || !channel->management || description == NULL) {
		return ALPACA_FAILED;
	}
	memset(description, 0, sizeof(alpaca_description));
	pthread_mutex_lock(&channel->mutex);
	alpaca_result result = alpaca_request(channel, false, "/management/v1/description", NULL, 0, ALPACA_WAIT_ESTABLISH, true);
	if (result == ALPACA_OK && alpaca_json_get_type(channel->value) != ALPACA_JSON_OBJECT) {
		result = alpaca_fail(channel, ALPACA_PROTOCOL_ERROR, "Value is not an object");
	}
	if (result == ALPACA_OK) {
		alpaca_copy_member(channel->value, "ServerName", description->server_name, sizeof(description->server_name));
		alpaca_copy_member(channel->value, "Manufacturer", description->manufacturer, sizeof(description->manufacturer));
		alpaca_copy_member(channel->value, "ManufacturerVersion", description->manufacturer_version, sizeof(description->manufacturer_version));
		alpaca_copy_member(channel->value, "Location", description->location, sizeof(description->location));
	}
	alpaca_release(channel);
	return result;
}

alpaca_result alpaca_get_configured_devices(alpaca_channel *channel, alpaca_configured_device *devices, int max, int *item_count) {
	int stored = 0;
	if (channel == NULL || !channel->management || devices == NULL || item_count == NULL) {
		return ALPACA_FAILED;
	}
	pthread_mutex_lock(&channel->mutex);
	alpaca_result result = alpaca_request(channel, false, "/management/v1/configureddevices", NULL, 0, ALPACA_WAIT_ESTABLISH, true);
	if (result == ALPACA_OK && alpaca_json_get_type(channel->value) != ALPACA_JSON_ARRAY) {
		result = alpaca_fail(channel, ALPACA_PROTOCOL_ERROR, "Value is not an array");
	}
	for (const alpaca_json_value *item = alpaca_json_first(channel->value); result == ALPACA_OK && item != NULL && stored < max; item = alpaca_json_next(item)) {
		alpaca_configured_device *device = devices + stored;
		int64_t number = 0;
		memset(device, 0, sizeof(alpaca_configured_device));
		alpaca_copy_member(item, "DeviceType", device->device_type, sizeof(device->device_type));
		if (*device->device_type == 0 || !alpaca_json_get_int(alpaca_json_get(item, "DeviceNumber"), &number) || number < 0 || number > INT32_MAX) {
			continue;
		}
		device->device_number = (int)number;
		alpaca_copy_member(item, "DeviceName", device->device_name, sizeof(device->device_name));
		alpaca_copy_member(item, "UniqueID", device->unique_id, sizeof(device->unique_id));
		stored++;
	}
	*item_count = result == ALPACA_OK ? stored : 0;
	alpaca_release(channel);
	return result;
}

#pragma mark - discovery and addresses

bool alpaca_parse_discovery_reply(const char *reply, long length, int *port) {
	int64_t value = 0;
	if (reply == NULL || length <= 0) {
		return false;
	}
	alpaca_json_value *document = alpaca_json_parse(reply, (size_t)length, NULL, 0);
	bool result = alpaca_json_get_type(document) == ALPACA_JSON_OBJECT && alpaca_json_get_int(alpaca_json_get(document, "AlpacaPort"), &value) && value >= 1 && value <= 65535;
	alpaca_json_free(document);
	if (result && port != NULL) {
		*port = (int)value;
	}
	return result;
}

bool alpaca_parse_endpoint(const char *text, int default_port, char *host, size_t host_size, int *port) {
	const char *port_text = NULL;
	size_t host_length = 0;
	long value = default_port;
	char *end = NULL;
	if (text == NULL || host == NULL || host_size == 0 || port == NULL) {
		return false;
	}
	while (*text == ' ') {
		text++;
	}
	if (!strncmp(text, "http://", 7)) {
		text += 7;
	}
	size_t length = strlen(text);
	while (length > 0 && (text[length - 1] == ' ' || text[length - 1] == '/')) {
		length--;
	}
	if (*text == '[') {
		const char *bracket = memchr(text, ']', length);
		if (bracket == NULL) {
			return false;
		}
		host_length = (size_t)(bracket - text - 1);
		text++;
		length -= host_length + 2;
		if (length > 0) {
			if (bracket[1] != ':') {
				return false;
			}
			port_text = bracket + 2;
			length--;
		}
	} else {
		const char *colon = memchr(text, ':', length);
		// more than one colon is an IPv6 address without brackets, which can not carry a port
		if (colon != NULL && memchr(colon + 1, ':', length - (size_t)(colon + 1 - text)) == NULL) {
			host_length = (size_t)(colon - text);
			port_text = colon + 1;
			length -= host_length + 1;
		} else {
			host_length = length;
			length = 0;
		}
	}
	if (host_length == 0 || host_length >= host_size || host_length >= ALPACA_HOST_SIZE) {
		return false;
	}
	for (size_t i = 0; i < host_length; i++) {
		if ((unsigned char)text[i] <= ' ' || text[i] == '/' || text[i] == '?' || text[i] == '#' || text[i] == '@') {
			return false;
		}
	}
	if (port_text != NULL) {
		if (length == 0 || length > 5 || *port_text < '0' || *port_text > '9') {
			return false;
		}
		value = strtol(port_text, &end, 10);
		if (end != port_text + length) {
			return false;
		}
	}
	if (value < 1 || value > 65535) {
		return false;
	}
	memcpy(host, text, host_length);
	host[host_length] = 0;
	*port = (int)value;
	return true;
}
