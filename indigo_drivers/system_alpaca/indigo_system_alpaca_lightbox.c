// Copyright (c) 2026 CloudMakers, s. r. o.
// All rights reserved.
//
// You can use this software under the terms of 'INDIGO Astronomy
// open-source license' (see LICENSE.md).
//
// THIS SOFTWARE IS PROVIDED BY THE AUTHORS 'AS IS' AND ANY EXPRESS
// OR IMPLIED WARRANTIES, INCLUDING, BUT NOT LIMITED TO, THE IMPLIED
// WARRANTIES OF MERCHANTABILITY AND FITNESS FOR A PARTICULAR PURPOSE
// ARE DISCLAIMED. IN NO EVENT SHALL THE AUTHOR BE LIABLE FOR ANY
// DIRECT, INDIRECT, INCIDENTAL, SPECIAL, EXEMPLARY, OR CONSEQUENTIAL
// DAMAGES (INCLUDING, BUT NOT LIMITED TO, PROCUREMENT OF SUBSTITUTE
// GOODS OR SERVICES; LOSS OF USE, DATA, OR PROFITS; OR BUSINESS
// INTERRUPTION) HOWEVER CAUSED AND ON ANY THEORY OF LIABILITY,
// WHETHER IN CONTRACT, STRICT LIABILITY, OR TORT (INCLUDING
// NEGLIGENCE OR OTHERWISE) ARISING IN ANY WAY OUT OF THE USE OF THIS
// SOFTWARE, EVEN IF ADVISED OF THE POSSIBILITY OF SUCH DAMAGE.

// version history
// 3.0 by Peter Polakovic <peter.polakovic@cloudmakers.eu>

// Code is generated by AI

/** INDIGO ASCOM Alpaca client driver, CoverCalibrator device class: Alpaca CoverCalibrator as an INDIGO light box and dust cap
 \file indigo_system_alpaca_lightbox.c

 An Alpaca CoverCalibrator is a dust cover, a flat field light source or both. Which parts exist is read on every connect
 from CoverState and CalibratorState (NotPresent):

 - cover: AUX_COVER (OPEN, CLOSE) and X_ALPACA_COVER_ABORT_MOTION (HaltCover);
 - calibrator: AUX_LIGHT_SWITCH (ON, OFF) and AUX_LIGHT_INTENSITY (0 to MaxBrightness in the units of the device; hidden if
   MaxBrightness is 1 or less, the light is then simply on or off).

 INFO.DEVICE_INTERFACE is INDIGO_INTERFACE_AUX_LIGHTBOX before the first connection, afterwards it has the light box bit for a
 calibrator and the dust cap bit for a cover.

 Completion follows the Alpaca specification: from interface version 2 on a cover move ends when CoverMoving becomes false and
 a change of the calibrator when CalibratorChanging becomes false; older devices are watched through CoverState (Moving) and
 CalibratorState (NotReady). Both use the handler + finalizer pattern; nothing waits in a handler.

 AUX_COVER, AUX_LIGHT_SWITCH and AUX_LIGHT_INTENSITY are accepted while they are BUSY, too. A request for the other direction
 while the cover moves stops the cover (HaltCover, if the device can do that) and sends it the other way; a new brightness while
 the light stabilises is sent at once. The brightness of a light that is off is only remembered and used when it is switched on,
 because Alpaca reports Brightness 0 while the calibrator is off.

 Nothing is stopped on disconnect: a cover that is moving finishes its move, a light that is on stays on.

 While the state of the device can not be read (the device answers the polling with an error) AUX_COVER and AUX_LIGHT_SWITCH are in
 ALERT with what was read last, unless a request or a move owns them; they are OK again with the first state that is read.

 Threads: change_property runs on a bus thread, everything else on the handler queue of the device. The three properties that are
 accepted while they are BUSY are written by both sides, so both do it under the lock of the device, together with the number of
 requests that wait for their handler: the polling and the end of a move leave a property alone while a request for it waits.
 */

#pragma mark - Includes

#include <stdlib.h>
#include <string.h>
#include <stdint.h>
#include <assert.h>

#include <indigo/indigo_aux_driver.h>

#include "indigo_system_alpaca_private.h"

#pragma mark - Property definitions

#define LIGHTBOX_DATA																	((lightbox_data *)CLASS_DATA)

#define AUX_COVER_PROPERTY														(LIGHTBOX_DATA->aux_cover_property)
#define AUX_COVER_OPEN_ITEM														(AUX_COVER_PROPERTY->items + 0)
#define AUX_COVER_CLOSE_ITEM													(AUX_COVER_PROPERTY->items + 1)

#define AUX_LIGHT_SWITCH_PROPERTY											(LIGHTBOX_DATA->aux_light_switch_property)
#define AUX_LIGHT_SWITCH_ON_ITEM											(AUX_LIGHT_SWITCH_PROPERTY->items + 0)
#define AUX_LIGHT_SWITCH_OFF_ITEM											(AUX_LIGHT_SWITCH_PROPERTY->items + 1)

#define AUX_LIGHT_INTENSITY_PROPERTY									(LIGHTBOX_DATA->aux_light_intensity_property)
#define AUX_LIGHT_INTENSITY_ITEM											(AUX_LIGHT_INTENSITY_PROPERTY->items + 0)

#define X_ALPACA_COVER_ABORT_MOTION_PROPERTY					(LIGHTBOX_DATA->x_alpaca_cover_abort_motion_property)
#define X_ALPACA_COVER_ABORT_MOTION_ITEM							(X_ALPACA_COVER_ABORT_MOTION_PROPERTY->items + 0)

#define X_ALPACA_COVER_ABORT_MOTION_PROPERTY_NAME			"X_ALPACA_COVER_ABORT_MOTION"
#define X_ALPACA_COVER_ABORT_MOTION_ITEM_NAME					"ABORT_MOTION"

#pragma mark - Private data definition

/** Alpaca CoverState.
 */
#define LIGHTBOX_COVER_NOT_PRESENT										0
#define LIGHTBOX_COVER_CLOSED													1
#define LIGHTBOX_COVER_MOVING													2
#define LIGHTBOX_COVER_OPEN														3
#define LIGHTBOX_COVER_UNKNOWN												4
#define LIGHTBOX_COVER_ERROR													5

/** Alpaca CalibratorState.
 */
#define LIGHTBOX_CALIBRATOR_NOT_PRESENT								0
#define LIGHTBOX_CALIBRATOR_OFF												1
#define LIGHTBOX_CALIBRATOR_NOT_READY									2
#define LIGHTBOX_CALIBRATOR_READY											3
#define LIGHTBOX_CALIBRATOR_UNKNOWN										4
#define LIGHTBOX_CALIBRATOR_ERROR											5

/** A state that is no state of the device: nothing is shown yet.
 */
#define LIGHTBOX_NOT_SHOWN														(-1)

/** Longest time in seconds a cover move and the stabilisation of the calibrator may take.
 */
#define LIGHTBOX_COVER_TIMEOUT												300
#define LIGHTBOX_CALIBRATOR_TIMEOUT										300

typedef struct {
	indigo_property *aux_cover_property;
	indigo_property *aux_light_switch_property;
	indigo_property *aux_light_intensity_property;
	indigo_property *x_alpaca_cover_abort_motion_property;
	alpaca_operation cover;
	alpaca_operation calibrator;
	bool cover_open;										///< direction of the running cover move
	bool light_on;											///< the light is on or is being switched on
	int brightness_sent;								///< Brightness of the running change of the calibrator
	int max_brightness;
	int cover_state;										///< last CoverState read from the device
	int cover_shown;										///< CoverState AUX_COVER shows
	int calibrator_state;								///< last CalibratorState read from the device
	int calibrator_shown;								///< CalibratorState AUX_LIGHT_SWITCH shows
	int brightness;											///< last Brightness read from the device
	int cover_pending;									///< requests of AUX_COVER that were accepted and whose handler did not run yet; guarded by the lock of the device
	int calibrator_pending;							///< the same for AUX_LIGHT_SWITCH and AUX_LIGHT_INTENSITY
} lightbox_data;

/** Operational state of the device, read member by member or from DeviceState.
 */
typedef struct {
	int cover;
	int calibrator;
	int brightness;
} lightbox_status;

#pragma mark - Low level code

static void lightbox_cover_finalizer(indigo_device *device);
static void lightbox_calibrator_finalizer(indigo_device *device);

// Read the state of the parts the device has. Inside on_poll the values come from DeviceState where it has them.
static alpaca_result lightbox_read_status(indigo_device *device, lightbox_status *status) {
	alpaca_result result = ALPACA_OK;
	status->cover = LIGHTBOX_COVER_NOT_PRESENT;
	status->calibrator = LIGHTBOX_CALIBRATOR_NOT_PRESENT;
	status->brightness = 0;
	if (!AUX_COVER_PROPERTY->hidden) {
		result = system_alpaca_state_int(device, "CoverState", &status->cover);
	}
	if (result == ALPACA_OK && !AUX_LIGHT_SWITCH_PROPERTY->hidden) {
		result = system_alpaca_state_int(device, "CalibratorState", &status->calibrator);
	}
	if (result == ALPACA_OK && !AUX_LIGHT_SWITCH_PROPERTY->hidden) {
		result = system_alpaca_state_int(device, "Brightness", &status->brightness);
		if (alpaca_is_unsupported(result)) {
			// a device without Brightness is on with the brightness it was sent, or off
			status->brightness = status->calibrator == LIGHTBOX_CALIBRATOR_OFF ? 0 : LIGHTBOX_DATA->brightness_sent;
			result = ALPACA_OK;
		}
	}
	return result;
}

// Completion of a cover move: CoverMoving from interface version 2 on, CoverState of older devices.
static alpaca_result lightbox_cover_moving(indigo_device *device, bool *moving) {
	int state = LIGHTBOX_COVER_UNKNOWN;
	if (PRIVATE_DATA->interface_version >= 2 && system_alpaca_supported(device, "covermoving")) {
		alpaca_result result = system_alpaca_get_bool(device, "covermoving", moving);
		if (!alpaca_is_unsupported(result)) {
			return result;
		}
		system_alpaca_set_unsupported(device, "covermoving");
	}
	alpaca_result result = system_alpaca_get_int(device, "coverstate", &state);
	*moving = state == LIGHTBOX_COVER_MOVING;
	return result;
}

// Completion of a change of the calibrator: CalibratorChanging from interface version 2 on, CalibratorState of older devices.
static alpaca_result lightbox_calibrator_changing(indigo_device *device, bool *changing) {
	int state = LIGHTBOX_CALIBRATOR_UNKNOWN;
	if (PRIVATE_DATA->interface_version >= 2 && system_alpaca_supported(device, "calibratorchanging")) {
		alpaca_result result = system_alpaca_get_bool(device, "calibratorchanging", changing);
		if (!alpaca_is_unsupported(result)) {
			return result;
		}
		system_alpaca_set_unsupported(device, "calibratorchanging");
	}
	alpaca_result result = system_alpaca_get_int(device, "calibratorstate", &state);
	*changing = state == LIGHTBOX_CALIBRATOR_NOT_READY;
	return result;
}

// Select an item of a switch that shows the state of the device. indigo_set_switch() marks the property as changed even if the item
// is selected already, and the property would then be published on every poll tick.
static void lightbox_select(indigo_property *property, indigo_item *item) {
	if (!item->sw.value) {
		indigo_set_switch(property, item, true);
	}
}

// Show a CoverState on AUX_COVER. A request that failed stays in ALERT until the cover reports another state.
// Called with the lock of the device held.
static void lightbox_apply_cover(indigo_device *device, int state) {
	switch (state) {
		case LIGHTBOX_COVER_CLOSED:
			lightbox_select(AUX_COVER_PROPERTY, AUX_COVER_CLOSE_ITEM);
			break;
		case LIGHTBOX_COVER_OPEN:
			lightbox_select(AUX_COVER_PROPERTY, AUX_COVER_OPEN_ITEM);
			break;
		case LIGHTBOX_COVER_MOVING:
			// the state does not tell where the cover is going
			break;
		case LIGHTBOX_COVER_UNKNOWN:
		case LIGHTBOX_COVER_ERROR:
			// neither open nor closed is known
			indigo_set_switch(AUX_COVER_PROPERTY, AUX_COVER_OPEN_ITEM, false);
			indigo_set_switch(AUX_COVER_PROPERTY, AUX_COVER_CLOSE_ITEM, false);
			break;
		default:
			return;
	}
	if (state == LIGHTBOX_COVER_UNKNOWN || state == LIGHTBOX_COVER_ERROR) {
		AUX_COVER_PROPERTY->state = INDIGO_ALERT_STATE;
	} else if (state == LIGHTBOX_COVER_MOVING) {
		AUX_COVER_PROPERTY->state = INDIGO_BUSY_STATE;
	} else if (AUX_COVER_PROPERTY->state == INDIGO_BUSY_STATE || state != LIGHTBOX_DATA->cover_shown) {
		AUX_COVER_PROPERTY->state = INDIGO_OK_STATE;
	}
	LIGHTBOX_DATA->cover_shown = state;
}

// Show a CalibratorState and the Brightness on AUX_LIGHT_SWITCH and AUX_LIGHT_INTENSITY. A request that failed stays in ALERT until
// the calibrator reports another state. Called with the lock of the device held.
static void lightbox_apply_calibrator(indigo_device *device, int state, int brightness) {
	bool on = state == LIGHTBOX_CALIBRATOR_READY || (state == LIGHTBOX_CALIBRATOR_NOT_READY && brightness > 0);
	switch (state) {
		case LIGHTBOX_CALIBRATOR_OFF:
			lightbox_select(AUX_LIGHT_SWITCH_PROPERTY, AUX_LIGHT_SWITCH_OFF_ITEM);
			LIGHTBOX_DATA->light_on = false;
			break;
		case LIGHTBOX_CALIBRATOR_READY:
		case LIGHTBOX_CALIBRATOR_NOT_READY:
			if (on) {
				lightbox_select(AUX_LIGHT_SWITCH_PROPERTY, AUX_LIGHT_SWITCH_ON_ITEM);
				LIGHTBOX_DATA->light_on = true;
			}
			break;
		case LIGHTBOX_CALIBRATOR_UNKNOWN:
		case LIGHTBOX_CALIBRATOR_ERROR:
			break;
		default:
			return;
	}
	if (state == LIGHTBOX_CALIBRATOR_UNKNOWN || state == LIGHTBOX_CALIBRATOR_ERROR) {
		AUX_LIGHT_SWITCH_PROPERTY->state = INDIGO_ALERT_STATE;
	} else if (state == LIGHTBOX_CALIBRATOR_NOT_READY) {
		AUX_LIGHT_SWITCH_PROPERTY->state = INDIGO_BUSY_STATE;
	} else if (AUX_LIGHT_SWITCH_PROPERTY->state == INDIGO_BUSY_STATE || state != LIGHTBOX_DATA->calibrator_shown) {
		AUX_LIGHT_SWITCH_PROPERTY->state = INDIGO_OK_STATE;
	}
	if (on) {
		// Brightness is 0 while the calibrator is off, the intensity then keeps the value for the next time it is switched on
		AUX_LIGHT_INTENSITY_ITEM->number.value = brightness;
		if (LIGHTBOX_DATA->calibrator_pending == 0) {
			// what is shown is what the light is switched on with the next time, unless a request for another intensity waits for its handler
			AUX_LIGHT_INTENSITY_ITEM->number.target = brightness;
		}
	}
	if (on && state == LIGHTBOX_CALIBRATOR_NOT_READY) {
		AUX_LIGHT_INTENSITY_PROPERTY->state = INDIGO_BUSY_STATE;
	} else if (AUX_LIGHT_INTENSITY_PROPERTY->state == INDIGO_BUSY_STATE || state != LIGHTBOX_DATA->calibrator_shown) {
		AUX_LIGHT_INTENSITY_PROPERTY->state = INDIGO_OK_STATE;
	}
	LIGHTBOX_DATA->calibrator_shown = state;
}

// Put the state of the device into the properties without publishing them. A property with a request that is waiting for its
// handler or for its finalizer belongs to that request and is left alone. It is done in one step under the lock of the device,
// so a request that is accepted meanwhile either finds its property untouched or is seen as waiting here.
static void lightbox_apply_status(indigo_device *device, const lightbox_status *status) {
	LIGHTBOX_DATA->cover_state = status->cover;
	LIGHTBOX_DATA->calibrator_state = status->calibrator;
	LIGHTBOX_DATA->brightness = status->brightness;
	system_alpaca_lock(device);
	if (!AUX_COVER_PROPERTY->hidden && !LIGHTBOX_DATA->cover.active && LIGHTBOX_DATA->cover_pending == 0) {
		lightbox_apply_cover(device, status->cover);
	}
	if (!AUX_LIGHT_SWITCH_PROPERTY->hidden && !LIGHTBOX_DATA->calibrator.active && LIGHTBOX_DATA->calibrator_pending == 0) {
		lightbox_apply_calibrator(device, status->calibrator, status->brightness);
	}
	system_alpaca_unlock(device);
}

// The device answers the polling and does not tell its state: what the properties show is not the state of the device any more.
// A property that a request or a move owns is left alone. The properties are OK again when the state is read, see lightbox_apply_cover()
// and lightbox_apply_calibrator().
static void lightbox_status_unreadable(indigo_device *device, alpaca_result result, const char *reason) {
	system_alpaca_lock(device);
	bool cover = !AUX_COVER_PROPERTY->hidden && !LIGHTBOX_DATA->cover.active && LIGHTBOX_DATA->cover_pending == 0 && AUX_COVER_PROPERTY->state == INDIGO_OK_STATE;
	bool calibrator = !AUX_LIGHT_SWITCH_PROPERTY->hidden && !LIGHTBOX_DATA->calibrator.active && LIGHTBOX_DATA->calibrator_pending == 0 && AUX_LIGHT_SWITCH_PROPERTY->state == INDIGO_OK_STATE;
	if (cover) {
		AUX_COVER_PROPERTY->state = INDIGO_ALERT_STATE;
		LIGHTBOX_DATA->cover_shown = LIGHTBOX_NOT_SHOWN;
	}
	if (calibrator) {
		AUX_LIGHT_SWITCH_PROPERTY->state = INDIGO_ALERT_STATE;
		LIGHTBOX_DATA->calibrator_shown = LIGHTBOX_NOT_SHOWN;
	}
	system_alpaca_unlock(device);
	if (cover) {
		system_alpaca_report(device, AUX_COVER_PROPERTY, result, "Reading the state of the cover", reason);
	}
	if (calibrator) {
		system_alpaca_report(device, AUX_LIGHT_SWITCH_PROPERTY, result, "Reading the state of the calibrator", reason);
	}
}

// Publish the state of the device; a property that did not change is not sent again.
static void lightbox_show_status(indigo_device *device, const lightbox_status *status) {
	lightbox_apply_status(device, status);
	indigo_update_property(device, AUX_COVER_PROPERTY, NULL);
	indigo_update_property(device, AUX_LIGHT_SWITCH_PROPERTY, NULL);
	indigo_update_property(device, AUX_LIGHT_INTENSITY_PROPERTY, NULL);
}

// HaltCover is not implemented: the movement of this cover can not be interrupted, so there is nothing to abort it with.
static void lightbox_no_halt(indigo_device *device) {
	system_alpaca_set_unsupported(device, "haltcover");
	indigo_delete_property(device, X_ALPACA_COVER_ABORT_MOTION_PROPERTY, NULL);
	X_ALPACA_COVER_ABORT_MOTION_PROPERTY->hidden = true;
}

// Send CalibratorOn with the requested intensity or CalibratorOff and watch the calibrator until it is stable.
// property is the one the request came through; it gets the message if the request fails.
static void lightbox_calibrator_start(indigo_device *device, bool on, indigo_property *property) {
	char reason[INDIGO_VALUE_SIZE];
	int brightness = 0;
	if (on) {
		system_alpaca_lock(device);
		brightness = AUX_LIGHT_INTENSITY_PROPERTY->hidden ? (LIGHTBOX_DATA->max_brightness > 0 ? LIGHTBOX_DATA->max_brightness : 1) : (int)(AUX_LIGHT_INTENSITY_ITEM->number.target + 0.5);
		system_alpaca_unlock(device);
	}
	if (LIGHTBOX_DATA->calibrator.active && LIGHTBOX_DATA->light_on == on && LIGHTBOX_DATA->brightness_sent == brightness) {
		// the calibrator is on its way there already
		return;
	}
	alpaca_param params[] = { ALPACA_INT_PARAM("Brightness", brightness) };
	alpaca_result result = on ? system_alpaca_put(device, "calibratoron", params, 1, ALPACA_WAIT_LONG | ALPACA_REPLAYABLE) : system_alpaca_put(device, "calibratoroff", NULL, 0, ALPACA_WAIT_LONG | ALPACA_REPLAYABLE);
	system_alpaca_reason(device, result, reason, sizeof(reason));
	if (result == ALPACA_OK) {
		LIGHTBOX_DATA->light_on = on;
		LIGHTBOX_DATA->brightness_sent = brightness;
		system_alpaca_lock(device);
		indigo_set_switch(AUX_LIGHT_SWITCH_PROPERTY, on ? AUX_LIGHT_SWITCH_ON_ITEM : AUX_LIGHT_SWITCH_OFF_ITEM, true);
		AUX_LIGHT_SWITCH_PROPERTY->state = INDIGO_BUSY_STATE;
		AUX_LIGHT_INTENSITY_PROPERTY->state = on ? INDIGO_BUSY_STATE : INDIGO_OK_STATE;
		system_alpaca_unlock(device);
		indigo_update_property(device, AUX_LIGHT_SWITCH_PROPERTY, NULL);
		indigo_update_property(device, AUX_LIGHT_INTENSITY_PROPERTY, NULL);
		indigo_cancel_pending_handler(device, lightbox_calibrator_finalizer);
		system_alpaca_operation_start(device, &LIGHTBOX_DATA->calibrator, LIGHTBOX_CALIBRATOR_TIMEOUT, lightbox_calibrator_finalizer);
		return;
	}
	system_alpaca_lock(device);
	// the calibrator did not take the request: the intensity goes back to what the device has, unless the next request is waiting already
	if (LIGHTBOX_DATA->calibrator_pending == 0) {
		AUX_LIGHT_INTENSITY_ITEM->number.target = AUX_LIGHT_INTENSITY_ITEM->number.value;
	}
	if (LIGHTBOX_DATA->calibrator.active) {
		// the running change goes on
		indigo_set_switch(AUX_LIGHT_SWITCH_PROPERTY, LIGHTBOX_DATA->light_on ? AUX_LIGHT_SWITCH_ON_ITEM : AUX_LIGHT_SWITCH_OFF_ITEM, true);
		AUX_LIGHT_SWITCH_PROPERTY->state = AUX_LIGHT_INTENSITY_PROPERTY->state = INDIGO_BUSY_STATE;
		system_alpaca_unlock(device);
		indigo_update_property(device, AUX_LIGHT_SWITCH_PROPERTY, NULL);
		indigo_update_property(device, AUX_LIGHT_INTENSITY_PROPERTY, NULL);
		indigo_send_message(device, ALERT_PROPERTY, "Calibrator %s failed: %s", on ? "on" : "off", alpaca_result_text(result));
		return;
	}
	LIGHTBOX_DATA->calibrator_shown = LIGHTBOX_NOT_SHOWN;
	lightbox_apply_calibrator(device, LIGHTBOX_DATA->calibrator_state, LIGHTBOX_DATA->brightness);
	system_alpaca_unlock(device);
	indigo_update_property(device, AUX_LIGHT_SWITCH_PROPERTY, NULL);
	indigo_update_property(device, AUX_LIGHT_INTENSITY_PROPERTY, NULL);
	system_alpaca_finish_with(device, property, result, on ? "Calibrator on" : "Calibrator off", reason);
	if (system_alpaca_not_implemented(result, on ? 1 : 0)) {
		// the device says it has a calibrator and does not implement its methods: there is nothing to control
		// (HTTP 400 to CalibratorOn may as well mean that the server did not like the brightness)
		system_alpaca_set_unsupported(device, on ? "calibratoron" : "calibratoroff");
		indigo_delete_property(device, AUX_LIGHT_SWITCH_PROPERTY, NULL);
		indigo_delete_property(device, AUX_LIGHT_INTENSITY_PROPERTY, NULL);
		AUX_LIGHT_SWITCH_PROPERTY->hidden = AUX_LIGHT_INTENSITY_PROPERTY->hidden = true;
	}
}

#pragma mark - High level code (lightbox)

static void lightbox_cover_finalizer(indigo_device *device) {
	int state = LIGHTBOX_COVER_UNKNOWN;
	bool moving = false;
	if (!system_alpaca_is_active(device)) {
		return;
	}
	alpaca_result result = lightbox_cover_moving(device, &moving);
	if (result == ALPACA_OK && moving && system_alpaca_operation_continue(device, &LIGHTBOX_DATA->cover, lightbox_cover_finalizer)) {
		return;
	}
	system_alpaca_operation_end(device, &LIGHTBOX_DATA->cover);
	if (result == ALPACA_OK && !moving) {
		result = system_alpaca_get_int(device, "coverstate", &state);
	}
	if (result == ALPACA_OK && !moving) {
		bool arrived = state == (LIGHTBOX_DATA->cover_open ? LIGHTBOX_COVER_OPEN : LIGHTBOX_COVER_CLOSED);
		LIGHTBOX_DATA->cover_state = state;
		// the end of the move is put into the property in one step with the look at the waiting requests
		system_alpaca_lock(device);
		bool superseded = LIGHTBOX_DATA->cover_pending > 0;
		if (!superseded) {
			lightbox_apply_cover(device, state);
			if (!arrived) {
				AUX_COVER_PROPERTY->state = INDIGO_ALERT_STATE;
			}
		}
		system_alpaca_unlock(device);
		if (superseded) {
			// the next request is accepted already and AUX_COVER shows it: its handler goes on from here
			return;
		}
		if (arrived) {
			indigo_update_property(device, AUX_COVER_PROPERTY, NULL);
		} else {
			indigo_update_property(device, AUX_COVER_PROPERTY, "%s cover failed: %s", LIGHTBOX_DATA->cover_open ? "Open" : "Close", state == LIGHTBOX_COVER_ERROR ? "the cover reports an error" : "the cover stopped");
		}
	} else {
		// a request that waits for its handler owns AUX_COVER: the failure of the running move is told, the state is left to that request
		char reason[INDIGO_VALUE_SIZE];
		system_alpaca_reason(device, result, reason, sizeof(reason));
		system_alpaca_lock(device);
		bool superseded = LIGHTBOX_DATA->cover_pending > 0;
		if (!superseded) {
			AUX_COVER_PROPERTY->state = INDIGO_ALERT_STATE;
		}
		system_alpaca_unlock(device);
		system_alpaca_report(device, AUX_COVER_PROPERTY, result == ALPACA_OK ? ALPACA_TIMED_OUT : result, LIGHTBOX_DATA->cover_open ? "Open cover" : "Close cover", reason);
	}
}

static void lightbox_calibrator_finalizer(indigo_device *device) {
	int state = LIGHTBOX_CALIBRATOR_UNKNOWN, brightness = LIGHTBOX_DATA->brightness_sent;
	bool changing = false, on = LIGHTBOX_DATA->light_on;
	if (!system_alpaca_is_active(device)) {
		return;
	}
	alpaca_result result = lightbox_calibrator_changing(device, &changing);
	if (result == ALPACA_OK && changing && system_alpaca_operation_continue(device, &LIGHTBOX_DATA->calibrator, lightbox_calibrator_finalizer)) {
		return;
	}
	system_alpaca_operation_end(device, &LIGHTBOX_DATA->calibrator);
	if (result == ALPACA_OK && !changing) {
		result = system_alpaca_get_int(device, "calibratorstate", &state);
	}
	if (result == ALPACA_OK && !changing) {
		// the brightness the device really has is the one that is published
		result = system_alpaca_get_int(device, "brightness", &brightness);
		if (alpaca_is_unsupported(result)) {
			brightness = LIGHTBOX_DATA->brightness_sent;
			result = ALPACA_OK;
		}
	}
	if (result == ALPACA_OK && !changing) {
		bool arrived = state == (on ? LIGHTBOX_CALIBRATOR_READY : LIGHTBOX_CALIBRATOR_OFF);
		LIGHTBOX_DATA->calibrator_state = state;
		LIGHTBOX_DATA->brightness = brightness;
		// the end of the change is put into the properties in one step with the look at the waiting requests
		system_alpaca_lock(device);
		bool superseded = LIGHTBOX_DATA->calibrator_pending > 0;
		if (!superseded) {
			lightbox_apply_calibrator(device, state, brightness);
			if (!arrived) {
				AUX_LIGHT_SWITCH_PROPERTY->state = INDIGO_ALERT_STATE;
			}
		}
		system_alpaca_unlock(device);
		if (superseded) {
			// the next request is accepted already and the properties show it: its handler goes on from here
			return;
		}
		if (arrived) {
			indigo_update_property(device, AUX_LIGHT_SWITCH_PROPERTY, NULL);
		} else {
			// what was asked for is named, not what the calibrator turned out to be
			indigo_update_property(device, AUX_LIGHT_SWITCH_PROPERTY, "Calibrator %s failed: %s", on ? "on" : "off", state == LIGHTBOX_CALIBRATOR_ERROR ? "the calibrator reports an error" : "the calibrator is in another state");
		}
		indigo_update_property(device, AUX_LIGHT_INTENSITY_PROPERTY, NULL);
	} else {
		// a request that waits for its handler owns AUX_LIGHT_SWITCH and AUX_LIGHT_INTENSITY: the failure of the running change is told,
		// the states are left to that request
		char reason[INDIGO_VALUE_SIZE];
		system_alpaca_reason(device, result, reason, sizeof(reason));
		system_alpaca_lock(device);
		bool superseded = LIGHTBOX_DATA->calibrator_pending > 0;
		if (!superseded) {
			AUX_LIGHT_SWITCH_PROPERTY->state = AUX_LIGHT_INTENSITY_PROPERTY->state = INDIGO_ALERT_STATE;
		}
		system_alpaca_unlock(device);
		if (!superseded) {
			indigo_update_property(device, AUX_LIGHT_INTENSITY_PROPERTY, NULL);
		}
		system_alpaca_report(device, AUX_LIGHT_SWITCH_PROPERTY, result == ALPACA_OK ? ALPACA_TIMED_OUT : result, on ? "Calibrator on" : "Calibrator off", reason);
	}
}

// AUX_COVER shows a move in the given direction. A request that waits for its handler has put its own direction there already.
static void lightbox_show_cover_move(indigo_device *device, bool open) {
	system_alpaca_lock(device);
	if (LIGHTBOX_DATA->cover_pending == 0) {
		indigo_set_switch(AUX_COVER_PROPERTY, open ? AUX_COVER_OPEN_ITEM : AUX_COVER_CLOSE_ITEM, true);
	}
	AUX_COVER_PROPERTY->state = INDIGO_BUSY_STATE;
	system_alpaca_unlock(device);
}

static void lightbox_aux_cover_handler(indigo_device *device, void *data) {
	bool open = data != NULL;
	const char *member = open ? "opencover" : "closecover";
	char reason[INDIGO_VALUE_SIZE] = { 0 };
	int state = LIGHTBOX_COVER_UNKNOWN;
	system_alpaca_lock(device);
	LIGHTBOX_DATA->cover_pending--;
	system_alpaca_unlock(device);
	if (!system_alpaca_is_active(device)) {
		return;
	}
	if (LIGHTBOX_DATA->cover.active && LIGHTBOX_DATA->cover_open == open) {
		// the cover is on its way there already
		return;
	}
	if (LIGHTBOX_DATA->cover.active && system_alpaca_supported(device, "haltcover")) {
		// a request for the other direction replaces the running move: the cover is stopped before it is sent back
		if (system_alpaca_not_implemented(system_alpaca_put(device, "haltcover", NULL, 0, ALPACA_REPLAYABLE), 0)) {
			lightbox_no_halt(device);
		}
	}
	alpaca_result result = system_alpaca_put(device, member, NULL, 0, ALPACA_WAIT_LONG);
	system_alpaca_reason(device, result, reason, sizeof(reason));
	if (alpaca_may_have_executed(result) && system_alpaca_get_int(device, "coverstate", &state) == ALPACA_OK && (state == LIGHTBOX_COVER_MOVING || state == (open ? LIGHTBOX_COVER_OPEN : LIGHTBOX_COVER_CLOSED))) {
		// the request failed on the way, but the cover does what it was asked for
		result = ALPACA_OK;
	}
	if (result == ALPACA_OK) {
		LIGHTBOX_DATA->cover_open = open;
		lightbox_show_cover_move(device, open);
		indigo_update_property(device, AUX_COVER_PROPERTY, NULL);
		indigo_cancel_pending_handler(device, lightbox_cover_finalizer);
		system_alpaca_operation_start(device, &LIGHTBOX_DATA->cover, LIGHTBOX_COVER_TIMEOUT, lightbox_cover_finalizer);
	} else if (LIGHTBOX_DATA->cover.active) {
		// the finalizer of the running move tells where the cover ended
		lightbox_show_cover_move(device, LIGHTBOX_DATA->cover_open);
		indigo_update_property(device, AUX_COVER_PROPERTY, "%s cover failed: %s%s%s%s", open ? "Open" : "Close", alpaca_result_text(result), *reason ? " (" : "", reason, *reason ? ")" : "");
	} else {
		system_alpaca_lock(device);
		LIGHTBOX_DATA->cover_shown = LIGHTBOX_NOT_SHOWN;
		lightbox_apply_cover(device, LIGHTBOX_DATA->cover_state);
		system_alpaca_unlock(device);
		system_alpaca_finish_with(device, AUX_COVER_PROPERTY, result, open ? "Open cover" : "Close cover", reason);
		if (system_alpaca_not_implemented(result, 0)) {
			// the device says it has a cover and does not implement its methods: there is nothing to control
			system_alpaca_set_unsupported(device, member);
			indigo_delete_property(device, AUX_COVER_PROPERTY, NULL);
			indigo_delete_property(device, X_ALPACA_COVER_ABORT_MOTION_PROPERTY, NULL);
			AUX_COVER_PROPERTY->hidden = X_ALPACA_COVER_ABORT_MOTION_PROPERTY->hidden = true;
		}
	}
}

static void lightbox_x_alpaca_cover_abort_motion_handler(indigo_device *device) {
	char reason[INDIGO_VALUE_SIZE] = { 0 };
	int state = LIGHTBOX_COVER_UNKNOWN;
	alpaca_result result = ALPACA_OK;
	if (!system_alpaca_is_active(device)) {
		return;
	}
	if (X_ALPACA_COVER_ABORT_MOTION_ITEM->sw.value) {
		X_ALPACA_COVER_ABORT_MOTION_ITEM->sw.value = false;
		result = system_alpaca_put(device, "haltcover", NULL, 0, ALPACA_REPLAYABLE);
		system_alpaca_reason(device, result, reason, sizeof(reason));
		if (result == ALPACA_OK) {
			// the move is over, wherever the cover is now
			indigo_cancel_pending_handler(device, lightbox_cover_finalizer);
			system_alpaca_operation_end(device, &LIGHTBOX_DATA->cover);
			system_alpaca_lock(device);
			bool idle = LIGHTBOX_DATA->cover_pending == 0;
			system_alpaca_unlock(device);
			// a request that waits for its handler owns AUX_COVER; one that arrives while the cover is asked does, too
			if (idle && system_alpaca_get_int(device, "coverstate", &state) == ALPACA_OK) {
				LIGHTBOX_DATA->cover_state = state;
				system_alpaca_lock(device);
				idle = LIGHTBOX_DATA->cover_pending == 0;
				if (idle) {
					lightbox_apply_cover(device, state);
				}
				system_alpaca_unlock(device);
				if (idle) {
					indigo_update_property(device, AUX_COVER_PROPERTY, NULL);
				}
			}
		}
	}
	system_alpaca_finish_with(device, X_ALPACA_COVER_ABORT_MOTION_PROPERTY, result, "Halt cover", reason);
	if (system_alpaca_not_implemented(result, 0)) {
		lightbox_no_halt(device);
	}
}

static void lightbox_aux_light_switch_handler(indigo_device *device, void *data) {
	system_alpaca_lock(device);
	LIGHTBOX_DATA->calibrator_pending--;
	system_alpaca_unlock(device);
	if (!system_alpaca_is_active(device)) {
		return;
	}
	lightbox_calibrator_start(device, data != NULL, AUX_LIGHT_SWITCH_PROPERTY);
}

static void lightbox_aux_light_intensity_handler(indigo_device *device) {
	system_alpaca_lock(device);
	LIGHTBOX_DATA->calibrator_pending--;
	system_alpaca_unlock(device);
	if (!system_alpaca_is_active(device)) {
		return;
	}
	if (LIGHTBOX_DATA->light_on) {
		// a new brightness of a light that is on is CalibratorOn again
		lightbox_calibrator_start(device, true, AUX_LIGHT_INTENSITY_PROPERTY);
	} else {
		// The intensity of a light that is off is kept for the next time it is switched on. A change of the calibrator whose finalizer
		// found this request waiting left AUX_LIGHT_SWITCH to it: it is ended here with what that finalizer read from the device.
		system_alpaca_lock(device);
		bool end_switch = !LIGHTBOX_DATA->calibrator.active && LIGHTBOX_DATA->calibrator_pending == 0 && AUX_LIGHT_SWITCH_PROPERTY->state == INDIGO_BUSY_STATE;
		bool arrived = LIGHTBOX_DATA->calibrator_state == LIGHTBOX_CALIBRATOR_OFF;
		double intensity = AUX_LIGHT_INTENSITY_ITEM->number.target;
		if (end_switch) {
			lightbox_apply_calibrator(device, LIGHTBOX_DATA->calibrator_state, LIGHTBOX_DATA->brightness);
			if (!arrived) {
				AUX_LIGHT_SWITCH_PROPERTY->state = INDIGO_ALERT_STATE;
			}
		}
		if (!LIGHTBOX_DATA->light_on) {
			AUX_LIGHT_INTENSITY_ITEM->number.value = AUX_LIGHT_INTENSITY_ITEM->number.target = intensity;
		}
		AUX_LIGHT_INTENSITY_PROPERTY->state = INDIGO_OK_STATE;
		system_alpaca_unlock(device);
		if (end_switch && arrived) {
			indigo_update_property(device, AUX_LIGHT_SWITCH_PROPERTY, NULL);
		} else if (end_switch) {
			indigo_update_property(device, AUX_LIGHT_SWITCH_PROPERTY, "Calibrator off failed: %s", LIGHTBOX_DATA->calibrator_state == LIGHTBOX_CALIBRATOR_ERROR ? "the calibrator reports an error" : "the calibrator is in another state");
		}
		indigo_update_property(device, AUX_LIGHT_INTENSITY_PROPERTY, NULL);
	}
}

#pragma mark - Hooks

static bool lightbox_on_probe(indigo_device *device) {
	int cover = LIGHTBOX_COVER_NOT_PRESENT, calibrator = LIGHTBOX_CALIBRATOR_NOT_PRESENT, max_brightness = 0;
	// a part is missing if its state is NotPresent, or if the device does not even have the state
	alpaca_result result = system_alpaca_get_int(device, "coverstate", &cover);
	if (result != ALPACA_OK && !alpaca_is_unsupported(result)) {
		return false;
	}
	result = system_alpaca_get_int(device, "calibratorstate", &calibrator);
	if (result != ALPACA_OK && !alpaca_is_unsupported(result)) {
		return false;
	}
	if (calibrator != LIGHTBOX_CALIBRATOR_NOT_PRESENT) {
		result = system_alpaca_get_int(device, "maxbrightness", &max_brightness);
		if (result != ALPACA_OK && !alpaca_is_unsupported(result)) {
			return false;
		}
	}
	LIGHTBOX_DATA->cover_state = cover;
	LIGHTBOX_DATA->calibrator_state = calibrator;
	LIGHTBOX_DATA->max_brightness = max_brightness;
	return true;
}

static bool lightbox_on_connect(indigo_device *device) {
	lightbox_status status = { 0 };
	bool cover = LIGHTBOX_DATA->cover_state != LIGHTBOX_COVER_NOT_PRESENT, calibrator = LIGHTBOX_DATA->calibrator_state != LIGHTBOX_CALIBRATOR_NOT_PRESENT;
	// everything the last connection left behind is forgotten, the device may be another one now
	system_alpaca_lock(device);
	LIGHTBOX_DATA->cover_pending = LIGHTBOX_DATA->calibrator_pending = 0;
	LIGHTBOX_DATA->cover_shown = LIGHTBOX_DATA->calibrator_shown = LIGHTBOX_NOT_SHOWN;
	LIGHTBOX_DATA->light_on = false;
	LIGHTBOX_DATA->brightness_sent = 0;
	AUX_COVER_PROPERTY->hidden = X_ALPACA_COVER_ABORT_MOTION_PROPERTY->hidden = !cover;
	AUX_LIGHT_SWITCH_PROPERTY->hidden = !calibrator;
	AUX_LIGHT_INTENSITY_PROPERTY->hidden = !calibrator || LIGHTBOX_DATA->max_brightness <= 1;
	AUX_COVER_PROPERTY->state = AUX_LIGHT_SWITCH_PROPERTY->state = AUX_LIGHT_INTENSITY_PROPERTY->state = X_ALPACA_COVER_ABORT_MOTION_PROPERTY->state = INDIGO_OK_STATE;
	X_ALPACA_COVER_ABORT_MOTION_ITEM->sw.value = false;
	system_alpaca_unlock(device);
	if (lightbox_read_status(device, &status) != ALPACA_OK) {
		return false;
	}
	system_alpaca_lock(device);
	if (calibrator) {
		AUX_LIGHT_INTENSITY_ITEM->number.max = LIGHTBOX_DATA->max_brightness > 0 ? LIGHTBOX_DATA->max_brightness : 1;
		if (AUX_LIGHT_INTENSITY_ITEM->number.value <= 0 || AUX_LIGHT_INTENSITY_ITEM->number.value > AUX_LIGHT_INTENSITY_ITEM->number.max) {
			// a light that is off has no brightness: the one for the next time it is switched on starts at the maximum
			AUX_LIGHT_INTENSITY_ITEM->number.value = AUX_LIGHT_INTENSITY_ITEM->number.max;
		}
	}
	lightbox_apply_status(device, &status);
	AUX_LIGHT_INTENSITY_ITEM->number.target = AUX_LIGHT_INTENSITY_ITEM->number.value;
	system_alpaca_unlock(device);
	// the interface tells what the device is: a light box, a dust cap or both
	snprintf(INFO_DEVICE_INTERFACE_ITEM->text.value, INDIGO_VALUE_SIZE, "%d", INDIGO_INTERFACE_AUX | (calibrator ? INDIGO_INTERFACE_AUX_LIGHTBOX : 0) | (cover ? INDIGO_INTERFACE_AUX_DUSTCAP : 0));
	indigo_update_property(device, INFO_PROPERTY, NULL);
	indigo_define_property(device, AUX_COVER_PROPERTY, NULL);
	indigo_define_property(device, X_ALPACA_COVER_ABORT_MOTION_PROPERTY, NULL);
	indigo_define_property(device, AUX_LIGHT_SWITCH_PROPERTY, NULL);
	indigo_define_property(device, AUX_LIGHT_INTENSITY_PROPERTY, NULL);
	return true;
}

static void lightbox_on_disconnect(indigo_device *device) {
	// nothing is stopped: a cover that is moving finishes its move, a light that is on stays on
	system_alpaca_operation_end(device, &LIGHTBOX_DATA->cover);
	system_alpaca_operation_end(device, &LIGHTBOX_DATA->calibrator);
	indigo_delete_property(device, AUX_COVER_PROPERTY, NULL);
	indigo_delete_property(device, X_ALPACA_COVER_ABORT_MOTION_PROPERTY, NULL);
	indigo_delete_property(device, AUX_LIGHT_SWITCH_PROPERTY, NULL);
	indigo_delete_property(device, AUX_LIGHT_INTENSITY_PROPERTY, NULL);
}

static void lightbox_on_poll(indigo_device *device) {
	char reason[INDIGO_VALUE_SIZE];
	lightbox_status status = { 0 };
	alpaca_result result = lightbox_read_status(device, &status);
	system_alpaca_reason(device, result, reason, sizeof(reason));
	if (result == ALPACA_OK) {
		lightbox_show_status(device, &status);
	} else if (!alpaca_is_transport_error(result)) {
		lightbox_status_unreadable(device, result, reason);
	}
}

#pragma mark - Device API (lightbox)

static indigo_result lightbox_enumerate_properties(indigo_device *device, indigo_client *client, indigo_property *property);

static indigo_result lightbox_attach(indigo_device *device) {
	assert(device != NULL);
	if (indigo_aux_attach(device, DRIVER_NAME, DRIVER_VERSION, INDIGO_INTERFACE_AUX_LIGHTBOX) == INDIGO_OK) {
		AUX_COVER_PROPERTY = indigo_init_switch_property(NULL, device->name, AUX_COVER_PROPERTY_NAME, AUX_MAIN_GROUP, "Cover", INDIGO_OK_STATE, INDIGO_RW_PERM, INDIGO_ONE_OF_MANY_RULE, 2);
		if (AUX_COVER_PROPERTY == NULL) {
			return INDIGO_FAILED;
		}
		indigo_init_switch_item(AUX_COVER_OPEN_ITEM, AUX_COVER_OPEN_ITEM_NAME, "Open", false);
		indigo_init_switch_item(AUX_COVER_CLOSE_ITEM, AUX_COVER_CLOSE_ITEM_NAME, "Close", true);
		X_ALPACA_COVER_ABORT_MOTION_PROPERTY = indigo_init_switch_property(NULL, device->name, X_ALPACA_COVER_ABORT_MOTION_PROPERTY_NAME, AUX_MAIN_GROUP, "Abort cover motion", INDIGO_OK_STATE, INDIGO_RW_PERM, INDIGO_AT_MOST_ONE_RULE, 1);
		if (X_ALPACA_COVER_ABORT_MOTION_PROPERTY == NULL) {
			return INDIGO_FAILED;
		}
		indigo_init_switch_item(X_ALPACA_COVER_ABORT_MOTION_ITEM, X_ALPACA_COVER_ABORT_MOTION_ITEM_NAME, "Abort motion", false);
		AUX_LIGHT_SWITCH_PROPERTY = indigo_init_switch_property(NULL, device->name, AUX_LIGHT_SWITCH_PROPERTY_NAME, AUX_MAIN_GROUP, "Light (on/off)", INDIGO_OK_STATE, INDIGO_RW_PERM, INDIGO_ONE_OF_MANY_RULE, 2);
		if (AUX_LIGHT_SWITCH_PROPERTY == NULL) {
			return INDIGO_FAILED;
		}
		indigo_init_switch_item(AUX_LIGHT_SWITCH_ON_ITEM, AUX_LIGHT_SWITCH_ON_ITEM_NAME, "On", false);
		indigo_init_switch_item(AUX_LIGHT_SWITCH_OFF_ITEM, AUX_LIGHT_SWITCH_OFF_ITEM_NAME, "Off", true);
		AUX_LIGHT_INTENSITY_PROPERTY = indigo_init_number_property(NULL, device->name, AUX_LIGHT_INTENSITY_PROPERTY_NAME, AUX_MAIN_GROUP, "Light intensity", INDIGO_OK_STATE, INDIGO_RW_PERM, 1);
		if (AUX_LIGHT_INTENSITY_PROPERTY == NULL) {
			return INDIGO_FAILED;
		}
		indigo_init_number_item(AUX_LIGHT_INTENSITY_ITEM, AUX_LIGHT_INTENSITY_ITEM_NAME, "Intensity", 0, 1, 1, 0);
		INDIGO_COPY_VALUE(AUX_LIGHT_INTENSITY_ITEM->number.format, "%g");
		return system_alpaca_attach(device) == INDIGO_OK ? lightbox_enumerate_properties(device, NULL, NULL) : INDIGO_FAILED;
	}
	return INDIGO_FAILED;
}

static indigo_result lightbox_enumerate_properties(indigo_device *device, indigo_client *client, indigo_property *property) {
	if (system_alpaca_is_active(device)) {
		INDIGO_DEFINE_MATCHING_PROPERTY(AUX_COVER_PROPERTY);
		INDIGO_DEFINE_MATCHING_PROPERTY(X_ALPACA_COVER_ABORT_MOTION_PROPERTY);
		INDIGO_DEFINE_MATCHING_PROPERTY(AUX_LIGHT_SWITCH_PROPERTY);
		INDIGO_DEFINE_MATCHING_PROPERTY(AUX_LIGHT_INTENSITY_PROPERTY);
	}
	return indigo_aux_enumerate_properties(device, client, property);
}

static indigo_result lightbox_change_property(indigo_device *device, indigo_client *client, indigo_property *property) {
	if (system_alpaca_change_property(device, property)) {
		return INDIGO_OK;
	}
	if (indigo_property_match_changeable(AUX_COVER_PROPERTY, property)) {
		// accepted while the cover moves as well, see lightbox_aux_cover_handler()
		bool open = indigo_get_switch(property, AUX_COVER_OPEN_ITEM_NAME);
		system_alpaca_lock(device);
		LIGHTBOX_DATA->cover_pending++;
		indigo_property_copy_values(AUX_COVER_PROPERTY, property, false);
		AUX_COVER_PROPERTY->state = INDIGO_BUSY_STATE;
		system_alpaca_unlock(device);
		indigo_update_property(device, AUX_COVER_PROPERTY, NULL);
		indigo_execute_handler_with_data(device, lightbox_aux_cover_handler, (void *)(intptr_t)open);
		return INDIGO_OK;
	} else if (indigo_property_match_changeable(X_ALPACA_COVER_ABORT_MOTION_PROPERTY, property)) {
		system_alpaca_accept(device, X_ALPACA_COVER_ABORT_MOTION_PROPERTY, property, ALPACA_ACCEPT_VALUES, NULL, lightbox_x_alpaca_cover_abort_motion_handler);
		return INDIGO_OK;
	} else if (indigo_property_match_changeable(AUX_LIGHT_SWITCH_PROPERTY, property)) {
		// accepted while the calibrator stabilises as well: a light that is not ready yet can be switched off
		bool on = indigo_get_switch(property, AUX_LIGHT_SWITCH_ON_ITEM_NAME);
		system_alpaca_lock(device);
		LIGHTBOX_DATA->calibrator_pending++;
		indigo_property_copy_values(AUX_LIGHT_SWITCH_PROPERTY, property, false);
		AUX_LIGHT_SWITCH_PROPERTY->state = INDIGO_BUSY_STATE;
		system_alpaca_unlock(device);
		indigo_update_property(device, AUX_LIGHT_SWITCH_PROPERTY, NULL);
		indigo_execute_handler_with_data(device, lightbox_aux_light_switch_handler, (void *)(intptr_t)on);
		return INDIGO_OK;
	} else if (indigo_property_match_changeable(AUX_LIGHT_INTENSITY_PROPERTY, property)) {
		// accepted while the calibrator stabilises as well: the last of a series of requests is the brightness that stays
		system_alpaca_lock(device);
		LIGHTBOX_DATA->calibrator_pending++;
		indigo_property_copy_targets(AUX_LIGHT_INTENSITY_PROPERTY, property, false);
		AUX_LIGHT_INTENSITY_PROPERTY->state = INDIGO_BUSY_STATE;
		system_alpaca_unlock(device);
		indigo_update_property(device, AUX_LIGHT_INTENSITY_PROPERTY, NULL);
		indigo_execute_handler(device, lightbox_aux_light_intensity_handler);
		return INDIGO_OK;
	}
	return indigo_aux_change_property(device, client, property);
}

static indigo_result lightbox_detach(indigo_device *device) {
	assert(device != NULL);
	system_alpaca_detach(device);
	indigo_release_property(AUX_COVER_PROPERTY);
	indigo_release_property(X_ALPACA_COVER_ABORT_MOTION_PROPERTY);
	indigo_release_property(AUX_LIGHT_SWITCH_PROPERTY);
	indigo_release_property(AUX_LIGHT_INTENSITY_PROPERTY);
	INDIGO_DEVICE_DETACH_LOG(DRIVER_NAME, device->name);
	return indigo_aux_detach(device);
}

#pragma mark - Device class

const alpaca_class system_alpaca_lightbox_class = {
	.device_type = "CoverCalibrator",
	.platform7_version = 2,
	.data_size = sizeof(lightbox_data),
	.attach = lightbox_attach,
	.enumerate_properties = lightbox_enumerate_properties,
	.change_property = lightbox_change_property,
	.detach = lightbox_detach,
	.base_change_property = indigo_aux_change_property,
	.on_probe = lightbox_on_probe,
	.on_connect = lightbox_on_connect,
	.on_disconnect = lightbox_on_disconnect,
	.on_poll = lightbox_on_poll
};
