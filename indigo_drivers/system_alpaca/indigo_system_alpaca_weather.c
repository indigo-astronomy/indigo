// Copyright (c) 2026 CloudMakers, s. r. o.
// All rights reserved.
//
// You can use this software under the terms of 'INDIGO Astronomy
// open-source license' (see LICENSE.md).
//
// THIS SOFTWARE IS PROVIDED BY THE AUTHORS 'AS IS' AND ANY EXPRESS
// OR IMPLIED WARRANTIES, INCLUDING, BUT NOT LIMITED TO, THE IMPLIED
// WARRANTIES OF MERCHANTABILITY AND FITNESS FOR A PARTICULAR PURPOSE
// ARE DISCLAIMED. IN NO EVENT SHALL THE AUTHOR BE LIABLE FOR ANY
// DIRECT, INDIRECT, INCIDENTAL, SPECIAL, EXEMPLARY, OR CONSEQUENTIAL
// DAMAGES (INCLUDING, BUT NOT LIMITED TO, PROCUREMENT OF SUBSTITUTE
// GOODS OR SERVICES; LOSS OF USE, DATA, OR PROFITS; OR BUSINESS
// INTERRUPTION) HOWEVER CAUSED AND ON ANY THEORY OF LIABILITY,
// WHETHER IN CONTRACT, STRICT LIABILITY, OR TORT (INCLUDING
// NEGLIGENCE OR OTHERWISE) ARISING IN ANY WAY OUT OF THE USE OF THIS
// SOFTWARE, EVEN IF ADVISED OF THE POSSIBILITY OF SUCH DAMAGE.

// version history
// 3.0 by Peter Polakovic <peter.polakovic@cloudmakers.eu>

// Code is generated by AI

/** INDIGO ASCOM Alpaca client driver, ObservingConditions device class: Alpaca ObservingConditions as an INDIGO weather device
 \file indigo_system_alpaca_weather.c

 Every sensor of an Alpaca ObservingConditions device is optional. The sensors are read once when the device is connected; a sensor
 that answers "not implemented" gets no item, and without any sensor AUX_WEATHER is not defined at all. The Alpaca units are the
 units INDIGO uses, so no value is converted:

   Temperature -> AUX_WEATHER.TEMPERATURE [C]              WindDirection -> AUX_WEATHER.WIND_DIRECTION [degrees, as reported]
   Humidity -> AUX_WEATHER.HUMIDITY [%]                    RainRate -> AUX_WEATHER.X_RAIN_RATE [mm/h]
   DewPoint -> AUX_WEATHER.DEWPOINT [C]                    CloudCover -> AUX_WEATHER.X_CLOUD_COVER [%]
   Pressure -> AUX_WEATHER.ATMOSPHERIC_PRESSURE [hPa]      SkyTemperature -> AUX_WEATHER.SKY_TEMPERATURE [C]
   WindSpeed -> AUX_WEATHER.WIND_SPEED [m/s]               SkyQuality -> AUX_WEATHER.SKY_BRIGHTNESS [mag/arcsec2]
   WindGust -> AUX_WEATHER.X_WIND_GUST [m/s]               SkyBrightness -> AUX_WEATHER.X_SKY_ILLUMINANCE [lux]
   StarFWHM -> AUX_WEATHER.X_STAR_FWHM [arcsec]

 The INDIGO item SKY_BRIGHTNESS is a sky quality in mag/arcsec2, which is the Alpaca SkyQuality; the Alpaca SkyBrightness is an
 illuminance in lux and has no standard item. AUX_WEATHER.SKY_BORTLE_CLASS is derived from SkyQuality like in the SQM drivers.
 The standard item RAIN is a raw dampness, not a rain rate, so it is not used.

 X_ALPACA_WEATHER_SENSORS holds SensorDescription of every sensor, X_ALPACA_WEATHER_AVERAGE_PERIOD is AveragePeriod (hours),
 X_ALPACA_WEATHER_REFRESH calls Refresh and X_ALPACA_WEATHER_AGE is TimeSinceLastUpdate of the most recently updated sensor.

 Polling: on a Platform 7 device the values come with the devicestate snapshot of every tick and cost no request. Everything
 that needs a request of its own (sensors that are not in the snapshot, all sensors of an older device, AveragePeriod and
 TimeSinceLastUpdate) is read on every WEATHER_POLL_DIVIDER-th tick only: weather does not change within a second.

 Threads: change_property runs on a bus thread, everything else on the handler queue of the device. A request is accepted
 with system_alpaca_accept() and the poll publishes the averaging period of the device under the lock of the device, so a poll
 tick never replaces a period that was just requested with the one the device still has.
 */

#pragma mark - Includes

#include <stdlib.h>
#include <stdio.h>
#include <string.h>
#include <assert.h>

#include <indigo/indigo_aux_driver.h>

#include "indigo_system_alpaca_private.h"

#pragma mark - Common definitions

#define WEATHER_GROUP												"Weather"

// Items of AUX_WEATHER for the sensors that have no standard item.
#define X_WIND_GUST_ITEM_NAME								"X_WIND_GUST"
#define X_RAIN_RATE_ITEM_NAME								"X_RAIN_RATE"
#define X_CLOUD_COVER_ITEM_NAME							"X_CLOUD_COVER"
#define X_SKY_ILLUMINANCE_ITEM_NAME					"X_SKY_ILLUMINANCE"
#define X_STAR_FWHM_ITEM_NAME								"X_STAR_FWHM"

// The members that need a request of their own are read on every WEATHER_POLL_DIVIDER-th poll tick.
#define WEATHER_POLL_DIVIDER								10

typedef struct {
	const char *member;				///< Alpaca member, name of the DeviceState entry and SensorName
	const char *item_name;
	const char *label;
	const char *format;
	double min;
	double max;
} weather_sensor;

static const weather_sensor weather_sensors[] = {
	{ "Temperature", AUX_WEATHER_TEMPERATURE_ITEM_NAME, "Ambient temperature [°C]", "%.1f", -100, 100 },
	{ "Humidity", AUX_WEATHER_HUMIDITY_ITEM_NAME, "Humidity [%]", "%.1f", 0, 100 },
	{ "DewPoint", AUX_WEATHER_DEWPOINT_ITEM_NAME, "Dew point [°C]", "%.1f", -100, 100 },
	{ "Pressure", AUX_WEATHER_PRESSURE_ITEM_NAME, "Atmospheric pressure [hPa]", "%.1f", 0, 2000 },
	{ "WindSpeed", AUX_WEATHER_WIND_SPEED_ITEM_NAME, "Wind speed [m/s]", "%.1f", 0, 200 },
	{ "WindGust", X_WIND_GUST_ITEM_NAME, "Wind gust [m/s]", "%.1f", 0, 200 },
	{ "WindDirection", AUX_WEATHER_WIND_DIRECTION_ITEM_NAME, "Wind direction [°]", "%.0f", 0, 360 },
	{ "RainRate", X_RAIN_RATE_ITEM_NAME, "Rain rate [mm/h]", "%.2f", 0, 1000 },
	{ "CloudCover", X_CLOUD_COVER_ITEM_NAME, "Cloud cover [%]", "%.1f", 0, 100 },
	{ "SkyTemperature", AUX_WEATHER_SKY_TEMPERATURE_ITEM_NAME, "Sky temperature [°C]", "%.1f", -200, 100 },
	{ "SkyQuality", AUX_WEATHER_SKY_BRIGHTNESS_ITEM_NAME, "Sky brightness [mag/arcsec²]", "%.2f", 0, 30 },
	{ "SkyBrightness", X_SKY_ILLUMINANCE_ITEM_NAME, "Sky illuminance [lux]", "%g", 0, 200000 },
	{ "StarFWHM", X_STAR_FWHM_ITEM_NAME, "Star FWHM [arcsec]", "%.2f", 0, 100 }
};

#define WEATHER_SENSOR_COUNT								((int)(sizeof(weather_sensors) / sizeof(weather_sensors[0])))
#define WEATHER_SKY_QUALITY									10

typedef struct {
	indigo_property *weather_property;
	indigo_property *sensors_property;
	indigo_property *average_period_property;
	indigo_property *refresh_property;
	indigo_property *age_property;
	bool supported[WEATHER_SENSOR_COUNT];
	bool failed[WEATHER_SENSOR_COUNT];			///< the last read of the sensor failed
	double values[WEATHER_SENSOR_COUNT];
	int items[WEATHER_SENSOR_COUNT];				///< index of the item of the sensor in AUX_WEATHER
	char descriptions[WEATHER_SENSOR_COUNT][ALPACA_TEXT_SIZE];
	int sensor_count;
	bool has_average_period;
	bool has_age;
	bool alert;															///< AUX_WEATHER is in ALERT because a sensor could not be read
	double average_period;
	double age;
	int tick;
} weather_data;

#define WEATHER_DATA												((weather_data *)CLASS_DATA)

#pragma mark - Property definitions

#define AUX_WEATHER_PROPERTY														(WEATHER_DATA->weather_property)

#define X_ALPACA_WEATHER_SENSORS_PROPERTY								(WEATHER_DATA->sensors_property)

#define X_ALPACA_WEATHER_SENSORS_PROPERTY_NAME					"X_ALPACA_WEATHER_SENSORS"

#define X_ALPACA_WEATHER_AVERAGE_PERIOD_PROPERTY				(WEATHER_DATA->average_period_property)
#define X_ALPACA_WEATHER_AVERAGE_PERIOD_ITEM						(X_ALPACA_WEATHER_AVERAGE_PERIOD_PROPERTY->items + 0)

#define X_ALPACA_WEATHER_AVERAGE_PERIOD_PROPERTY_NAME		"X_ALPACA_WEATHER_AVERAGE_PERIOD"
#define X_ALPACA_WEATHER_AVERAGE_PERIOD_ITEM_NAME				"PERIOD"

#define X_ALPACA_WEATHER_REFRESH_PROPERTY								(WEATHER_DATA->refresh_property)
#define X_ALPACA_WEATHER_REFRESH_ITEM										(X_ALPACA_WEATHER_REFRESH_PROPERTY->items + 0)

#define X_ALPACA_WEATHER_REFRESH_PROPERTY_NAME					"X_ALPACA_WEATHER_REFRESH"
#define X_ALPACA_WEATHER_REFRESH_ITEM_NAME							"REFRESH"

#define X_ALPACA_WEATHER_AGE_PROPERTY										(WEATHER_DATA->age_property)
#define X_ALPACA_WEATHER_AGE_ITEM												(X_ALPACA_WEATHER_AGE_PROPERTY->items + 0)

#define X_ALPACA_WEATHER_AGE_PROPERTY_NAME							"X_ALPACA_WEATHER_AGE"
#define X_ALPACA_WEATHER_AGE_ITEM_NAME									"AGE"

#pragma mark - Low level code

// Text of a failed request in the form system_alpaca_finish() uses, taken before a following request replaces the error of the channel.
static void weather_failure(indigo_device *device, alpaca_result result, const char *action, char *message, size_t size) {
	char reason[INDIGO_VALUE_SIZE];
	system_alpaca_reason(device, result, reason, sizeof(reason));
	snprintf(message, size, "%s failed: %s%s%s%s", action, alpaca_result_text(result), *reason ? " (" : "", reason, *reason ? ")" : "");
}

// Handler queue: end a request. The state is set under the lock, the property is published without it.
static void weather_finish(indigo_device *device, indigo_property *property, const char *message) {
	system_alpaca_set_state(device, property, message != NULL && *message ? INDIGO_ALERT_STATE : INDIGO_OK_STATE);
	if (message != NULL && *message) {
		indigo_update_property(device, property, "%s", message);
	} else {
		indigo_update_property(device, property, NULL);
	}
}

// TimeSinceLastUpdate of the sensor that was updated last (an empty SensorName).
static alpaca_result weather_read_age(indigo_device *device, double *age) {
	alpaca_param params[] = { ALPACA_STRING_PARAM("SensorName", "") };
	return system_alpaca_check(device, alpaca_get_double(system_alpaca_channel(device), "timesincelastupdate", params, 1, ALPACA_WAIT_STANDARD, age));
}

// Read the sensors: from the devicestate snapshot of the running poll tick if from_state is set, and with a request for every
// sensor that is not there if with_requests is set. The text of the first new failure is left in message.
static void weather_read(indigo_device *device, bool from_state, bool with_requests, char *message, size_t size) {
	alpaca_result result = ALPACA_OK;
	for (int i = 0; i < WEATHER_SENSOR_COUNT && !alpaca_is_transport_error(result); i++) {
		double value = 0;
		if (!WEATHER_DATA->supported[i]) {
			continue;
		}
		if (from_state && alpaca_state_double(&PRIVATE_DATA->state, weather_sensors[i].member, &value)) {
			WEATHER_DATA->values[i] = value;
			WEATHER_DATA->failed[i] = false;
		} else if (with_requests) {
			result = system_alpaca_get_double(device, weather_sensors[i].member, &value);
			if (result == ALPACA_OK) {
				WEATHER_DATA->values[i] = value;
			} else if (!WEATHER_DATA->failed[i] && *message == 0) {
				char action[64];
				snprintf(action, sizeof(action), "Reading %s", weather_sensors[i].member);
				weather_failure(device, result, action, message, size);
			}
			WEATHER_DATA->failed[i] = result != ALPACA_OK;
		}
	}
}

// Copy the values of the sensors to AUX_WEATHER and publish it if a value or the state changed.
static void weather_publish(indigo_device *device, const char *message) {
	bool changed = false, alert = false;
	for (int i = 0; i < WEATHER_SENSOR_COUNT; i++) {
		if (WEATHER_DATA->supported[i]) {
			indigo_item *item = AUX_WEATHER_PROPERTY->items + WEATHER_DATA->items[i];
			changed = changed || item->number.value != WEATHER_DATA->values[i];
			item->number.value = WEATHER_DATA->values[i];
			alert = alert || WEATHER_DATA->failed[i];
			if (i == WEATHER_SKY_QUALITY) {
				item[1].number.value = indigo_aux_sky_bortle(WEATHER_DATA->values[i]);
			}
		}
	}
	if (alert != WEATHER_DATA->alert) {
		WEATHER_DATA->alert = alert;
		AUX_WEATHER_PROPERTY->state = alert ? INDIGO_ALERT_STATE : INDIGO_OK_STATE;
		changed = true;
	}
	if (changed && alert && message != NULL && *message) {
		indigo_update_property(device, AUX_WEATHER_PROPERTY, "%s", message);
	} else if (changed) {
		indigo_update_property(device, AUX_WEATHER_PROPERTY, NULL);
	}
}

// Read and publish what is polled with requests of its own besides the sensors: TimeSinceLastUpdate and AveragePeriod.
static void weather_read_settings(indigo_device *device) {
	double value = 0;
	if (WEATHER_DATA->has_age && system_alpaca_channel(device) != NULL) {
		alpaca_result result = weather_read_age(device, &value);
		if (result == ALPACA_OK) {
			X_ALPACA_WEATHER_AGE_ITEM->number.value = WEATHER_DATA->age = value;
		}
		X_ALPACA_WEATHER_AGE_PROPERTY->state = system_alpaca_property_state(result);
		indigo_update_property(device, X_ALPACA_WEATHER_AGE_PROPERTY, NULL);
	}
	if (WEATHER_DATA->has_average_period && system_alpaca_channel(device) != NULL) {
		if (system_alpaca_get_double(device, "averageperiod", &value) == ALPACA_OK && value != WEATHER_DATA->average_period) {
			// a period that was requested since is kept: the property is BUSY then, and its handler reads the period back
			system_alpaca_lock(device);
			bool busy = X_ALPACA_WEATHER_AVERAGE_PERIOD_PROPERTY->state == INDIGO_BUSY_STATE;
			if (!busy) {
				X_ALPACA_WEATHER_AVERAGE_PERIOD_ITEM->number.value = X_ALPACA_WEATHER_AVERAGE_PERIOD_ITEM->number.target = WEATHER_DATA->average_period = value;
				X_ALPACA_WEATHER_AVERAGE_PERIOD_PROPERTY->state = INDIGO_OK_STATE;
			}
			system_alpaca_unlock(device);
			if (!busy) {
				indigo_update_property(device, X_ALPACA_WEATHER_AVERAGE_PERIOD_PROPERTY, NULL);
			}
		}
	}
}

#pragma mark - High level code (weather)

// X_ALPACA_WEATHER_AVERAGE_PERIOD: the period is set and read back; after a failure the property shows the period of the device.
static void weather_average_period_handler(indigo_device *device) {
	char message[INDIGO_VALUE_SIZE] = { 0 };
	double value = 0;
	if (!system_alpaca_is_active(device)) {
		return;
	}
	alpaca_param params[] = { ALPACA_DOUBLE_PARAM("AveragePeriod", X_ALPACA_WEATHER_AVERAGE_PERIOD_ITEM->number.target) };
	alpaca_result result = system_alpaca_put(device, "averageperiod", params, 1, ALPACA_REPLAYABLE);
	if (result != ALPACA_OK) {
		weather_failure(device, result, "Setting the averaging period", message, sizeof(message));
	}
	if (!alpaca_is_transport_error(result)) {
		alpaca_result read_result = system_alpaca_get_double(device, "averageperiod", &value);
		if (read_result == ALPACA_OK) {
			WEATHER_DATA->average_period = value;
		} else if (*message == 0) {
			weather_failure(device, read_result, "Reading the averaging period", message, sizeof(message));
		}
	}
	X_ALPACA_WEATHER_AVERAGE_PERIOD_ITEM->number.value = X_ALPACA_WEATHER_AVERAGE_PERIOD_ITEM->number.target = WEATHER_DATA->average_period;
	weather_finish(device, X_ALPACA_WEATHER_AVERAGE_PERIOD_PROPERTY, message);
}

// X_ALPACA_WEATHER_REFRESH: Refresh, then everything is read again. A device without Refresh loses the property for the
// rest of the connection.
static void weather_refresh_handler(indigo_device *device) {
	char message[INDIGO_VALUE_SIZE] = { 0 };
	if (!system_alpaca_is_active(device)) {
		return;
	}
	if (!X_ALPACA_WEATHER_REFRESH_ITEM->sw.value) {
		// a request that switches the item off asks for nothing
		weather_finish(device, X_ALPACA_WEATHER_REFRESH_PROPERTY, NULL);
		return;
	}
	alpaca_result result = system_alpaca_put(device, "refresh", NULL, 0, ALPACA_REPLAYABLE);
	X_ALPACA_WEATHER_REFRESH_ITEM->sw.value = false;
	if (system_alpaca_not_implemented(result, 0)) {
		system_alpaca_set_unsupported(device, "refresh");
		indigo_delete_property(device, X_ALPACA_WEATHER_REFRESH_PROPERTY, "Refresh is not implemented by the device");
		X_ALPACA_WEATHER_REFRESH_PROPERTY->hidden = true;
		return;
	}
	if (result == ALPACA_OK) {
		weather_read(device, false, true, message, sizeof(message));
		weather_publish(device, message);
		weather_read_settings(device);
		*message = 0;
	} else {
		weather_failure(device, result, "Refresh", message, sizeof(message));
	}
	weather_finish(device, X_ALPACA_WEATHER_REFRESH_PROPERTY, message);
}

// Find out which sensors the device has and read everything once. Only a transport error fails the connection.
static bool weather_on_probe(indigo_device *device) {
	WEATHER_DATA->sensor_count = 0;
	WEATHER_DATA->has_average_period = WEATHER_DATA->has_age = WEATHER_DATA->alert = false;
	for (int i = 0; i < WEATHER_SENSOR_COUNT; i++) {
		alpaca_result result = system_alpaca_get_double(device, weather_sensors[i].member, WEATHER_DATA->values + i);
		if (alpaca_is_transport_error(result)) {
			return false;
		}
		WEATHER_DATA->supported[i] = !alpaca_is_unsupported(result);
		WEATHER_DATA->failed[i] = WEATHER_DATA->supported[i] && result != ALPACA_OK;
		WEATHER_DATA->descriptions[i][0] = 0;
		if (!WEATHER_DATA->supported[i]) {
			system_alpaca_set_unsupported(device, weather_sensors[i].member);
			continue;
		}
		if (result != ALPACA_OK) {
			WEATHER_DATA->values[i] = 0;
		}
		WEATHER_DATA->sensor_count++;
		alpaca_param params[] = { ALPACA_STRING_PARAM("SensorName", weather_sensors[i].member) };
		result = system_alpaca_check(device, alpaca_get_string(system_alpaca_channel(device), "sensordescription", params, 1, ALPACA_WAIT_STANDARD, WEATHER_DATA->descriptions[i], ALPACA_TEXT_SIZE));
		if (alpaca_is_transport_error(result)) {
			return false;
		}
		if (result != ALPACA_OK) {
			WEATHER_DATA->descriptions[i][0] = 0;
		}
	}
	alpaca_result result = system_alpaca_get_double(device, "averageperiod", &WEATHER_DATA->average_period);
	if (alpaca_is_transport_error(result)) {
		return false;
	}
	WEATHER_DATA->has_average_period = result == ALPACA_OK;
	if (WEATHER_DATA->sensor_count > 0) {
		result = weather_read_age(device, &WEATHER_DATA->age);
		if (alpaca_is_transport_error(result)) {
			return false;
		}
		WEATHER_DATA->has_age = result == ALPACA_OK;
	}
	return true;
}

// Set up the properties for the sensors the device has. The items of the missing ones are left out before anything is defined.
static bool weather_on_connect(indigo_device *device) {
	int count = 0;
	for (int i = 0; i < WEATHER_SENSOR_COUNT; i++) {
		const weather_sensor *sensor = weather_sensors + i;
		if (!WEATHER_DATA->supported[i]) {
			continue;
		}
		WEATHER_DATA->alert = WEATHER_DATA->alert || WEATHER_DATA->failed[i];
		WEATHER_DATA->items[i] = count;
		indigo_init_number_item(AUX_WEATHER_PROPERTY->items + count, sensor->item_name, sensor->label, sensor->min, sensor->max, 0, WEATHER_DATA->values[i]);
		INDIGO_COPY_VALUE(AUX_WEATHER_PROPERTY->items[count].number.format, sensor->format);
		count++;
		if (i == WEATHER_SKY_QUALITY) {
			indigo_init_number_item(AUX_WEATHER_PROPERTY->items + count, AUX_WEATHER_SKY_BORTLE_CLASS_ITEM_NAME, "Sky Bortle class", 1, 9, 0, indigo_aux_sky_bortle(WEATHER_DATA->values[i]));
			INDIGO_COPY_VALUE(AUX_WEATHER_PROPERTY->items[count].number.format, "%.1f");
			count++;
		}
	}
	AUX_WEATHER_PROPERTY->count = count;
	AUX_WEATHER_PROPERTY->hidden = count == 0;
	AUX_WEATHER_PROPERTY->state = WEATHER_DATA->alert ? INDIGO_ALERT_STATE : INDIGO_OK_STATE;
	count = 0;
	for (int i = 0; i < WEATHER_SENSOR_COUNT; i++) {
		if (WEATHER_DATA->supported[i]) {
			indigo_init_text_item_raw(X_ALPACA_WEATHER_SENSORS_PROPERTY->items + count++, weather_sensors[i].item_name, weather_sensors[i].label, WEATHER_DATA->descriptions[i]);
		}
	}
	X_ALPACA_WEATHER_SENSORS_PROPERTY->count = count;
	X_ALPACA_WEATHER_SENSORS_PROPERTY->hidden = count == 0;
	X_ALPACA_WEATHER_AVERAGE_PERIOD_ITEM->number.value = X_ALPACA_WEATHER_AVERAGE_PERIOD_ITEM->number.target = WEATHER_DATA->average_period;
	X_ALPACA_WEATHER_AVERAGE_PERIOD_PROPERTY->hidden = !WEATHER_DATA->has_average_period;
	X_ALPACA_WEATHER_AVERAGE_PERIOD_PROPERTY->state = INDIGO_OK_STATE;
	X_ALPACA_WEATHER_REFRESH_ITEM->sw.value = false;
	X_ALPACA_WEATHER_REFRESH_PROPERTY->hidden = count == 0;
	X_ALPACA_WEATHER_REFRESH_PROPERTY->state = INDIGO_OK_STATE;
	X_ALPACA_WEATHER_AGE_ITEM->number.value = WEATHER_DATA->age;
	X_ALPACA_WEATHER_AGE_PROPERTY->hidden = !WEATHER_DATA->has_age;
	X_ALPACA_WEATHER_AGE_PROPERTY->state = INDIGO_OK_STATE;
	WEATHER_DATA->tick = 0;
	indigo_define_property(device, AUX_WEATHER_PROPERTY, NULL);
	indigo_define_property(device, X_ALPACA_WEATHER_SENSORS_PROPERTY, NULL);
	indigo_define_property(device, X_ALPACA_WEATHER_AVERAGE_PERIOD_PROPERTY, NULL);
	indigo_define_property(device, X_ALPACA_WEATHER_REFRESH_PROPERTY, NULL);
	indigo_define_property(device, X_ALPACA_WEATHER_AGE_PROPERTY, NULL);
	return true;
}

static void weather_on_disconnect(indigo_device *device) {
	indigo_delete_property(device, AUX_WEATHER_PROPERTY, NULL);
	indigo_delete_property(device, X_ALPACA_WEATHER_SENSORS_PROPERTY, NULL);
	indigo_delete_property(device, X_ALPACA_WEATHER_AVERAGE_PERIOD_PROPERTY, NULL);
	indigo_delete_property(device, X_ALPACA_WEATHER_REFRESH_PROPERTY, NULL);
	indigo_delete_property(device, X_ALPACA_WEATHER_AGE_PROPERTY, NULL);
}

static void weather_on_poll(indigo_device *device) {
	char message[INDIGO_VALUE_SIZE] = { 0 };
	bool with_requests = ++WEATHER_DATA->tick % WEATHER_POLL_DIVIDER == 0;
	weather_read(device, true, with_requests, message, sizeof(message));
	weather_publish(device, message);
	if (with_requests) {
		weather_read_settings(device);
	}
}

#pragma mark - Device API (weather)

static indigo_result weather_enumerate_properties(indigo_device *device, indigo_client *client, indigo_property *property);

static indigo_result weather_attach(indigo_device *device) {
	assert(device != NULL);
	if (indigo_aux_attach(device, DRIVER_NAME, DRIVER_VERSION, INDIGO_INTERFACE_AUX_WEATHER) == INDIGO_OK) {
		// one item for every sensor and one for the Bortle class derived from the sky quality
		AUX_WEATHER_PROPERTY = indigo_init_number_property(NULL, device->name, AUX_WEATHER_PROPERTY_NAME, WEATHER_GROUP, "Weather conditions", INDIGO_OK_STATE, INDIGO_RO_PERM, WEATHER_SENSOR_COUNT + 1);
		if (AUX_WEATHER_PROPERTY == NULL) {
			return INDIGO_FAILED;
		}
		X_ALPACA_WEATHER_SENSORS_PROPERTY = indigo_init_text_property(NULL, device->name, X_ALPACA_WEATHER_SENSORS_PROPERTY_NAME, WEATHER_GROUP, "Sensors", INDIGO_OK_STATE, INDIGO_RO_PERM, WEATHER_SENSOR_COUNT);
		if (X_ALPACA_WEATHER_SENSORS_PROPERTY == NULL) {
			return INDIGO_FAILED;
		}
		X_ALPACA_WEATHER_AVERAGE_PERIOD_PROPERTY = indigo_init_number_property(NULL, device->name, X_ALPACA_WEATHER_AVERAGE_PERIOD_PROPERTY_NAME, WEATHER_GROUP, "Averaging period", INDIGO_OK_STATE, INDIGO_RW_PERM, 1);
		if (X_ALPACA_WEATHER_AVERAGE_PERIOD_PROPERTY == NULL) {
			return INDIGO_FAILED;
		}
		indigo_init_number_item(X_ALPACA_WEATHER_AVERAGE_PERIOD_ITEM, X_ALPACA_WEATHER_AVERAGE_PERIOD_ITEM_NAME, "Averaging period [h]", 0, 1000, 0, 0);
		X_ALPACA_WEATHER_REFRESH_PROPERTY = indigo_init_switch_property(NULL, device->name, X_ALPACA_WEATHER_REFRESH_PROPERTY_NAME, WEATHER_GROUP, "Refresh", INDIGO_OK_STATE, INDIGO_RW_PERM, INDIGO_ANY_OF_MANY_RULE, 1);
		if (X_ALPACA_WEATHER_REFRESH_PROPERTY == NULL) {
			return INDIGO_FAILED;
		}
		indigo_init_switch_item(X_ALPACA_WEATHER_REFRESH_ITEM, X_ALPACA_WEATHER_REFRESH_ITEM_NAME, "Refresh the sensor values", false);
		X_ALPACA_WEATHER_AGE_PROPERTY = indigo_init_number_property(NULL, device->name, X_ALPACA_WEATHER_AGE_PROPERTY_NAME, WEATHER_GROUP, "Age of the values", INDIGO_OK_STATE, INDIGO_RO_PERM, 1);
		if (X_ALPACA_WEATHER_AGE_PROPERTY == NULL) {
			return INDIGO_FAILED;
		}
		indigo_init_number_item(X_ALPACA_WEATHER_AGE_ITEM, X_ALPACA_WEATHER_AGE_ITEM_NAME, "Time since the last update [s]", -1, 1e9, 0, 0);
		return system_alpaca_attach(device) == INDIGO_OK ? weather_enumerate_properties(device, NULL, NULL) : INDIGO_FAILED;
	}
	return INDIGO_FAILED;
}

static indigo_result weather_enumerate_properties(indigo_device *device, indigo_client *client, indigo_property *property) {
	if (system_alpaca_is_active(device)) {
		INDIGO_DEFINE_MATCHING_PROPERTY(AUX_WEATHER_PROPERTY);
		INDIGO_DEFINE_MATCHING_PROPERTY(X_ALPACA_WEATHER_SENSORS_PROPERTY);
		INDIGO_DEFINE_MATCHING_PROPERTY(X_ALPACA_WEATHER_AVERAGE_PERIOD_PROPERTY);
		INDIGO_DEFINE_MATCHING_PROPERTY(X_ALPACA_WEATHER_REFRESH_PROPERTY);
		INDIGO_DEFINE_MATCHING_PROPERTY(X_ALPACA_WEATHER_AGE_PROPERTY);
	}
	return indigo_aux_enumerate_properties(device, client, property);
}

static indigo_result weather_change_property(indigo_device *device, indigo_client *client, indigo_property *property) {
	if (system_alpaca_change_property(device, property)) {
		return INDIGO_OK;
	}
	if (indigo_property_match_changeable(X_ALPACA_WEATHER_AVERAGE_PERIOD_PROPERTY, property)) {
		system_alpaca_accept(device, X_ALPACA_WEATHER_AVERAGE_PERIOD_PROPERTY, property, ALPACA_ACCEPT_TARGETS, NULL, weather_average_period_handler);
		return INDIGO_OK;
	}
	if (indigo_property_match_changeable(X_ALPACA_WEATHER_REFRESH_PROPERTY, property)) {
		system_alpaca_accept(device, X_ALPACA_WEATHER_REFRESH_PROPERTY, property, ALPACA_ACCEPT_VALUES, NULL, weather_refresh_handler);
		return INDIGO_OK;
	}
	return indigo_aux_change_property(device, client, property);
}

static indigo_result weather_detach(indigo_device *device) {
	assert(device != NULL);
	system_alpaca_detach(device);
	indigo_release_property(AUX_WEATHER_PROPERTY);
	indigo_release_property(X_ALPACA_WEATHER_SENSORS_PROPERTY);
	indigo_release_property(X_ALPACA_WEATHER_AVERAGE_PERIOD_PROPERTY);
	indigo_release_property(X_ALPACA_WEATHER_REFRESH_PROPERTY);
	indigo_release_property(X_ALPACA_WEATHER_AGE_PROPERTY);
	INDIGO_DEVICE_DETACH_LOG(DRIVER_NAME, device->name);
	return indigo_aux_detach(device);
}

#pragma mark - Device class

const alpaca_class system_alpaca_weather_class = {
	.device_type = "ObservingConditions",
	.platform7_version = 2,
	.data_size = sizeof(weather_data),
	.attach = weather_attach,
	.enumerate_properties = weather_enumerate_properties,
	.change_property = weather_change_property,
	.detach = weather_detach,
	.base_change_property = indigo_aux_change_property,
	.on_probe = weather_on_probe,
	.on_connect = weather_on_connect,
	.on_disconnect = weather_on_disconnect,
	.on_poll = weather_on_poll
};
