// Copyright (c) 2026 CloudMakers, s. r. o.
// All rights reserved.
//
// You can use this software under the terms of 'INDIGO Astronomy
// open-source license' (see LICENSE.md).
//
// THIS SOFTWARE IS PROVIDED BY THE AUTHORS 'AS IS' AND ANY EXPRESS
// OR IMPLIED WARRANTIES, INCLUDING, BUT NOT LIMITED TO, THE IMPLIED
// WARRANTIES OF MERCHANTABILITY AND FITNESS FOR A PARTICULAR PURPOSE
// ARE DISCLAIMED. IN NO EVENT SHALL THE AUTHOR BE LIABLE FOR ANY
// DIRECT, INDIRECT, INCIDENTAL, SPECIAL, EXEMPLARY, OR CONSEQUENTIAL
// DAMAGES (INCLUDING, BUT NOT LIMITED TO, PROCUREMENT OF SUBSTITUTE
// GOODS OR SERVICES; LOSS OF USE, DATA, OR PROFITS; OR BUSINESS
// INTERRUPTION) HOWEVER CAUSED AND ON ANY THEORY OF LIABILITY,
// WHETHER IN CONTRACT, STRICT LIABILITY, OR TORT (INCLUDING
// NEGLIGENCE OR OTHERWISE) ARISING IN ANY WAY OUT OF THE USE OF THIS
// SOFTWARE, EVEN IF ADVISED OF THE POSSIBILITY OF SUCH DAMAGE.

// version history
// 3.0 by Peter Polakovic <peter.polakovic@cloudmakers.eu>

// Code is generated by AI

/** INDIGO ASCOM Alpaca client driver
 \file indigo_system_alpaca.c

 The driver is hand-written, because the driver generator has neither a "system" class nor network discovery, but it
 is laid out like a generated hot-plug driver: the sections follow the order of the generator, the discovery results
 take the place of the USB hot-plug events and are processed on the per-driver queue, the proxy devices live in
 devices[MAX_DEVICES], and the connection helpers are system_alpaca_open() and system_alpaca_close().

 Threads:
 - bus callbacks (bridge_change_property, change_property of a proxy) only copy the request and queue a handler;
 - the driver queue runs discovery, the management requests and every attach and detach, so the lists of servers
   and devices are touched by one thread only;
 - the handler queue of a proxy device runs its connection, polling and everything of its device class;
 - what a bus thread and the handler queue of a proxy device share (CONNECTION, the session flags, the state and the requested
   values of the properties a client can change) is written under the lock of the device, system_alpaca_lock(), which is never
   held across a request or a call of the bus. The header indigo_system_alpaca_private.h describes the rules for a class module.

 Devices (decision D15, which replaces D4):
 - every Alpaca device the driver learns about (discovery, a manual server, a device a server lists later) is proxied by default;
   X_ALPACA_DEVICES has one switch per known device, named by its key (UniqueID made safe, make_key()), and it is on by default;
 - what is remembered is the set of keys the user switched off (switched_off[]): a switch that is turned off puts the key there, one that
   is turned on takes it out. A key that is not listed yet is taken as it is, so a saved configuration, which is restored before
   anything is discovered, applies to devices that appear later. A device that is switched off stays listed (OFFLINE while no server
   lists it) so that its switch is saved with the configuration (CONFIG SAVE writes the whole property); a device that is on and is no
   longer listed by any server is forgotten, there is nothing to remember about it;
 - nothing is attached while the configuration of the bridge is being restored (bridge_reconcile() waits for it): the restore of
   X_ALPACA_SERVERS asks the manual servers for their devices before X_ALPACA_DEVICES comes in the file, and a device switched off
   there must never get a proxy, not even for a moment. The switch is recorded on the bus thread when the request is accepted, so the
   set is complete when the restore ends;
 - the proxies are attached in the order in which the devices became known; when more devices are on than MAX_DEVICES proxy devices
   fit, the rest wait as FAILED with the reason in X_ALPACA_DEVICE_STATUS and a message, and get their proxy as soon as there is room
   (a device switched off makes room at once).

 Names (decision D17, which replaces the "<DeviceName> on <ServerName>" of D14): "ALPACA <DeviceName>" without any "alpaca" of the
 DeviceName and without "@", the DeviceType if nothing is left; devices of the same name are numbered " #2", " #3"... in the order of their
 keys, see proxy_make_name(). The guider of a camera or a telescope is "<name> (guider)".
 */

#pragma mark - Includes

#include <stdlib.h>
#include <string.h>
#include <stdio.h>
#include <stdarg.h>
#include <math.h>
#include <assert.h>
#include <pthread.h>

#include <indigo/indigo_driver_xml.h>
#include <indigo/indigo_aux_driver.h>
#include <indigo/indigo_uni_io.h>

#include "indigo_system_alpaca.h"
#include "indigo_system_alpaca_private.h"

#pragma mark - Common definitions

#define BRIDGE_DEVICE_NAME												"Alpaca"
#define MAX_DEVICES																32
#define MAX_SERVERS																16
#define MAX_RECORDS																128
#define MAX_LISTED_DEVICES												64
#define MAX_TARGETS																16
#define KEY_SIZE																	64
#define BRIDGE_DATA																((bridge_private_data *)bridge->private_data)

#define DISCOVERY_GROUP														"Discovery"
#define SERVERS_GROUP															"Servers"
#define DEVICES_GROUP															"Devices"

#define INDIGO_BRIDGE_SERVER_NAME									"INDIGO-Alpaca Bridge"
#define INDIGO_BRIDGE_MANUFACTURER								"The INDIGO Initiative"

#define CONFIG_WAIT_INTERVAL											0.1
#define CONNECTING_POLL_INTERVAL									0.1
#define TRANSPORT_ERROR_LIMIT											2
#define DEVICE_STATE_FAILURE_LIMIT								5
#define SHUTDOWN_WAIT															5.0
#define DEVICE_NAME_PART_SIZE											100

#pragma mark - Property definitions

#define X_ALPACA_DISCOVERY_PROPERTY								(BRIDGE_DATA->x_alpaca_discovery_property)
#define X_ALPACA_DISCOVERY_ENABLED_ITEM						(X_ALPACA_DISCOVERY_PROPERTY->items + 0)
#define X_ALPACA_DISCOVERY_DISABLED_ITEM					(X_ALPACA_DISCOVERY_PROPERTY->items + 1)

#define X_ALPACA_DISCOVERY_PROPERTY_NAME					"X_ALPACA_DISCOVERY"
#define X_ALPACA_DISCOVERY_ENABLED_ITEM_NAME			"ENABLED"
#define X_ALPACA_DISCOVERY_DISABLED_ITEM_NAME			"DISABLED"

#define X_ALPACA_DISCOVERY_SETTINGS_PROPERTY			(BRIDGE_DATA->x_alpaca_discovery_settings_property)
#define X_ALPACA_DISCOVERY_SETTINGS_PORT_ITEM			(X_ALPACA_DISCOVERY_SETTINGS_PROPERTY->items + 0)
#define X_ALPACA_DISCOVERY_SETTINGS_INTERVAL_ITEM	(X_ALPACA_DISCOVERY_SETTINGS_PROPERTY->items + 1)
#define X_ALPACA_DISCOVERY_SETTINGS_TIMEOUT_ITEM	(X_ALPACA_DISCOVERY_SETTINGS_PROPERTY->items + 2)
#define X_ALPACA_DISCOVERY_SETTINGS_POLLS_ITEM		(X_ALPACA_DISCOVERY_SETTINGS_PROPERTY->items + 3)
#define X_ALPACA_DISCOVERY_SETTINGS_RETENTION_ITEM	(X_ALPACA_DISCOVERY_SETTINGS_PROPERTY->items + 4)

#define X_ALPACA_DISCOVERY_SETTINGS_PROPERTY_NAME	"X_ALPACA_DISCOVERY_SETTINGS"
#define X_ALPACA_DISCOVERY_SETTINGS_PORT_ITEM_NAME	"PORT"
#define X_ALPACA_DISCOVERY_SETTINGS_INTERVAL_ITEM_NAME	"INTERVAL"
#define X_ALPACA_DISCOVERY_SETTINGS_TIMEOUT_ITEM_NAME	"TIMEOUT"
#define X_ALPACA_DISCOVERY_SETTINGS_POLLS_ITEM_NAME	"POLLS"
#define X_ALPACA_DISCOVERY_SETTINGS_RETENTION_ITEM_NAME	"RETENTION"

#define X_ALPACA_DISCOVERY_TARGETS_PROPERTY				(BRIDGE_DATA->x_alpaca_discovery_targets_property)
#define X_ALPACA_DISCOVERY_TARGETS_ITEM						(X_ALPACA_DISCOVERY_TARGETS_PROPERTY->items + 0)

#define X_ALPACA_DISCOVERY_TARGETS_PROPERTY_NAME	"X_ALPACA_DISCOVERY_TARGETS"
#define X_ALPACA_DISCOVERY_TARGETS_ITEM_NAME			"TARGETS"

#define X_ALPACA_DISCOVER_PROPERTY								(BRIDGE_DATA->x_alpaca_discover_property)
#define X_ALPACA_DISCOVER_ITEM										(X_ALPACA_DISCOVER_PROPERTY->items + 0)

#define X_ALPACA_DISCOVER_PROPERTY_NAME						"X_ALPACA_DISCOVER"
#define X_ALPACA_DISCOVER_ITEM_NAME								"DISCOVER"

#define X_ALPACA_SERVERS_PROPERTY									(BRIDGE_DATA->x_alpaca_servers_property)
#define X_ALPACA_SERVERS_LIST_ITEM								(X_ALPACA_SERVERS_PROPERTY->items + 0)
#define X_ALPACA_SERVERS_ADD_ITEM									(X_ALPACA_SERVERS_PROPERTY->items + 1)
#define X_ALPACA_SERVERS_REMOVE_ITEM							(X_ALPACA_SERVERS_PROPERTY->items + 2)

#define X_ALPACA_SERVERS_PROPERTY_NAME						"X_ALPACA_SERVERS"
#define X_ALPACA_SERVERS_LIST_ITEM_NAME						"LIST"
#define X_ALPACA_SERVERS_ADD_ITEM_NAME						"ADD"
#define X_ALPACA_SERVERS_REMOVE_ITEM_NAME					"REMOVE"

#define X_ALPACA_SERVER_STATUS_PROPERTY						(BRIDGE_DATA->x_alpaca_server_status_property)

#define X_ALPACA_SERVER_STATUS_PROPERTY_NAME			"X_ALPACA_SERVER_STATUS"

#define X_ALPACA_DEVICES_PROPERTY									(BRIDGE_DATA->x_alpaca_devices_property)

#define X_ALPACA_DEVICES_PROPERTY_NAME						"X_ALPACA_DEVICES"

#define X_ALPACA_DEVICE_STATUS_PROPERTY						(BRIDGE_DATA->x_alpaca_device_status_property)

#define X_ALPACA_DEVICE_STATUS_PROPERTY_NAME			"X_ALPACA_DEVICE_STATUS"

#define X_ALPACA_TIMEOUTS_PROPERTY								(BRIDGE_DATA->x_alpaca_timeouts_property)
#define X_ALPACA_TIMEOUTS_ESTABLISH_ITEM					(X_ALPACA_TIMEOUTS_PROPERTY->items + 0)
#define X_ALPACA_TIMEOUTS_STANDARD_ITEM						(X_ALPACA_TIMEOUTS_PROPERTY->items + 1)
#define X_ALPACA_TIMEOUTS_LONG_ITEM								(X_ALPACA_TIMEOUTS_PROPERTY->items + 2)

#define X_ALPACA_TIMEOUTS_PROPERTY_NAME						"X_ALPACA_TIMEOUTS"
#define X_ALPACA_TIMEOUTS_ESTABLISH_ITEM_NAME			"ESTABLISH"
#define X_ALPACA_TIMEOUTS_STANDARD_ITEM_NAME			"STANDARD"
#define X_ALPACA_TIMEOUTS_LONG_ITEM_NAME					"LONG"

#define X_ALPACA_POLLING_PROPERTY									(BRIDGE_DATA->x_alpaca_polling_property)
#define X_ALPACA_POLLING_IDLE_ITEM								(X_ALPACA_POLLING_PROPERTY->items + 0)
#define X_ALPACA_POLLING_ACTIVE_ITEM							(X_ALPACA_POLLING_PROPERTY->items + 1)

#define X_ALPACA_POLLING_PROPERTY_NAME						"X_ALPACA_POLLING"
#define X_ALPACA_POLLING_IDLE_ITEM_NAME						"IDLE"
#define X_ALPACA_POLLING_ACTIVE_ITEM_NAME					"ACTIVE"

#pragma mark - Private data definition

typedef struct {
	indigo_property *x_alpaca_discovery_property;
	indigo_property *x_alpaca_discovery_settings_property;
	indigo_property *x_alpaca_discovery_targets_property;
	indigo_property *x_alpaca_discover_property;
	indigo_property *x_alpaca_servers_property;
	indigo_property *x_alpaca_server_status_property;
	indigo_property *x_alpaca_devices_property;
	indigo_property *x_alpaca_device_status_property;
	indigo_property *x_alpaca_timeouts_property;
	indigo_property *x_alpaca_polling_property;
} bridge_private_data;

// One Alpaca server, known from discovery or from the manual list.
typedef struct {
	bool used;
	alpaca_server *transport;												// shared by the proxy devices of the server
	alpaca_channel *channel;												// management API
	bool manual;																		// listed in X_ALPACA_SERVERS
	bool discovered;																// answered a discovery request
	bool described;																	// apiversions and description are known
	bool online;																		// answered configureddevices and did not stay silent for RETENTION cycles since
	bool bridge;																		// INDIGO agent_alpaca, its devices are never imported
	bool unsupported;																// no Alpaca API version 1
	int missed;																			// consecutive cycles without an answer
	int device_count;
	int duplicate_count;
	alpaca_description description;
	char name[INDIGO_NAME_SIZE];										// ServerName, cut to the size of a label
	char maker[INDIGO_NAME_SIZE];										// Manufacturer and ManufacturerVersion
	char error[INDIGO_NAME_SIZE];
} server_record;

// One Alpaca device, known from configureddevices of a server or because it was switched off by its key.
typedef struct {
	bool used;
	char key[KEY_SIZE];															// UniqueID in lower case with unsafe characters replaced, the item name in X_ALPACA_DEVICES
	char unique_id[INDIGO_NAME_SIZE];
	char name[INDIGO_NAME_SIZE];
	char type[ALPACA_TYPE_SIZE];
	int number;
	server_record *server;													// server that lists the device, NULL if no server does
	bool present;																		// listed by its server
	bool listed;																		// seen in the listing that is being processed
	bool selected;																	// its switch in X_ALPACA_DEVICES is on, i.e. it is not switched off (decision D15)
	bool reattach;																	// the device type changed, the proxy has to be created again
	indigo_device *device;													// attached proxy device
	char message[INDIGO_NAME_SIZE];									// why the device that is switched on has no proxy
} device_record;

typedef struct {
	char name[INDIGO_NAME_SIZE];
	char label[INDIGO_VALUE_SIZE];
	char text[INDIGO_VALUE_SIZE];
	bool value;
} list_item;

typedef struct {
	int count;
	struct {
		char host[ALPACA_HOST_SIZE];
		int port;
	} endpoints[MAX_SERVERS];
} discovery_result;

#pragma mark - Low level code

static indigo_queue *driver_queue = NULL;
static pthread_mutex_t driver_queue_mutex = PTHREAD_MUTEX_INITIALIZER;

// bridge_mutex guards what bus threads and the driver queue share of the bridge device: the items of the properties that are rebuilt
// at run time, the states and the settings of its properties (bridge_finish(), bridge_setting()) and the set of switched off devices;
// settings_mutex guards the scalar settings read by the handler queues of the proxy devices.
// Lock order: a bus callback runs with the lock of the bus held and takes bridge_mutex inside it. The driver queue therefore
// never calls the bus (define, update, delete of a property) while it holds bridge_mutex: it only edits items under it.
static pthread_mutex_t bridge_mutex;
static pthread_mutex_t settings_mutex = PTHREAD_MUTEX_INITIALIZER;
static indigo_device *bridge = NULL;
static indigo_device *devices[MAX_DEVICES];
static server_record servers[MAX_SERVERS];
static device_record records[MAX_RECORDS];
// keys of the devices the user switched off in X_ALPACA_DEVICES; written by a bus thread, read by the driver queue, under bridge_mutex
static char switched_off[MAX_RECORDS][KEY_SIZE];
static int switched_off_count = 0;
static bool selection_pending = false;
static bool reconcile_pending = false;
static int capacity_refused = 0;
static bool servers_pending = false;
static list_item list_items[MAX_RECORDS];
static alpaca_configured_device listed_devices[MAX_LISTED_DEVICES];
static discovery_result discovered;
static bool shutting_down = false;
static bool lists_pending = false;
static int lost_record_count = 0;
static unsigned discovery_generation = 0;
static double poll_idle_interval = 1.0;
static double poll_active_interval = 0.2;
static int establish_timeout = ALPACA_ESTABLISH_TIMEOUT;
static int standard_timeout = ALPACA_STANDARD_TIMEOUT;
static int long_timeout = ALPACA_LONG_TIMEOUT;

static const alpaca_class *system_alpaca_classes[] = {
	&system_alpaca_focuser_class,
	&system_alpaca_wheel_class,
	&system_alpaca_rotator_class,
	&system_alpaca_mount_class,
	&system_alpaca_ccd_class,
	&system_alpaca_dome_class,
	&system_alpaca_lightbox_class,
	&system_alpaca_switch_class,
	&system_alpaca_weather_class,
	&system_alpaca_safety_class
};

static char lower_case(char c) {
	return c >= 'A' && c <= 'Z' ? (char)(c - 'A' + 'a') : c;
}

static bool same_text(const char *text, const char *other) {
	while (*text && lower_case(*text) == lower_case(*other)) {
		text++;
		other++;
	}
	return *text == 0 && *other == 0;
}

// Copy text into a buffer of size bytes, cut at a UTF-8 character boundary.
static void copy_text(char *target, size_t size, const char *source) {
	size_t length = strlen(source);
	if (length >= size) {
		length = size - 1;
		while (length > 0 && ((unsigned char)source[length] & 0xC0) == 0x80) {
			length--;
		}
	}
	memcpy(target, source, length);
	target[length] = 0;
}

// Copy text that becomes a part of a device name: characters that are not allowed in file names (the configuration of a device is
// saved in a file named after it), control characters and "@" are replaced, white space at both ends is removed. "@" is the separator
// of the remote service in the names of the bus: indigo_bus.c routes a request to a remote service "@ <service>" whose name is contained
// in the device name, indigo_xml.c cuts a name at its last "@" before it is sent to a server and indigo_filter.c takes a related device
// with "@" for a remote one, so a proxy name has none.
static void copy_name_part(char *target, size_t size, const char *source) {
	while (*source == ' ') {
		source++;
	}
	copy_text(target, size, source);
	for (char *c = target; *c; c++) {
		if ((unsigned char)*c < ' ' || strchr("/\\:*?\"<>|@", *c) != NULL) {
			*c = '-';
		}
	}
	size_t length = strlen(target);
	while (length > 0 && target[length - 1] == ' ') {
		target[--length] = 0;
	}
}

static void single_line(char *text) {
	for (char *c = text; *c; c++) {
		if ((unsigned char)*c < ' ') {
			*c = ' ';
		}
	}
}

// Key of a device: its UniqueID in lower case (UniqueIDs are compared without regard to case) with everything that is not safe in an
// item name replaced by '_'. A UniqueID that had a character replaced or is too long gets a hash of the whole text (after its beginning),
// so it stays unique: "cam:1" and "cam/1" are two devices.
static void make_key(const char *unique_id, char *key) {
	size_t length = strlen(unique_id);
	uint32_t hash = 2166136261u;
	bool replaced = false;
	for (size_t i = 0; i < length; i++) {
		char c = lower_case(unique_id[i]);
		bool safe = (c >= 'a' && c <= 'z') || (c >= '0' && c <= '9') || c == '-' || c == '.' || c == '_';
		hash = (hash ^ (unsigned char)c) * 16777619u;
		replaced = replaced || !safe;
		if (i < KEY_SIZE - 1) {
			key[i] = safe ? c : '_';
		}
	}
	if (length >= KEY_SIZE - 10 && (replaced || length >= KEY_SIZE)) {
		snprintf(key + KEY_SIZE - 10, 10, "_%08x", (unsigned)hash);
	} else if (replaced) {
		snprintf(key + length, 10, "_%08x", (unsigned)hash);
	} else {
		key[length] = 0;
	}
}

static const alpaca_class *find_class(const char *device_type) {
	for (size_t i = 0; i < sizeof(system_alpaca_classes) / sizeof(system_alpaca_classes[0]); i++) {
		if (system_alpaca_classes[i]->device_type != NULL && same_text(system_alpaca_classes[i]->device_type, device_type)) {
			return system_alpaca_classes[i];
		}
	}
	return NULL;
}

static bool is_shutting_down(void) {
	pthread_mutex_lock(&settings_mutex);
	bool result = shutting_down;
	pthread_mutex_unlock(&settings_mutex);
	return result;
}

static unsigned current_discovery_generation(void) {
	pthread_mutex_lock(&settings_mutex);
	unsigned result = discovery_generation;
	pthread_mutex_unlock(&settings_mutex);
	return result;
}

double system_alpaca_poll_interval(bool active) {
	pthread_mutex_lock(&settings_mutex);
	double result = active ? poll_active_interval : poll_idle_interval;
	pthread_mutex_unlock(&settings_mutex);
	return result;
}

static void get_timeouts(int *establish, int *standard, int *longest) {
	pthread_mutex_lock(&settings_mutex);
	*establish = establish_timeout;
	*standard = standard_timeout;
	*longest = long_timeout;
	pthread_mutex_unlock(&settings_mutex);
}

#pragma mark - Low level code (proxy devices)

static void proxy_connection_finalizer(indigo_device *device);
static void proxy_poll_handler(indigo_device *device);
static bool proxy_close_session(indigo_device *device, bool wait);

static alpaca_capability *capability_find(indigo_device *device, const char *member) {
	for (int i = 0; i < PRIVATE_DATA->capability_count; i++) {
		if (same_text(PRIVATE_DATA->capabilities[i].member, member)) {
			return PRIVATE_DATA->capabilities + i;
		}
	}
	return NULL;
}

static void capability_set(indigo_device *device, const char *member, bool supported, bool value) {
	alpaca_capability *capability = capability_find(device, member);
	if (capability == NULL && PRIVATE_DATA->capability_count < ALPACA_MAX_CAPABILITIES && strlen(member) < ALPACA_MEMBER_SIZE) {
		capability = PRIVATE_DATA->capabilities + PRIVATE_DATA->capability_count++;
		strcpy(capability->member, member);
	}
	if (capability != NULL) {
		capability->supported = supported;
		capability->value = supported && value;
	}
}

alpaca_channel *system_alpaca_channel(indigo_device *device) {
	return PRIVATE_DATA->offline ? NULL : PRIVATE_DATA->channel;
}

alpaca_channel *system_alpaca_transfer_channel(indigo_device *device, size_t max_body_size) {
	if (PRIVATE_DATA->offline) {
		return NULL;
	}
	if (PRIVATE_DATA->transfer == NULL) {
		PRIVATE_DATA->transfer = alpaca_channel_create(PRIVATE_DATA->server, PRIVATE_DATA->device_type, PRIVATE_DATA->device_number, max_body_size);
	}
	return PRIVATE_DATA->transfer;
}

alpaca_result system_alpaca_check(indigo_device *device, alpaca_result result) {
	if (alpaca_is_transport_error(result)) {
		if (++PRIVATE_DATA->transport_errors >= TRANSPORT_ERROR_LIMIT) {
			PRIVATE_DATA->offline = true;
		}
	} else if (result != ALPACA_FAILED) {
		// every reply of the server, also an error, proves that the transport works
		PRIVATE_DATA->transport_errors = 0;
		if (result == ALPACA_NOT_CONNECTED) {
			PRIVATE_DATA->not_connected = true;
		}
	}
	return result;
}

alpaca_result system_alpaca_get_bool(indigo_device *device, const char *member, bool *value) {
	return system_alpaca_check(device, alpaca_get_bool(system_alpaca_channel(device), member, NULL, 0, ALPACA_WAIT_STANDARD, value));
}

alpaca_result system_alpaca_get_int(indigo_device *device, const char *member, int *value) {
	return system_alpaca_check(device, alpaca_get_int(system_alpaca_channel(device), member, NULL, 0, ALPACA_WAIT_STANDARD, value));
}

alpaca_result system_alpaca_get_double(indigo_device *device, const char *member, double *value) {
	return system_alpaca_check(device, alpaca_get_double(system_alpaca_channel(device), member, NULL, 0, ALPACA_WAIT_STANDARD, value));
}

alpaca_result system_alpaca_get_string(indigo_device *device, const char *member, char *value, size_t size) {
	return system_alpaca_check(device, alpaca_get_string(system_alpaca_channel(device), member, NULL, 0, ALPACA_WAIT_STANDARD, value, size));
}

alpaca_result system_alpaca_put(indigo_device *device, const char *member, const alpaca_param *params, int count, int options) {
	return system_alpaca_check(device, alpaca_put(system_alpaca_channel(device), member, params, count, options));
}

const char *system_alpaca_error(indigo_device *device) {
	return PRIVATE_DATA->offline ? "connection lost" : alpaca_last_error_message(PRIVATE_DATA->channel);
}

double system_alpaca_long_timeout(indigo_device *device) {
	alpaca_server *server = PRIVATE_DATA->server;
	pthread_mutex_lock(&server->mutex);
	double timeout = server->long_timeout / 1000.0;
	pthread_mutex_unlock(&server->mutex);
	return timeout;
}

void system_alpaca_reason(indigo_device *device, alpaca_result result, char *reason, size_t size) {
	copy_text(reason, size, result == ALPACA_OK || result == ALPACA_FAILED || alpaca_is_transport_error(result) ? "" : system_alpaca_error(device));
}

bool system_alpaca_not_implemented(alpaca_result result, int parameter_count) {
	return result == ALPACA_UNSUPPORTED || (result == ALPACA_REJECTED && parameter_count == 0);
}

bool system_alpaca_is_active(indigo_device *device) {
	if (DEVICE_CONTEXT == NULL) {
		return false;
	}
	pthread_mutex_lock(&PRIVATE_DATA->mutex);
	bool active = device == PRIVATE_DATA->device ? PRIVATE_DATA->session : PRIVATE_DATA->secondary_session;
	pthread_mutex_unlock(&PRIVATE_DATA->mutex);
	return active;
}

void system_alpaca_lock(indigo_device *device) {
	pthread_mutex_lock(&PRIVATE_DATA->mutex);
}

void system_alpaca_unlock(indigo_device *device) {
	pthread_mutex_unlock(&PRIVATE_DATA->mutex);
}

// Bus thread, with the lock of the device held: what indigo_reject_change() does to the property, without its write of the state outside
// the lock. A property that is BUSY belongs to a request that waits for its handler (ALPACA_ACCEPT_ANYTIME): it is not changed and the
// refusal is only told with a BUSY message. Returns true if the property was put into ALERT and has to be published.
static bool system_alpaca_refuse_locked(indigo_property *property) {
	if (property->state == INDIGO_BUSY_STATE) {
		return false;
	}
	for (int i = 0; i < property->count; i++) {
		property->items[i].do_update = true;
	}
	property->state = INDIGO_ALERT_STATE;
	return true;
}

static void system_alpaca_publish_refusal(indigo_device *device, indigo_property *property, bool publish, const char *message) {
	if (publish) {
		indigo_update_property(device, property, "%s", message);
	} else {
		indigo_send_message(device, BUSY_PROPERTY, "%s", message);
	}
}

void system_alpaca_reject(indigo_device *device, indigo_property *property, const char *message) {
	pthread_mutex_lock(&PRIVATE_DATA->mutex);
	bool publish = system_alpaca_refuse_locked(property);
	pthread_mutex_unlock(&PRIVATE_DATA->mutex);
	system_alpaca_publish_refusal(device, property, publish, message);
}

bool system_alpaca_accept(indigo_device *device, indigo_property *property, indigo_property *request, int options, alpaca_refusal refusal, indigo_timer_callback handler) {
	const char *refused = NULL;
	bool accepted = false, publish = false;
	pthread_mutex_lock(&PRIVATE_DATA->mutex);
	if ((options & ALPACA_ACCEPT_ANYTIME) || property->state != INDIGO_BUSY_STATE) {
		refused = refusal != NULL ? refusal(device) : NULL;
		if (refused != NULL) {
			publish = system_alpaca_refuse_locked(property);
		} else {
			if (options & ALPACA_ACCEPT_TARGETS) {
				indigo_property_copy_targets(property, request, false);
			} else {
				indigo_property_copy_values(property, request, false);
			}
			property->state = INDIGO_BUSY_STATE;
			accepted = true;
		}
	}
	pthread_mutex_unlock(&PRIVATE_DATA->mutex);
	if (accepted) {
		indigo_update_property(device, property, NULL);
		if (handler != NULL) {
			indigo_execute_priority_handler_in(device, (options & ALPACA_ACCEPT_URGENT) ? INDIGO_TASK_PRIORITY_URGENT : INDIGO_TASK_PRIORITY_NORMAL, 0, handler);
		}
	} else if (refused != NULL) {
		system_alpaca_publish_refusal(device, property, publish, refused);
	}
	return accepted;
}

void system_alpaca_set_state(indigo_device *device, indigo_property *property, indigo_property_state state) {
	pthread_mutex_lock(&PRIVATE_DATA->mutex);
	property->state = state;
	pthread_mutex_unlock(&PRIVATE_DATA->mutex);
}

void system_alpaca_update(indigo_device *device, indigo_property *property, indigo_property_state state, const char *format, ...) {
	char message[INDIGO_VALUE_SIZE];
	system_alpaca_set_state(device, property, state);
	if (format == NULL) {
		indigo_update_property(device, property, NULL);
		return;
	}
	va_list args;
	va_start(args, format);
	vsnprintf(message, sizeof(message), format, args);
	va_end(args);
	indigo_update_property(device, property, "%s", message);
}

alpaca_result system_alpaca_state_bool(indigo_device *device, const char *name, bool *value) {
	if (PRIVATE_DATA->polling && alpaca_state_bool(&PRIVATE_DATA->state, name, value)) {
		return ALPACA_OK;
	}
	if (!system_alpaca_supported(device, name)) {
		return ALPACA_UNSUPPORTED;
	}
	alpaca_result result = system_alpaca_get_bool(device, name, value);
	if (alpaca_is_unsupported(result)) {
		system_alpaca_set_unsupported(device, name);
	}
	return result;
}

alpaca_result system_alpaca_state_int(indigo_device *device, const char *name, int *value) {
	if (PRIVATE_DATA->polling && alpaca_state_int(&PRIVATE_DATA->state, name, value)) {
		return ALPACA_OK;
	}
	if (!system_alpaca_supported(device, name)) {
		return ALPACA_UNSUPPORTED;
	}
	alpaca_result result = system_alpaca_get_int(device, name, value);
	if (alpaca_is_unsupported(result)) {
		system_alpaca_set_unsupported(device, name);
	}
	return result;
}

alpaca_result system_alpaca_state_double(indigo_device *device, const char *name, double *value) {
	if (PRIVATE_DATA->polling && alpaca_state_double(&PRIVATE_DATA->state, name, value)) {
		return ALPACA_OK;
	}
	if (!system_alpaca_supported(device, name)) {
		return ALPACA_UNSUPPORTED;
	}
	alpaca_result result = system_alpaca_get_double(device, name, value);
	if (alpaca_is_unsupported(result)) {
		system_alpaca_set_unsupported(device, name);
	}
	return result;
}

alpaca_result system_alpaca_state_string(indigo_device *device, const char *name, char *value, size_t size) {
	const char *text = NULL;
	if (PRIVATE_DATA->polling && alpaca_state_string(&PRIVATE_DATA->state, name, &text)) {
		if (value != NULL && size > 0) {
			copy_text(value, size, text);
		}
		return ALPACA_OK;
	}
	if (!system_alpaca_supported(device, name)) {
		return ALPACA_UNSUPPORTED;
	}
	alpaca_result result = system_alpaca_get_string(device, name, value, size);
	if (alpaca_is_unsupported(result)) {
		system_alpaca_set_unsupported(device, name);
	}
	return result;
}

alpaca_result system_alpaca_probe_bool(indigo_device *device, const char *member, bool *value) {
	alpaca_capability *capability = capability_find(device, member);
	bool flag = false;
	if (capability != NULL) {
		flag = capability->value;
	} else {
		alpaca_result result = system_alpaca_get_bool(device, member, &flag);
		if (result == ALPACA_OK) {
			capability_set(device, member, true, flag);
		} else if (alpaca_is_unsupported(result)) {
			flag = false;
			capability_set(device, member, false, false);
		} else {
			return result;
		}
	}
	if (value != NULL) {
		*value = flag;
	}
	return ALPACA_OK;
}

alpaca_result system_alpaca_probe_member(indigo_device *device, const char *member, bool *supported) {
	alpaca_capability *capability = capability_find(device, member);
	bool flag = true;
	if (capability != NULL) {
		flag = capability->supported;
	} else {
		alpaca_channel *channel = system_alpaca_channel(device);
		alpaca_result result = system_alpaca_check(device, alpaca_get_value(channel, member, NULL, 0, ALPACA_WAIT_STANDARD, NULL));
		if (result == ALPACA_OK) {
			alpaca_end(channel);
		} else if (alpaca_is_transport_error(result) || result == ALPACA_PROTOCOL_ERROR || result == ALPACA_SERVER_ERROR || result == ALPACA_FAILED) {
			// no answer of the device at all, or one that says nothing about the member
			return result;
		}
		flag = !alpaca_is_unsupported(result);
		capability_set(device, member, flag, false);
	}
	if (supported != NULL) {
		*supported = flag;
	}
	return ALPACA_OK;
}

bool system_alpaca_can(indigo_device *device, const char *member) {
	alpaca_capability *capability = capability_find(device, member);
	return capability != NULL && capability->value;
}

bool system_alpaca_supported(indigo_device *device, const char *member) {
	alpaca_capability *capability = capability_find(device, member);
	return capability == NULL || capability->supported;
}

void system_alpaca_set_unsupported(indigo_device *device, const char *member) {
	capability_set(device, member, false, false);
}

void system_alpaca_operation_start(indigo_device *device, alpaca_operation *operation, double timeout, indigo_timer_callback finalizer) {
	if (!operation->active) {
		operation->active = true;
		// the first operation moves the next poll tick from the idle rhythm to the active one, unless the tick is running right now
		if (PRIVATE_DATA->operations++ == 0 && system_alpaca_is_active(PRIVATE_DATA->device) && !PRIVATE_DATA->polling) {
			indigo_cancel_pending_handler(PRIVATE_DATA->device, proxy_poll_handler);
			indigo_execute_handler_in(PRIVATE_DATA->device, system_alpaca_poll_interval(true), proxy_poll_handler);
		}
	}
	operation->deadline = indigo_monotonic_time() + timeout;
	indigo_execute_handler_in(device, system_alpaca_poll_interval(true), finalizer);
}

bool system_alpaca_operation_continue(indigo_device *device, alpaca_operation *operation, indigo_timer_callback finalizer) {
	if (!operation->active || indigo_monotonic_time() >= operation->deadline) {
		return false;
	}
	indigo_execute_handler_in(device, system_alpaca_poll_interval(true), finalizer);
	return true;
}

void system_alpaca_operation_end(indigo_device *device, alpaca_operation *operation) {
	if (operation->active) {
		operation->active = false;
		if (PRIVATE_DATA->operations > 0) {
			PRIVATE_DATA->operations--;
		}
	}
}

indigo_property_state system_alpaca_property_state(alpaca_result result) {
	return result == ALPACA_OK ? INDIGO_OK_STATE : INDIGO_ALERT_STATE;
}

void system_alpaca_report(indigo_device *device, indigo_property *property, alpaca_result result, const char *action, const char *reason) {
	char text[INDIGO_VALUE_SIZE];
	if (result == ALPACA_OK) {
		indigo_update_property(device, property, NULL);
		return;
	}
	if (reason == NULL) {
		system_alpaca_reason(device, result, text, sizeof(text));
		reason = text;
	}
	indigo_update_property(device, property, "%s failed: %s%s%s%s", action != NULL ? action : "Request", alpaca_result_text(result), *reason ? " (" : "", reason, *reason ? ")" : "");
}

void system_alpaca_finish_with(indigo_device *device, indigo_property *property, alpaca_result result, const char *action, const char *reason) {
	system_alpaca_set_state(device, property, system_alpaca_property_state(result));
	system_alpaca_report(device, property, result, action, reason);
}

void system_alpaca_finish(indigo_device *device, indigo_property *property, alpaca_result result, const char *action) {
	system_alpaca_finish_with(device, property, result, action, NULL);
}

// Connect the Alpaca device: read InterfaceVersion to learn which members exist and send connect (Platform 7) or Connected=True.
// Returns true when the device accepted the request; the completion of a Platform 7 connect is watched by proxy_connection_finalizer().
// Returns false after closing the socket, which is everything the attempt acquired.
static bool system_alpaca_open(indigo_device *device) {
	int version = 0;
	PRIVATE_DATA->offline = false;
	PRIVATE_DATA->not_connected = false;
	PRIVATE_DATA->transport_errors = 0;
	PRIVATE_DATA->capability_count = 0;
	PRIVATE_DATA->operations = 0;
	PRIVATE_DATA->state.count = 0;
	PRIVATE_DATA->state_failures = 0;
	alpaca_result result = system_alpaca_check(device, alpaca_get_int(PRIVATE_DATA->channel, "interfaceversion", NULL, 0, ALPACA_WAIT_ESTABLISH, &version));
	if (result == ALPACA_OK) {
		PRIVATE_DATA->interface_version = version;
		PRIVATE_DATA->platform7 = version >= PRIVATE_DATA->device_class->platform7_version;
		if (PRIVATE_DATA->platform7) {
			result = system_alpaca_check(device, alpaca_put_connect(PRIVATE_DATA->channel));
			if (alpaca_is_unsupported(result)) {
				INDIGO_DRIVER_DEBUG(DRIVER_NAME, "'%s' reports interface version %d but has no connect method, using Connected", device->name, version);
				PRIVATE_DATA->platform7 = false;
			}
		}
		if (!PRIVATE_DATA->platform7) {
			result = system_alpaca_check(device, alpaca_put_connected(PRIVATE_DATA->channel, true));
		}
	}
	INDIGO_DRIVER_DEBUG(DRIVER_NAME, "'%s' open (interface version %d, %s) -> %s", device->name, version, PRIVATE_DATA->platform7 ? "connect" : "Connected=True", alpaca_result_text(result));
	if (result != ALPACA_OK) {
		alpaca_channel_close(PRIVATE_DATA->channel);
		return false;
	}
	return true;
}

// Decision D5: an INDIGO disconnect disconnects the Alpaca device. Nothing is sent when the transport is known to be lost
// or when the device reported that it is not connected any more. One failed request is no reason not to try.
// A Platform 7 disconnect is asynchronous, its completion is Connecting false (REFACTOR.md 2.4, 2.7). With wait the device is asked
// once right away; if it is still disconnecting, true is returned and the channel stays open for proxy_disconnection_finalizer().
static bool system_alpaca_close(indigo_device *device, bool wait) {
	bool disconnecting = false;
	if (!PRIVATE_DATA->offline && !PRIVATE_DATA->not_connected) {
		alpaca_result result = PRIVATE_DATA->platform7 ? alpaca_put_disconnect(PRIVATE_DATA->channel) : alpaca_put_connected(PRIVATE_DATA->channel, false);
		INDIGO_DRIVER_DEBUG(DRIVER_NAME, "'%s' close (%s) -> %s", device->name, PRIVATE_DATA->platform7 ? "disconnect" : "Connected=False", alpaca_result_text(result));
		if (wait && PRIVATE_DATA->platform7 && result == ALPACA_OK && alpaca_get_bool(PRIVATE_DATA->channel, "connecting", NULL, 0, ALPACA_WAIT_ESTABLISH, &disconnecting) != ALPACA_OK) {
			disconnecting = false;
		}
	}
	if (!disconnecting) {
		alpaca_channel_close(PRIVATE_DATA->channel);
	}
	alpaca_channel_free(PRIVATE_DATA->transfer);
	PRIVATE_DATA->transfer = NULL;
	PRIVATE_DATA->capability_count = 0;
	PRIVATE_DATA->operations = 0;
	PRIVATE_DATA->state.count = 0;
	return disconnecting;
}

// Detach the secondary device from the bus. It is returned and has to be released with proxy_free_secondary() once no handler of it can be pending.
static indigo_device *proxy_detach_secondary(indigo_device *device) {
	indigo_device *secondary = PRIVATE_DATA->secondary;
	if (secondary != NULL) {
		// on_disconnect of the secondary class runs while the properties of the device are still defined
		proxy_close_session(secondary, false);
		indigo_detach_device(secondary);
		PRIVATE_DATA->secondary = NULL;
		PRIVATE_DATA->secondary_class = NULL;
		indigo_safe_free(PRIVATE_DATA->secondary_data);
		PRIVATE_DATA->secondary_data = NULL;
	}
	return secondary;
}

static void proxy_free_secondary(indigo_device *secondary) {
	if (secondary != NULL) {
		indigo_cancel_pending_handlers(secondary);
		indigo_safe_free(secondary);
	}
}

// End the session of one logical device: call on_disconnect if on_connect succeeded and give up the reference to the open Alpaca device.
// The primary device holds the first reference and the secondary one the second, because it exists only while the primary one is connected.
// The count is kept under the lock of the device, because SHUTDOWN reads it on another thread. Returns the result of system_alpaca_close():
// true if the Alpaca device is still disconnecting (only with wait).
static bool proxy_close_session(indigo_device *device, bool wait) {
	bool is_secondary = device == PRIVATE_DATA->secondary;
	const alpaca_class *device_class = is_secondary ? PRIVATE_DATA->secondary_class : PRIVATE_DATA->device_class;
	bool *session = is_secondary ? &PRIVATE_DATA->secondary_session : &PRIVATE_DATA->session;
	pthread_mutex_lock(&PRIVATE_DATA->mutex);
	bool open = *session;
	*session = false;
	pthread_mutex_unlock(&PRIVATE_DATA->mutex);
	if (open && device_class->on_disconnect != NULL) {
		device_class->on_disconnect(device);
	}
	pthread_mutex_lock(&PRIVATE_DATA->mutex);
	bool last = PRIVATE_DATA->count >= (is_secondary ? 2 : 1) && --PRIVATE_DATA->count == 0;
	pthread_mutex_unlock(&PRIVATE_DATA->mutex);
	return last && system_alpaca_close(device, wait);
}

// Number of logical devices that hold the connection to the Alpaca device open.
static int proxy_count(indigo_device *device) {
	pthread_mutex_lock(&PRIVATE_DATA->mutex);
	int count = PRIVATE_DATA->count;
	pthread_mutex_unlock(&PRIVATE_DATA->mutex);
	return count;
}

// CONNECTION is changed by a bus thread when a request for it is accepted, so the handler queue sets it under the lock of the device.
// With disconnected set the switch goes to DISCONNECTED as well.
static void proxy_set_connection(indigo_device *device, indigo_property_state state, bool disconnected) {
	pthread_mutex_lock(&PRIVATE_DATA->mutex);
	if (disconnected) {
		indigo_set_switch(CONNECTION_PROPERTY, CONNECTION_DISCONNECTED_ITEM, true);
	}
	CONNECTION_PROPERTY->state = state;
	pthread_mutex_unlock(&PRIVATE_DATA->mutex);
}

static void proxy_connection_failed(indigo_device *device, const char *reason) {
	bool is_secondary = device == PRIVATE_DATA->secondary;
	const alpaca_class *device_class = is_secondary ? PRIVATE_DATA->secondary_class : PRIVATE_DATA->device_class;
	char message[ALPACA_TEXT_SIZE];
	copy_text(message, sizeof(message), reason);
	if (!is_secondary) {
		proxy_free_secondary(proxy_detach_secondary(device));
	}
	proxy_close_session(device, false);
	proxy_set_connection(device, INDIGO_ALERT_STATE, true);
	indigo_send_message(device, ALERT_PROPERTY, "Failed to connect to %s%s%s", device->name, *message ? ": " : "", message);
	device_class->base_change_property(device, NULL, CONNECTION_PROPERTY);
}

// INFO of a connected device: MODEL is the Description of the device, the "firmware" is the driver behind the Alpaca device
// (DriverVersion and DriverInfo), the "hardware" is the interface version. Members a device does not answer are left out.
static alpaca_result proxy_read_info(indigo_device *device) {
	char description[ALPACA_TEXT_SIZE] = { 0 };
	char driver_info[ALPACA_TEXT_SIZE] = { 0 };
	char driver_version[INDIGO_NAME_SIZE] = { 0 };
	alpaca_result result = system_alpaca_get_string(device, "description", description, sizeof(description));
	if (!alpaca_is_transport_error(result)) {
		result = system_alpaca_get_string(device, "driverinfo", driver_info, sizeof(driver_info));
	}
	if (!alpaca_is_transport_error(result)) {
		result = system_alpaca_get_string(device, "driverversion", driver_version, sizeof(driver_version));
	}
	if (alpaca_is_transport_error(result)) {
		return result;
	}
	single_line(description);
	single_line(driver_info);
	single_line(driver_version);
	INDIGO_COPY_VALUE(INFO_DEVICE_MODEL_ITEM->text.value, *description ? description : PRIVATE_DATA->device_name);
	if (*driver_version && *driver_info) {
		snprintf(INFO_DEVICE_FW_REVISION_ITEM->text.value, INDIGO_VALUE_SIZE, "%s (%s)", driver_version, driver_info);
	} else {
		snprintf(INFO_DEVICE_FW_REVISION_ITEM->text.value, INDIGO_VALUE_SIZE, "%s", *driver_version ? driver_version : *driver_info ? driver_info : "N/A");
	}
	snprintf(INFO_DEVICE_HW_REVISION_ITEM->text.value, INDIGO_VALUE_SIZE, "%d", PRIVATE_DATA->interface_version);
	indigo_update_property(device, INFO_PROPERTY, NULL);
	return ALPACA_OK;
}

// The Alpaca device is connected: verify it, fill INFO, let the class probe the capabilities and set up its properties, start polling.
static void proxy_connection_complete(indigo_device *device) {
	bool is_secondary = device == PRIVATE_DATA->secondary;
	const alpaca_class *device_class = is_secondary ? PRIVATE_DATA->secondary_class : PRIVATE_DATA->device_class;
	if (!is_secondary) {
		bool connected = false;
		alpaca_result result = system_alpaca_check(device, alpaca_get_bool(PRIVATE_DATA->channel, "connected", NULL, 0, ALPACA_WAIT_ESTABLISH, &connected));
		if (result == ALPACA_OK && !connected) {
			proxy_connection_failed(device, "the device did not connect");
			return;
		}
		if (result == ALPACA_OK) {
			result = proxy_read_info(device);
		}
		if (result != ALPACA_OK) {
			proxy_connection_failed(device, alpaca_last_error_message(PRIVATE_DATA->channel));
			return;
		}
		PRIVATE_DATA->has_device_state = PRIVATE_DATA->platform7;
		PRIVATE_DATA->state_failures = 0;
	}
	if (device_class->on_probe != NULL && !device_class->on_probe(device)) {
		proxy_connection_failed(device, system_alpaca_error(device));
		return;
	}
	if (device_class->on_connect != NULL && !device_class->on_connect(device)) {
		proxy_connection_failed(device, system_alpaca_error(device));
		return;
	}
	pthread_mutex_lock(&PRIVATE_DATA->mutex);
	if (is_secondary) {
		PRIVATE_DATA->secondary_session = true;
	} else {
		PRIVATE_DATA->session = true;
	}
	CONNECTION_PROPERTY->state = INDIGO_OK_STATE;
	pthread_mutex_unlock(&PRIVATE_DATA->mutex);
	indigo_send_message(device, OK_PROPERTY, "Connected to %s", device->name);
	device_class->base_change_property(device, NULL, CONNECTION_PROPERTY);
	if (!is_secondary) {
		indigo_execute_handler_in(device, system_alpaca_poll_interval(false), proxy_poll_handler);
	}
}

// Completion of a Platform 7 connect: "connecting" is polled until it is false, for no longer than the establish timeout.
static void proxy_connection_finalizer(indigo_device *device) {
	bool connecting = false;
	if (DEVICE_CONTEXT == NULL || PRIVATE_DATA->detaching) {
		return;
	}
	alpaca_result result = system_alpaca_check(device, alpaca_get_bool(PRIVATE_DATA->channel, "connecting", NULL, 0, ALPACA_WAIT_ESTABLISH, &connecting));
	if (result != ALPACA_OK) {
		proxy_connection_failed(device, alpaca_last_error_message(PRIVATE_DATA->channel));
	} else if (!connecting) {
		proxy_connection_complete(device);
	} else if (indigo_monotonic_time() < PRIVATE_DATA->connect_deadline) {
		indigo_execute_handler_in(device, CONNECTING_POLL_INTERVAL, proxy_connection_finalizer);
	} else {
		proxy_connection_failed(device, "the device did not finish connecting in time");
	}
}

// The device is disconnected: the message, CONNECTION and the base class. reason is NULL for a disconnect that completed.
static void proxy_disconnected(indigo_device *device, const char *reason) {
	const alpaca_class *device_class = device == PRIVATE_DATA->secondary ? PRIVATE_DATA->secondary_class : PRIVATE_DATA->device_class;
	if (reason == NULL) {
		indigo_send_message(device, OK_PROPERTY, "Disconnected from %s", device->name);
	} else {
		indigo_send_message(device, ALERT_PROPERTY, "Disconnected from %s: %s", device->name, reason);
	}
	proxy_set_connection(device, reason == NULL ? INDIGO_OK_STATE : INDIGO_ALERT_STATE, false);
	device_class->base_change_property(device, NULL, CONNECTION_PROPERTY);
}

// Completion of a Platform 7 disconnect: "connecting" is polled until it is false, for no longer than the establish timeout. CONNECTION
// stays BUSY meanwhile, so a request to connect again is not accepted before the device has finished disconnecting. A detach of the device
// takes over (it empties the queue and closes the channel), and so does a lost transport: the answer is not waited for then.
static void proxy_disconnection_finalizer(indigo_device *device) {
	bool connecting = false;
	if (DEVICE_CONTEXT == NULL || PRIVATE_DATA->detaching) {
		return;
	}
	alpaca_result result = system_alpaca_check(device, alpaca_get_bool(PRIVATE_DATA->channel, "connecting", NULL, 0, ALPACA_WAIT_ESTABLISH, &connecting));
	if (result == ALPACA_OK && connecting && indigo_monotonic_time() < PRIVATE_DATA->connect_deadline) {
		indigo_execute_handler_in(device, CONNECTING_POLL_INTERVAL, proxy_disconnection_finalizer);
		return;
	}
	INDIGO_DRIVER_DEBUG(DRIVER_NAME, "'%s' connecting -> %s, %s", device->name, alpaca_result_text(result), connecting ? "true" : "false");
	alpaca_channel_close(PRIVATE_DATA->channel);
	proxy_disconnected(device, result == ALPACA_OK && connecting ? "the device did not finish disconnecting in time" : NULL);
}

static void proxy_connection_handler(indigo_device *device) {
	if (DEVICE_CONTEXT == NULL || PRIVATE_DATA->detaching) {
		return;
	}
	bool is_secondary = device == PRIVATE_DATA->secondary;
	// the switch was written by the bus thread that accepted the request
	pthread_mutex_lock(&PRIVATE_DATA->mutex);
	bool connect = CONNECTION_CONNECTED_ITEM->sw.value;
	pthread_mutex_unlock(&PRIVATE_DATA->mutex);
	if (connect) {
		bool connection_result = true;
		char reason[ALPACA_TEXT_SIZE] = { 0 };
		pthread_mutex_lock(&PRIVATE_DATA->mutex);
		bool first = PRIVATE_DATA->count++ == 0;
		pthread_mutex_unlock(&PRIVATE_DATA->mutex);
		if (first) {
			connection_result = system_alpaca_open(device);
			if (!connection_result) {
				pthread_mutex_lock(&PRIVATE_DATA->mutex);
				PRIVATE_DATA->count--;
				pthread_mutex_unlock(&PRIVATE_DATA->mutex);
				copy_text(reason, sizeof(reason), alpaca_last_error_message(PRIVATE_DATA->channel));
			} else if (PRIVATE_DATA->platform7) {
				int establish = 0, standard = 0, longest = 0;
				get_timeouts(&establish, &standard, &longest);
				PRIVATE_DATA->connect_deadline = indigo_monotonic_time() + establish / 1000.0;
				indigo_execute_handler_in(device, CONNECTING_POLL_INTERVAL, proxy_connection_finalizer);
				return;
			}
		}
		if (connection_result) {
			proxy_connection_complete(device);
		} else {
			proxy_connection_failed(device, reason);
		}
	} else {
		indigo_cancel_pending_handlers(device);
		if (!is_secondary) {
			proxy_free_secondary(proxy_detach_secondary(device));
		}
		if (proxy_close_session(device, true)) {
			int establish = 0, standard = 0, longest = 0;
			get_timeouts(&establish, &standard, &longest);
			PRIVATE_DATA->connect_deadline = indigo_monotonic_time() + establish / 1000.0;
			indigo_execute_handler_in(device, CONNECTING_POLL_INTERVAL, proxy_disconnection_finalizer);
			return;
		}
		proxy_disconnected(device, NULL);
	}
}

// The transport to a connected device is lost or the device is not connected on the server any more: the device goes to
// the disconnected state with CONNECTION in ALERT, everything of the session is released, a new connect starts from scratch.
static void proxy_connection_lost(indigo_device *device, const char *reason) {
	INDIGO_DRIVER_ERROR(DRIVER_NAME, "'%s': %s", device->name, reason);
	indigo_cancel_pending_handlers(device);
	proxy_free_secondary(proxy_detach_secondary(device));
	proxy_close_session(device, false);
	proxy_set_connection(device, INDIGO_ALERT_STATE, true);
	indigo_send_message(device, ALERT_PROPERTY, "%s: %s", device->name, reason);
	PRIVATE_DATA->device_class->base_change_property(device, NULL, CONNECTION_PROPERTY);
}

// devicestate got an answer that is no snapshot (HTTP 500, a reply that can not be read, an error of the device). The tick goes on
// without a snapshot, so the class reads the members it needs one by one and nothing it publishes freezes. A device whose devicestate
// fails DEVICE_STATE_FAILURE_LIMIT ticks in a row is polled without it for the rest of the connection.
static void proxy_device_state_failed(indigo_device *device, alpaca_result result) {
	char reason[INDIGO_VALUE_SIZE];
	system_alpaca_reason(device, result, reason, sizeof(reason));
	PRIVATE_DATA->state.count = 0;
	if (++PRIVATE_DATA->state_failures < DEVICE_STATE_FAILURE_LIMIT) {
		INDIGO_DRIVER_DEBUG(DRIVER_NAME, "'%s' devicestate -> %s%s%s, polling the members one by one in this tick", device->name, alpaca_result_text(result), *reason ? ": " : "", reason);
		return;
	}
	PRIVATE_DATA->has_device_state = false;
	INDIGO_DRIVER_ERROR(DRIVER_NAME, "'%s' devicestate failed %d times in a row (%s%s%s), it is not used any more", device->name, PRIVATE_DATA->state_failures, alpaca_result_text(result), *reason ? ": " : "", reason);
	indigo_send_message(device, ALERT_PROPERTY, "%s: DeviceState can not be read (%s%s%s), the state is read member by member", device->name, alpaca_result_text(result), *reason ? ": " : "", reason);
}

// Poll tick of a connected primary device. Platform 7: one devicestate request, served to on_poll through system_alpaca_state_*().
// Older devices: "connected" is read as the sign of life and the class reads what it needs with requests of its own.
// on_poll is called on every tick the server answered, also when the answer was an error: only a request without an answer
// (a transport error, counted by system_alpaca_check()) skips it, because every further request of the tick would wait for its timeout.
// Read the state and serve it to on_poll of the primary device and, with secondary, of the secondary device. A lost connection is only
// noted (offline, not_connected); the caller handles it.
static void proxy_poll_once(indigo_device *device, bool secondary) {
	alpaca_result result = ALPACA_OK;
	if (!PRIVATE_DATA->offline && !PRIVATE_DATA->not_connected) {
		if (PRIVATE_DATA->has_device_state) {
			result = system_alpaca_check(device, alpaca_get_device_state(PRIVATE_DATA->channel, &PRIVATE_DATA->state));
			if (result == ALPACA_OK) {
				PRIVATE_DATA->state_failures = 0;
			} else if (alpaca_is_unsupported(result)) {
				INDIGO_DRIVER_DEBUG(DRIVER_NAME, "'%s' has no devicestate, polling the members one by one", device->name);
				PRIVATE_DATA->has_device_state = false;
				PRIVATE_DATA->state.count = 0;
			} else if (!alpaca_is_transport_error(result) && result != ALPACA_NOT_CONNECTED) {
				proxy_device_state_failed(device, result);
				result = ALPACA_OK;
			}
		}
		if (!PRIVATE_DATA->has_device_state) {
			bool connected = true;
			result = system_alpaca_get_bool(device, "connected", &connected);
			if (result == ALPACA_OK && !connected) {
				PRIVATE_DATA->not_connected = true;
			} else if (!alpaca_is_transport_error(result)) {
				// any answer of the server is a sign of life; what the device can still tell is up to its members
				result = ALPACA_OK;
			}
		}
	}
	if (result == ALPACA_OK && !PRIVATE_DATA->offline && !PRIVATE_DATA->not_connected) {
		PRIVATE_DATA->polling = true;
		if (PRIVATE_DATA->device_class->on_poll != NULL) {
			PRIVATE_DATA->device_class->on_poll(device);
		}
		if (secondary && PRIVATE_DATA->secondary != NULL && system_alpaca_is_active(PRIVATE_DATA->secondary) && PRIVATE_DATA->secondary_class->on_poll != NULL) {
			PRIVATE_DATA->secondary_class->on_poll(PRIVATE_DATA->secondary);
		}
		PRIVATE_DATA->polling = false;
	}
	PRIVATE_DATA->state.count = 0;
}

static void proxy_poll_handler(indigo_device *device) {
	// the session is tested, not CONNECTION: a bus thread changes CONNECTION when a disconnect is requested
	if (!system_alpaca_is_active(device) || PRIVATE_DATA->detaching) {
		return;
	}
	proxy_poll_once(device, true);
	if (PRIVATE_DATA->not_connected) {
		proxy_connection_lost(device, "the device was disconnected on the Alpaca server");
	} else if (PRIVATE_DATA->offline) {
		proxy_connection_lost(device, "connection to the Alpaca server lost");
	} else {
		indigo_execute_handler_in(device, system_alpaca_poll_interval(PRIVATE_DATA->operations > 0), proxy_poll_handler);
	}
}

// Only the state of the primary device is read: a lost connection is left to the regular tick, which takes the secondary device away,
// and the caller may be a handler of that secondary device.
void system_alpaca_poll_now(indigo_device *device) {
	indigo_device *primary = PRIVATE_DATA->device;
	if (!system_alpaca_is_active(primary) || PRIVATE_DATA->detaching) {
		return;
	}
	proxy_poll_once(primary, false);
}

static const char *proxy_info_model(indigo_device *device) {
	return INFO_DEVICE_MODEL_ITEM->text.value;
}

static const char *proxy_info_driver(indigo_device *device) {
	return INFO_DEVICE_FW_REVISION_ITEM->text.value;
}

indigo_result system_alpaca_attach(indigo_device *device) {
	bool is_secondary = device == PRIVATE_DATA->secondary;
	INFO_PROPERTY->count = 8;
	INDIGO_COPY_VALUE(INFO_DEVICE_MODEL_ITEM->text.value, PRIVATE_DATA->device_name);
	INDIGO_COPY_VALUE(INFO_DEVICE_FW_REVISION_ITEM->label, "Alpaca driver");
	INDIGO_COPY_VALUE(INFO_DEVICE_HW_REVISION_ITEM->label, "Alpaca interface version");
	INDIGO_COPY_VALUE(INFO_DEVICE_SERIAL_NUM_ITEM->label, "Alpaca UniqueID");
	INDIGO_COPY_VALUE(INFO_DEVICE_SERIAL_NUM_ITEM->text.value, PRIVATE_DATA->unique_id);
	snprintf(INFO_DEVICE_HW_REVISION_ITEM->text.value, INDIGO_VALUE_SIZE, "%d", PRIVATE_DATA->interface_version);
	if (is_secondary) {
		// the secondary device is attached while the primary one is connected, so INFO of the Alpaca device is known
		INDIGO_COPY_VALUE(INFO_DEVICE_MODEL_ITEM->text.value, proxy_info_model(PRIVATE_DATA->device));
		INDIGO_COPY_VALUE(INFO_DEVICE_FW_REVISION_ITEM->text.value, proxy_info_driver(PRIVATE_DATA->device));
	}
	// "Simulator" in the name of an Alpaca device does not make the proxy an INDIGO simulator
	SIMULATION_PROPERTY->hidden = true;
	ADDITIONAL_INSTANCES_PROPERTY->hidden = true;
	INDIGO_DEVICE_ATTACH_LOG(DRIVER_NAME, device->name);
	return INDIGO_OK;
}

bool system_alpaca_change_property(indigo_device *device, indigo_property *property) {
	assert(device != NULL);
	assert(property != NULL);
	if (indigo_property_match_changeable(CONNECTION_PROPERTY, property)) {
		// the steps of INDIGO_PROCESS_CONNECT under the lock of the device: the handler queue sets CONNECTION as well (a failed connect, a lost transport)
		pthread_mutex_lock(&PRIVATE_DATA->mutex);
		bool accepted = !indigo_ignore_connection_change(device, property);
		if (accepted) {
			indigo_property_copy_values(CONNECTION_PROPERTY, property, false);
			CONNECTION_PROPERTY->state = INDIGO_BUSY_STATE;
		}
		pthread_mutex_unlock(&PRIVATE_DATA->mutex);
		if (accepted) {
			indigo_update_property(device, CONNECTION_PROPERTY, NULL);
			indigo_execute_handler(device, proxy_connection_handler);
		}
		return true;
	}
	return false;
}

void system_alpaca_detach(indigo_device *device) {
	// The core disconnects a primary device before it detaches it and cancels the pending handlers; a secondary device is detached by
	// its primary one. What is left here is to end a session that is still open, on the thread that already has the device for itself.
	proxy_close_session(device, false);
}

bool system_alpaca_attach_secondary(indigo_device *device, const alpaca_class *secondary_class) {
	static const indigo_device secondary_template = INDIGO_DEVICE_INITIALIZER("", NULL, NULL, NULL, NULL, NULL);
	if (device != PRIVATE_DATA->device || PRIVATE_DATA->secondary != NULL || secondary_class == NULL || secondary_class->name_suffix == NULL) {
		return false;
	}
	indigo_device *secondary = indigo_safe_malloc_copy(sizeof(indigo_device), (void *)&secondary_template);
	snprintf(secondary->name, INDIGO_NAME_SIZE, "%s%s", device->name, secondary_class->name_suffix);
	secondary->private_data = PRIVATE_DATA;
	secondary->master_device = device;
	secondary->attach = secondary_class->attach;
	secondary->enumerate_properties = secondary_class->enumerate_properties;
	secondary->change_property = secondary_class->change_property;
	secondary->detach = secondary_class->detach;
	PRIVATE_DATA->secondary_data = secondary_class->data_size > 0 ? indigo_safe_malloc(secondary_class->data_size) : NULL;
	PRIVATE_DATA->secondary_class = secondary_class;
	PRIVATE_DATA->secondary = secondary;
	if (indigo_attach_device(secondary) != INDIGO_OK || secondary->last_result != INDIGO_OK) {
		INDIGO_DRIVER_ERROR(DRIVER_NAME, "Failed to attach '%s'", secondary->name);
		if (secondary->device_context == NULL) {
			secondary->detach = NULL;
		}
		proxy_free_secondary(proxy_detach_secondary(device));
		return false;
	}
	return true;
}

#pragma mark - High level code (bridge)

static void bridge_discovery_handler(indigo_device *device, void *data);
static void bridge_lists_handler(indigo_device *device);
static void bridge_reconcile_handler(indigo_device *device);

// Value of a number item of a setting of the bridge. A bus thread writes the settings under bridge_mutex when a client changes them.
static double bridge_setting(indigo_item *item) {
	pthread_mutex_lock(&bridge_mutex);
	double value = item->number.value;
	pthread_mutex_unlock(&bridge_mutex);
	return value;
}

// Driver queue: end a request for a property of the bridge. The state is set under bridge_mutex, because a bus thread accepts the
// next request and enumerates the properties under it; the property is published without it. reset is a switch item to clear, or NULL.
static void bridge_finish(indigo_device *device, indigo_property *property, indigo_item *reset) {
	pthread_mutex_lock(&bridge_mutex);
	if (reset != NULL) {
		reset->sw.value = false;
	}
	property->state = INDIGO_OK_STATE;
	pthread_mutex_unlock(&bridge_mutex);
	indigo_update_property(device, property, NULL);
}

// CONFIG of the bridge is written by the framework (the bus thread that starts a restore, the background handler of the restore that
// ends it) without any lock this driver could take as well, so the read can not be ordered against those writes from here. A stale
// value only defers the work by one CONFIG_WAIT_INTERVAL or lets one list update through before the restore has set BUSY.
static bool bridge_config_busy(void) {
	indigo_device *device = bridge;
	return CONFIG_PROPERTY->state == INDIGO_BUSY_STATE;
}

static server_record *server_find(const char *host, int port) {
	for (int i = 0; i < MAX_SERVERS; i++) {
		if (servers[i].used && servers[i].transport->port == port && same_text(servers[i].transport->host, host)) {
			return servers + i;
		}
	}
	return NULL;
}

static server_record *server_add(const char *host, int port) {
	int establish = 0, standard = 0, longest = 0;
	for (int i = 0; i < MAX_SERVERS; i++) {
		server_record *server = servers + i;
		if (!server->used) {
			memset(server, 0, sizeof(server_record));
			server->transport = alpaca_server_create(host, port);
			if (server->transport == NULL) {
				return NULL;
			}
			get_timeouts(&establish, &standard, &longest);
			alpaca_server_set_timeouts(server->transport, establish, standard, longest);
			server->channel = alpaca_channel_create(server->transport, NULL, 0, ALPACA_CONTROL_MAX_BODY);
			server->used = true;
			INDIGO_DRIVER_LOG(DRIVER_NAME, "Alpaca server %s:%d added", host, port);
			return server;
		}
	}
	INDIGO_DRIVER_ERROR(DRIVER_NAME, "Alpaca server %s:%d ignored, the limit of %d servers is reached", host, port, MAX_SERVERS);
	return NULL;
}

// Remove a server. No proxy device may use it any more: the devices of the server have to be detached before.
static void server_remove(server_record *server) {
	INDIGO_DRIVER_LOG(DRIVER_NAME, "Alpaca server %s:%d removed", server->transport->host, server->transport->port);
	for (int i = 0; i < MAX_RECORDS; i++) {
		if (records[i].used && records[i].server == server) {
			records[i].server = NULL;
			records[i].present = false;
		}
	}
	alpaca_channel_free(server->channel);
	alpaca_server_free(server->transport);
	memset(server, 0, sizeof(server_record));
}

static void server_set_absent(server_record *server) {
	for (int i = 0; i < MAX_RECORDS; i++) {
		if (records[i].used && records[i].server == server && records[i].present) {
			records[i].present = false;
			lost_record_count++;
		}
	}
	server->device_count = 0;
	server->duplicate_count = 0;
}

static device_record *record_find(const char *key) {
	for (int i = 0; i < MAX_RECORDS; i++) {
		if (records[i].used && !strcmp(records[i].key, key)) {
			return records + i;
		}
	}
	return NULL;
}

static device_record *record_add(const char *key) {
	for (int i = 0; i < MAX_RECORDS; i++) {
		device_record *record = records + i;
		if (!record->used) {
			memset(record, 0, sizeof(device_record));
			strcpy(record->key, key);
			record->used = true;
			return record;
		}
	}
	return NULL;
}

// Index of a key in switched_off, -1 if the device is not switched off. Called with bridge_mutex held.
static int switched_off_find(const char *key) {
	for (int i = 0; i < switched_off_count; i++) {
		if (!strcmp(switched_off[i], key)) {
			return i;
		}
	}
	return -1;
}

// Switch a device off or on by its key. Returns false if the set is full and the device could not be switched off. Called with bridge_mutex held.
static bool switched_off_set(const char *key, bool off) {
	int index = switched_off_find(key);
	if (off && index < 0) {
		if (switched_off_count == MAX_RECORDS) {
			return false;
		}
		strcpy(switched_off[switched_off_count++], key);
	} else if (!off && index >= 0) {
		// the last key takes the place of the one taken out; the last one itself only shortens the set
		if (index < --switched_off_count) {
			strcpy(switched_off[index], switched_off[switched_off_count]);
		}
	}
	return true;
}

// Driver queue: bring the records in line with switched_off. A device that is switched off and is not known yet gets a record of its own,
// listed as OFFLINE until a server lists it, so that its switch stays in X_ALPACA_DEVICES and is saved with the configuration.
static void records_apply_selection(void) {
	int lost = 0;
	pthread_mutex_lock(&bridge_mutex);
	for (int i = 0; i < MAX_RECORDS; i++) {
		if (records[i].used) {
			records[i].selected = switched_off_find(records[i].key) < 0;
		}
	}
	for (int i = 0; i < switched_off_count; i++) {
		if (record_find(switched_off[i]) == NULL) {
			device_record *record = record_add(switched_off[i]);
			if (record != NULL) {
				copy_text(record->unique_id, sizeof(record->unique_id), switched_off[i]);
			} else {
				lost++;
			}
		}
	}
	pthread_mutex_unlock(&bridge_mutex);
	if (lost > 0) {
		INDIGO_DRIVER_ERROR(DRIVER_NAME, "%d device(s) switched off are not listed, the limit of %d devices is reached", lost, MAX_RECORDS);
	}
}

static void proxy_free(indigo_device *device) {
	alpaca_private_data *private_data = PRIVATE_DATA;
	pthread_mutex_destroy(&private_data->mutex);
	alpaca_channel_free(private_data->channel);
	alpaca_channel_free(private_data->transfer);
	indigo_safe_free(private_data->class_data);
	indigo_safe_free(private_data->secondary_data);
	indigo_safe_free(private_data);
	indigo_safe_free(device);
}

// Remove every "alpaca" from a name, in any letter case and also inside a word ("MyAlpacaDome" becomes "MyDome"), and tidy what is
// left: a run of spaces becomes one space, and spaces and separators ("-", "_", ":") left dangling at either end are removed.
static void strip_alpaca(char *text) {
	static const char *word = "alpaca";
	size_t length = strlen(word);
	char *target = text;
	for (const char *source = text; *source; ) {
		size_t matched = 0;
		while (matched < length && source[matched] && lower_case(source[matched]) == word[matched]) {
			matched++;
		}
		if (matched == length) {
			source += length;
		} else if (*source == ' ' && (target == text || target[-1] == ' ')) {
			source++;
		} else {
			*target++ = *source++;
		}
	}
	*target = 0;
	while (target > text && strchr(" -_:", target[-1]) != NULL) {
		*--target = 0;
	}
	size_t skip = strspn(text, " -_:");
	memmove(text, text + skip, strlen(text + skip) + 1);
}

// Name of an Alpaca device without a number (decision D17): "ALPACA <DeviceName>", without any "alpaca" of the DeviceName (strip_alpaca())
// and with the characters a device name can not have replaced (copy_name_part(), "@" included, D14). If nothing is left of the
// DeviceName, the DeviceType is used. The prefix in upper case keeps every proxy apart from the bridge device "Alpaca".
// The DeviceName part is cut between UTF-8 characters to DEVICE_NAME_PART_SIZE, so that "ALPACA ", the number of a duplicate (" #" and
// up to 3 digits) and the suffix of a secondary device (" (guider)") still fit into INDIGO_NAME_SIZE with the terminating zero: 7 + 99 + 5 + 9 + 1 < 128.
static void proxy_base_name(const device_record *record, char *name) {
	char part[INDIGO_NAME_SIZE];
	char cut[DEVICE_NAME_PART_SIZE];
	copy_name_part(part, sizeof(part), record->name);
	strip_alpaca(part);
	if (*part == 0) {
		copy_name_part(part, sizeof(part), record->type);
		strip_alpaca(part);
	}
	copy_text(cut, sizeof(cut), *part ? part : "Device");
	strip_alpaca(cut);
	snprintf(name, INDIGO_NAME_SIZE, "ALPACA %s", cut);
}

// No device of the bus has the name. indigo_make_name_unique() is asked on a copy: it changes the copy only if the name is taken.
static bool proxy_name_free(const char *name) {
	char probe[INDIGO_NAME_SIZE + 16];
	snprintf(probe, sizeof(probe), "%s", name);
	indigo_make_name_unique(probe, NULL);
	return !strcmp(probe, name);
}

// Name of a proxy device (decision D17). Devices of the same name get a running number: "ALPACA Focuser Simulator", "ALPACA Focuser
// Simulator #2", ... The configuration of a device is saved under its name, so the numbers are given in a fixed order, not in the order
// of attaching: a device gets the place of its key among the keys of all devices of the same name the servers list now, switched on or
// off. A name that is taken on the bus (a device of that name that kept its name while it is attached, or any other device) is passed
// over for the next number. A proxy keeps its name while it is attached.
static void proxy_make_name(const device_record *record, char *name) {
	char base[INDIGO_NAME_SIZE];
	char other[INDIGO_NAME_SIZE];
	int number = 1;
	proxy_base_name(record, base);
	for (int i = 0; i < MAX_RECORDS; i++) {
		if (records[i].used && records + i != record && records[i].server != NULL && records[i].present) {
			proxy_base_name(records + i, other);
			if (!strcmp(base, other) && strcmp(records[i].key, record->key) < 0) {
				number++;
			}
		}
	}
	for (int attempt = 0; attempt < 1000; attempt++, number++) {
		if (number == 1) {
			strcpy(name, base);
		} else {
			snprintf(name, INDIGO_NAME_SIZE, "%s #%d", base, number);
		}
		if (proxy_name_free(name)) {
			return;
		}
	}
	indigo_make_name_unique(name, NULL);
}

// Create and attach the proxy device of an Alpaca device that is switched on. The device has to answer InterfaceVersion first: a device that is
// listed but does not work is not attached. On failure everything is released again and record->message says why.
static bool proxy_attach(device_record *record, const alpaca_class *device_class) {
	static const indigo_device proxy_template = INDIGO_DEVICE_INITIALIZER("", NULL, NULL, NULL, NULL, NULL);
	int slot = 0;
	int version = 0;
	while (slot < MAX_DEVICES && devices[slot] != NULL) {
		slot++;
	}
	if (slot == MAX_DEVICES) {
		snprintf(record->message, sizeof(record->message), "the limit of %d proxy devices is reached", MAX_DEVICES);
		return false;
	}
	alpaca_private_data *private_data = indigo_safe_malloc(sizeof(alpaca_private_data));
	indigo_device *device = indigo_safe_malloc_copy(sizeof(indigo_device), (void *)&proxy_template);
	pthread_mutexattr_t attributes;
	pthread_mutexattr_init(&attributes);
	pthread_mutexattr_settype(&attributes, PTHREAD_MUTEX_RECURSIVE);
	pthread_mutex_init(&private_data->mutex, &attributes);
	pthread_mutexattr_destroy(&attributes);
	private_data->server = record->server->transport;
	private_data->device_class = device_class;
	private_data->device_number = record->number;
	private_data->device = device;
	copy_text(private_data->device_type, sizeof(private_data->device_type), record->type);
	copy_text(private_data->device_name, sizeof(private_data->device_name), *record->name ? record->name : record->type);
	copy_text(private_data->unique_id, sizeof(private_data->unique_id), record->unique_id);
	private_data->channel = alpaca_channel_create(private_data->server, record->type, record->number, ALPACA_CONTROL_MAX_BODY);
	private_data->class_data = device_class->data_size > 0 ? indigo_safe_malloc(device_class->data_size) : NULL;
	device->private_data = private_data;
	device->master_device = device;
	device->attach = device_class->attach;
	device->enumerate_properties = device_class->enumerate_properties;
	device->change_property = device_class->change_property;
	device->detach = device_class->detach;
	alpaca_result result = alpaca_get_int(private_data->channel, "interfaceversion", NULL, 0, ALPACA_WAIT_ESTABLISH, &version);
	if (result != ALPACA_OK) {
		char reason[INDIGO_NAME_SIZE - 64];
		copy_text(reason, sizeof(reason), alpaca_last_error_message(private_data->channel));
		snprintf(record->message, sizeof(record->message), "the device does not answer (%s%s%s)", alpaca_result_text(result), *reason ? ", " : "", reason);
		proxy_free(device);
		return false;
	}
	alpaca_channel_close(private_data->channel);
	private_data->interface_version = version;
	private_data->platform7 = version >= device_class->platform7_version;
	proxy_make_name(record, device->name);
	devices[slot] = device;
	if (indigo_attach_device(device) != INDIGO_OK || device->last_result != INDIGO_OK) {
		snprintf(record->message, sizeof(record->message), "the proxy device could not be attached");
		devices[slot] = NULL;
		// a device whose base class was not attached has nothing its detach callback could release
		if (device->device_context == NULL) {
			device->detach = NULL;
		}
		indigo_detach_device(device);
		proxy_free(device);
		return false;
	}
	record->device = device;
	record->message[0] = 0;
	return true;
}

// Disconnect (decision D5) and detach the proxy device of a record. The handler queue of the device is emptied first and the lock of
// the device of the framework is taken, so no handler of the device runs while its session is closed; handlers that are queued
// afterwards see the detaching flag or a session that is closed and do nothing.
// Nothing may empty the queue (indigo_cancel_pending_handler(s)) while that lock is held: the worker of the queue marks a task as running
// before it takes the lock, and the cancel waits for a running task that matches, which waits for the lock. So the queue is emptied
// before the lock is taken, every handler and finalizer that runs after the detaching flag is set returns without queuing anything,
// and on_disconnect of a class does not cancel anything while the device is being detached.
static void proxy_detach(device_record *record) {
	indigo_device *device = record->device;
	indigo_device *secondary = NULL;
	indigo_cancel_pending_handlers(device);
	// The handlers of the device run with this lock held, so the flag is written while none of them runs and is read by them without
	// a race. From here on no handler attaches or detaches the secondary device, so its pointer stays valid without the lock.
	indigo_lock_master_device(device);
	PRIVATE_DATA->detaching = true;
	indigo_device *guider = PRIVATE_DATA->secondary;
	indigo_unlock_master_device(device);
	// the queue is not emptied with the lock held: it waits for a handler that is running, and that one may wait for the lock
	if (guider != NULL) {
		indigo_cancel_pending_handlers(guider);
	}
	indigo_lock_master_device(device);
	if (proxy_count(device) > 0 || system_alpaca_is_active(device)) {
		secondary = proxy_detach_secondary(device);
		proxy_close_session(device, false);
		proxy_set_connection(device, INDIGO_OK_STATE, true);
		PRIVATE_DATA->device_class->base_change_property(device, NULL, CONNECTION_PROPERTY);
	}
	indigo_unlock_master_device(device);
	proxy_free_secondary(secondary);
	for (int i = 0; i < MAX_DEVICES; i++) {
		if (devices[i] == device) {
			devices[i] = NULL;
		}
	}
	indigo_detach_device(device);
	proxy_free(device);
	record->device = NULL;
}

// A device that is attached was found at another address or with another device number: its channels follow it.
static void proxy_rebind(device_record *record) {
	indigo_device *device = record->device;
	indigo_lock_master_device(device);
	PRIVATE_DATA->server = record->server->transport;
	PRIVATE_DATA->device_number = record->number;
	alpaca_channel_bind(PRIVATE_DATA->channel, PRIVATE_DATA->server, record->type, record->number);
	if (PRIVATE_DATA->transfer != NULL) {
		alpaca_channel_bind(PRIVATE_DATA->transfer, PRIVATE_DATA->server, record->type, record->number);
	}
	indigo_unlock_master_device(device);
	INDIGO_DRIVER_LOG(DRIVER_NAME, "'%s' is now %s #%d at %s:%d", device->name, record->type, record->number, PRIVATE_DATA->server->host, PRIVATE_DATA->server->port);
}

static void server_missed(server_record *server, const char *error) {
	int retention = (int)bridge_setting(X_ALPACA_DISCOVERY_SETTINGS_RETENTION_ITEM);
	copy_text(server->error, sizeof(server->error), error);
	server->missed++;
	if (server->missed >= retention) {
		if (server->online) {
			INDIGO_DRIVER_LOG(DRIVER_NAME, "Alpaca server %s:%d does not answer (%s), its devices are removed", server->transport->host, server->transport->port, error);
		}
		server->online = false;
		server->described = false;
		server_set_absent(server);
	}
}

// Ask a server what it is and which devices it has, and merge the answer into the list of devices.
static void server_query(server_record *server) {
	int versions[8];
	int count = 0;
	alpaca_result result = ALPACA_OK;
	char key[KEY_SIZE];
	char generated_id[ALPACA_TEXT_SIZE];
	if (!server->described) {
		bool version1 = false;
		// An answer that is no Alpaca envelope is asked for again at once, twice: a server that echoes a wrong ClientTransactionID
		// is accepted by the transport layer at the third answer, and must not look like a silent server until then.
		for (int attempt = 0; attempt < 3; attempt++) {
			result = alpaca_get_api_versions(server->channel, versions, 8, &count);
			if (result != ALPACA_PROTOCOL_ERROR) {
				break;
			}
		}
		// a server without the apiversions request is taken as a version 1 server
		if (result != ALPACA_OK && !alpaca_is_unsupported(result)) {
			server_missed(server, alpaca_last_error_message(server->channel));
			return;
		}
		for (int i = 0; i < count; i++) {
			version1 = version1 || versions[i] == 1;
		}
		server->unsupported = result == ALPACA_OK && !version1;
		result = alpaca_get_description(server->channel, &server->description);
		if (result != ALPACA_OK && !alpaca_is_unsupported(result)) {
			server_missed(server, alpaca_last_error_message(server->channel));
			return;
		}
		single_line(server->description.server_name);
		single_line(server->description.manufacturer);
		single_line(server->description.manufacturer_version);
		copy_text(server->name, sizeof(server->name), server->description.server_name);
		copy_text(server->maker, sizeof(server->maker) - 40, server->description.manufacturer);
		if (*server->description.manufacturer_version) {
			size_t length = strlen(server->maker);
			server->maker[length++] = ' ';
			copy_text(server->maker + length, 39, server->description.manufacturer_version);
		}
		// proxy loop: the Alpaca server of INDIGO itself (agent_alpaca) exports INDIGO devices, importing them again would duplicate them endlessly
		server->bridge = same_text(server->description.server_name, INDIGO_BRIDGE_SERVER_NAME) || same_text(server->description.manufacturer, INDIGO_BRIDGE_MANUFACTURER);
		server->described = true;
		INDIGO_DRIVER_LOG(DRIVER_NAME, "Alpaca server %s:%d is '%s' (%s %s)%s", server->transport->host, server->transport->port, server->description.server_name, server->description.manufacturer, server->description.manufacturer_version, server->bridge ? ", an INDIGO bridge that is ignored" : server->unsupported ? ", without API version 1" : "");
	}
	if (server->bridge || server->unsupported) {
		server->online = true;
		server->missed = 0;
		server->error[0] = 0;
		server_set_absent(server);
		return;
	}
	result = alpaca_get_configured_devices(server->channel, listed_devices, MAX_LISTED_DEVICES, &count);
	if (result != ALPACA_OK) {
		server_missed(server, alpaca_last_error_message(server->channel));
		return;
	}
	if (count == MAX_LISTED_DEVICES && server->device_count != count) {
		INDIGO_DRIVER_ERROR(DRIVER_NAME, "Alpaca server %s:%d lists more than %d devices, the rest is ignored", server->transport->host, server->transport->port, MAX_LISTED_DEVICES);
	}
	server->online = true;
	server->missed = 0;
	server->error[0] = 0;
	server->device_count = count;
	server->duplicate_count = 0;
	for (int i = 0; i < MAX_RECORDS; i++) {
		records[i].listed = false;
	}
	for (int i = 0; i < count; i++) {
		alpaca_configured_device *listed = listed_devices + i;
		const char *unique_id = listed->unique_id;
		if (*unique_id == 0) {
			// a device without UniqueID gets one from its address; it loses its identity when the address changes
			snprintf(generated_id, sizeof(generated_id), "%s-%d-%s-%d", listed->device_type, listed->device_number, server->transport->host, server->transport->port);
			unique_id = generated_id;
		}
		make_key(unique_id, key);
		device_record *record = record_find(key);
		if (record == NULL) {
			record = record_add(key);
			if (record == NULL) {
				INDIGO_DRIVER_ERROR(DRIVER_NAME, "Alpaca device '%s' ignored, the limit of %d devices is reached", listed->device_name, MAX_RECORDS);
				continue;
			}
		} else if (record->listed || (record->server != NULL && record->server != server && record->server->online && record->present)) {
			// the same UniqueID twice: on another server that is alive (a server reachable at two addresses, or a cloned device) or in this listing; the first one stays
			server->duplicate_count++;
			continue;
		}
		bool moved = record->device != NULL && (record->server != server || record->number != listed->device_number);
		record->reattach = record->reattach || (record->device != NULL && !same_text(record->type, listed->device_type));
		record->server = server;
		record->number = listed->device_number;
		record->present = true;
		record->listed = true;
		copy_text(record->unique_id, sizeof(record->unique_id), unique_id);
		copy_text(record->name, sizeof(record->name), listed->device_name);
		copy_text(record->type, sizeof(record->type), listed->device_type);
		single_line(record->name);
		if (moved && !record->reattach) {
			proxy_rebind(record);
		}
	}
	for (int i = 0; i < MAX_RECORDS; i++) {
		if (records[i].used && records[i].server == server && !records[i].listed && records[i].present) {
			records[i].present = false;
			lost_record_count++;
		}
	}
}

// The management connection is not kept open between the cycles: small embedded servers have only a few sockets,
// and those are better used by the devices.
static void server_refresh(server_record *server) {
	server_query(server);
	alpaca_channel_close(server->channel);
}

static const char *record_state(const device_record *record) {
	if (record->device != NULL) {
		return "ATTACHED";
	}
	if (!record->present) {
		return "OFFLINE";
	}
	if (find_class(record->type) == NULL) {
		return "UNSUPPORTED";
	}
	return record->selected ? "FAILED" : "AVAILABLE";
}

// Replace the items of a property whose item list changes at run time with list_items[0..count). If only values changed, the
// property is updated; if the items themselves changed, it is deleted and defined again, as clients expect. The property was
// allocated for its largest item count, so it never moves. The items are edited under bridge_mutex, the bus is called without it.
static void bridge_sync_property(indigo_device *device, indigo_property *property, int count) {
	bool changed = false;
	pthread_mutex_lock(&bridge_mutex);
	bool same = property->count == count;
	for (int i = 0; same && i < count; i++) {
		indigo_item *item = property->items + i;
		same = !strcmp(item->name, list_items[i].name) && !strcmp(item->label, list_items[i].label);
		changed = changed || (property->type == INDIGO_SWITCH_VECTOR ? item->sw.value != list_items[i].value : strcmp(indigo_get_text_item_value(item), list_items[i].text) != 0);
	}
	for (int i = 0; same && changed && i < count; i++) {
		if (property->type == INDIGO_SWITCH_VECTOR) {
			property->items[i].sw.value = list_items[i].value;
		} else {
			indigo_set_text_item_value(property->items + i, list_items[i].text);
		}
	}
	pthread_mutex_unlock(&bridge_mutex);
	if (same) {
		if (changed) {
			indigo_update_property(device, property, NULL);
		}
		return;
	}
	indigo_delete_property(device, property, NULL);
	pthread_mutex_lock(&bridge_mutex);
	indigo_resize_property(property, count);
	for (int i = 0; i < count; i++) {
		if (property->type == INDIGO_SWITCH_VECTOR) {
			indigo_init_switch_item(property->items + i, list_items[i].name, list_items[i].label, list_items[i].value);
		} else {
			indigo_init_text_item(property->items + i, list_items[i].name, list_items[i].label, "%s", list_items[i].text);
		}
	}
	pthread_mutex_unlock(&bridge_mutex);
	indigo_define_property(device, property, NULL);
}

// Publish the lists of servers and devices. The item lists are not touched while the configuration is being restored, because the
// restore of a property fails when the property is deleted in the middle of it; the update is repeated when the restore is over.
// The switches are taken from switched_off, so a request accepted since the last reconcile is not published back to its old value.
static void bridge_update_lists(void) {
	indigo_device *device = bridge;
	int count = 0;
	if (bridge_config_busy()) {
		if (!lists_pending) {
			lists_pending = true;
			indigo_queue_add(driver_queue, device, INDIGO_TASK_PRIORITY_NORMAL, CONFIG_WAIT_INTERVAL, bridge_lists_handler, &driver_queue_mutex);
		}
		return;
	}
	records_apply_selection();
	for (int i = 0; i < MAX_SERVERS; i++) {
		server_record *server = servers + i;
		if (server->used) {
			list_item *item = list_items + count++;
			const char *origin = server->manual && server->discovered ? "manual and discovered" : server->manual ? "manual" : "discovered";
			snprintf(item->name, sizeof(item->name), "%s:%d", server->transport->host, server->transport->port);
			snprintf(item->label, sizeof(item->label), "%s", *server->name ? server->name : item->name);
			if (server->bridge) {
				snprintf(item->text, sizeof(item->text), "IGNORED: INDIGO Alpaca bridge, its devices are INDIGO devices already (%s)", origin);
			} else if (server->unsupported) {
				snprintf(item->text, sizeof(item->text), "UNSUPPORTED: the server has no Alpaca API version 1 (%s)", origin);
			} else if (server->online && server->missed == 0) {
				snprintf(item->text, sizeof(item->text), "ONLINE: %d device(s), %d duplicate(s), %s (%s)", server->device_count, server->duplicate_count, server->maker, origin);
			} else {
				snprintf(item->text, sizeof(item->text), "%s: no answer to %d request(s), %s (%s)", server->online ? "SILENT" : "OFFLINE", server->missed, server->error, origin);
			}
		}
	}
	bridge_sync_property(device, X_ALPACA_SERVER_STATUS_PROPERTY, count);
	count = 0;
	for (int i = 0; i < MAX_RECORDS; i++) {
		device_record *record = records + i;
		if (record->used) {
			list_item *item = list_items + count++;
			strcpy(item->name, record->key);
			item->value = record->selected;
			if (record->server != NULL) {
				snprintf(item->label, sizeof(item->label), "%s (%s) @ %s", record->name, record->type, *record->server->name ? record->server->name : record->server->transport->host);
				snprintf(item->text, sizeof(item->text), "%s: %s #%d at %s:%d, UniqueID %s", record_state(record), record->type, record->number, record->server->transport->host, record->server->transport->port, record->unique_id);
			} else {
				snprintf(item->label, sizeof(item->label), "%s%s%s%s", *record->name ? record->name : record->unique_id, *record->type ? " (" : "", record->type, *record->type ? ")" : "");
				snprintf(item->text, sizeof(item->text), "%s: not listed by any server, UniqueID %s", record_state(record), record->unique_id);
			}
			size_t length = strlen(item->text);
			if (record->device != NULL) {
				snprintf(item->text + length, sizeof(item->text) - length, ", device '%s'", record->device->name);
			} else if (*record->message) {
				snprintf(item->text + length, sizeof(item->text) - length, ", %s", record->message);
			}
		}
	}
	bridge_sync_property(device, X_ALPACA_DEVICES_PROPERTY, count);
	bridge_sync_property(device, X_ALPACA_DEVICE_STATUS_PROPERTY, count);
}

static bool proxy_room(void) {
	for (int slot = 0; slot < MAX_DEVICES; slot++) {
		if (devices[slot] == NULL) {
			return true;
		}
	}
	return false;
}

// Bring the proxy devices in line with the lists: attach what is switched on and present, detach what is not, forget what is on and
// listed by no server. Nothing is done while the configuration is being restored (see the top of this file): the work is repeated when
// the restore is over, so the switches restored from the configuration are known before the first proxy device is attached.
// The devices are detached first, so that the room a device switched off leaves is there for a device that waits for it.
static void bridge_reconcile(void) {
	int retention = (int)bridge_setting(X_ALPACA_DISCOVERY_SETTINGS_RETENTION_ITEM);
	bool stopping = is_shutting_down();
	int refused = 0;
	if (bridge_config_busy()) {
		if (!reconcile_pending) {
			reconcile_pending = true;
			indigo_queue_add(driver_queue, bridge, INDIGO_TASK_PRIORITY_NORMAL, CONFIG_WAIT_INTERVAL, bridge_reconcile_handler, &driver_queue_mutex);
		}
		return;
	}
	// this reconcile does what a deferred one would have done
	reconcile_pending = false;
	records_apply_selection();
	for (int i = 0; i < MAX_RECORDS; i++) {
		device_record *record = records + i;
		bool wanted = record->selected && record->present && find_class(record->type) != NULL && !stopping;
		if (record->used && record->device != NULL && (!wanted || record->reattach)) {
			INDIGO_DRIVER_LOG(DRIVER_NAME, "'%s' is detached (%s)", record->device->name, !record->selected ? "switched off" : !record->present ? "not available any more" : "changed");
			proxy_detach(record);
		}
	}
	for (int i = 0; i < MAX_RECORDS; i++) {
		device_record *record = records + i;
		if (!record->used) {
			continue;
		}
		const alpaca_class *device_class = find_class(record->type);
		bool wanted = record->selected && record->present && device_class != NULL && !stopping;
		record->reattach = false;
		if (wanted && record->device == NULL) {
			char previous[INDIGO_NAME_SIZE];
			strcpy(previous, record->message);
			bool attached = false;
			if (proxy_room()) {
				attached = proxy_attach(record, device_class);
			} else {
				snprintf(record->message, sizeof(record->message), "the limit of %d proxy devices is reached", MAX_DEVICES);
				refused++;
			}
			if (!attached && strcmp(previous, record->message)) {
				INDIGO_DRIVER_ERROR(DRIVER_NAME, "Alpaca device '%s' (%s #%d) is not attached: %s", record->name, record->type, record->number, record->message);
			}
		} else if (!wanted) {
			record->message[0] = 0;
		}
		if (!record->present && record->selected) {
			memset(record, 0, sizeof(device_record));
		}
	}
	for (int i = 0; i < MAX_SERVERS; i++) {
		server_record *server = servers + i;
		if (server->used && !server->manual && (!server->discovered || (!server->online && server->missed >= retention))) {
			server_remove(server);
		}
	}
	if (refused > 0 && refused != capacity_refused) {
		indigo_send_message(bridge, NULL, "%d Alpaca device(s) have no proxy device, the limit of %d proxy devices is reached; switch devices off in %s to make room", refused, MAX_DEVICES, X_ALPACA_DEVICES_PROPERTY_NAME);
	}
	capacity_refused = refused;
	bridge_update_lists();
}

// The reconcile deferred while the configuration was being restored, unless another one has run since.
static void bridge_reconcile_handler(indigo_device *device) {
	assert(device != NULL);
	if (reconcile_pending && !is_shutting_down()) {
		reconcile_pending = false;
		bridge_reconcile();
	}
}

static bool discovery_callback(const char *responder, int responder_port, const char *reply, long length, void *context) {
	discovery_result *result = context;
	int port = 0;
	if (!alpaca_parse_discovery_reply(reply, length, &port)) {
		INDIGO_DRIVER_DEBUG(DRIVER_NAME, "Discovery reply of %s:%d ignored: '%.*s'", responder, responder_port, (int)(length > 100 ? 100 : length), reply);
		return true;
	}
	for (int i = 0; i < result->count; i++) {
		if (result->endpoints[i].port == port && !strcmp(result->endpoints[i].host, responder)) {
			return true;
		}
	}
	if (result->count < MAX_SERVERS && strlen(responder) < ALPACA_HOST_SIZE) {
		strcpy(result->endpoints[result->count].host, responder);
		result->endpoints[result->count++].port = port;
	}
	return true;
}

// Send the discovery request: to the targets of X_ALPACA_DISCOVERY_TARGETS if there are any, otherwise as a broadcast on every
// interface and on the loopback network, and collect the endpoints (address of the responder and AlpacaPort) that answered.
static void bridge_discover(void) {
	// The UDP discovery waits for replies for polls * timeout, the handler queue task has no run time limit.
	indigo_set_handler_max_run_time(0);
	int port = (int)bridge_setting(X_ALPACA_DISCOVERY_SETTINGS_PORT_ITEM);
	int polls = (int)bridge_setting(X_ALPACA_DISCOVERY_SETTINGS_POLLS_ITEM);
	long timeout = (long)bridge_setting(X_ALPACA_DISCOVERY_SETTINGS_TIMEOUT_ITEM) * 1000;
	char targets[INDIGO_VALUE_SIZE];
	char host[ALPACA_HOST_SIZE];
	int target_count = 0;
	int target_port = 0;
	memset(&discovered, 0, sizeof(discovered));
	pthread_mutex_lock(&bridge_mutex);
	copy_text(targets, sizeof(targets), X_ALPACA_DISCOVERY_TARGETS_ITEM->text.value);
	pthread_mutex_unlock(&bridge_mutex);
	for (char *token = targets, *next = NULL; token != NULL && target_count < MAX_TARGETS; token = next) {
		next = strpbrk(token, ",; ");
		if (next != NULL) {
			*next++ = 0;
		}
		if (*token && alpaca_parse_endpoint(token, port, host, sizeof(host), &target_port)) {
			target_count++;
			indigo_uni_discover(host, target_port, ALPACA_DISCOVERY_MESSAGE, (long)strlen(ALPACA_DISCOVERY_MESSAGE), polls, timeout, false, discovery_callback, &discovered);
		}
	}
	if (target_count == 0) {
		indigo_uni_discover(NULL, port, ALPACA_DISCOVERY_MESSAGE, (long)strlen(ALPACA_DISCOVERY_MESSAGE), polls, timeout, true, discovery_callback, &discovered);
	}
	for (int i = 0; i < discovered.count; i++) {
		server_record *server = server_find(discovered.endpoints[i].host, discovered.endpoints[i].port);
		if (server == NULL) {
			server = server_add(discovered.endpoints[i].host, discovered.endpoints[i].port);
		}
		if (server != NULL) {
			server->discovered = true;
		}
	}
}

// One cycle: discovery (if asked for), then every known server is asked for its devices, then the proxy devices are brought in line.
static void bridge_cycle(bool discover) {
	if (discover) {
		bridge_discover();
	}
	lost_record_count = 0;
	for (int i = 0; i < MAX_SERVERS; i++) {
		if (servers[i].used) {
			server_refresh(servers + i);
		}
	}
	// A device that was refused as a duplicate while another server still listed it is taken over in the same cycle in which
	// that server lost it, whatever the order of the servers is, so the proxy device of a device that moved is kept.
	for (int i = 0; lost_record_count > 0 && i < MAX_SERVERS; i++) {
		if (servers[i].used && servers[i].online && servers[i].duplicate_count > 0) {
			server_refresh(servers + i);
		}
	}
	bridge_reconcile();
}

// The periodic cycle. It runs every INTERVAL seconds whether discovery is enabled or not: X_ALPACA_DISCOVERY only decides whether
// the cycle looks for new servers. The known servers (the manual ones above all) are always asked again, so a server that was down
// is found when it is back, a device that disappeared is detached and a failed attach is tried again.
// data is the generation the chain of calls belongs to: a change of the discovery properties starts a new generation, and a call
// of an older one ends its chain. Nothing runs while the configuration is being restored, so the first cycle after INIT already
// uses the saved settings.
static void bridge_discovery_handler(indigo_device *device, void *data) {
	unsigned generation = (unsigned)(uintptr_t)data;
	if (is_shutting_down() || generation != current_discovery_generation()) {
		return;
	}
	if (bridge_config_busy()) {
		indigo_queue_add_with_data(driver_queue, device, INDIGO_TASK_PRIORITY_NORMAL, CONFIG_WAIT_INTERVAL, bridge_discovery_handler, data, &driver_queue_mutex);
		return;
	}
	pthread_mutex_lock(&bridge_mutex);
	bool enabled = X_ALPACA_DISCOVERY_ENABLED_ITEM->sw.value;
	pthread_mutex_unlock(&bridge_mutex);
	bridge_cycle(enabled);
	if (!is_shutting_down() && generation == current_discovery_generation()) {
		indigo_queue_add_with_data(driver_queue, device, INDIGO_TASK_PRIORITY_NORMAL, bridge_setting(X_ALPACA_DISCOVERY_SETTINGS_INTERVAL_ITEM), bridge_discovery_handler, data, &driver_queue_mutex);
	}
}

// Start a new chain of periodic cycles, with the first cycle now or one interval from now.
static void bridge_restart_discovery(indigo_device *device, bool immediately) {
	pthread_mutex_lock(&settings_mutex);
	unsigned generation = ++discovery_generation;
	pthread_mutex_unlock(&settings_mutex);
	indigo_queue_add_with_data(driver_queue, device, INDIGO_TASK_PRIORITY_NORMAL, immediately ? 0 : X_ALPACA_DISCOVERY_SETTINGS_INTERVAL_ITEM->number.value, bridge_discovery_handler, (void *)(uintptr_t)generation, &driver_queue_mutex);
}

static void bridge_x_alpaca_discover_handler(indigo_device *device) {
	if (is_shutting_down()) {
		return;
	}
	if (bridge_config_busy()) {
		indigo_queue_add(driver_queue, device, INDIGO_TASK_PRIORITY_NORMAL, CONFIG_WAIT_INTERVAL, bridge_x_alpaca_discover_handler, &driver_queue_mutex);
		return;
	}
	bridge_cycle(true);
	bridge_finish(device, X_ALPACA_DISCOVER_PROPERTY, X_ALPACA_DISCOVER_ITEM);
}

// Apply X_ALPACA_SERVERS: servers that are new in the list are added and asked for their devices at once,
// servers that left the list and were not discovered are removed together with their devices.
// This handler and the one of X_ALPACA_DEVICES also run while the configuration is being restored: the restore waits for the
// property to leave the BUSY state. Only the lists are published later, see bridge_update_lists().
static void bridge_x_alpaca_servers_handler(indigo_device *device) {
	char list[INDIGO_VALUE_SIZE];
	char host[ALPACA_HOST_SIZE];
	int port = 0;
	if (is_shutting_down()) {
		return;
	}
	pthread_mutex_lock(&bridge_mutex);
	servers_pending = false;
	copy_text(list, sizeof(list), X_ALPACA_SERVERS_LIST_ITEM->text.value);
	pthread_mutex_unlock(&bridge_mutex);
	for (int i = 0; i < MAX_SERVERS; i++) {
		servers[i].manual = false;
	}
	for (char *token = list, *next = NULL; token != NULL; token = next) {
		next = strpbrk(token, ",; ");
		if (next != NULL) {
			*next++ = 0;
		}
		if (*token && alpaca_parse_endpoint(token, ALPACA_DEFAULT_PORT, host, sizeof(host), &port)) {
			server_record *server = server_find(host, port);
			if (server == NULL) {
				server = server_add(host, port);
			}
			if (server != NULL) {
				server->manual = true;
			}
		}
	}
	for (int i = 0; i < MAX_SERVERS; i++) {
		server_record *server = servers + i;
		if (server->used && !server->manual && !server->discovered) {
			server_set_absent(server);
		} else if (server->used && !server->described) {
			server_refresh(server);
		}
	}
	bridge_reconcile();
	bridge_finish(device, X_ALPACA_SERVERS_PROPERTY, NULL);
}

// Bring the proxy devices in line with the switches recorded by bridge_change_devices().
static void bridge_x_alpaca_devices_handler(indigo_device *device) {
	assert(device != NULL);
	if (is_shutting_down()) {
		return;
	}
	pthread_mutex_lock(&bridge_mutex);
	selection_pending = false;
	pthread_mutex_unlock(&bridge_mutex);
	bridge_reconcile();
}

static void bridge_x_alpaca_timeouts_handler(indigo_device *device) {
	if (is_shutting_down()) {
		return;
	}
	int establish = (int)round(bridge_setting(X_ALPACA_TIMEOUTS_ESTABLISH_ITEM) * 1000);
	int standard = (int)round(bridge_setting(X_ALPACA_TIMEOUTS_STANDARD_ITEM) * 1000);
	int longest = (int)round(bridge_setting(X_ALPACA_TIMEOUTS_LONG_ITEM) * 1000);
	pthread_mutex_lock(&settings_mutex);
	establish_timeout = establish;
	standard_timeout = standard;
	long_timeout = longest;
	pthread_mutex_unlock(&settings_mutex);
	for (int i = 0; i < MAX_SERVERS; i++) {
		if (servers[i].used) {
			alpaca_server_set_timeouts(servers[i].transport, establish, standard, longest);
		}
	}
	bridge_finish(device, X_ALPACA_TIMEOUTS_PROPERTY, NULL);
}

static void bridge_lists_handler(indigo_device *device) {
	assert(device != NULL);
	lists_pending = false;
	if (!is_shutting_down()) {
		bridge_update_lists();
	}
}

// Normalise a list of servers given by the user: every entry has to be host[:port], the result is "host:port, host:port" without
// duplicates. add and remove are single entries that are appended to or taken out of the list. Returns false if an entry is not valid
// or there are too many of them.
static bool bridge_edit_servers(const char *list, const char *add, const char *remove, char *result, size_t size) {
	char text[2 * INDIGO_VALUE_SIZE];
	char entries[MAX_SERVERS][ALPACA_HOST_SIZE + 16];
	char entry[ALPACA_HOST_SIZE + 16];
	char removed[ALPACA_HOST_SIZE + 16] = { 0 };
	char host[ALPACA_HOST_SIZE];
	int port = 0;
	int count = 0;
	size_t used = 0;
	if (*remove) {
		if (!alpaca_parse_endpoint(remove, ALPACA_DEFAULT_PORT, host, sizeof(host), &port)) {
			return false;
		}
		snprintf(removed, sizeof(removed), strchr(host, ':') != NULL ? "[%s]:%d" : "%s:%d", host, port);
	}
	snprintf(text, sizeof(text), "%s,%s", list, add);
	for (char *token = text, *next = NULL; token != NULL; token = next) {
		next = strpbrk(token, ",; ");
		if (next != NULL) {
			*next++ = 0;
		}
		if (*token == 0) {
			continue;
		}
		if (!alpaca_parse_endpoint(token, ALPACA_DEFAULT_PORT, host, sizeof(host), &port)) {
			return false;
		}
		snprintf(entry, sizeof(entry), strchr(host, ':') != NULL ? "[%s]:%d" : "%s:%d", host, port);
		bool skip = same_text(entry, removed);
		for (int i = 0; i < count && !skip; i++) {
			skip = same_text(entry, entries[i]);
		}
		if (skip) {
			continue;
		}
		if (count == MAX_SERVERS) {
			return false;
		}
		strcpy(entries[count++], entry);
	}
	*result = 0;
	for (int i = 0; i < count; i++) {
		if (used + strlen(entries[i]) + 3 > size) {
			return false;
		}
		used += (size_t)snprintf(result + used, size - used, "%s%s", i > 0 ? ", " : "", entries[i]);
	}
	return true;
}

// Discovery targets are numeric IPv4 addresses with an optional port, because that is what the discovery request can be sent to.
static bool bridge_targets_valid(const char *targets) {
	char text[INDIGO_VALUE_SIZE];
	char host[ALPACA_HOST_SIZE];
	int port = 0;
	int count = 0;
	if (strlen(targets) >= sizeof(text)) {
		return false;
	}
	strcpy(text, targets);
	for (char *token = text, *next = NULL; token != NULL; token = next) {
		next = strpbrk(token, ",; ");
		if (next != NULL) {
			*next++ = 0;
		}
		if (*token == 0) {
			continue;
		}
		if (++count > MAX_TARGETS || !alpaca_parse_endpoint(token, ALPACA_DISCOVERY_PORT, host, sizeof(host), &port) || strspn(host, "0123456789.") != strlen(host)) {
			return false;
		}
	}
	return true;
}

#pragma mark - Device API (bridge)

static indigo_result bridge_enumerate_properties(indigo_device *device, indigo_client *client, indigo_property *property);

static indigo_result bridge_attach(indigo_device *device) {
	if (indigo_aux_attach(device, DRIVER_NAME, DRIVER_VERSION, INDIGO_INTERFACE_AUX) == INDIGO_OK) {
		// the bridge has nothing to connect to, it works from the moment it is attached
		CONNECTION_PROPERTY->hidden = true;
		X_ALPACA_DISCOVERY_PROPERTY = indigo_init_switch_property(NULL, device->name, X_ALPACA_DISCOVERY_PROPERTY_NAME, DISCOVERY_GROUP, "Periodic discovery", INDIGO_OK_STATE, INDIGO_RW_PERM, INDIGO_ONE_OF_MANY_RULE, 2);
		if (X_ALPACA_DISCOVERY_PROPERTY == NULL) {
			return INDIGO_FAILED;
		}
		indigo_init_switch_item(X_ALPACA_DISCOVERY_ENABLED_ITEM, X_ALPACA_DISCOVERY_ENABLED_ITEM_NAME, "Enabled", true);
		indigo_init_switch_item(X_ALPACA_DISCOVERY_DISABLED_ITEM, X_ALPACA_DISCOVERY_DISABLED_ITEM_NAME, "Disabled", false);
		X_ALPACA_DISCOVERY_SETTINGS_PROPERTY = indigo_init_number_property(NULL, device->name, X_ALPACA_DISCOVERY_SETTINGS_PROPERTY_NAME, DISCOVERY_GROUP, "Discovery settings", INDIGO_OK_STATE, INDIGO_RW_PERM, 5);
		if (X_ALPACA_DISCOVERY_SETTINGS_PROPERTY == NULL) {
			return INDIGO_FAILED;
		}
		indigo_init_number_item(X_ALPACA_DISCOVERY_SETTINGS_PORT_ITEM, X_ALPACA_DISCOVERY_SETTINGS_PORT_ITEM_NAME, "UDP port", 1, 65535, 1, ALPACA_DISCOVERY_PORT);
		indigo_init_number_item(X_ALPACA_DISCOVERY_SETTINGS_INTERVAL_ITEM, X_ALPACA_DISCOVERY_SETTINGS_INTERVAL_ITEM_NAME, "Interval between discovery cycles (s)", 1, 3600, 1, 30);
		indigo_init_number_item(X_ALPACA_DISCOVERY_SETTINGS_TIMEOUT_ITEM, X_ALPACA_DISCOVERY_SETTINGS_TIMEOUT_ITEM_NAME, "Time to wait for replies (ms)", 50, 10000, 1, 1000);
		indigo_init_number_item(X_ALPACA_DISCOVERY_SETTINGS_POLLS_ITEM, X_ALPACA_DISCOVERY_SETTINGS_POLLS_ITEM_NAME, "Requests per cycle", 1, 10, 1, 2);
		indigo_init_number_item(X_ALPACA_DISCOVERY_SETTINGS_RETENTION_ITEM, X_ALPACA_DISCOVERY_SETTINGS_RETENTION_ITEM_NAME, "Cycles a silent server is kept", 1, 100, 1, 3);
		X_ALPACA_DISCOVERY_TARGETS_PROPERTY = indigo_init_text_property(NULL, device->name, X_ALPACA_DISCOVERY_TARGETS_PROPERTY_NAME, DISCOVERY_GROUP, "Discovery targets", INDIGO_OK_STATE, INDIGO_RW_PERM, 1);
		if (X_ALPACA_DISCOVERY_TARGETS_PROPERTY == NULL) {
			return INDIGO_FAILED;
		}
		indigo_init_text_item(X_ALPACA_DISCOVERY_TARGETS_ITEM, X_ALPACA_DISCOVERY_TARGETS_ITEM_NAME, "IPv4 addresses (address[:port], ...), empty for broadcast", "");
		X_ALPACA_DISCOVER_PROPERTY = indigo_init_switch_property(NULL, device->name, X_ALPACA_DISCOVER_PROPERTY_NAME, DISCOVERY_GROUP, "Discover now", INDIGO_OK_STATE, INDIGO_RW_PERM, INDIGO_ANY_OF_MANY_RULE, 1);
		if (X_ALPACA_DISCOVER_PROPERTY == NULL) {
			return INDIGO_FAILED;
		}
		indigo_init_switch_item(X_ALPACA_DISCOVER_ITEM, X_ALPACA_DISCOVER_ITEM_NAME, "Discover", false);
		X_ALPACA_SERVERS_PROPERTY = indigo_init_text_property(NULL, device->name, X_ALPACA_SERVERS_PROPERTY_NAME, SERVERS_GROUP, "Manually added servers", INDIGO_OK_STATE, INDIGO_RW_PERM, 3);
		if (X_ALPACA_SERVERS_PROPERTY == NULL) {
			return INDIGO_FAILED;
		}
		indigo_init_text_item(X_ALPACA_SERVERS_LIST_ITEM, X_ALPACA_SERVERS_LIST_ITEM_NAME, "Servers (host:port, ...)", "");
		indigo_init_text_item(X_ALPACA_SERVERS_ADD_ITEM, X_ALPACA_SERVERS_ADD_ITEM_NAME, "Add server (host:port)", "");
		indigo_init_text_item(X_ALPACA_SERVERS_REMOVE_ITEM, X_ALPACA_SERVERS_REMOVE_ITEM_NAME, "Remove server (host:port)", "");
		X_ALPACA_SERVER_STATUS_PROPERTY = indigo_init_text_property(NULL, device->name, X_ALPACA_SERVER_STATUS_PROPERTY_NAME, SERVERS_GROUP, "Servers", INDIGO_OK_STATE, INDIGO_RO_PERM, MAX_SERVERS);
		if (X_ALPACA_SERVER_STATUS_PROPERTY == NULL) {
			return INDIGO_FAILED;
		}
		X_ALPACA_SERVER_STATUS_PROPERTY->count = 0;
		X_ALPACA_DEVICES_PROPERTY = indigo_init_switch_property(NULL, device->name, X_ALPACA_DEVICES_PROPERTY_NAME, DEVICES_GROUP, "Devices used by INDIGO", INDIGO_OK_STATE, INDIGO_RW_PERM, INDIGO_ANY_OF_MANY_RULE, MAX_RECORDS);
		if (X_ALPACA_DEVICES_PROPERTY == NULL) {
			return INDIGO_FAILED;
		}
		X_ALPACA_DEVICES_PROPERTY->count = 0;
		X_ALPACA_DEVICE_STATUS_PROPERTY = indigo_init_text_property(NULL, device->name, X_ALPACA_DEVICE_STATUS_PROPERTY_NAME, DEVICES_GROUP, "Devices", INDIGO_OK_STATE, INDIGO_RO_PERM, MAX_RECORDS);
		if (X_ALPACA_DEVICE_STATUS_PROPERTY == NULL) {
			return INDIGO_FAILED;
		}
		// the three lists start empty; they are allocated for their largest size so that they never move when their items change
		X_ALPACA_DEVICE_STATUS_PROPERTY->count = 0;
		X_ALPACA_TIMEOUTS_PROPERTY = indigo_init_number_property(NULL, device->name, X_ALPACA_TIMEOUTS_PROPERTY_NAME, ADVANCED_GROUP, "Request timeouts", INDIGO_OK_STATE, INDIGO_RW_PERM, 3);
		if (X_ALPACA_TIMEOUTS_PROPERTY == NULL) {
			return INDIGO_FAILED;
		}
		indigo_init_number_item(X_ALPACA_TIMEOUTS_ESTABLISH_ITEM, X_ALPACA_TIMEOUTS_ESTABLISH_ITEM_NAME, "Establishing a connection (s)", 0.1, 60, 0.1, ALPACA_ESTABLISH_TIMEOUT / 1000.0);
		indigo_init_number_item(X_ALPACA_TIMEOUTS_STANDARD_ITEM, X_ALPACA_TIMEOUTS_STANDARD_ITEM_NAME, "Ordinary requests (s)", 0.1, 300, 0.1, ALPACA_STANDARD_TIMEOUT / 1000.0);
		indigo_init_number_item(X_ALPACA_TIMEOUTS_LONG_ITEM, X_ALPACA_TIMEOUTS_LONG_ITEM_NAME, "Long operations and transfers (s)", 0.1, 3600, 0.1, ALPACA_LONG_TIMEOUT / 1000.0);
		X_ALPACA_POLLING_PROPERTY = indigo_init_number_property(NULL, device->name, X_ALPACA_POLLING_PROPERTY_NAME, ADVANCED_GROUP, "Polling intervals", INDIGO_OK_STATE, INDIGO_RW_PERM, 2);
		if (X_ALPACA_POLLING_PROPERTY == NULL) {
			return INDIGO_FAILED;
		}
		indigo_init_number_item(X_ALPACA_POLLING_IDLE_ITEM, X_ALPACA_POLLING_IDLE_ITEM_NAME, "Idle device (s)", 0.05, 60, 0.05, 1);
		indigo_init_number_item(X_ALPACA_POLLING_ACTIVE_ITEM, X_ALPACA_POLLING_ACTIVE_ITEM_NAME, "Operation in progress (s)", 0.05, 10, 0.05, 0.2);
		INDIGO_DEVICE_ATTACH_LOG(DRIVER_NAME, device->name);
		return bridge_enumerate_properties(device, NULL, NULL);
	}
	return INDIGO_FAILED;
}

static indigo_result bridge_enumerate_properties(indigo_device *device, indigo_client *client, indigo_property *property) {
	// the driver queue edits the items of the lists and the states of the properties under bridge_mutex
	pthread_mutex_lock(&bridge_mutex);
	INDIGO_DEFINE_MATCHING_PROPERTY(X_ALPACA_DISCOVERY_PROPERTY);
	INDIGO_DEFINE_MATCHING_PROPERTY(X_ALPACA_DISCOVERY_SETTINGS_PROPERTY);
	INDIGO_DEFINE_MATCHING_PROPERTY(X_ALPACA_DISCOVERY_TARGETS_PROPERTY);
	INDIGO_DEFINE_MATCHING_PROPERTY(X_ALPACA_DISCOVER_PROPERTY);
	INDIGO_DEFINE_MATCHING_PROPERTY(X_ALPACA_SERVERS_PROPERTY);
	INDIGO_DEFINE_MATCHING_PROPERTY(X_ALPACA_SERVER_STATUS_PROPERTY);
	INDIGO_DEFINE_MATCHING_PROPERTY(X_ALPACA_DEVICES_PROPERTY);
	INDIGO_DEFINE_MATCHING_PROPERTY(X_ALPACA_DEVICE_STATUS_PROPERTY);
	INDIGO_DEFINE_MATCHING_PROPERTY(X_ALPACA_TIMEOUTS_PROPERTY);
	INDIGO_DEFINE_MATCHING_PROPERTY(X_ALPACA_POLLING_PROPERTY);
	pthread_mutex_unlock(&bridge_mutex);
	return indigo_aux_enumerate_properties(device, client, property);
}

// The switches of the devices (decision D15): every device is on unless it was switched off. The switch is recorded here, on the bus
// thread, in switched_off, so that the switches a configuration restore sends are all known when the restore ends; the handler then
// brings the proxy devices in line. An item is named by the key of its device; a name that is not a key yet (a UniqueID in upper case)
// is made one. A key that is not listed is taken as it is: switched off it is remembered and listed until its device appears, switched
// on it needs nothing, because on is the default.
static void bridge_change_devices(indigo_device *device, indigo_property *property) {
	int ignored = 0;
	for (int i = 0; i < property->count; i++) {
		indigo_item *request = property->items + i;
		char key[KEY_SIZE];
		if (*request->name == 0) {
			continue;
		}
		make_key(request->name, key);
		indigo_item *item = indigo_get_item(X_ALPACA_DEVICES_PROPERTY, key);
		if (item != NULL) {
			item->sw.value = request->sw.value;
			item->do_update = true;
		}
		if (!switched_off_set(key, !request->sw.value)) {
			ignored++;
		}
	}
	// every request is answered, also one that changes no item that exists yet: a client and the configuration restore wait for the answer
	X_ALPACA_DEVICES_PROPERTY->do_update = true;
	X_ALPACA_DEVICES_PROPERTY->state = ignored > 0 ? INDIGO_ALERT_STATE : INDIGO_OK_STATE;
	if (ignored > 0) {
		indigo_update_property(device, X_ALPACA_DEVICES_PROPERTY, "%d device(s) not switched off, at most %d devices can be switched off", ignored, MAX_RECORDS);
	} else {
		indigo_update_property(device, X_ALPACA_DEVICES_PROPERTY, NULL);
	}
	// one handler applies all the requests recorded until it runs, so a client that sends many requests does not fill the queue
	if (!selection_pending) {
		selection_pending = true;
		indigo_queue_add(driver_queue, device, INDIGO_TASK_PRIORITY_NORMAL, 0, bridge_x_alpaca_devices_handler, &driver_queue_mutex);
	}
}

static void bridge_change_servers(indigo_device *device, indigo_property *property) {
	char list[INDIGO_VALUE_SIZE];
	const char *requested = X_ALPACA_SERVERS_LIST_ITEM->text.value;
	const char *add = "";
	const char *remove = "";
	for (int i = 0; i < property->count; i++) {
		indigo_item *item = property->items + i;
		if (!strcmp(item->name, X_ALPACA_SERVERS_LIST_ITEM_NAME)) {
			requested = indigo_get_text_item_value(item);
		} else if (!strcmp(item->name, X_ALPACA_SERVERS_ADD_ITEM_NAME)) {
			add = indigo_get_text_item_value(item);
		} else if (!strcmp(item->name, X_ALPACA_SERVERS_REMOVE_ITEM_NAME)) {
			remove = indigo_get_text_item_value(item);
		}
	}
	if (strlen(requested) >= INDIGO_VALUE_SIZE || strlen(add) >= ALPACA_HOST_SIZE || strlen(remove) >= ALPACA_HOST_SIZE || !bridge_edit_servers(requested, add, remove, list, sizeof(list))) {
		indigo_reject_change(device, X_ALPACA_SERVERS_PROPERTY, "Servers have to be given as host:port, at most %d of them", MAX_SERVERS);
		return;
	}
	indigo_set_text_item_value(X_ALPACA_SERVERS_LIST_ITEM, list);
	indigo_set_text_item_value(X_ALPACA_SERVERS_ADD_ITEM, "");
	indigo_set_text_item_value(X_ALPACA_SERVERS_REMOVE_ITEM, "");
	X_ALPACA_SERVERS_PROPERTY->do_update = true;
	X_ALPACA_SERVERS_PROPERTY->state = INDIGO_BUSY_STATE;
	indigo_update_property(device, X_ALPACA_SERVERS_PROPERTY, NULL);
	if (!servers_pending) {
		servers_pending = true;
		indigo_queue_add(driver_queue, device, INDIGO_TASK_PRIORITY_NORMAL, 0, bridge_x_alpaca_servers_handler, &driver_queue_mutex);
	}
}

// Returns true if the request was for a property of the bridge and is handled. Called with bridge_mutex held.
static bool bridge_process_change(indigo_device *device, indigo_property *property) {
	if (indigo_property_match_changeable(X_ALPACA_DISCOVERY_PROPERTY, property)) {
		indigo_property_copy_values(X_ALPACA_DISCOVERY_PROPERTY, property, false);
		X_ALPACA_DISCOVERY_PROPERTY->state = INDIGO_OK_STATE;
		indigo_update_property(device, X_ALPACA_DISCOVERY_PROPERTY, NULL);
		bridge_restart_discovery(device, X_ALPACA_DISCOVERY_ENABLED_ITEM->sw.value);
		return true;
	} else if (indigo_property_match_changeable(X_ALPACA_DISCOVERY_SETTINGS_PROPERTY, property)) {
		indigo_property_copy_values(X_ALPACA_DISCOVERY_SETTINGS_PROPERTY, property, false);
		X_ALPACA_DISCOVERY_SETTINGS_PROPERTY->state = INDIGO_OK_STATE;
		indigo_update_property(device, X_ALPACA_DISCOVERY_SETTINGS_PROPERTY, NULL);
		bridge_restart_discovery(device, false);
		return true;
	} else if (indigo_property_match_changeable(X_ALPACA_DISCOVERY_TARGETS_PROPERTY, property)) {
		indigo_item *targets = indigo_get_item(property, X_ALPACA_DISCOVERY_TARGETS_ITEM_NAME);
		if (targets != NULL && !bridge_targets_valid(indigo_get_text_item_value(targets))) {
			indigo_reject_change(device, X_ALPACA_DISCOVERY_TARGETS_PROPERTY, "Discovery targets have to be IPv4 addresses, address[:port], at most %d of them", MAX_TARGETS);
			return true;
		}
		indigo_property_copy_values(X_ALPACA_DISCOVERY_TARGETS_PROPERTY, property, false);
		X_ALPACA_DISCOVERY_TARGETS_PROPERTY->state = INDIGO_OK_STATE;
		indigo_update_property(device, X_ALPACA_DISCOVERY_TARGETS_PROPERTY, NULL);
		bridge_restart_discovery(device, false);
		return true;
	} else if (indigo_property_match_changeable(X_ALPACA_DISCOVER_PROPERTY, property)) {
		if (X_ALPACA_DISCOVER_PROPERTY->state != INDIGO_BUSY_STATE) {
			indigo_property_copy_values(X_ALPACA_DISCOVER_PROPERTY, property, false);
			if (X_ALPACA_DISCOVER_ITEM->sw.value) {
				X_ALPACA_DISCOVER_PROPERTY->state = INDIGO_BUSY_STATE;
				indigo_queue_add(driver_queue, device, INDIGO_TASK_PRIORITY_NORMAL, 0, bridge_x_alpaca_discover_handler, &driver_queue_mutex);
			} else {
				X_ALPACA_DISCOVER_PROPERTY->state = INDIGO_OK_STATE;
			}
		}
		// a request that arrives while a cycle runs changes nothing, but it is answered with the current state all the same
		X_ALPACA_DISCOVER_PROPERTY->do_update = true;
		indigo_update_property(device, X_ALPACA_DISCOVER_PROPERTY, NULL);
		return true;
	} else if (indigo_property_match_changeable(X_ALPACA_SERVERS_PROPERTY, property)) {
		bridge_change_servers(device, property);
		return true;
	} else if (indigo_property_match_changeable(X_ALPACA_DEVICES_PROPERTY, property)) {
		bridge_change_devices(device, property);
		return true;
	} else if (indigo_property_match_changeable(X_ALPACA_TIMEOUTS_PROPERTY, property)) {
		bool pending = X_ALPACA_TIMEOUTS_PROPERTY->state == INDIGO_BUSY_STATE;
		indigo_property_copy_values(X_ALPACA_TIMEOUTS_PROPERTY, property, false);
		X_ALPACA_TIMEOUTS_PROPERTY->state = INDIGO_BUSY_STATE;
		indigo_update_property(device, X_ALPACA_TIMEOUTS_PROPERTY, NULL);
		if (!pending) {
			indigo_queue_add(driver_queue, device, INDIGO_TASK_PRIORITY_NORMAL, 0, bridge_x_alpaca_timeouts_handler, &driver_queue_mutex);
		}
		return true;
	} else if (indigo_property_match_changeable(X_ALPACA_POLLING_PROPERTY, property)) {
		indigo_property_copy_values(X_ALPACA_POLLING_PROPERTY, property, false);
		pthread_mutex_lock(&settings_mutex);
		poll_idle_interval = X_ALPACA_POLLING_IDLE_ITEM->number.value;
		poll_active_interval = X_ALPACA_POLLING_ACTIVE_ITEM->number.value;
		pthread_mutex_unlock(&settings_mutex);
		X_ALPACA_POLLING_PROPERTY->state = INDIGO_OK_STATE;
		indigo_update_property(device, X_ALPACA_POLLING_PROPERTY, NULL);
		return true;
	} else if (indigo_property_match(CONFIG_PROPERTY, property)) {
		if (indigo_switch_match(CONFIG_SAVE_ITEM, property) && CONFIG_PROPERTY->state != INDIGO_BUSY_STATE) {
			indigo_save_property(device, NULL, X_ALPACA_DISCOVERY_PROPERTY);
			indigo_save_property(device, NULL, X_ALPACA_DISCOVERY_SETTINGS_PROPERTY);
			indigo_save_property(device, NULL, X_ALPACA_DISCOVERY_TARGETS_PROPERTY);
			indigo_save_property(device, NULL, X_ALPACA_TIMEOUTS_PROPERTY);
			indigo_save_property(device, NULL, X_ALPACA_POLLING_PROPERTY);
			indigo_save_property(device, NULL, X_ALPACA_SERVERS_PROPERTY);
			indigo_save_property(device, NULL, X_ALPACA_DEVICES_PROPERTY);
		}
	}
	return false;
}

static indigo_result bridge_change_property(indigo_device *device, indigo_client *client, indigo_property *property) {
	assert(device != NULL);
	assert(property != NULL);
	pthread_mutex_lock(&bridge_mutex);
	bool handled = bridge_process_change(device, property);
	pthread_mutex_unlock(&bridge_mutex);
	if (handled) {
		return INDIGO_OK;
	}
	return indigo_aux_change_property(device, client, property);
}

static indigo_result bridge_detach(indigo_device *device) {
	indigo_release_property(X_ALPACA_DISCOVERY_PROPERTY);
	indigo_release_property(X_ALPACA_DISCOVERY_SETTINGS_PROPERTY);
	indigo_release_property(X_ALPACA_DISCOVERY_TARGETS_PROPERTY);
	indigo_release_property(X_ALPACA_DISCOVER_PROPERTY);
	indigo_release_property(X_ALPACA_SERVERS_PROPERTY);
	indigo_release_property(X_ALPACA_SERVER_STATUS_PROPERTY);
	indigo_release_property(X_ALPACA_DEVICES_PROPERTY);
	indigo_release_property(X_ALPACA_DEVICE_STATUS_PROPERTY);
	indigo_release_property(X_ALPACA_TIMEOUTS_PROPERTY);
	indigo_release_property(X_ALPACA_POLLING_PROPERTY);
	INDIGO_DEVICE_DETACH_LOG(DRIVER_NAME, device->name);
	return indigo_aux_detach(device);
}

#pragma mark - Device templates

static indigo_device bridge_template = INDIGO_DEVICE_INITIALIZER(BRIDGE_DEVICE_NAME, bridge_attach, bridge_enumerate_properties, bridge_change_property, NULL, bridge_detach);

#pragma mark - Hot-plug code

// A proxy device that is connected, or still connecting, keeps the driver loaded, as a connected device of a hot-plug driver does.
// It runs on the thread of SHUTDOWN with the driver queue locked, so devices[] does not change; CONNECTION and the count of the
// logical devices that hold the Alpaca device open are read under the lock of the device, which the bus thread and the handler queue
// write them under.
static indigo_result verify_devices_disconnected(void) {
	for (int i = 0; i < MAX_DEVICES; i++) {
		indigo_device *device = devices[i];
		if (device != NULL) {
			pthread_mutex_lock(&PRIVATE_DATA->mutex);
			bool busy = !IS_DISCONNECTED || PRIVATE_DATA->count > 0;
			pthread_mutex_unlock(&PRIVATE_DATA->mutex);
			if (busy) {
				return INDIGO_BUSY;
			}
		}
	}
	return INDIGO_OK;
}

// Take the lock the tasks of the driver queue run under, waiting at most the given number of seconds for a running task.
static bool lock_driver_queue(double timeout) {
	double deadline = indigo_monotonic_time() + timeout;
	while (pthread_mutex_trylock(&driver_queue_mutex) != 0) {
		if (indigo_monotonic_time() >= deadline) {
			return false;
		}
		indigo_usleep(10000);
	}
	return true;
}

static void remove_all_devices(void) {
	for (int i = MAX_RECORDS - 1; i >= 0; i--) {
		if (records[i].used && records[i].device != NULL) {
			proxy_detach(records + i);
		}
	}
	for (int i = 0; i < MAX_SERVERS; i++) {
		if (servers[i].used) {
			alpaca_channel_free(servers[i].channel);
			alpaca_server_free(servers[i].transport);
		}
	}
	memset(servers, 0, sizeof(servers));
	memset(records, 0, sizeof(records));
	switched_off_count = 0;
}

#pragma mark - Main code

indigo_result indigo_system_alpaca(indigo_driver_action action, indigo_driver_info *info) {
	static indigo_driver_action last_action = INDIGO_DRIVER_SHUTDOWN;
	SET_DRIVER_INFO(info, DRIVER_LABEL, __FUNCTION__, DRIVER_VERSION, true, last_action);
	if (action == last_action) {
		return INDIGO_OK;
	}
	switch (action) {
		case INDIGO_DRIVER_INIT: {
			last_action = action;
			pthread_mutexattr_t attributes;
			for (int i = 0; i < MAX_DEVICES; i++) {
				devices[i] = NULL;
			}
			memset(servers, 0, sizeof(servers));
			memset(records, 0, sizeof(records));
			switched_off_count = 0;
			selection_pending = false;
			reconcile_pending = false;
			capacity_refused = 0;
			servers_pending = false;
			lists_pending = false;
			pthread_mutex_lock(&settings_mutex);
			shutting_down = false;
			poll_idle_interval = 1.0;
			poll_active_interval = 0.2;
			establish_timeout = ALPACA_ESTABLISH_TIMEOUT;
			standard_timeout = ALPACA_STANDARD_TIMEOUT;
			long_timeout = ALPACA_LONG_TIMEOUT;
			pthread_mutex_unlock(&settings_mutex);
			pthread_mutexattr_init(&attributes);
			pthread_mutexattr_settype(&attributes, PTHREAD_MUTEX_RECURSIVE);
			pthread_mutex_init(&bridge_mutex, &attributes);
			pthread_mutexattr_destroy(&attributes);
			driver_queue = indigo_queue_create(NULL);
			if (driver_queue == NULL) {
				INDIGO_DRIVER_ERROR(DRIVER_NAME, "Failed to create driver queue");
				pthread_mutex_destroy(&bridge_mutex);
				last_action = INDIGO_DRIVER_SHUTDOWN;
				return INDIGO_FAILED;
			}
			indigo_queue_set_name(driver_queue, "Queue " DRIVER_LABEL);
			bridge = indigo_safe_malloc_copy(sizeof(indigo_device), &bridge_template);
			bridge->private_data = indigo_safe_malloc(sizeof(bridge_private_data));
			if (indigo_attach_device(bridge) != INDIGO_OK || bridge->last_result != INDIGO_OK) {
				INDIGO_DRIVER_ERROR(DRIVER_NAME, "Failed to attach '%s'", bridge->name);
				if (bridge->device_context == NULL) {
					bridge->detach = NULL;
				}
				indigo_detach_device(bridge);
				indigo_safe_free(bridge->private_data);
				indigo_safe_free(bridge);
				bridge = NULL;
				indigo_queue_delete(&driver_queue);
				pthread_mutex_destroy(&bridge_mutex);
				last_action = INDIGO_DRIVER_SHUTDOWN;
				return INDIGO_FAILED;
			}
			bridge_restart_discovery(bridge, true);
			break;
		}
		case INDIGO_DRIVER_SHUTDOWN: {
			// The driver queue may be in the middle of a cycle, which takes seconds and publishes properties. SHUTDOWN can be called
			// from a bus callback (a client unloads the driver), where the bus is locked and a cycle that needs the bus can not finish:
			// waiting for it without a limit would hang the bus. The wait is therefore bounded, and the shutdown is refused if the
			// queue does not become free in time; the caller can ask again.
			if (!lock_driver_queue(SHUTDOWN_WAIT)) {
				INDIGO_DRIVER_ERROR(DRIVER_NAME, "Shutdown refused, discovery is in progress");
				return INDIGO_BUSY;
			}
			indigo_result shutdown_result = verify_devices_disconnected();
			if (shutdown_result == INDIGO_OK) {
				// stop the producers of driver queue tasks: from now on every task of the queue returns at once
				pthread_mutex_lock(&settings_mutex);
				shutting_down = true;
				discovery_generation++;
				pthread_mutex_unlock(&settings_mutex);
			}
			pthread_mutex_unlock(&driver_queue_mutex);
			if (shutdown_result != INDIGO_OK) {
				return shutdown_result;
			}
			last_action = action;
			indigo_queue_remove(driver_queue, NULL, NULL);
			indigo_queue_drain(driver_queue);
			remove_all_devices();
			indigo_detach_device(bridge);
			indigo_safe_free(bridge->private_data);
			indigo_safe_free(bridge);
			bridge = NULL;
			indigo_queue_delete(&driver_queue);
			pthread_mutex_destroy(&bridge_mutex);
			break;
		}
		case INDIGO_DRIVER_INFO:
			break;
	}
	return INDIGO_OK;
}
