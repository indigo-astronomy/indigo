// Copyright (c) 2026 CloudMakers, s. r. o.
// All rights reserved.
//
// You can use this software under the terms of 'INDIGO Astronomy
// open-source license' (see LICENSE.md).
//
// THIS SOFTWARE IS PROVIDED BY THE AUTHORS 'AS IS' AND ANY EXPRESS
// OR IMPLIED WARRANTIES, INCLUDING, BUT NOT LIMITED TO, THE IMPLIED
// WARRANTIES OF MERCHANTABILITY AND FITNESS FOR A PARTICULAR PURPOSE
// ARE DISCLAIMED. IN NO EVENT SHALL THE AUTHOR BE LIABLE FOR ANY
// DIRECT, INDIRECT, INCIDENTAL, SPECIAL, EXEMPLARY, OR CONSEQUENTIAL
// DAMAGES (INCLUDING, BUT NOT LIMITED TO, PROCUREMENT OF SUBSTITUTE
// GOODS OR SERVICES; LOSS OF USE, DATA, OR PROFITS; OR BUSINESS
// INTERRUPTION) HOWEVER CAUSED AND ON ANY THEORY OF LIABILITY,
// WHETHER IN CONTRACT, STRICT LIABILITY, OR TORT (INCLUDING
// NEGLIGENCE OR OTHERWISE) ARISING IN ANY WAY OUT OF THE USE OF THIS
// SOFTWARE, EVEN IF ADVISED OF THE POSSIBILITY OF SUCH DAMAGE.

// version history
// 3.0 by Peter Polakovic <peter.polakovic@cloudmakers.eu>

// Code is generated by AI

/** INDIGO ASCOM Alpaca client driver, Rotator device class: Alpaca Rotator as an INDIGO rotator
 \file indigo_system_alpaca_rotator.c

 Mapping of the Alpaca members onto the INDIGO properties:

 - Position: value of ROTATOR_POSITION; its target is the angle a move of this driver goes to. Alpaca angles are 0 <= angle < 360;
   a request of -180 ... 360 is brought into that range before it is sent, so 360 is sent as 0 and -90 as 270.
 - TargetPosition: the target of a move the driver did not start (another client) and of a move that runs at connection time.
 - MoveAbsolute, Sync: a change of ROTATOR_POSITION, as ROTATOR_ON_POSITION_SET says. Sync exists from IRotatorV3 on;
   ROTATOR_ON_POSITION_SET is hidden for older devices and removed if the device answers NotImplemented.
 - Move: ROTATOR_RELATIVE_MOVE, the signed angle is sent as it is.
 - MechanicalPosition (IRotatorV3): ROTATOR_RAW_POSITION (read-only) and the value of X_ALPACA_MECHANICAL_POSITION.
 - MoveMechanical (IRotatorV3): a change of X_ALPACA_MECHANICAL_POSITION. The target of ROTATOR_POSITION is then the mechanical
   target plus the sync offset.
 - IsMoving: completion of every move (rotator_move_finalizer), for no longer than ROTATOR_MOVE_TIMEOUT_FACTOR times the long
   request timeout. Motion the driver did not start shows as ROTATOR_POSITION in the BUSY state. While IsMoving or Position can
   not be read (the device answers with an error) ROTATOR_POSITION is in ALERT with the last position; it is OK again with the
   first position that is read.
 - Halt: ROTATOR_ABORT_MOTION.
 - CanReverse, Reverse: ROTATOR_DIRECTION (REVERSED is Reverse=True), hidden if the rotator can not reverse.
 - StepSize: ROTATOR_STEPS_PER_REVOLUTION as 360 / StepSize, read-only, hidden if the member is not implemented.

 The sync offset lives in the Alpaca device, so ROTATOR_POSITION_OFFSET stays hidden; Alpaca has no limits and no backlash,
 so ROTATOR_LIMITS and ROTATOR_BACKLASH stay hidden as well.

 While a move runs all motion properties are BUSY. A request for a motion property that is BUSY is ignored and the move in
 progress goes on; a request for another motion property or for ROTATOR_DIRECTION is rejected with a message. Nothing is sent
 to the device on disconnect: a move in progress is left to finish.

 Threads: change_property runs on a bus thread, everything else on the handler queue of the device. A request is accepted
 with system_alpaca_accept() and a poll tick publishes what the device says under the lock of the device, so a tick never replaces
 a request that was just accepted with the old state of the device; for the same reason a tick asks the device first and touches
 the properties afterwards.
 */

#pragma mark - Includes

#include <math.h>
#include <stdlib.h>
#include <string.h>
#include <assert.h>

#include <indigo/indigo_rotator_driver.h>

#include "indigo_system_alpaca_private.h"

#pragma mark - Common definitions

#define ROTATOR_MOVE_TIMEOUT_FACTOR						6
#define ROTATOR_SYNC_VERSION									3

#pragma mark - Property definitions

#define X_ALPACA_MECHANICAL_POSITION_PROPERTY					(ROTATOR_DATA->x_alpaca_mechanical_position_property)
#define X_ALPACA_MECHANICAL_POSITION_ITEM							(X_ALPACA_MECHANICAL_POSITION_PROPERTY->items + 0)

#define X_ALPACA_MECHANICAL_POSITION_PROPERTY_NAME		"X_ALPACA_MECHANICAL_POSITION"
#define X_ALPACA_MECHANICAL_POSITION_ITEM_NAME				"POSITION"

#pragma mark - Private data definition

#define ROTATOR_DATA													((rotator_data *)CLASS_DATA)

typedef struct {
	indigo_property *x_alpaca_mechanical_position_property;
	alpaca_operation move;
	bool can_reverse;						///< CanReverse
	bool reverse;								///< Reverse as last reported by the device
	bool has_mechanical;				///< MechanicalPosition is implemented (IRotatorV3)
	bool has_target;						///< TargetPosition is implemented
	bool has_step_size;					///< StepSize is implemented
	bool moving;								///< IsMoving at the time of the connection
	bool external;							///< ROTATOR_POSITION is BUSY because the device moves without a request of this driver
	bool unreadable;						///< ROTATOR_POSITION is in ALERT because the polling can not read the position
	double position;
	double target;
	double mechanical;
	double step_size;
} rotator_data;

#pragma mark - Low level code

static void rotator_position_handler(indigo_device *device);
static void rotator_relative_move_handler(indigo_device *device);
static void rotator_mechanical_position_handler(indigo_device *device);

// False if a request made while connecting got no usable answer, so that the connection has to fail.
static bool rotator_answered(alpaca_result result) {
	return !alpaca_is_transport_error(result) && result != ALPACA_PROTOCOL_ERROR && result != ALPACA_SERVER_ERROR && result != ALPACA_FAILED;
}

// Time a move may take: a multiple of the timeout of long requests (X_ALPACA_TIMEOUTS of the bridge device).
static double rotator_move_timeout(indigo_device *device) {
	return ROTATOR_MOVE_TIMEOUT_FACTOR * system_alpaca_long_timeout(device);
}

// One of the motion properties is BUSY: a move runs or a request waits for its handler. Called with the lock of the device held.
static bool rotator_is_busy(indigo_device *device) {
	return ROTATOR_POSITION_PROPERTY->state == INDIGO_BUSY_STATE || ROTATOR_RELATIVE_MOVE_PROPERTY->state == INDIGO_BUSY_STATE || X_ALPACA_MECHANICAL_POSITION_PROPERTY->state == INDIGO_BUSY_STATE;
}

// Refusal of a request for a motion property or for ROTATOR_DIRECTION while another motion property is BUSY (the property of the
// request itself is not, or the request would have been dropped). Called by system_alpaca_accept() with the lock of the device held.
static const char *rotator_motion_refusal(indigo_device *device) {
	return rotator_is_busy(device) ? "Rotator is moving: request can not be completed" : NULL;
}

// Read Position and MechanicalPosition into the values of the properties, without publishing them.
static alpaca_result rotator_read_position(indigo_device *device) {
	rotator_data *data = ROTATOR_DATA;
	double position = 0;
	alpaca_result result = system_alpaca_get_double(device, "position", &position);
	if (result == ALPACA_OK) {
		ROTATOR_POSITION_ITEM->number.value = position;
		if (data->has_mechanical) {
			result = system_alpaca_get_double(device, "mechanicalposition", &position);
			if (result == ALPACA_OK) {
				ROTATOR_RAW_POSITION_ITEM->number.value = X_ALPACA_MECHANICAL_POSITION_ITEM->number.value = position;
			}
		}
	}
	return result;
}

// Give all motion properties the same state. A move that is over leaves no relative move and no mechanical target behind,
// and a failed one no target at all.
static void rotator_set_state(indigo_device *device, indigo_property_state state) {
	system_alpaca_lock(device);
	ROTATOR_POSITION_PROPERTY->state = ROTATOR_RELATIVE_MOVE_PROPERTY->state = X_ALPACA_MECHANICAL_POSITION_PROPERTY->state = state;
	if (state != INDIGO_BUSY_STATE) {
		ROTATOR_RELATIVE_MOVE_ITEM->number.value = ROTATOR_RELATIVE_MOVE_ITEM->number.target = 0;
		X_ALPACA_MECHANICAL_POSITION_ITEM->number.target = X_ALPACA_MECHANICAL_POSITION_ITEM->number.value;
	}
	if (state == INDIGO_ALERT_STATE) {
		ROTATOR_POSITION_ITEM->number.target = ROTATOR_POSITION_ITEM->number.value;
	}
	system_alpaca_unlock(device);
}

// Publish the properties that follow the position, all but ROTATOR_POSITION.
static void rotator_update(indigo_device *device) {
	indigo_update_property(device, ROTATOR_RAW_POSITION_PROPERTY, NULL);
	indigo_update_property(device, ROTATOR_RELATIVE_MOVE_PROPERTY, NULL);
	indigo_update_property(device, X_ALPACA_MECHANICAL_POSITION_PROPERTY, NULL);
}

// End of a move, or of a request that did not start one: all motion properties get the state of the result, the message goes
// with ROTATOR_POSITION. It is published last: a client that waits for it finds the properties that follow the position settled.
static void rotator_finish(indigo_device *device, alpaca_result result, const char *action, const char *reason) {
	ROTATOR_DATA->external = false;
	rotator_set_state(device, system_alpaca_property_state(result));
	rotator_update(device);
	system_alpaca_report(device, ROTATOR_POSITION_PROPERTY, result, action, reason);
}

// Completion of a move: IsMoving is polled until it is false, the positions are published on the way.
static void rotator_move_finalizer(indigo_device *device) {
	rotator_data *data = ROTATOR_DATA;
	bool moving = false;
	if (!system_alpaca_is_active(device)) {
		return;
	}
	alpaca_result result = system_alpaca_get_bool(device, "ismoving", &moving);
	if (result == ALPACA_OK) {
		result = rotator_read_position(device);
	}
	if (result == ALPACA_OK && moving && system_alpaca_operation_continue(device, &data->move, rotator_move_finalizer)) {
		rotator_update(device);
		indigo_update_property(device, ROTATOR_POSITION_PROPERTY, NULL);
		return;
	}
	system_alpaca_operation_end(device, &data->move);
	rotator_finish(device, result == ALPACA_OK && moving ? ALPACA_TIMED_OUT : result, "Move", NULL);
}

// Send one of the three moves. A move is not repeated when its reply is lost; IsMoving tells whether the device accepted it.
// The target of ROTATOR_POSITION is the one the caller computed: the requested sky angle of MoveAbsolute, the position plus the angle
// of Move, the mechanical target plus the sync offset of MoveMechanical. TargetPosition is not read back: the standard defines it as
// that same sky angle, and OmniSim 0.5.0 reports the mechanical target there instead, without the sync offset (OMNI-2).
// Returns the result of the request itself.
static alpaca_result rotator_start(indigo_device *device, const char *member, double angle) {
	rotator_data *data = ROTATOR_DATA;
	alpaca_param params[] = { ALPACA_DOUBLE_PARAM("Position", angle) };
	char reason[INDIGO_VALUE_SIZE];
	bool moving = false;
	alpaca_result put_result = system_alpaca_put(device, member, params, 1, ALPACA_WAIT_LONG);
	alpaca_result result = put_result;
	system_alpaca_reason(device, result, reason, sizeof(reason));
	if (result != ALPACA_OK && alpaca_may_have_executed(result) && system_alpaca_get_bool(device, "ismoving", &moving) == ALPACA_OK && moving) {
		INDIGO_DRIVER_DEBUG(DRIVER_NAME, "'%s' gave no valid reply to %s (%s) but is moving", device->name, member, alpaca_result_text(result));
		result = ALPACA_OK;
	}
	if (result == ALPACA_OK) {
		data->external = false;
		rotator_set_state(device, INDIGO_BUSY_STATE);
		rotator_update(device);
		indigo_update_property(device, ROTATOR_POSITION_PROPERTY, NULL);
		system_alpaca_operation_start(device, &data->move, rotator_move_timeout(device), rotator_move_finalizer);
	} else {
		rotator_finish(device, result, "Move", reason);
	}
	return put_result;
}

#pragma mark - High level code (rotator)

static bool rotator_on_probe(indigo_device *device) {
	rotator_data *data = ROTATOR_DATA;
	data->can_reverse = data->reverse = data->has_mechanical = data->has_target = data->has_step_size = data->moving = data->external = data->unreadable = false;
	data->position = data->target = data->mechanical = data->step_size = 0;
	if (system_alpaca_probe_bool(device, "canreverse", &data->can_reverse) != ALPACA_OK) {
		return false;
	}
	alpaca_result result = ALPACA_OK;
	if (data->can_reverse) {
		result = system_alpaca_get_bool(device, "reverse", &data->reverse);
		if (!rotator_answered(result)) {
			return false;
		}
		data->can_reverse = result == ALPACA_OK;
		data->reverse = data->can_reverse && data->reverse;
	}
	if (system_alpaca_get_double(device, "position", &data->position) != ALPACA_OK) {
		return false;
	}
	result = system_alpaca_get_bool(device, "ismoving", &data->moving);
	if (!rotator_answered(result)) {
		return false;
	}
	data->moving = result == ALPACA_OK && data->moving;
	result = system_alpaca_get_double(device, "targetposition", &data->target);
	if (!rotator_answered(result)) {
		return false;
	}
	data->has_target = result == ALPACA_OK;
	result = system_alpaca_get_double(device, "stepsize", &data->step_size);
	if (!rotator_answered(result)) {
		return false;
	}
	data->has_step_size = result == ALPACA_OK && data->step_size > 0;
	if (PRIVATE_DATA->interface_version >= ROTATOR_SYNC_VERSION) {
		result = system_alpaca_get_double(device, "mechanicalposition", &data->mechanical);
		if (!rotator_answered(result)) {
			return false;
		}
		data->has_mechanical = result == ALPACA_OK;
	}
	INDIGO_DRIVER_DEBUG(DRIVER_NAME, "'%s' CanReverse = %d, MechanicalPosition %s, TargetPosition %s, StepSize %s", device->name, data->can_reverse, data->has_mechanical ? "implemented" : "not implemented", data->has_target ? "implemented" : "not implemented", data->has_step_size ? "implemented" : "not implemented");
	return true;
}

static bool rotator_on_connect(indigo_device *device) {
	rotator_data *data = ROTATOR_DATA;
	bool can_sync = PRIVATE_DATA->interface_version >= ROTATOR_SYNC_VERSION;
	ROTATOR_LIMITS_PROPERTY->hidden = true;
	ROTATOR_BACKLASH_PROPERTY->hidden = true;
	ROTATOR_POSITION_OFFSET_PROPERTY->hidden = true;
	ROTATOR_ABORT_MOTION_PROPERTY->hidden = false;
	ROTATOR_RELATIVE_MOVE_PROPERTY->hidden = false;
	ROTATOR_ON_POSITION_SET_PROPERTY->hidden = !can_sync;
	ROTATOR_DIRECTION_PROPERTY->hidden = !data->can_reverse;
	ROTATOR_RAW_POSITION_PROPERTY->hidden = !data->has_mechanical;
	ROTATOR_STEPS_PER_REVOLUTION_PROPERTY->hidden = !data->has_step_size;
	X_ALPACA_MECHANICAL_POSITION_PROPERTY->hidden = !data->has_mechanical;
	if (!can_sync) {
		indigo_set_switch(ROTATOR_ON_POSITION_SET_PROPERTY, ROTATOR_ON_POSITION_SET_GOTO_ITEM, true);
	}
	data->external = data->moving;
	system_alpaca_lock(device);
	ROTATOR_POSITION_PROPERTY->state = data->moving ? INDIGO_BUSY_STATE : INDIGO_OK_STATE;
	ROTATOR_RELATIVE_MOVE_PROPERTY->state = INDIGO_OK_STATE;
	ROTATOR_ABORT_MOTION_PROPERTY->state = INDIGO_OK_STATE;
	ROTATOR_DIRECTION_PROPERTY->state = INDIGO_OK_STATE;
	X_ALPACA_MECHANICAL_POSITION_PROPERTY->state = INDIGO_OK_STATE;
	system_alpaca_unlock(device);
	ROTATOR_POSITION_ITEM->number.value = data->position;
	ROTATOR_POSITION_ITEM->number.target = data->moving && data->has_target ? data->target : data->position;
	ROTATOR_RELATIVE_MOVE_ITEM->number.value = ROTATOR_RELATIVE_MOVE_ITEM->number.target = 0;
	ROTATOR_ABORT_MOTION_ITEM->sw.value = false;
	indigo_set_switch(ROTATOR_DIRECTION_PROPERTY, data->reverse ? ROTATOR_DIRECTION_REVERSED_ITEM : ROTATOR_DIRECTION_NORMAL_ITEM, true);
	ROTATOR_RAW_POSITION_ITEM->number.min = 0;
	ROTATOR_RAW_POSITION_ITEM->number.value = ROTATOR_RAW_POSITION_ITEM->number.target = data->mechanical;
	ROTATOR_STEPS_PER_REVOLUTION_PROPERTY->perm = INDIGO_RO_PERM;
	if (data->has_step_size) {
		ROTATOR_STEPS_PER_REVOLUTION_ITEM->number.max = ROTATOR_STEPS_PER_REVOLUTION_ITEM->number.value = ROTATOR_STEPS_PER_REVOLUTION_ITEM->number.target = round(360 / data->step_size);
	}
	X_ALPACA_MECHANICAL_POSITION_ITEM->number.value = X_ALPACA_MECHANICAL_POSITION_ITEM->number.target = data->mechanical;
	indigo_define_property(device, X_ALPACA_MECHANICAL_POSITION_PROPERTY, NULL);
	return true;
}

static void rotator_on_disconnect(indigo_device *device) {
	rotator_data *data = ROTATOR_DATA;
	system_alpaca_operation_end(device, &data->move);
	data->external = data->unreadable = false;
	// the properties are still defined, so a request may be accepted while they are reset; its handler finds the session closed
	system_alpaca_lock(device);
	ROTATOR_ABORT_MOTION_ITEM->sw.value = false;
	ROTATOR_ABORT_MOTION_PROPERTY->state = ROTATOR_RELATIVE_MOVE_PROPERTY->state = ROTATOR_DIRECTION_PROPERTY->state = X_ALPACA_MECHANICAL_POSITION_PROPERTY->state = INDIGO_OK_STATE;
	indigo_set_switch(ROTATOR_DIRECTION_PROPERTY, data->reverse ? ROTATOR_DIRECTION_REVERSED_ITEM : ROTATOR_DIRECTION_NORMAL_ITEM, true);
	system_alpaca_unlock(device);
	indigo_delete_property(device, X_ALPACA_MECHANICAL_POSITION_PROPERTY, NULL);
}

static void rotator_on_poll(indigo_device *device) {
	rotator_data *data = ROTATOR_DATA;
	bool moving = false, reverse = false, has_reverse = false, has_mechanical = false, has_target = false, publish_direction = false, publish_position = false, publish_failure = false;
	char reason[INDIGO_VALUE_SIZE] = { 0 };
	double position = 0, mechanical = 0, target = 0;
	// the positions belong to the finalizer while a move runs
	if (data->move.active) {
		return;
	}
	// The device is asked first and the properties are touched afterwards, in one step under the lock of the device: a request of a client that
	// arrives while the device answers finds its property as the client knows it, and is not replaced by what the device said.
	if (data->can_reverse) {
		has_reverse = system_alpaca_get_bool(device, "reverse", &reverse) == ALPACA_OK;
	}
	alpaca_result position_result = system_alpaca_state_bool(device, "IsMoving", &moving);
	if (position_result == ALPACA_OK) {
		position_result = system_alpaca_state_double(device, "Position", &position);
	}
	system_alpaca_reason(device, position_result, reason, sizeof(reason));
	bool has_position = position_result == ALPACA_OK;
	if (has_position && data->has_mechanical) {
		has_mechanical = system_alpaca_state_double(device, "MechanicalPosition", &mechanical) == ALPACA_OK;
	}
	// the target of a move the driver did not start is asked for when the move is seen for the first time
	if (has_position && moving && !data->external && data->has_target) {
		has_target = system_alpaca_get_double(device, "targetposition", &target) == ALPACA_OK;
	}
	system_alpaca_lock(device);
	// a request that was accepted and waits for its handler owns the properties
	if (ROTATOR_DIRECTION_PROPERTY->state != INDIGO_BUSY_STATE && (!rotator_is_busy(device) || data->external)) {
		if (has_reverse && reverse != data->reverse) {
			data->reverse = reverse;
			indigo_set_switch(ROTATOR_DIRECTION_PROPERTY, reverse ? ROTATOR_DIRECTION_REVERSED_ITEM : ROTATOR_DIRECTION_NORMAL_ITEM, true);
			ROTATOR_DIRECTION_PROPERTY->state = INDIGO_OK_STATE;
			publish_direction = true;
		}
		if (has_position) {
			if (has_mechanical) {
				ROTATOR_RAW_POSITION_ITEM->number.value = X_ALPACA_MECHANICAL_POSITION_ITEM->number.value = X_ALPACA_MECHANICAL_POSITION_ITEM->number.target = mechanical;
			}
			if (moving && ROTATOR_POSITION_PROPERTY->state != INDIGO_BUSY_STATE) {
				ROTATOR_POSITION_PROPERTY->state = INDIGO_BUSY_STATE;
				data->external = true;
				if (has_target) {
					ROTATOR_POSITION_ITEM->number.target = target;
				}
			} else if (!moving && (data->external || (data->unreadable && ROTATOR_POSITION_PROPERTY->state == INDIGO_ALERT_STATE))) {
				ROTATOR_POSITION_PROPERTY->state = INDIGO_OK_STATE;
				data->external = false;
			}
			data->unreadable = false;
			ROTATOR_POSITION_ITEM->number.value = position;
			if (!moving) {
				ROTATOR_POSITION_ITEM->number.target = position;
			}
			publish_position = true;
		} else if (!alpaca_is_transport_error(position_result) && ROTATOR_POSITION_PROPERTY->state == INDIGO_OK_STATE) {
			// the device answers and does not tell where it is: the position that is shown is not the one of the device any more
			ROTATOR_POSITION_PROPERTY->state = INDIGO_ALERT_STATE;
			data->unreadable = true;
			publish_failure = true;
		}
	}
	system_alpaca_unlock(device);
	if (publish_direction) {
		indigo_update_property(device, ROTATOR_DIRECTION_PROPERTY, NULL);
	}
	if (publish_position) {
		indigo_update_property(device, ROTATOR_RAW_POSITION_PROPERTY, NULL);
		indigo_update_property(device, X_ALPACA_MECHANICAL_POSITION_PROPERTY, NULL);
		indigo_update_property(device, ROTATOR_POSITION_PROPERTY, NULL);
	} else if (publish_failure) {
		system_alpaca_report(device, ROTATOR_POSITION_PROPERTY, position_result, "Reading the position", reason);
	}
}

static void rotator_position_handler(indigo_device *device) {
	if (!system_alpaca_is_active(device)) {
		return;
	}
	double angle = indigo_range360(ROTATOR_POSITION_ITEM->number.target);
	ROTATOR_POSITION_ITEM->number.target = angle;
	if (ROTATOR_ON_POSITION_SET_SYNC_ITEM->sw.value && !ROTATOR_ON_POSITION_SET_PROPERTY->hidden) {
		alpaca_param params[] = { ALPACA_DOUBLE_PARAM("Position", angle) };
		char reason[INDIGO_VALUE_SIZE];
		// Sync to an angle twice is Sync to it once
		alpaca_result sync_result = system_alpaca_put(device, "sync", params, 1, ALPACA_REPLAYABLE);
		alpaca_result result = sync_result;
		system_alpaca_reason(device, result, reason, sizeof(reason));
		if (result == ALPACA_OK) {
			result = rotator_read_position(device);
			system_alpaca_reason(device, result, reason, sizeof(reason));
		}
		rotator_finish(device, result, "Sync", reason);
		if (system_alpaca_not_implemented(sync_result, 1)) {
			// the device has no Sync in spite of its interface version: only GOTO is left
			system_alpaca_set_unsupported(device, "sync");
			indigo_delete_property(device, ROTATOR_ON_POSITION_SET_PROPERTY, NULL);
			indigo_set_switch(ROTATOR_ON_POSITION_SET_PROPERTY, ROTATOR_ON_POSITION_SET_GOTO_ITEM, true);
			ROTATOR_ON_POSITION_SET_PROPERTY->hidden = true;
		}
	} else {
		rotator_start(device, "moveabsolute", angle);
	}
}

static void rotator_relative_move_handler(indigo_device *device) {
	if (!system_alpaca_is_active(device)) {
		return;
	}
	double angle = ROTATOR_RELATIVE_MOVE_ITEM->number.target;
	if (angle == 0) {
		rotator_finish(device, ALPACA_OK, NULL, NULL);
	} else {
		// ROTATOR_RELATIVE_MOVE is BUSY, so no request for ROTATOR_POSITION is accepted meanwhile
		ROTATOR_POSITION_ITEM->number.target = indigo_range360(ROTATOR_POSITION_ITEM->number.value + angle);
		rotator_start(device, "move", angle);
	}
}

static void rotator_mechanical_position_handler(indigo_device *device) {
	if (!system_alpaca_is_active(device)) {
		return;
	}
	double angle = indigo_range360(X_ALPACA_MECHANICAL_POSITION_ITEM->number.target);
	X_ALPACA_MECHANICAL_POSITION_ITEM->number.target = angle;
	// X_ALPACA_MECHANICAL_POSITION is BUSY, so no request for ROTATOR_POSITION is accepted meanwhile
	ROTATOR_POSITION_ITEM->number.target = indigo_range360(ROTATOR_POSITION_ITEM->number.value + angle - X_ALPACA_MECHANICAL_POSITION_ITEM->number.value);
	if (system_alpaca_not_implemented(rotator_start(device, "movemechanical", angle), 1)) {
		// the device has no MoveMechanical in spite of its interface version: the mechanical position can only be read
		system_alpaca_set_unsupported(device, "movemechanical");
		indigo_delete_property(device, X_ALPACA_MECHANICAL_POSITION_PROPERTY, NULL);
		X_ALPACA_MECHANICAL_POSITION_PROPERTY->hidden = true;
	}
}

static void rotator_abort_motion_handler(indigo_device *device) {
	rotator_data *data = ROTATOR_DATA;
	char reason[INDIGO_VALUE_SIZE];
	if (!system_alpaca_is_active(device)) {
		return;
	}
	ROTATOR_ABORT_MOTION_ITEM->sw.value = false;
	alpaca_result result = system_alpaca_put(device, "halt", NULL, 0, ALPACA_REPLAYABLE);
	system_alpaca_reason(device, result, reason, sizeof(reason));
	if (result == ALPACA_OK) {
		// the device confirmed the halt: the move is not watched any more
		indigo_cancel_pending_handler(device, rotator_move_finalizer);
		system_alpaca_operation_end(device, &data->move);
		rotator_read_position(device);
	}
	// A request that did not start yet is given up, and so is a move that was stopped. A move in progress whose halt failed is watched
	// on, and a move of the device itself that could not be stopped stays BUSY: the device still moves.
	indigo_cancel_pending_handler(device, rotator_position_handler);
	indigo_cancel_pending_handler(device, rotator_relative_move_handler);
	indigo_cancel_pending_handler(device, rotator_mechanical_position_handler);
	system_alpaca_lock(device);
	bool settle = !data->move.active && rotator_is_busy(device) && (result == ALPACA_OK || !data->external);
	system_alpaca_unlock(device);
	if (settle) {
		data->external = false;
		rotator_set_state(device, INDIGO_ALERT_STATE);
		rotator_update(device);
		indigo_update_property(device, ROTATOR_POSITION_PROPERTY, NULL);
	}
	system_alpaca_finish_with(device, ROTATOR_ABORT_MOTION_PROPERTY, result, "Abort", reason);
	if (system_alpaca_not_implemented(result, 0)) {
		system_alpaca_set_unsupported(device, "halt");
		indigo_delete_property(device, ROTATOR_ABORT_MOTION_PROPERTY, NULL);
		ROTATOR_ABORT_MOTION_PROPERTY->hidden = true;
	}
}

static void rotator_direction_handler(indigo_device *device) {
	rotator_data *data = ROTATOR_DATA;
	char reason[INDIGO_VALUE_SIZE];
	if (!system_alpaca_is_active(device)) {
		return;
	}
	bool reverse = ROTATOR_DIRECTION_REVERSED_ITEM->sw.value;
	alpaca_param params[] = { ALPACA_BOOL_PARAM("Reverse", reverse) };
	alpaca_result result = system_alpaca_put(device, "reverse", params, 1, ALPACA_REPLAYABLE);
	system_alpaca_reason(device, result, reason, sizeof(reason));
	if (result == ALPACA_OK) {
		data->reverse = reverse;
	} else {
		indigo_set_switch(ROTATOR_DIRECTION_PROPERTY, data->reverse ? ROTATOR_DIRECTION_REVERSED_ITEM : ROTATOR_DIRECTION_NORMAL_ITEM, true);
	}
	system_alpaca_finish_with(device, ROTATOR_DIRECTION_PROPERTY, result, "Change of direction", reason);
}

#pragma mark - Device API (rotator)

static indigo_result rotator_enumerate_properties(indigo_device *device, indigo_client *client, indigo_property *property);

static indigo_result rotator_attach(indigo_device *device) {
	assert(device != NULL);
	if (indigo_rotator_attach(device, DRIVER_NAME, DRIVER_VERSION) == INDIGO_OK) {
		X_ALPACA_MECHANICAL_POSITION_PROPERTY = indigo_init_number_property(NULL, device->name, X_ALPACA_MECHANICAL_POSITION_PROPERTY_NAME, ROTATOR_MAIN_GROUP, "Mechanical position", INDIGO_OK_STATE, INDIGO_RW_PERM, 1);
		if (X_ALPACA_MECHANICAL_POSITION_PROPERTY == NULL) {
			return INDIGO_FAILED;
		}
		indigo_init_number_item(X_ALPACA_MECHANICAL_POSITION_ITEM, X_ALPACA_MECHANICAL_POSITION_ITEM_NAME, "Mechanical position [°]", -180, 360, 1, 0);
		X_ALPACA_MECHANICAL_POSITION_PROPERTY->hidden = true;
		return system_alpaca_attach(device) == INDIGO_OK ? rotator_enumerate_properties(device, NULL, NULL) : INDIGO_FAILED;
	}
	return INDIGO_FAILED;
}

static indigo_result rotator_enumerate_properties(indigo_device *device, indigo_client *client, indigo_property *property) {
	if (system_alpaca_is_active(device)) {
		INDIGO_DEFINE_MATCHING_PROPERTY(X_ALPACA_MECHANICAL_POSITION_PROPERTY);
	}
	return indigo_rotator_enumerate_properties(device, client, property);
}

static indigo_result rotator_change_property(indigo_device *device, indigo_client *client, indigo_property *property) {
	if (system_alpaca_change_property(device, property)) {
		return INDIGO_OK;
	}
	if (indigo_property_match_changeable(ROTATOR_POSITION_PROPERTY, property)) {
		system_alpaca_accept(device, ROTATOR_POSITION_PROPERTY, property, ALPACA_ACCEPT_TARGETS, rotator_motion_refusal, rotator_position_handler);
		return INDIGO_OK;
	}
	if (indigo_property_match_changeable(ROTATOR_RELATIVE_MOVE_PROPERTY, property)) {
		system_alpaca_accept(device, ROTATOR_RELATIVE_MOVE_PROPERTY, property, ALPACA_ACCEPT_TARGETS, rotator_motion_refusal, rotator_relative_move_handler);
		return INDIGO_OK;
	}
	if (indigo_property_match_changeable(X_ALPACA_MECHANICAL_POSITION_PROPERTY, property)) {
		system_alpaca_accept(device, X_ALPACA_MECHANICAL_POSITION_PROPERTY, property, ALPACA_ACCEPT_TARGETS, rotator_motion_refusal, rotator_mechanical_position_handler);
		return INDIGO_OK;
	}
	if (indigo_property_match_changeable(ROTATOR_ABORT_MOTION_PROPERTY, property)) {
		system_alpaca_accept(device, ROTATOR_ABORT_MOTION_PROPERTY, property, ALPACA_ACCEPT_VALUES | ALPACA_ACCEPT_URGENT, NULL, rotator_abort_motion_handler);
		return INDIGO_OK;
	}
	if (indigo_property_match_changeable(ROTATOR_DIRECTION_PROPERTY, property)) {
		system_alpaca_accept(device, ROTATOR_DIRECTION_PROPERTY, property, ALPACA_ACCEPT_VALUES, rotator_motion_refusal, rotator_direction_handler);
		return INDIGO_OK;
	}
	return indigo_rotator_change_property(device, client, property);
}

static indigo_result rotator_detach(indigo_device *device) {
	assert(device != NULL);
	system_alpaca_detach(device);
	indigo_release_property(X_ALPACA_MECHANICAL_POSITION_PROPERTY);
	INDIGO_DEVICE_DETACH_LOG(DRIVER_NAME, device->name);
	return indigo_rotator_detach(device);
}

#pragma mark - Device class

const alpaca_class system_alpaca_rotator_class = {
	.device_type = "Rotator",
	.platform7_version = 4,
	.data_size = sizeof(rotator_data),
	.attach = rotator_attach,
	.enumerate_properties = rotator_enumerate_properties,
	.change_property = rotator_change_property,
	.detach = rotator_detach,
	.base_change_property = indigo_rotator_change_property,
	.on_probe = rotator_on_probe,
	.on_connect = rotator_on_connect,
	.on_disconnect = rotator_on_disconnect,
	.on_poll = rotator_on_poll
};
