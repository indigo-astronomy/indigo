// Copyright (c) 2026 CloudMakers, s. r. o.
// All rights reserved.
//
// You can use this software under the terms of 'INDIGO Astronomy
// open-source license' (see LICENSE.md).
//
// THIS SOFTWARE IS PROVIDED BY THE AUTHORS 'AS IS' AND ANY EXPRESS
// OR IMPLIED WARRANTIES, INCLUDING, BUT NOT LIMITED TO, THE IMPLIED
// WARRANTIES OF MERCHANTABILITY AND FITNESS FOR A PARTICULAR PURPOSE
// ARE DISCLAIMED. IN NO EVENT SHALL THE AUTHOR BE LIABLE FOR ANY
// DIRECT, INDIRECT, INCIDENTAL, SPECIAL, EXEMPLARY, OR CONSEQUENTIAL
// DAMAGES (INCLUDING, BUT NOT LIMITED TO, PROCUREMENT OF SUBSTITUTE
// GOODS OR SERVICES; LOSS OF USE, DATA, OR PROFITS; OR BUSINESS
// INTERRUPTION) HOWEVER CAUSED AND ON ANY THEORY OF LIABILITY,
// WHETHER IN CONTRACT, STRICT LIABILITY, OR TORT (INCLUDING
// NEGLIGENCE OR OTHERWISE) ARISING IN ANY WAY OUT OF THE USE OF THIS
// SOFTWARE, EVEN IF ADVISED OF THE POSSIBILITY OF SUCH DAMAGE.

// version history
// 3.0 by Peter Polakovic <peter.polakovic@cloudmakers.eu>

// Code is generated by AI

/** INDIGO ASCOM Alpaca client driver, Dome device class: Alpaca Dome as an INDIGO dome
 \file indigo_system_alpaca_dome.c

 What is exposed depends on the capabilities of the device, read on every connect:

 - CanSetAzimuth: DOME_HORIZONTAL_COORDINATES (AZ; ALT as well with CanSetAltitude), DOME_STEPS and DOME_DIRECTION (a relative
   move is a slew to the azimuth computed from the current one), DOME_ON_COORDINATES_SET (SYNC with CanSyncAzimuth),
   DOME_DIMENSION and DOME_SLAVING_PARAMETERS. Without it the device is a roll-off roof and all of them are hidden.
 - CanSetShutter: DOME_SHUTTER. CanPark: DOME_PARK. CanFindHome: DOME_HOME, ON while AtHome is true (FindHome is a request to turn it
   ON). CanSetPark: X_ALPACA_DOME_PARK_SET.
   CanSlave: X_ALPACA_DOME_SLAVED.
 - DOME_ABORT_MOTION and DOME_STATE always. DOME_SPEED is hidden, Alpaca has no dome speed.

 Completion follows the Alpaca specification: an azimuth or altitude slew, Park and FindHome end when Slewing becomes false
 (Park and FindHome succeeded if AtPark / AtHome is true then), a shutter move ends when ShutterStatus leaves Opening / Closing.
 All of them use the handler + finalizer pattern; nothing waits in a handler.

 Slewing is true while "any part of the dome" moves, so many devices report it while the shutter moves as well. A slew that was
 requested during a shutter move therefore ends when both are over. A motion nobody asked this driver for (see Slaving) is shown
 on DOME_HORIZONTAL_COORDINATES while the device reports Slewing; while the shutter moves that is done only if the azimuth or
 the altitude is seen to change, so that a moving shutter alone is not taken for a turning dome.

 DOME_SHUTTER is accepted while the shutter moves (closing a shutter that is opening must not have to wait), the other motion
 properties are not accepted while they are BUSY. A member the device answers with NotImplemented although its Can* flag
 announced it (or with HTTP 400, for the methods without a parameter) takes its property or item away until the next connection.

 Slaving. INDIGO slaves a dome from the mount agent, which writes DOME_HORIZONTAL_COORDINATES; the INDIGO dome class has no
 slaving of its own. Alpaca "Slaved" is something else: the dome hardware follows a telescope by itself and refuses SlewToAzimuth,
 SlewToAltitude, Park and FindHome with InvalidWhileSlaved. The driver exposes it as X_ALPACA_DOME_SLAVED and never changes it
 on its own (AbortSlew, sent for DOME_ABORT_MOTION, switches it off in the device, as the specification says). While it is on,
 the motion of the dome is only reported: DOME_HORIZONTAL_COORDINATES is BUSY while the device reports Slewing and follows
 its azimuth, and a request to move the dome is sent once, refused by the device and ends in ALERT with its message. So the two
 kinds of slaving can not move the dome against each other; the user enables one of them.

 Parking. Alpaca has no unpark: AtPark is cleared by the next slew. DOME_PARK.UNPARKED therefore sends nothing; it only lets
 the driver accept motion requests again, which it refuses with "Dome is parked" while the dome is parked, as INDIGO domes do.

 Nothing is stopped on disconnect: a dome that is closing its shutter or parking finishes that when INDIGO disconnects.

 While the state of the dome can not be read (the device answers the polling with an error) DOME_HORIZONTAL_COORDINATES and
 DOME_SHUTTER are in ALERT with what was read last, unless a request or a motion owns them; they are OK again with the first state
 that is read.

 Threads: change_property runs on a bus thread, everything else on the handler queue of the device. A request is accepted
 (system_alpaca_accept(), or the same steps with what the request needs besides) and the polling and the finalizers put the state
 of the device into the properties under the lock of the device, so neither replaces a request that was just accepted.
 DOME_SHUTTER is accepted while it is BUSY; the number of its requests that wait for their handler is kept under the same lock
 and the end of a shutter move leaves the property alone while one waits.
 */

#pragma mark - Includes

#include <stdlib.h>
#include <string.h>
#include <stdint.h>
#include <math.h>
#include <assert.h>

#include <indigo/indigo_dome_driver.h>

#include "indigo_system_alpaca_private.h"

#pragma mark - Property definitions

#define DOME_DATA																			((dome_data *)CLASS_DATA)

#define X_ALPACA_DOME_SLAVED_PROPERTY									(DOME_DATA->x_alpaca_dome_slaved_property)
#define X_ALPACA_DOME_SLAVED_ENABLED_ITEM							(X_ALPACA_DOME_SLAVED_PROPERTY->items + 0)
#define X_ALPACA_DOME_SLAVED_DISABLED_ITEM						(X_ALPACA_DOME_SLAVED_PROPERTY->items + 1)

#define X_ALPACA_DOME_SLAVED_PROPERTY_NAME						"X_ALPACA_DOME_SLAVED"
#define X_ALPACA_DOME_SLAVED_ENABLED_ITEM_NAME				"ENABLED"
#define X_ALPACA_DOME_SLAVED_DISABLED_ITEM_NAME				"DISABLED"

#define X_ALPACA_DOME_PARK_SET_PROPERTY								(DOME_DATA->x_alpaca_dome_park_set_property)
#define X_ALPACA_DOME_PARK_SET_CURRENT_ITEM						(X_ALPACA_DOME_PARK_SET_PROPERTY->items + 0)

#define X_ALPACA_DOME_PARK_SET_PROPERTY_NAME					"X_ALPACA_DOME_PARK_SET"
#define X_ALPACA_DOME_PARK_SET_CURRENT_ITEM_NAME			"CURRENT"

#pragma mark - Private data definition

/** Alpaca ShutterStatus.
 */
#define DOME_SHUTTER_OPEN															0
#define DOME_SHUTTER_CLOSED														1
#define DOME_SHUTTER_OPENING													2
#define DOME_SHUTTER_CLOSING													3
#define DOME_SHUTTER_ERROR														4
#define DOME_SHUTTER_UNKNOWN													(-1)

/** Longest time in seconds a slew, a park, a search of the home position or a shutter move may take.
 */
#define DOME_MOTION_TIMEOUT														600
#define DOME_SHUTTER_TIMEOUT													600

typedef struct {
	indigo_property *x_alpaca_dome_slaved_property;
	indigo_property *x_alpaca_dome_park_set_property;
	alpaca_operation motion;						///< a slew, a park or a search of the home position: everything that ends when Slewing becomes false
	alpaca_operation shutter;
	bool slew_active;										///< DOME_HORIZONTAL_COORDINATES waits for the end of the motion
	bool steps_active;									///< DOME_STEPS waits for the end of the motion
	bool park_active;										///< DOME_PARK waits for the end of the motion
	bool home_active;										///< DOME_HOME waits for the end of the motion
	bool azimuth_requested;							///< the last request of DOME_HORIZONTAL_COORDINATES named AZ
	bool altitude_requested;						///< the last request of DOME_HORIZONTAL_COORDINATES named ALT
	bool external_motion;								///< DOME_HORIZONTAL_COORDINATES is BUSY because the device reports a motion nobody asked this driver for
	bool status_seen;										///< DOME_HORIZONTAL_COORDINATES has the position of the device of this connection
	bool unreadable;										///< DOME_HORIZONTAL_COORDINATES is in ALERT because the polling can not read the state of the device
	bool slewing;												///< the device reported Slewing at the last look and it was not the shutter alone that moved
	bool parked;												///< DOME_PARK shows PARKED
	bool unparked;											///< the user unparked the dome while the device still reports AtPark
	bool slaved;												///< last Slaved read from the device
	bool shutter_open;									///< direction of the running shutter move
	int shutter_status;									///< last ShutterStatus read from the device
	int shutter_shown;									///< ShutterStatus DOME_SHUTTER shows
	int shutter_pending;								///< requests of DOME_SHUTTER that were accepted and whose handler did not run yet; guarded by the lock of the device
	bool reason_kept;										///< reason is the one of the request that is being finished, see dome_keep_reason()
	char reason[INDIGO_VALUE_SIZE];			///< reason of the failure of a request that was followed by a look at the device
} dome_data;

/** Operational state of the device, read member by member or from DeviceState.
 */
typedef struct {
	bool slewing;
	double azimuth;
	double altitude;
	int shutter;
	bool at_park;
	bool at_home;
	bool slaved;
} dome_status;

#pragma mark - Low level code

static void dome_motion_finalizer(indigo_device *device);
static void dome_shutter_finalizer(indigo_device *device);

static double dome_wrap(double angle) {
	angle = fmod(angle, 360);
	return angle < 0 ? angle + 360 : angle;
}

// A member the device does not have is skipped, anything else that is not a value is a failure.
static bool dome_failed(alpaca_result result) {
	return result != ALPACA_OK && !alpaca_is_unsupported(result);
}

// Read the state of the members that back a visible property. Inside on_poll the values come from DeviceState where it has them.
static alpaca_result dome_read_status(indigo_device *device, dome_status *status) {
	alpaca_result result = system_alpaca_state_bool(device, "Slewing", &status->slewing);
	status->shutter = DOME_SHUTTER_UNKNOWN;
	if (!dome_failed(result) && !DOME_HORIZONTAL_COORDINATES_PROPERTY->hidden) {
		result = system_alpaca_state_double(device, "Azimuth", &status->azimuth);
	}
	if (!dome_failed(result) && !DOME_HORIZONTAL_COORDINATES_PROPERTY->hidden && DOME_HORIZONTAL_COORDINATES_PROPERTY->count > 1) {
		result = system_alpaca_state_double(device, "Altitude", &status->altitude);
	}
	if (!dome_failed(result) && !DOME_SHUTTER_PROPERTY->hidden) {
		result = system_alpaca_state_int(device, "ShutterStatus", &status->shutter);
	}
	if (!dome_failed(result) && !DOME_PARK_PROPERTY->hidden) {
		result = system_alpaca_state_bool(device, "AtPark", &status->at_park);
	}
	if (!dome_failed(result) && !DOME_HOME_PROPERTY->hidden) {
		result = system_alpaca_state_bool(device, "AtHome", &status->at_home);
	}
	if (!dome_failed(result) && !X_ALPACA_DOME_SLAVED_PROPERTY->hidden) {
		result = system_alpaca_state_bool(device, "Slaved", &status->slaved);
	}
	return dome_failed(result) ? result : ALPACA_OK;
}

// Select an item of a switch that shows the state of the device. indigo_set_switch() marks the property as changed even if the item
// is selected already, and the property would then be published on every poll tick.
static void dome_select(indigo_property *property, indigo_item *item) {
	if (!item->sw.value) {
		indigo_set_switch(property, item, true);
	}
}

// Show a ShutterStatus on DOME_SHUTTER. A request that failed stays in ALERT until the shutter reports another status.
static void dome_apply_shutter(indigo_device *device, int status) {
	switch (status) {
		case DOME_SHUTTER_OPEN:
		case DOME_SHUTTER_OPENING:
			dome_select(DOME_SHUTTER_PROPERTY, DOME_SHUTTER_OPENED_ITEM);
			break;
		case DOME_SHUTTER_CLOSED:
		case DOME_SHUTTER_CLOSING:
			dome_select(DOME_SHUTTER_PROPERTY, DOME_SHUTTER_CLOSED_ITEM);
			break;
		case DOME_SHUTTER_ERROR:
			// neither open nor closed is known
			indigo_set_switch(DOME_SHUTTER_PROPERTY, DOME_SHUTTER_OPENED_ITEM, false);
			indigo_set_switch(DOME_SHUTTER_PROPERTY, DOME_SHUTTER_CLOSED_ITEM, false);
			break;
		default:
			return;
	}
	if (status == DOME_SHUTTER_ERROR) {
		DOME_SHUTTER_PROPERTY->state = INDIGO_ALERT_STATE;
	} else if (status == DOME_SHUTTER_OPENING || status == DOME_SHUTTER_CLOSING) {
		DOME_SHUTTER_PROPERTY->state = INDIGO_BUSY_STATE;
	} else if (DOME_SHUTTER_PROPERTY->state == INDIGO_BUSY_STATE || status != DOME_DATA->shutter_shown) {
		DOME_SHUTTER_PROPERTY->state = INDIGO_OK_STATE;
	}
	DOME_DATA->shutter_shown = status;
}

// Put the state of the device into the properties without publishing them. A property that is BUSY because of a request of a client
// belongs to that request and is left alone, except for the azimuth and the altitude, which show the progress of the motion.
// It is done in one step under the lock of the device, so a request that is accepted meanwhile either finds its property untouched
// or is seen as BUSY here.
static void dome_apply_status(indigo_device *device, const dome_status *status) {
	system_alpaca_lock(device);
	// Slewing is true while any part of the dome moves, on many devices while the shutter moves as well. While the shutter moves and
	// this driver did not start a motion, Slewing is taken for the shutter, unless the azimuth or the altitude changes: then the dome
	// moves by itself and is shown as moving until Slewing ends. (This only tells who moves; when a motion is over is told by Slewing.)
	bool shutter_moving = DOME_DATA->shutter.active || status->shutter == DOME_SHUTTER_OPENING || status->shutter == DOME_SHUTTER_CLOSING;
	bool moved = DOME_DATA->status_seen && !DOME_HORIZONTAL_COORDINATES_PROPERTY->hidden && (status->azimuth != DOME_HORIZONTAL_COORDINATES_AZ_ITEM->number.value || (DOME_HORIZONTAL_COORDINATES_PROPERTY->count > 1 && status->altitude != DOME_HORIZONTAL_COORDINATES_ALT_ITEM->number.value));
	bool rotating = status->slewing && (DOME_DATA->motion.active || DOME_DATA->external_motion || !shutter_moving || moved);
	DOME_DATA->status_seen = true;
	DOME_DATA->slewing = rotating;
	DOME_DATA->shutter_status = status->shutter;
	DOME_DATA->slaved = status->slaved;
	if (!DOME_HORIZONTAL_COORDINATES_PROPERTY->hidden) {
		DOME_HORIZONTAL_COORDINATES_AZ_ITEM->number.value = status->azimuth;
		if (DOME_HORIZONTAL_COORDINATES_PROPERTY->count > 1) {
			DOME_HORIZONTAL_COORDINATES_ALT_ITEM->number.value = status->altitude;
		}
		if (rotating && DOME_HORIZONTAL_COORDINATES_PROPERTY->state != INDIGO_BUSY_STATE) {
			// the device moves by itself: it is slaved to a telescope, or somebody else moves it
			DOME_HORIZONTAL_COORDINATES_PROPERTY->state = INDIGO_BUSY_STATE;
			DOME_DATA->external_motion = true;
		} else if (!rotating && (DOME_DATA->external_motion || (DOME_DATA->unreadable && DOME_HORIZONTAL_COORDINATES_PROPERTY->state == INDIGO_ALERT_STATE))) {
			DOME_HORIZONTAL_COORDINATES_PROPERTY->state = INDIGO_OK_STATE;
			DOME_DATA->external_motion = false;
		}
	}
	DOME_DATA->unreadable = false;
	if (!DOME_SHUTTER_PROPERTY->hidden && !DOME_DATA->shutter.active && DOME_DATA->shutter_pending == 0) {
		dome_apply_shutter(device, status->shutter);
	}
	if (!DOME_PARK_PROPERTY->hidden && DOME_PARK_PROPERTY->state != INDIGO_BUSY_STATE) {
		if (!status->at_park) {
			DOME_DATA->unparked = false;
		}
		bool parked = status->at_park && !DOME_DATA->unparked;
		if (parked != DOME_DATA->parked || parked != DOME_PARK_PARKED_ITEM->sw.value) {
			indigo_set_switch(DOME_PARK_PROPERTY, parked ? DOME_PARK_PARKED_ITEM : DOME_PARK_UNPARKED_ITEM, true);
			DOME_PARK_PROPERTY->state = INDIGO_OK_STATE;
			DOME_DATA->parked = parked;
		}
	}
	// DOME_HOME is ON while the dome is at home, as in dome_beaver; a search for home that runs owns the item
	if (!DOME_HOME_PROPERTY->hidden && DOME_HOME_PROPERTY->state != INDIGO_BUSY_STATE && status->at_home != DOME_HOME_ITEM->sw.value) {
		DOME_HOME_ITEM->sw.value = status->at_home;
	}
	if (!X_ALPACA_DOME_SLAVED_PROPERTY->hidden && X_ALPACA_DOME_SLAVED_PROPERTY->state != INDIGO_BUSY_STATE && status->slaved != X_ALPACA_DOME_SLAVED_ENABLED_ITEM->sw.value) {
		indigo_set_switch(X_ALPACA_DOME_SLAVED_PROPERTY, status->slaved ? X_ALPACA_DOME_SLAVED_ENABLED_ITEM : X_ALPACA_DOME_SLAVED_DISABLED_ITEM, true);
		X_ALPACA_DOME_SLAVED_PROPERTY->state = INDIGO_OK_STATE;
	}
	system_alpaca_unlock(device);
}

// The device answers the polling and does not tell its state: what the properties show is not the state of the device any more.
// A property that a request or a motion owns is left alone. The shutter is OK again when its status is read, see dome_apply_shutter().
static void dome_status_unreadable(indigo_device *device, alpaca_result result, const char *reason) {
	system_alpaca_lock(device);
	bool coordinates = !DOME_HORIZONTAL_COORDINATES_PROPERTY->hidden && DOME_HORIZONTAL_COORDINATES_PROPERTY->state == INDIGO_OK_STATE;
	bool shutter = !DOME_SHUTTER_PROPERTY->hidden && !DOME_DATA->shutter.active && DOME_DATA->shutter_pending == 0 && DOME_SHUTTER_PROPERTY->state == INDIGO_OK_STATE;
	if (coordinates) {
		DOME_HORIZONTAL_COORDINATES_PROPERTY->state = INDIGO_ALERT_STATE;
		DOME_DATA->unreadable = true;
	}
	if (shutter) {
		DOME_SHUTTER_PROPERTY->state = INDIGO_ALERT_STATE;
		DOME_DATA->shutter_shown = DOME_SHUTTER_UNKNOWN;
	}
	system_alpaca_unlock(device);
	if (coordinates) {
		system_alpaca_report(device, DOME_HORIZONTAL_COORDINATES_PROPERTY, result, "Reading the state of the dome", reason);
	}
	if (shutter) {
		system_alpaca_report(device, DOME_SHUTTER_PROPERTY, result, "Reading the state of the dome", reason);
	}
}

// DOME_STATE: what the dome does, whoever started it.
static void dome_apply_lights(indigo_device *device) {
	bool shutter_moving = DOME_DATA->shutter.active || DOME_DATA->shutter_status == DOME_SHUTTER_OPENING || DOME_DATA->shutter_status == DOME_SHUTTER_CLOSING;
	system_alpaca_lock(device);
	if (DOME_DATA->slewing || DOME_DATA->motion.active) {
		DOME_STATE_SLEW_ITEM->light.value = INDIGO_BUSY_STATE;
	} else {
		DOME_STATE_SLEW_ITEM->light.value = !DOME_HORIZONTAL_COORDINATES_PROPERTY->hidden && DOME_HORIZONTAL_COORDINATES_PROPERTY->state == INDIGO_ALERT_STATE ? INDIGO_ALERT_STATE : INDIGO_IDLE_STATE;
	}
	if (DOME_PARK_PROPERTY->hidden) {
		DOME_STATE_PARK_ITEM->light.value = INDIGO_IDLE_STATE;
	} else if (DOME_DATA->park_active) {
		DOME_STATE_PARK_ITEM->light.value = INDIGO_BUSY_STATE;
	} else if (DOME_PARK_PROPERTY->state == INDIGO_ALERT_STATE) {
		DOME_STATE_PARK_ITEM->light.value = INDIGO_ALERT_STATE;
	} else {
		DOME_STATE_PARK_ITEM->light.value = DOME_DATA->parked ? INDIGO_OK_STATE : INDIGO_IDLE_STATE;
	}
	if (DOME_SHUTTER_PROPERTY->hidden) {
		DOME_STATE_OPEN_ITEM->light.value = INDIGO_IDLE_STATE;
	} else if (shutter_moving) {
		DOME_STATE_OPEN_ITEM->light.value = INDIGO_BUSY_STATE;
	} else if (DOME_SHUTTER_PROPERTY->state == INDIGO_ALERT_STATE) {
		DOME_STATE_OPEN_ITEM->light.value = INDIGO_ALERT_STATE;
	} else {
		DOME_STATE_OPEN_ITEM->light.value = DOME_DATA->shutter_status == DOME_SHUTTER_OPEN ? INDIGO_OK_STATE : INDIGO_IDLE_STATE;
	}
	system_alpaca_unlock(device);
}

static void dome_show_lights(indigo_device *device) {
	dome_apply_lights(device);
	indigo_update_property(device, DOME_STATE_PROPERTY, NULL);
}

// Publish the state of the device; a property that did not change is not sent again.
static void dome_show_status(indigo_device *device, const dome_status *status) {
	dome_apply_status(device, status);
	indigo_update_property(device, DOME_HORIZONTAL_COORDINATES_PROPERTY, NULL);
	indigo_update_property(device, DOME_SHUTTER_PROPERTY, NULL);
	indigo_update_property(device, DOME_PARK_PROPERTY, NULL);
	indigo_update_property(device, DOME_HOME_PROPERTY, NULL);
	indigo_update_property(device, X_ALPACA_DOME_SLAVED_PROPERTY, NULL);
	dome_show_lights(device);
}

// The device does not have the member: it answered NotImplemented, or HTTP 400 to a member without parameters. HTTP 400 to a member
// with a parameter may as well mean that the server did not like the value.
static bool dome_not_implemented(alpaca_result result, const char *member) {
	bool has_parameter = !strcmp(member, "slaved") || !strcmp(member, "slewtoazimuth") || !strcmp(member, "slewtoaltitude") || !strcmp(member, "synctoazimuth");
	return system_alpaca_not_implemented(result, has_parameter ? 1 : 0);
}

// Keep the reason of the failure of the last request: the channel only has the one of its last request, and a request that failed
// on the way is followed by a look at what the device does.
static alpaca_result dome_keep_reason(indigo_device *device, alpaca_result result) {
	system_alpaca_reason(device, result, DOME_DATA->reason, sizeof(DOME_DATA->reason));
	DOME_DATA->reason_kept = result != ALPACA_OK;
	return result;
}

// system_alpaca_finish() with the reason that dome_keep_reason() kept, if it kept one.
static void dome_report(indigo_device *device, indigo_property *property, alpaca_result result, const char *action) {
	system_alpaca_finish_with(device, property, result, action, DOME_DATA->reason_kept ? DOME_DATA->reason : NULL);
	DOME_DATA->reason_kept = false;
}

// Finish a request. A method the device does not implement is remembered and takes its property away until the next connection.
static void dome_finish(indigo_device *device, indigo_property *property, alpaca_result result, const char *action, const char *member) {
	dome_report(device, property, result, action);
	if (dome_not_implemented(result, member)) {
		system_alpaca_set_unsupported(device, member);
		indigo_delete_property(device, property, NULL);
		property->hidden = true;
	}
}

// Result of a PUT that starts a motion and can not be sent twice. A request that failed on the way may still have reached the device,
// so the device is asked whether it moves.
static alpaca_result dome_start_result(indigo_device *device, alpaca_result result) {
	bool slewing = false;
	dome_keep_reason(device, result);
	if (alpaca_may_have_executed(result) && system_alpaca_get_bool(device, "slewing", &slewing) == ALPACA_OK && slewing) {
		DOME_DATA->reason_kept = false;
		return ALPACA_OK;
	}
	return result;
}

// The item of DOME_PARK is not asked: a request to park that waits for its handler has changed it already.
static bool dome_is_parked(indigo_device *device) {
	return !DOME_PARK_PROPERTY->hidden && DOME_DATA->parked;
}

// The device accepted a slew, a park or a search of the home position: the motion is watched until Slewing becomes false.
// A motion that is already watched is replaced (a park during a slew), so its finalizer is scheduled anew.
static void dome_motion_start(indigo_device *device) {
	DOME_DATA->external_motion = false;
	system_alpaca_update(device, DOME_HORIZONTAL_COORDINATES_PROPERTY, INDIGO_BUSY_STATE, NULL);
	indigo_cancel_pending_handler(device, dome_motion_finalizer);
	system_alpaca_operation_start(device, &DOME_DATA->motion, DOME_MOTION_TIMEOUT, dome_motion_finalizer);
	dome_show_lights(device);
}

// The motion ended, failed or was aborted: publish where the dome is and finish every request that waited for it.
static void dome_motion_done(indigo_device *device, alpaca_result result, bool aborted) {
	dome_status status = { 0 };
	bool slew = DOME_DATA->slew_active, steps = DOME_DATA->steps_active, park = DOME_DATA->park_active, home = DOME_DATA->home_active;
	system_alpaca_operation_end(device, &DOME_DATA->motion);
	DOME_DATA->slew_active = DOME_DATA->steps_active = DOME_DATA->park_active = DOME_DATA->home_active = false;
	if (result == ALPACA_OK) {
		result = dome_read_status(device, &status);
	}
	if (result == ALPACA_OK) {
		dome_apply_status(device, &status);
	}
	indigo_property_state state = result == ALPACA_OK && !aborted ? INDIGO_OK_STATE : INDIGO_ALERT_STATE;
	if (result != ALPACA_OK && (slew || !(steps || park || home))) {
		system_alpaca_finish(device, DOME_HORIZONTAL_COORDINATES_PROPERTY, result, "Slew");
	} else {
		system_alpaca_update(device, DOME_HORIZONTAL_COORDINATES_PROPERTY, state, NULL);
	}
	if (steps) {
		if (result != ALPACA_OK) {
			system_alpaca_finish(device, DOME_STEPS_PROPERTY, result, "Move");
		} else {
			system_alpaca_update(device, DOME_STEPS_PROPERTY, state, NULL);
		}
	}
	if (park) {
		DOME_DATA->parked = result == ALPACA_OK && status.at_park;
		DOME_DATA->unparked = false;
		indigo_set_switch(DOME_PARK_PROPERTY, DOME_DATA->parked ? DOME_PARK_PARKED_ITEM : DOME_PARK_UNPARKED_ITEM, true);
		if (result != ALPACA_OK) {
			system_alpaca_finish(device, DOME_PARK_PROPERTY, result, "Park");
		} else {
			system_alpaca_update(device, DOME_PARK_PROPERTY, DOME_DATA->parked ? INDIGO_OK_STATE : INDIGO_ALERT_STATE, DOME_DATA->parked || aborted ? NULL : "Park failed: the dome stopped outside the park position");
		}
	}
	if (home) {
		DOME_HOME_ITEM->sw.value = result == ALPACA_OK && status.at_home;
		if (result != ALPACA_OK) {
			system_alpaca_finish(device, DOME_HOME_PROPERTY, result, "Find home");
		} else {
			system_alpaca_update(device, DOME_HOME_PROPERTY, status.at_home ? INDIGO_OK_STATE : INDIGO_ALERT_STATE, status.at_home || aborted ? NULL : "Find home failed: the dome stopped outside the home position");
		}
	}
	if (result == ALPACA_OK) {
		indigo_update_property(device, DOME_SHUTTER_PROPERTY, NULL);
		indigo_update_property(device, DOME_PARK_PROPERTY, NULL);
		indigo_update_property(device, X_ALPACA_DOME_SLAVED_PROPERTY, NULL);
	}
	dome_show_lights(device);
}

// A request of DOME_HORIZONTAL_COORDINATES failed. A method the device does not implement takes its item away.
static void dome_coordinates_failed(indigo_device *device, alpaca_result result, const char *action, const char *member) {
	dome_report(device, DOME_HORIZONTAL_COORDINATES_PROPERTY, result, action);
	if (dome_not_implemented(result, member)) {
		system_alpaca_set_unsupported(device, member);
		if (!strcmp(member, "synctoazimuth")) {
			indigo_delete_property(device, DOME_ON_COORDINATES_SET_PROPERTY, NULL);
			DOME_ON_COORDINATES_SET_PROPERTY->count = 1;
			indigo_set_switch(DOME_ON_COORDINATES_SET_PROPERTY, DOME_ON_COORDINATES_SET_GOTO_ITEM, true);
			indigo_define_property(device, DOME_ON_COORDINATES_SET_PROPERTY, NULL);
		} else if (!strcmp(member, "slewtoaltitude")) {
			indigo_delete_property(device, DOME_HORIZONTAL_COORDINATES_PROPERTY, NULL);
			DOME_HORIZONTAL_COORDINATES_PROPERTY->count = 1;
			indigo_define_property(device, DOME_HORIZONTAL_COORDINATES_PROPERTY, NULL);
		} else {
			indigo_delete_property(device, DOME_HORIZONTAL_COORDINATES_PROPERTY, NULL);
			DOME_HORIZONTAL_COORDINATES_PROPERTY->hidden = true;
		}
	}
	dome_show_lights(device);
}

#pragma mark - High level code (dome)

static void dome_motion_finalizer(indigo_device *device) {
	bool slewing = false;
	if (!system_alpaca_is_active(device)) {
		return;
	}
	alpaca_result result = system_alpaca_get_bool(device, "slewing", &slewing);
	if (result == ALPACA_OK && slewing && system_alpaca_operation_continue(device, &DOME_DATA->motion, dome_motion_finalizer)) {
		return;
	}
	dome_motion_done(device, result == ALPACA_OK && slewing ? ALPACA_TIMED_OUT : result, false);
}

static void dome_shutter_finalizer(indigo_device *device) {
	int status = DOME_SHUTTER_UNKNOWN;
	if (!system_alpaca_is_active(device)) {
		return;
	}
	alpaca_result result = system_alpaca_get_int(device, "shutterstatus", &status);
	bool moving = status == DOME_SHUTTER_OPENING || status == DOME_SHUTTER_CLOSING;
	if (result == ALPACA_OK && moving && system_alpaca_operation_continue(device, &DOME_DATA->shutter, dome_shutter_finalizer)) {
		return;
	}
	system_alpaca_operation_end(device, &DOME_DATA->shutter);
	if (result == ALPACA_OK && !moving) {
		bool arrived = status == (DOME_DATA->shutter_open ? DOME_SHUTTER_OPEN : DOME_SHUTTER_CLOSED);
		DOME_DATA->shutter_status = status;
		// the end of the move is put into the property in one step with the look at the waiting requests
		system_alpaca_lock(device);
		bool superseded = DOME_DATA->shutter_pending > 0;
		if (!superseded) {
			dome_apply_shutter(device, status);
			if (!arrived) {
				DOME_SHUTTER_PROPERTY->state = INDIGO_ALERT_STATE;
			}
		}
		system_alpaca_unlock(device);
		if (superseded) {
			// the next request is accepted already and DOME_SHUTTER shows it: its handler goes on from here
			dome_show_lights(device);
			return;
		}
		if (arrived) {
			indigo_update_property(device, DOME_SHUTTER_PROPERTY, NULL);
		} else {
			indigo_update_property(device, DOME_SHUTTER_PROPERTY, "%s shutter failed: %s", DOME_DATA->shutter_open ? "Open" : "Close", status == DOME_SHUTTER_ERROR ? "the shutter reports an error" : "the shutter stopped");
		}
	} else {
		// a request that waits for its handler owns DOME_SHUTTER: the failure of the running move is told, the state is left to that request
		char reason[INDIGO_VALUE_SIZE];
		system_alpaca_reason(device, result, reason, sizeof(reason));
		system_alpaca_lock(device);
		bool superseded = DOME_DATA->shutter_pending > 0;
		if (!superseded) {
			DOME_SHUTTER_PROPERTY->state = INDIGO_ALERT_STATE;
		}
		system_alpaca_unlock(device);
		system_alpaca_report(device, DOME_SHUTTER_PROPERTY, result == ALPACA_OK ? ALPACA_TIMED_OUT : result, DOME_DATA->shutter_open ? "Open shutter" : "Close shutter", reason);
	}
	dome_show_lights(device);
}

static void dome_horizontal_coordinates_handler(indigo_device *device) {
	alpaca_result result = ALPACA_OK;
	const char *member = "slewtoazimuth";
	if (!system_alpaca_is_active(device)) {
		return;
	}
	if (dome_is_parked(device)) {
		system_alpaca_update(device, DOME_HORIZONTAL_COORDINATES_PROPERTY, INDIGO_ALERT_STATE, "Dome is parked");
		dome_show_lights(device);
		return;
	}
	if (DOME_DATA->azimuth_requested) {
		// INDIGO accepts 0 to 360, Alpaca 0 <= Azimuth < 360
		alpaca_param params[] = { ALPACA_DOUBLE_PARAM("Azimuth", dome_wrap(DOME_HORIZONTAL_COORDINATES_AZ_ITEM->number.target)) };
		if (DOME_ON_COORDINATES_SET_PROPERTY->count > 1 && DOME_ON_COORDINATES_SET_SYNC_ITEM->sw.value) {
			member = "synctoazimuth";
			result = dome_keep_reason(device, system_alpaca_put(device, member, params, 1, ALPACA_WAIT_STANDARD));
		} else {
			result = dome_start_result(device, system_alpaca_put(device, member, params, 1, ALPACA_WAIT_LONG));
		}
	}
	if (result == ALPACA_OK && DOME_DATA->altitude_requested && DOME_HORIZONTAL_COORDINATES_PROPERTY->count > 1) {
		alpaca_param params[] = { ALPACA_DOUBLE_PARAM("Altitude", DOME_HORIZONTAL_COORDINATES_ALT_ITEM->number.target) };
		member = "slewtoaltitude";
		result = dome_start_result(device, system_alpaca_put(device, member, params, 1, ALPACA_WAIT_LONG));
	}
	if (result == ALPACA_OK) {
		// a synchronisation is finished the same way: Slewing is false at once and the azimuth is read back
		DOME_DATA->slew_active = true;
		dome_motion_start(device);
	} else {
		dome_coordinates_failed(device, result, !strcmp(member, "synctoazimuth") ? "Sync" : "Slew", member);
	}
}

static void dome_steps_handler(indigo_device *device) {
	double azimuth = 0;
	const char *member = "azimuth";
	if (!system_alpaca_is_active(device)) {
		return;
	}
	if (dome_is_parked(device)) {
		system_alpaca_update(device, DOME_STEPS_PROPERTY, INDIGO_ALERT_STATE, "Dome is parked");
		return;
	}
	if (DOME_STEPS_ITEM->number.value == 0) {
		system_alpaca_update(device, DOME_STEPS_PROPERTY, INDIGO_OK_STATE, NULL);
		return;
	}
	// Alpaca has no relative move: the target is computed from the azimuth of the device and the dome takes the shorter way to it
	alpaca_result result = dome_keep_reason(device, system_alpaca_get_double(device, "azimuth", &azimuth));
	if (result == ALPACA_OK) {
		double target = dome_wrap(azimuth + (DOME_DIRECTION_MOVE_COUNTERCLOCKWISE_ITEM->sw.value ? -DOME_STEPS_ITEM->number.value : DOME_STEPS_ITEM->number.value));
		alpaca_param params[] = { ALPACA_DOUBLE_PARAM("Azimuth", target) };
		member = "slewtoazimuth";
		result = dome_start_result(device, system_alpaca_put(device, member, params, 1, ALPACA_WAIT_LONG));
		if (result == ALPACA_OK) {
			system_alpaca_lock(device);
			DOME_HORIZONTAL_COORDINATES_AZ_ITEM->number.value = azimuth;
			DOME_HORIZONTAL_COORDINATES_AZ_ITEM->number.target = target;
			system_alpaca_unlock(device);
			DOME_DATA->steps_active = true;
			dome_motion_start(device);
			return;
		}
	}
	dome_finish(device, DOME_STEPS_PROPERTY, result, "Move", member);
}

static void dome_abort_motion_handler(indigo_device *device) {
	dome_status status = { 0 };
	alpaca_result result = ALPACA_OK;
	if (!system_alpaca_is_active(device)) {
		return;
	}
	if (DOME_ABORT_MOTION_ITEM->sw.value) {
		DOME_ABORT_MOTION_ITEM->sw.value = false;
		// AbortSlew stops the azimuth, the altitude and the shutter and switches the slaving of the device off
		result = dome_keep_reason(device, system_alpaca_put(device, "abortslew", NULL, 0, ALPACA_REPLAYABLE));
		if (result == ALPACA_OK) {
			bool motion = DOME_DATA->motion.active, shutter = DOME_DATA->shutter.active;
			indigo_cancel_pending_handler(device, dome_motion_finalizer);
			indigo_cancel_pending_handler(device, dome_shutter_finalizer);
			if (shutter) {
				// look at the shutter now: it is stopped, in error, or the device let it finish
				dome_shutter_finalizer(device);
			}
			if (motion) {
				dome_motion_done(device, ALPACA_OK, true);
			} else if (dome_read_status(device, &status) == ALPACA_OK) {
				dome_show_status(device, &status);
			}
		}
	}
	dome_finish(device, DOME_ABORT_MOTION_PROPERTY, result, "Abort", "abortslew");
}

// DOME_SHUTTER shows a move in the given direction. A request that waits for its handler has put its own direction there already.
static void dome_show_shutter_move(indigo_device *device, bool open) {
	system_alpaca_lock(device);
	if (DOME_DATA->shutter_pending == 0) {
		indigo_set_switch(DOME_SHUTTER_PROPERTY, open ? DOME_SHUTTER_OPENED_ITEM : DOME_SHUTTER_CLOSED_ITEM, true);
	}
	DOME_SHUTTER_PROPERTY->state = INDIGO_BUSY_STATE;
	system_alpaca_unlock(device);
}

static void dome_shutter_handler(indigo_device *device, void *data) {
	bool open = data != NULL;
	const char *member = open ? "openshutter" : "closeshutter";
	int status = DOME_SHUTTER_UNKNOWN;
	system_alpaca_lock(device);
	DOME_DATA->shutter_pending--;
	system_alpaca_unlock(device);
	if (!system_alpaca_is_active(device)) {
		return;
	}
	if (DOME_DATA->shutter.active && DOME_DATA->shutter_open == open) {
		// the shutter is on its way there already
		return;
	}
	alpaca_result result = dome_keep_reason(device, system_alpaca_put(device, member, NULL, 0, ALPACA_WAIT_LONG));
	if (alpaca_may_have_executed(result) && system_alpaca_get_int(device, "shutterstatus", &status) == ALPACA_OK && (status == (open ? DOME_SHUTTER_OPENING : DOME_SHUTTER_CLOSING) || status == (open ? DOME_SHUTTER_OPEN : DOME_SHUTTER_CLOSED))) {
		// the request failed on the way, but the shutter does what it was asked for
		result = dome_keep_reason(device, ALPACA_OK);
	}
	if (result == ALPACA_OK) {
		// a request for the other direction while the shutter moves replaces the running move
		DOME_DATA->shutter_open = open;
		dome_show_shutter_move(device, open);
		indigo_update_property(device, DOME_SHUTTER_PROPERTY, NULL);
		indigo_cancel_pending_handler(device, dome_shutter_finalizer);
		system_alpaca_operation_start(device, &DOME_DATA->shutter, DOME_SHUTTER_TIMEOUT, dome_shutter_finalizer);
	} else if (DOME_DATA->shutter.active) {
		// the running move goes on
		dome_show_shutter_move(device, DOME_DATA->shutter_open);
		indigo_update_property(device, DOME_SHUTTER_PROPERTY, "%s shutter failed: %s%s%s%s", open ? "Open" : "Close", alpaca_result_text(result), DOME_DATA->reason[0] ? " (" : "", DOME_DATA->reason, DOME_DATA->reason[0] ? ")" : "");
		DOME_DATA->reason_kept = false;
	} else {
		system_alpaca_lock(device);
		DOME_DATA->shutter_shown = DOME_SHUTTER_UNKNOWN;
		dome_apply_shutter(device, DOME_DATA->shutter_status);
		system_alpaca_unlock(device);
		dome_finish(device, DOME_SHUTTER_PROPERTY, result, open ? "Open shutter" : "Close shutter", member);
		DOME_DATA->shutter_shown = DOME_DATA->shutter_status;
	}
	dome_show_lights(device);
}

static void dome_park_handler(indigo_device *device) {
	if (!system_alpaca_is_active(device)) {
		return;
	}
	if (indigo_get_switch_target(DOME_PARK_PROPERTY, DOME_PARK_PARKED_ITEM_NAME)) {
		alpaca_result result = dome_start_result(device, system_alpaca_put(device, "park", NULL, 0, ALPACA_WAIT_LONG));
		if (result == ALPACA_OK) {
			// completion is AtPark, read when Slewing becomes false; a dome that is parked already is done at the first look
			indigo_apply_switch_targets(DOME_PARK_PROPERTY);
			DOME_DATA->park_active = true;
			dome_motion_start(device);
		} else {
			indigo_set_switch(DOME_PARK_PROPERTY, DOME_DATA->parked ? DOME_PARK_PARKED_ITEM : DOME_PARK_UNPARKED_ITEM, true);
			dome_finish(device, DOME_PARK_PROPERTY, result, "Park", "park");
			dome_show_lights(device);
		}
	} else {
		// Alpaca has no unpark, AtPark is cleared by the next slew
		indigo_apply_switch_targets(DOME_PARK_PROPERTY);
		DOME_DATA->parked = false;
		DOME_DATA->unparked = true;
		system_alpaca_update(device, DOME_PARK_PROPERTY, INDIGO_OK_STATE, NULL);
		dome_show_lights(device);
	}
}

static void dome_home_handler(indigo_device *device) {
	if (!system_alpaca_is_active(device)) {
		return;
	}
	if (!DOME_HOME_ITEM->sw.value) {
		system_alpaca_update(device, DOME_HOME_PROPERTY, INDIGO_OK_STATE, NULL);
		return;
	}
	if (dome_is_parked(device)) {
		DOME_HOME_ITEM->sw.value = false;
		system_alpaca_update(device, DOME_HOME_PROPERTY, INDIGO_ALERT_STATE, "Dome is parked");
		return;
	}
	alpaca_result result = dome_start_result(device, system_alpaca_put(device, "findhome", NULL, 0, ALPACA_WAIT_LONG));
	if (result == ALPACA_OK) {
		DOME_DATA->home_active = true;
		dome_motion_start(device);
	} else {
		DOME_HOME_ITEM->sw.value = false;
		dome_finish(device, DOME_HOME_PROPERTY, result, "Find home", "findhome");
	}
}

static void dome_x_alpaca_dome_slaved_handler(indigo_device *device) {
	bool slaved = false;
	if (!system_alpaca_is_active(device)) {
		return;
	}
	alpaca_param params[] = { ALPACA_BOOL_PARAM("Slaved", indigo_get_switch_target(X_ALPACA_DOME_SLAVED_PROPERTY, X_ALPACA_DOME_SLAVED_ENABLED_ITEM_NAME)) };
	alpaca_result result = dome_keep_reason(device, system_alpaca_put(device, "slaved", params, 1, ALPACA_REPLAYABLE));
	if (result == ALPACA_OK) {
		result = dome_keep_reason(device, system_alpaca_get_bool(device, "slaved", &slaved));
	}
	if (result == ALPACA_OK) {
		DOME_DATA->slaved = slaved;
	}
	indigo_set_switch(X_ALPACA_DOME_SLAVED_PROPERTY, DOME_DATA->slaved ? X_ALPACA_DOME_SLAVED_ENABLED_ITEM : X_ALPACA_DOME_SLAVED_DISABLED_ITEM, true);
	dome_finish(device, X_ALPACA_DOME_SLAVED_PROPERTY, result, "Slaving", "slaved");
}

static void dome_x_alpaca_dome_park_set_handler(indigo_device *device) {
	alpaca_result result = ALPACA_OK;
	if (!system_alpaca_is_active(device)) {
		return;
	}
	if (X_ALPACA_DOME_PARK_SET_CURRENT_ITEM->sw.value) {
		X_ALPACA_DOME_PARK_SET_CURRENT_ITEM->sw.value = false;
		result = dome_keep_reason(device, system_alpaca_put(device, "setpark", NULL, 0, ALPACA_REPLAYABLE));
	}
	dome_finish(device, X_ALPACA_DOME_PARK_SET_PROPERTY, result, "Set park position", "setpark");
}

// Refusal of a relative move while the dome moves. Called by system_alpaca_accept() with the lock of the device held.
static const char *dome_steps_refusal(indigo_device *device) {
	return DOME_HORIZONTAL_COORDINATES_PROPERTY->state == INDIGO_BUSY_STATE ? "Dome is moving: request can not be completed" : NULL;
}

// Refusal of a slew while a relative move, a park or a search of the home position is requested or running: each of them sends its own
// target to the device and writes DOME_HORIZONTAL_COORDINATES, which the slew would own. Called with the lock of the device held.
static const char *dome_coordinates_refusal(indigo_device *device) {
	bool busy = DOME_STEPS_PROPERTY->state == INDIGO_BUSY_STATE || DOME_PARK_PROPERTY->state == INDIGO_BUSY_STATE || DOME_HOME_PROPERTY->state == INDIGO_BUSY_STATE;
	return busy ? "Dome is moving: request can not be completed" : NULL;
}

#pragma mark - Hooks

static bool dome_on_probe(indigo_device *device) {
	static const char *capabilities[] = { "cansetazimuth", "cansetaltitude", "cansyncazimuth", "cansetshutter", "canpark", "cansetpark", "canfindhome", "canslave" };
	for (size_t i = 0; i < sizeof(capabilities) / sizeof(capabilities[0]); i++) {
		if (system_alpaca_probe_bool(device, capabilities[i], NULL) != ALPACA_OK) {
			return false;
		}
	}
	return true;
}

static bool dome_on_connect(indigo_device *device) {
	dome_status status = { 0 };
	bool azimuth = system_alpaca_can(device, "cansetazimuth");
	// everything the last connection left behind is forgotten, the device may be another one now
	DOME_DATA->slew_active = DOME_DATA->steps_active = DOME_DATA->park_active = DOME_DATA->home_active = false;
	DOME_DATA->external_motion = DOME_DATA->status_seen = DOME_DATA->parked = DOME_DATA->unparked = DOME_DATA->reason_kept = DOME_DATA->unreadable = false;
	system_alpaca_lock(device);
	DOME_DATA->shutter_pending = 0;
	DOME_DATA->shutter_shown = DOME_SHUTTER_UNKNOWN;
	DOME_SPEED_PROPERTY->hidden = true;
	DOME_DIRECTION_PROPERTY->hidden = DOME_STEPS_PROPERTY->hidden = DOME_HORIZONTAL_COORDINATES_PROPERTY->hidden = DOME_ON_COORDINATES_SET_PROPERTY->hidden = !azimuth;
	DOME_DIMENSION_PROPERTY->hidden = DOME_SLAVING_PARAMETERS_PROPERTY->hidden = !azimuth;
	DOME_HORIZONTAL_COORDINATES_PROPERTY->count = system_alpaca_can(device, "cansetaltitude") ? 2 : 1;
	DOME_ON_COORDINATES_SET_PROPERTY->count = system_alpaca_can(device, "cansyncazimuth") ? 2 : 1;
	indigo_set_switch(DOME_ON_COORDINATES_SET_PROPERTY, DOME_ON_COORDINATES_SET_GOTO_ITEM, true);
	DOME_SHUTTER_PROPERTY->hidden = !system_alpaca_can(device, "cansetshutter");
	DOME_PARK_PROPERTY->hidden = !system_alpaca_can(device, "canpark");
	DOME_HOME_PROPERTY->hidden = !system_alpaca_can(device, "canfindhome");
	DOME_ABORT_MOTION_PROPERTY->hidden = false;
	DOME_STATE_PROPERTY->hidden = false;
	X_ALPACA_DOME_SLAVED_PROPERTY->hidden = !system_alpaca_can(device, "canslave");
	X_ALPACA_DOME_PARK_SET_PROPERTY->hidden = !system_alpaca_can(device, "cansetpark");
	DOME_HORIZONTAL_COORDINATES_PROPERTY->state = DOME_STEPS_PROPERTY->state = DOME_SHUTTER_PROPERTY->state = DOME_PARK_PROPERTY->state = DOME_HOME_PROPERTY->state = DOME_ABORT_MOTION_PROPERTY->state = INDIGO_OK_STATE;
	X_ALPACA_DOME_SLAVED_PROPERTY->state = X_ALPACA_DOME_PARK_SET_PROPERTY->state = INDIGO_OK_STATE;
	DOME_HOME_ITEM->sw.value = DOME_ABORT_MOTION_ITEM->sw.value = X_ALPACA_DOME_PARK_SET_CURRENT_ITEM->sw.value = false;
	system_alpaca_unlock(device);
	if (dome_read_status(device, &status) != ALPACA_OK) {
		return false;
	}
	dome_apply_status(device, &status);
	dome_apply_lights(device);
	DOME_HORIZONTAL_COORDINATES_AZ_ITEM->number.target = DOME_HORIZONTAL_COORDINATES_AZ_ITEM->number.value;
	DOME_HORIZONTAL_COORDINATES_ALT_ITEM->number.target = DOME_HORIZONTAL_COORDINATES_ALT_ITEM->number.value;
	indigo_define_property(device, X_ALPACA_DOME_SLAVED_PROPERTY, NULL);
	indigo_define_property(device, X_ALPACA_DOME_PARK_SET_PROPERTY, NULL);
	return true;
}

static void dome_on_disconnect(indigo_device *device) {
	// nothing is stopped: a dome that is closing or parking finishes that without INDIGO
	system_alpaca_operation_end(device, &DOME_DATA->motion);
	system_alpaca_operation_end(device, &DOME_DATA->shutter);
	DOME_DATA->slew_active = DOME_DATA->steps_active = DOME_DATA->park_active = DOME_DATA->home_active = DOME_DATA->external_motion = false;
	// the properties are still defined, so a request may be accepted while they are reset; its handler finds the session closed
	system_alpaca_lock(device);
	DOME_ABORT_MOTION_PROPERTY->state = INDIGO_OK_STATE;
	DOME_ABORT_MOTION_ITEM->sw.value = false;
	system_alpaca_unlock(device);
	indigo_delete_property(device, X_ALPACA_DOME_SLAVED_PROPERTY, NULL);
	indigo_delete_property(device, X_ALPACA_DOME_PARK_SET_PROPERTY, NULL);
}

static void dome_on_poll(indigo_device *device) {
	char reason[INDIGO_VALUE_SIZE];
	dome_status status = { 0 };
	alpaca_result result = dome_read_status(device, &status);
	system_alpaca_reason(device, result, reason, sizeof(reason));
	if (result == ALPACA_OK) {
		dome_show_status(device, &status);
	} else if (!alpaca_is_transport_error(result)) {
		dome_status_unreadable(device, result, reason);
		dome_show_lights(device);
	}
}

#pragma mark - Device API (dome)

static indigo_result dome_enumerate_properties(indigo_device *device, indigo_client *client, indigo_property *property);

static indigo_result dome_attach(indigo_device *device) {
	assert(device != NULL);
	if (indigo_dome_attach(device, DRIVER_NAME, DRIVER_VERSION) == INDIGO_OK) {
		X_ALPACA_DOME_SLAVED_PROPERTY = indigo_init_switch_property(NULL, device->name, X_ALPACA_DOME_SLAVED_PROPERTY_NAME, DOME_MAIN_GROUP, "Slaved to the telescope by the Alpaca device", INDIGO_OK_STATE, INDIGO_RW_PERM, INDIGO_ONE_OF_MANY_RULE, 2);
		if (X_ALPACA_DOME_SLAVED_PROPERTY == NULL) {
			return INDIGO_FAILED;
		}
		indigo_init_switch_item(X_ALPACA_DOME_SLAVED_ENABLED_ITEM, X_ALPACA_DOME_SLAVED_ENABLED_ITEM_NAME, "Enabled", false);
		indigo_init_switch_item(X_ALPACA_DOME_SLAVED_DISABLED_ITEM, X_ALPACA_DOME_SLAVED_DISABLED_ITEM_NAME, "Disabled", true);
		X_ALPACA_DOME_PARK_SET_PROPERTY = indigo_init_switch_property(NULL, device->name, X_ALPACA_DOME_PARK_SET_PROPERTY_NAME, DOME_MAIN_GROUP, "Set park position", INDIGO_OK_STATE, INDIGO_RW_PERM, INDIGO_AT_MOST_ONE_RULE, 1);
		if (X_ALPACA_DOME_PARK_SET_PROPERTY == NULL) {
			return INDIGO_FAILED;
		}
		indigo_init_switch_item(X_ALPACA_DOME_PARK_SET_CURRENT_ITEM, X_ALPACA_DOME_PARK_SET_CURRENT_ITEM_NAME, "Current position", false);
		// what the device can do is not known before it is connected
		DOME_SPEED_PROPERTY->hidden = true;
		DOME_STATE_PROPERTY->hidden = false;
		return system_alpaca_attach(device) == INDIGO_OK ? dome_enumerate_properties(device, NULL, NULL) : INDIGO_FAILED;
	}
	return INDIGO_FAILED;
}

static indigo_result dome_enumerate_properties(indigo_device *device, indigo_client *client, indigo_property *property) {
	if (system_alpaca_is_active(device)) {
		INDIGO_DEFINE_MATCHING_PROPERTY(X_ALPACA_DOME_SLAVED_PROPERTY);
		INDIGO_DEFINE_MATCHING_PROPERTY(X_ALPACA_DOME_PARK_SET_PROPERTY);
	}
	return indigo_dome_enumerate_properties(device, client, property);
}

static indigo_result dome_change_property(indigo_device *device, indigo_client *client, indigo_property *property) {
	if (system_alpaca_change_property(device, property)) {
		return INDIGO_OK;
	}
	if (indigo_property_match_changeable(DOME_HORIZONTAL_COORDINATES_PROPERTY, property)) {
		// the steps of system_alpaca_accept(), and which items the request names: only those are sent to the device, a new azimuth does not move the altitude
		system_alpaca_lock(device);
		bool idle = DOME_HORIZONTAL_COORDINATES_PROPERTY->state != INDIGO_BUSY_STATE;
		const char *refused = idle ? dome_coordinates_refusal(device) : NULL;
		bool accepted = idle && refused == NULL;
		if (accepted) {
			DOME_DATA->azimuth_requested = indigo_get_item(property, DOME_HORIZONTAL_COORDINATES_AZ_ITEM_NAME) != NULL;
			DOME_DATA->altitude_requested = indigo_get_item(property, DOME_HORIZONTAL_COORDINATES_ALT_ITEM_NAME) != NULL;
			indigo_property_copy_targets(DOME_HORIZONTAL_COORDINATES_PROPERTY, property, false);
			DOME_HORIZONTAL_COORDINATES_PROPERTY->state = INDIGO_BUSY_STATE;
		}
		system_alpaca_unlock(device);
		if (accepted) {
			indigo_update_property(device, DOME_HORIZONTAL_COORDINATES_PROPERTY, NULL);
			indigo_execute_handler(device, dome_horizontal_coordinates_handler);
		} else if (refused != NULL) {
			system_alpaca_reject(device, DOME_HORIZONTAL_COORDINATES_PROPERTY, refused);
		}
		return INDIGO_OK;
	} else if (indigo_property_match_changeable(DOME_STEPS_PROPERTY, property)) {
		system_alpaca_accept(device, DOME_STEPS_PROPERTY, property, ALPACA_ACCEPT_VALUES, dome_steps_refusal, dome_steps_handler);
		return INDIGO_OK;
	} else if (indigo_property_match_changeable(DOME_ABORT_MOTION_PROPERTY, property)) {
		system_alpaca_accept(device, DOME_ABORT_MOTION_PROPERTY, property, ALPACA_ACCEPT_VALUES, NULL, dome_abort_motion_handler);
		return INDIGO_OK;
	} else if (indigo_property_match_changeable(DOME_SHUTTER_PROPERTY, property)) {
		// accepted while the shutter moves as well: closing a shutter that is opening must not have to wait
		bool open = indigo_get_switch(property, DOME_SHUTTER_OPENED_ITEM_NAME);
		system_alpaca_lock(device);
		DOME_DATA->shutter_pending++;
		indigo_property_copy_values(DOME_SHUTTER_PROPERTY, property, false);
		DOME_SHUTTER_PROPERTY->state = INDIGO_BUSY_STATE;
		system_alpaca_unlock(device);
		indigo_update_property(device, DOME_SHUTTER_PROPERTY, NULL);
		indigo_execute_handler_with_data(device, dome_shutter_handler, (void *)(intptr_t)open);
		return INDIGO_OK;
	} else if (indigo_property_match_changeable(DOME_PARK_PROPERTY, property)) {
		system_alpaca_accept(device, DOME_PARK_PROPERTY, property, ALPACA_ACCEPT_VALUES, NULL, dome_park_handler);
		return INDIGO_OK;
	} else if (indigo_property_match_changeable(DOME_HOME_PROPERTY, property)) {
		system_alpaca_accept(device, DOME_HOME_PROPERTY, property, ALPACA_ACCEPT_VALUES, NULL, dome_home_handler);
		return INDIGO_OK;
	} else if (indigo_property_match_changeable(X_ALPACA_DOME_SLAVED_PROPERTY, property)) {
		system_alpaca_accept(device, X_ALPACA_DOME_SLAVED_PROPERTY, property, ALPACA_ACCEPT_VALUES, NULL, dome_x_alpaca_dome_slaved_handler);
		return INDIGO_OK;
	} else if (indigo_property_match_changeable(X_ALPACA_DOME_PARK_SET_PROPERTY, property)) {
		system_alpaca_accept(device, X_ALPACA_DOME_PARK_SET_PROPERTY, property, ALPACA_ACCEPT_VALUES, NULL, dome_x_alpaca_dome_park_set_handler);
		return INDIGO_OK;
	}
	return indigo_dome_change_property(device, client, property);
}

static indigo_result dome_detach(indigo_device *device) {
	assert(device != NULL);
	system_alpaca_detach(device);
	indigo_release_property(X_ALPACA_DOME_SLAVED_PROPERTY);
	indigo_release_property(X_ALPACA_DOME_PARK_SET_PROPERTY);
	INDIGO_DEVICE_DETACH_LOG(DRIVER_NAME, device->name);
	return indigo_dome_detach(device);
}

#pragma mark - Device class

const alpaca_class system_alpaca_dome_class = {
	.device_type = "Dome",
	.platform7_version = 3,
	.data_size = sizeof(dome_data),
	.attach = dome_attach,
	.enumerate_properties = dome_enumerate_properties,
	.change_property = dome_change_property,
	.detach = dome_detach,
	.base_change_property = indigo_dome_change_property,
	.on_probe = dome_on_probe,
	.on_connect = dome_on_connect,
	.on_disconnect = dome_on_disconnect,
	.on_poll = dome_on_poll
};
