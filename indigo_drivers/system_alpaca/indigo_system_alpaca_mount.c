// Copyright (c) 2026 CloudMakers, s. r. o.
// All rights reserved.
//
// You can use this software under the terms of 'INDIGO Astronomy
// open-source license' (see LICENSE.md).
//
// THIS SOFTWARE IS PROVIDED BY THE AUTHORS 'AS IS' AND ANY EXPRESS
// OR IMPLIED WARRANTIES, INCLUDING, BUT NOT LIMITED TO, THE IMPLIED
// WARRANTIES OF MERCHANTABILITY AND FITNESS FOR A PARTICULAR PURPOSE
// ARE DISCLAIMED. IN NO EVENT SHALL THE AUTHOR BE LIABLE FOR ANY
// DIRECT, INDIRECT, INCIDENTAL, SPECIAL, EXEMPLARY, OR CONSEQUENTIAL
// DAMAGES (INCLUDING, BUT NOT LIMITED TO, PROCUREMENT OF SUBSTITUTE
// GOODS OR SERVICES; LOSS OF USE, DATA, OR PROFITS; OR BUSINESS
// INTERRUPTION) HOWEVER CAUSED AND ON ANY THEORY OF LIABILITY,
// WHETHER IN CONTRACT, STRICT LIABILITY, OR TORT (INCLUDING
// NEGLIGENCE OR OTHERWISE) ARISING IN ANY WAY OUT OF THE USE OF THIS
// SOFTWARE, EVEN IF ADVISED OF THE POSSIBILITY OF SUCH DAMAGE.

// version history
// 3.0 by Peter Polakovic <peter.polakovic@cloudmakers.eu>

// Code is generated by AI

/** INDIGO ASCOM Alpaca client driver, Telescope device class: Alpaca Telescope as an INDIGO mount, with a guider as its secondary device when the telescope can pulse guide
 \file indigo_system_alpaca_mount.c

 MAPPING

 MOUNT_INFO                     Name, Description, DriverVersion and DriverInfo
 MOUNT_EQUATORIAL_COORDINATES   RightAscension, Declination; SlewToCoordinatesAsync, SyncToCoordinates (MOUNT_ON_COORDINATES_SET)
 MOUNT_EPOCH                    EquatorialSystem
 MOUNT_HORIZONTAL_COORDINATES   Azimuth, Altitude (computed from the equatorial coordinates if the telescope has none)
 MOUNT_LST_TIME                 SiderealTime (computed if the telescope has none)
 UTC_TIME, MOUNT_SET_HOST_TIME  UTCDate
 GEOGRAPHIC_COORDINATES         SiteLatitude, SiteLongitude, SiteElevation
 MOUNT_PARK, MOUNT_PARK_SET     AtPark, Park, Unpark, SetPark
 MOUNT_HOME                     FindHome, AtHome
 MOUNT_TRACKING                 Tracking
 MOUNT_TRACK_RATE               TrackingRates, TrackingRate
 X_ALPACA_OFFSET_RATE           RightAscensionRate, DeclinationRate
 X_ALPACA_MOUNT_AXES            sense of MoveAxis (driver setting)
 X_ALPACA_SETTLE_TIME           pause after a motion (driver setting)
 MOUNT_GUIDE_RATE               GuideRateRightAscension, GuideRateDeclination
 MOUNT_SLEW_RATE                rates chosen from AxisRates
 MOUNT_MOTION_DEC, _RA          MoveAxis
 MOUNT_ABORT_MOTION             AbortSlew
 MOUNT_SIDE_OF_PIER             SideOfPier
 MOUNT_STATE                    Slewing, AtPark, AtHome, Tracking

 EPOCH

 The coordinates on the INDIGO bus are J2000. MOUNT_EPOCH is the equinox of the coordinates of the telescope, as in the other mount
 drivers: 0 (the equinox of date) for equTopocentric, 2000 for equJ2000, 2050 for equJ2050 and 1950 for equB1950, read only.
 A telescope that reports equOther, or does not report its system at all, leaves MOUNT_EPOCH to the user.
 Coordinates read from the telescope pass through indigo_eq_to_j2k() and targets sent to it through indigo_j2k_to_eq().

 MOTION

 A slew, a park, an unpark, a search for the home position and a pier flip are one "motion" of the telescope with one finalizer.
 Only a slew makes MOUNT_EQUATORIAL_COORDINATES BUSY; a park, an unpark, a search for home and a pier flip keep MOUNT_PARK,
 MOUNT_HOME or MOUNT_SIDE_OF_PIER BUSY and leave the coordinates alone (an unpark does not move the telescope at all). A slew and
 a pier flip are complete when Slewing is false. A park and a search for home are complete when AtPark / AtHome is true (the
 completion members of the standard, 2.7 of REFACTOR.md), whatever Slewing says: some telescopes report Slewing false and AtPark
 false for a moment after Park, or report Slewing false while they park. They fail when the telescope stalls: it neither slews
 nor moves (Altitude / Azimuth of the polling change by less than MOUNT_PROGRESS) and is not at the goal for MOUNT_STALL_TIME
 in a row. An unpark is complete when AtPark is false and Slewing is false, and fails the same way. Should the telescope reach
 the park (home) position after it was reported as failed, the polling ends MOUNT_PARK (MOUNT_HOME) in OK. A motion started while
 another one runs replaces it on the telescope; the properties of both are settled together when the telescope stops.

 Some telescopes ignore a motion command that arrives too soon after the end of a slew (HW-4; the Pegasus NYX-101 for about 1.5 s): a
 goto, park, search for home, pier flip or MoveAxis is sent no earlier than X_ALPACA_SETTLE_TIME (0 by default) after the end of the last
 motion; the property stays BUSY meanwhile and MOUNT_ABORT_MOTION cancels it.

 A goto requested while a park, a search for home or a pier flip runs is refused with a message; a goto requested while the
 coordinates are BUSY with a slew is answered with a message and leaves the slew alone. A goto requested while an unpark runs (or
 is accepted and waits for its handler) is accepted and sent when the unpark is complete, so a client may ask for the unpark and the
 goto in a row.

 Equatorial slews need Tracking to be on (the telescope answers InvalidOperation otherwise), so tracking is switched on before the
 slew when the telescope can do that. "Slew to target and stop" switches it off again after the arrival.
 Only the asynchronous slew is used. The deprecated synchronous slew would block the queue of the device, and with it the polling
 and MOUNT_ABORT_MOTION, for the whole slew; a telescope that has no SlewToCoordinatesAsync has no goto in this driver.

 PARKED

 While the telescope is parked, parks or unparks, MOUNT_MOTION_DEC, MOUNT_MOTION_RA, MOUNT_TRACKING and MOUNT_SIDE_OF_PIER are refused
 without a request to the telescope, as in the other mount drivers, and so is MOUNT_EQUATORIAL_COORDINATES unless an unpark runs or
 waits (see MOTION). MOUNT_HOME and MOUNT_ABORT_MOTION are sent and answered by the telescope (InvalidWhileParked). A telescope that
 somebody else parked is recognised by AtPark of the next poll or by the first InvalidWhileParked it answers.

 SITE

 GEOGRAPHIC_COORDINATES shows the site the telescope reports and setting it writes SiteLatitude, SiteLongitude and SiteElevation; the
 driver never writes the site on its own. A site of exactly 0° / 0° is almost certainly not set (a new controller, or a client that
 wrote its own unset site): the telescope then computes SiderealTime and its coordinates for Greenwich, so a warning says so once
 per connection and again whenever the site becomes 0° / 0°.

 MANUAL MOTION

 MOUNT_MOTION_RA and MOUNT_MOTION_DEC are MoveAxis of the primary and the secondary axis. The standard leaves the sense of rotation
 undefined; the driver follows ASCOM OmniSim, the reference implementation, and the common mounts. The axes are the mechanical ones:

 - Primary axis: a positive rate moves west (the hour angle grows, the right ascension falls) on both sides of the pier and in both
   hemispheres, so WEST is a positive rate and EAST a negative one, always.
 - Secondary axis: a positive rate raises the declination in the normal pointing state (SideOfPier pierEast) and lowers it when a German
   mount points through the pole (pierWest), in both hemispheres. NORTH always moves toward the north celestial pole and SOUTH away from
   it: the driver sends a positive rate for NORTH on pierEast and a negative one on pierWest. On a southern site NORTH moves away from
   the visible (south) pole as well; the declination grows.
 - HW-3: some telescopes move their axes in sky directions instead (the Pegasus NYX-101, firmware 1.32.1, measured on 2026-10-03): a
   positive primary rate moves east and a positive secondary rate moves south, on both sides of the pier. X_ALPACA_MOUNT_AXES selects the
   convention: MECHANICAL (the default, as described above) or SKY, with which both rates are negated and the pier side is not read.
 - The side is read with SideOfPier when the motion starts (the value of the last poll tick if that read fails). A telescope that does
   not implement SideOfPier, or reports pierUnknown, gets a positive rate for NORTH, which is right for a fork or any mount that never
   points through the pole.
 - The sense is chosen when MoveAxis is sent: a reversal, a change of the rate and every new start use the side of that moment. A motion
   that runs while the side changes is not sent again. The secondary axis that moves over the pole continues to turn the same way, as
   a hand controller does, and moves away from the pole on the other side; resending it with the other sign would only turn it back to
   the pole.

 Slews to horizontal coordinates are not mapped: MOUNT_HORIZONTAL_COORDINATES is read only in the INDIGO mount model.

 THREADS

 change_property runs on a bus thread, everything else on the handler queue of the device. A request is accepted with
 system_alpaca_accept(), and the polling and the finalizers put the state of the telescope into the properties under the lock of
 the device, so a poll tick never replaces a request that was just accepted with the old state of the telescope. What a bus thread
 has to know besides the properties (parked, the site is the one of the telescope) is kept in the class data under the same lock.
 */

#pragma mark - Includes

#include <stdlib.h>
#include <string.h>
#include <math.h>
#include <time.h>
#include <assert.h>

#include <indigo/indigo_mount_driver.h>
#include <indigo/indigo_align.h>

#include "indigo_system_alpaca_private.h"

#pragma mark - Common definitions

/** Longest time in seconds a slew, a park, an unpark, a search for the home position or a pier flip may take.
 */
#define MOUNT_MOTION_TIMEOUT							600

/** A park, an unpark or a search for home has failed when the telescope did not slew, did not move and was not at its goal for this many seconds in a row.
 Long enough for the delay some telescopes take before they start (NYX-101: about 0.5 s with Slewing and AtPark false), short against the motion timeout.
 */
#define MOUNT_STALL_TIME									10

/** Change of Altitude or Azimuth in degrees between two poll ticks that counts as progress of a park or a search for home. Larger than the change
 the tracking makes in MOUNT_STALL_TIME (at most 0.042°), so a telescope that tracks and does nothing else counts as stalled.
 */
#define MOUNT_PROGRESS										0.1

#define X_ALPACA_MOUNT_AXES_PROPERTY				(MOUNT_DATA->x_alpaca_mount_axes_property)
#define X_ALPACA_MOUNT_AXES_MECHANICAL_ITEM	(X_ALPACA_MOUNT_AXES_PROPERTY->items + 0)
#define X_ALPACA_MOUNT_AXES_SKY_ITEM				(X_ALPACA_MOUNT_AXES_PROPERTY->items + 1)
#define X_ALPACA_MOUNT_AXES_PROPERTY_NAME		"X_ALPACA_MOUNT_AXES"
#define X_ALPACA_MOUNT_AXES_MECHANICAL_ITEM_NAME	"MECHANICAL"
#define X_ALPACA_MOUNT_AXES_SKY_ITEM_NAME		"SKY"

#define X_ALPACA_SETTLE_TIME_PROPERTY				(MOUNT_DATA->x_alpaca_settle_time_property)
#define X_ALPACA_SETTLE_TIME_ITEM						(X_ALPACA_SETTLE_TIME_PROPERTY->items + 0)
#define X_ALPACA_SETTLE_TIME_PROPERTY_NAME	"X_ALPACA_SETTLE_TIME"
#define X_ALPACA_SETTLE_TIME_ITEM_NAME			"TIME"

/** The settings another client may change (tracking rate, guide rates, site, offset rates) are read on every n-th poll tick.
 */
#define MOUNT_SETTINGS_TICKS							10

/** Sidereal rate in degrees per second and the rates looked for in AxisRates for the items of MOUNT_SLEW_RATE.
 */
#define MOUNT_SIDEREAL_RATE								(15.0410686 / 3600)
#define MOUNT_GUIDE_SLEW_RATE							MOUNT_SIDEREAL_RATE
#define MOUNT_CENTERING_SLEW_RATE					(32 * MOUNT_SIDEREAL_RATE)
#define MOUNT_FIND_SLEW_RATE							(256 * MOUNT_SIDEREAL_RATE)

#define MOUNT_MAX_RATE_RANGES							16

#pragma mark - Property definitions

#define X_ALPACA_OFFSET_RATE_PROPERTY			(MOUNT_DATA->x_alpaca_offset_rate_property)
#define X_ALPACA_OFFSET_RATE_RA_ITEM			(X_ALPACA_OFFSET_RATE_PROPERTY->items + 0)
#define X_ALPACA_OFFSET_RATE_DEC_ITEM			(X_ALPACA_OFFSET_RATE_PROPERTY->items + 1)

#define X_ALPACA_OFFSET_RATE_PROPERTY_NAME	"X_ALPACA_OFFSET_RATE"
#define X_ALPACA_OFFSET_RATE_RA_ITEM_NAME		"RA"
#define X_ALPACA_OFFSET_RATE_DEC_ITEM_NAME	"DEC"

#pragma mark - Private data definition

#define MOUNT_DATA												((mount_data *)CLASS_DATA)

typedef struct {
	indigo_property *x_alpaca_offset_rate_property;
	indigo_property *x_alpaca_mount_axes_property;
	indigo_property *x_alpaca_settle_time_property;
	// running motion
	alpaca_operation motion;
	const char *action;							///< what the running motion is called in messages
	bool slew_requested;						///< the motion is a slew: MOUNT_EQUATORIAL_COORDINATES is BUSY and is settled when it ends
	bool goto_waits;								///< an accepted goto waits for the end of the running unpark
	double motion_ended;						///< monotonic time at which a motion of the telescope was last seen to end, 0 if none (HW-4)
	bool was_slewing;								///< Slewing of the previous mount_apply_state() (HW-4)
	double stall_since;							///< monotonic time since which a park, an unpark or a search for home shows no progress, 0 if it did not start
	double stall_altitude;					///< Altitude and Azimuth at stall_since
	double stall_azimuth;
	int park_alert;									///< MOUNT_PARK is in ALERT after a park (1) or an unpark (0) that was not confirmed; -1 otherwise
	bool home_alert;								///< MOUNT_HOME is in ALERT after a search for home that was not confirmed
	bool park_recovered;						///< the telescope reached the goal of park_alert later: MOUNT_PARK is published with a message
	bool home_recovered;						///< the same for home_alert
	bool site_warned;								///< the warning about a site of 0° / 0° was sent
	bool park_requested;						///< the motion has to end with AtPark
	bool unpark_requested;					///< the motion has to end without AtPark
	bool home_requested;						///< the motion has to end with AtHome
	bool flip_requested;						///< the motion is a pier flip
	bool stop_tracking;							///< tracking is switched off when the slew is over
	bool aborted;										///< AbortSlew was accepted and the telescope is still stopping
	bool external_slew;							///< MOUNT_EQUATORIAL_COORDINATES is BUSY because the telescope slews without a request of this driver
	bool coordinates_failed;				///< MOUNT_EQUATORIAL_COORDINATES is in ALERT because the coordinates can not be read
	bool utc_changed;								///< the value of UTC_TIME changed since it was published
	bool parked;										///< requests that move the telescope are refused, see mount_is_parked(); guarded by the lock of the device
	bool site;											///< GEOGRAPHIC_COORDINATES is the site of the telescope, see mount_has_site(); guarded by the lock of the device
	bool axis_moving[2];						///< MoveAxis with a rate that is not zero was sent
	// read once per connection
	char name[INDIGO_VALUE_SIZE];
	int equatorial_system;
	bool can_move_axis[2];
	double slew_rates[2][4];				///< rate of MoveAxis for every item of MOUNT_SLEW_RATE
	int track_rates[4];							///< DriveRates of the items of MOUNT_TRACK_RATE
	int track_rate_count;
	// operational state as last read
	alpaca_result coordinates;
	double right_ascension;
	double declination;
	double altitude;
	double azimuth;
	double sidereal_time;
	int side_of_pier;
	char utc[INDIGO_NAME_SIZE];
	bool slewing;
	bool at_park;
	bool at_home;
	bool tracking;
	// settings as last read
	int settings_ticks;
	int tracking_rate;
	double latitude;
	double longitude;
	double elevation;
	double guide_rate_ra;
	double guide_rate_dec;
	double offset_rate_ra;
	double offset_rate_dec;
} mount_data;

#pragma mark - Low level code (mount)

// The telescope is parked, parks or unparks: a goto, a manual motion, a change of tracking and a pier flip are refused.
// The flag follows AtPark of a telescope that has MOUNT_PARK; change_property does not look at the items of MOUNT_PARK,
// which the polling writes at the same time.
static bool mount_is_parked(indigo_device *device) {
	system_alpaca_lock(device);
	bool parked = MOUNT_DATA->parked;
	system_alpaca_unlock(device);
	return parked;
}

static void mount_set_parked(indigo_device *device, bool parked) {
	system_alpaca_lock(device);
	MOUNT_DATA->parked = parked;
	system_alpaca_unlock(device);
}

// Refusal of a request that would move a parked telescope. Called by system_alpaca_accept() with the lock of the device held.
static const char *mount_parked_refusal(indigo_device *device) {
	return MOUNT_DATA->parked ? "Mount is parked!" : NULL;
}

// Refusal of a goto or a sync, see MOTION. Called by system_alpaca_accept() with the lock of the device held; the request is accepted while the
// coordinates are BUSY, so that it is answered: a refused request keeps the BUSY state of the running slew and gets the message.
// A goto behind an unpark (MOUNT_PARK BUSY with UNPARKED, accepted or running) is accepted although the telescope is still parked.
static const char *mount_coordinates_refusal(indigo_device *device) {
	if (MOUNT_EQUATORIAL_COORDINATES_PROPERTY->state == INDIGO_BUSY_STATE) {
		return "Mount is slewing, the new coordinates are ignored!";
	}
	if (MOUNT_PARK_PROPERTY->state == INDIGO_BUSY_STATE) {
		return MOUNT_PARK_UNPARKED_ITEM->sw.value ? NULL : "Mount is parking!";
	}
	if (MOUNT_DATA->parked) {
		return "Mount is parked!";
	}
	if (MOUNT_HOME_PROPERTY->state == INDIGO_BUSY_STATE) {
		return "Mount is searching for its home position!";
	}
	if (MOUNT_SIDE_OF_PIER_PROPERTY->state == INDIGO_BUSY_STATE) {
		return "Mount is changing the side of pier!";
	}
	return NULL;
}

// The device answered, with a value or with an error of its own. False means that there is no usable answer and the connection has to be given up.
static bool mount_usable(alpaca_result result) {
	return !alpaca_is_transport_error(result) && result != ALPACA_PROTOCOL_ERROR && result != ALPACA_SERVER_ERROR && result != ALPACA_FAILED;
}

// Right ascension in hours within 0 <= ra < 24. A value that is in the range already is returned bit by bit, so that a target is sent as it was requested.
static double mount_wrap_hours(double ra) {
	if (ra >= 0 && ra < 24) {
		return ra;
	}
	ra = fmod(ra, 24);
	return ra < 0 ? ra + 24 : ra;
}

static double mount_nearest_rate(const double *minimum, const double *maximum, int count, double rate) {
	double nearest = 0;
	double distance = -1;
	for (int i = 0; i < count; i++) {
		double candidate = fmax(minimum[i], fmin(maximum[i], rate));
		if (distance < 0 || fabs(candidate - rate) < distance) {
			nearest = candidate;
			distance = fabs(candidate - rate);
		}
	}
	return nearest;
}

// CanMoveAxis and AxisRates of one axis: the rates of the four items of MOUNT_SLEW_RATE are the allowed rates nearest to the usual ones.
static bool mount_probe_axis(indigo_device *device, int axis) {
	mount_data *data = MOUNT_DATA;
	alpaca_channel *channel = system_alpaca_channel(device);
	alpaca_param params[] = { ALPACA_INT_PARAM("Axis", axis) };
	const alpaca_json_value *value = NULL;
	double minimum[MOUNT_MAX_RATE_RANGES];
	double maximum[MOUNT_MAX_RATE_RANGES];
	double fastest = 0;
	int count = 0;
	bool can_move = false;
	data->can_move_axis[axis] = false;
	alpaca_result result = system_alpaca_check(device, alpaca_get_bool(channel, "canmoveaxis", params, 1, ALPACA_WAIT_STANDARD, &can_move));
	if (result != ALPACA_OK || !can_move) {
		return mount_usable(result);
	}
	result = system_alpaca_check(device, alpaca_get_value(channel, "axisrates", params, 1, ALPACA_WAIT_STANDARD, &value));
	if (result != ALPACA_OK) {
		return mount_usable(result);
	}
	// A range is one object with Minimum and Maximum. The NYX-101 (firmware 1.32.1) splits every range into two objects, the first with
	// only Maximum and the next with only Minimum ([{"Maximum":4.5},{"Minimum":0}]); such halves are paired in the order they come.
	double half_minimum = NAN;
	double half_maximum = NAN;
	for (const alpaca_json_value *range = value != NULL ? alpaca_json_first(value) : NULL; range != NULL && count < MOUNT_MAX_RATE_RANGES; range = alpaca_json_next(range)) {
		double low = NAN;
		double high = NAN;
		bool has_low = alpaca_json_get_double(alpaca_json_get(range, "Minimum"), &low);
		bool has_high = alpaca_json_get_double(alpaca_json_get(range, "Maximum"), &high);
		if (has_low != has_high) {
			if (has_low) {
				half_minimum = low;
			} else {
				half_maximum = high;
			}
			if (isnan(half_minimum) || isnan(half_maximum)) {
				continue;
			}
			low = half_minimum;
			high = half_maximum;
			half_minimum = half_maximum = NAN;
		} else if (!has_low) {
			continue;
		}
		if (high > 0 && high >= low) {
			minimum[count] = low;
			maximum[count] = high;
			fastest = fmax(fastest, high);
			count++;
		}
	}
	alpaca_end(channel);
	if (count > 0) {
		data->can_move_axis[axis] = true;
		data->slew_rates[axis][0] = mount_nearest_rate(minimum, maximum, count, MOUNT_GUIDE_SLEW_RATE);
		data->slew_rates[axis][1] = mount_nearest_rate(minimum, maximum, count, MOUNT_CENTERING_SLEW_RATE);
		data->slew_rates[axis][2] = mount_nearest_rate(minimum, maximum, count, MOUNT_FIND_SLEW_RATE);
		data->slew_rates[axis][3] = fastest;
		INDIGO_DRIVER_DEBUG(DRIVER_NAME, "'%s' axis %d rates %g, %g, %g, %g deg/s", device->name, axis, data->slew_rates[axis][0], data->slew_rates[axis][1], data->slew_rates[axis][2], data->slew_rates[axis][3]);
	}
	return true;
}

// TrackingRates in the order of the items of MOUNT_TRACK_RATE: sidereal, solar, lunar, king.
static bool mount_probe_tracking_rates(indigo_device *device) {
	static const int order[] = { 0, 2, 1, 3 };
	mount_data *data = MOUNT_DATA;
	int rates[16];
	int count = 0;
	data->track_rate_count = 0;
	alpaca_result result = system_alpaca_check(device, alpaca_get_int_array(system_alpaca_channel(device), "trackingrates", NULL, 0, ALPACA_WAIT_STANDARD, rates, 16, &count));
	for (int i = 0; result == ALPACA_OK && i < 4; i++) {
		for (int j = 0; j < count; j++) {
			if (rates[j] == order[i]) {
				data->track_rates[data->track_rate_count++] = order[i];
				break;
			}
		}
	}
	return mount_usable(result);
}

// Read the operational state of the telescope: from the DeviceState snapshot inside on_poll, with a request for every member otherwise.
// A value that can not be read keeps its last value. Returns false if the telescope gave no usable answer.
static bool mount_read_state(indigo_device *device) {
	mount_data *data = MOUNT_DATA;
	char utc[INDIGO_NAME_SIZE] = { 0 };
	double right_ascension = 0;
	double declination = 0;
	alpaca_result result = system_alpaca_state_double(device, "RightAscension", &right_ascension);
	if (result == ALPACA_OK) {
		result = system_alpaca_state_double(device, "Declination", &declination);
	}
	if (result == ALPACA_OK) {
		data->right_ascension = right_ascension;
		data->declination = declination;
	}
	data->coordinates = result;
	bool usable = mount_usable(result);
	usable = mount_usable(system_alpaca_state_double(device, "Altitude", &data->altitude)) && usable;
	usable = mount_usable(system_alpaca_state_double(device, "Azimuth", &data->azimuth)) && usable;
	usable = mount_usable(system_alpaca_state_double(device, "SiderealTime", &data->sidereal_time)) && usable;
	usable = mount_usable(system_alpaca_state_bool(device, "Slewing", &data->slewing)) && usable;
	usable = mount_usable(system_alpaca_state_bool(device, "AtPark", &data->at_park)) && usable;
	usable = mount_usable(system_alpaca_state_bool(device, "AtHome", &data->at_home)) && usable;
	usable = mount_usable(system_alpaca_state_bool(device, "Tracking", &data->tracking)) && usable;
	result = system_alpaca_state_int(device, "SideOfPier", &data->side_of_pier);
	if (result != ALPACA_OK) {
		data->side_of_pier = -1;
	}
	usable = mount_usable(result) && usable;
	result = system_alpaca_state_string(device, "UTCDate", utc, sizeof(utc));
	if (result == ALPACA_OK && strlen(utc) >= 19) {
		utc[19] = 0;
		strcpy(data->utc, utc);
	}
	return mount_usable(result) && usable;
}

static bool mount_read_tracking_rate(indigo_device *device) {
	return mount_usable(system_alpaca_state_int(device, "TrackingRate", &MOUNT_DATA->tracking_rate));
}

// MOUNT_GUIDE_RATE exists if the telescope reports both rates; once one of them is known to be missing the other one is not read any more.
static bool mount_has_guide_rates(indigo_device *device) {
	return system_alpaca_supported(device, "GuideRateRightAscension") && system_alpaca_supported(device, "GuideRateDeclination");
}

static bool mount_read_guide_rates(indigo_device *device) {
	if (!mount_has_guide_rates(device)) {
		return true;
	}
	bool usable = mount_usable(system_alpaca_state_double(device, "GuideRateRightAscension", &MOUNT_DATA->guide_rate_ra));
	if (!mount_has_guide_rates(device)) {
		return usable;
	}
	return mount_usable(system_alpaca_state_double(device, "GuideRateDeclination", &MOUNT_DATA->guide_rate_dec)) && usable;
}

// The site is the one of the telescope if it reports both coordinates; otherwise GEOGRAPHIC_COORDINATES stays a setting of INDIGO and the site is not read any more.
static bool mount_has_site(indigo_device *device) {
	return system_alpaca_supported(device, "SiteLatitude") && system_alpaca_supported(device, "SiteLongitude");
}

// What change_property (a bus thread) has to know about the site: the capability cache belongs to the handler queue.
static void mount_note_site(indigo_device *device) {
	system_alpaca_lock(device);
	MOUNT_DATA->site = mount_has_site(device);
	system_alpaca_unlock(device);
}

static bool mount_site_owned(indigo_device *device) {
	system_alpaca_lock(device);
	bool site = MOUNT_DATA->site;
	system_alpaca_unlock(device);
	return site;
}

static bool mount_read_site(indigo_device *device) {
	if (!mount_has_site(device)) {
		return true;
	}
	bool usable = mount_usable(system_alpaca_state_double(device, "SiteLatitude", &MOUNT_DATA->latitude));
	if (!mount_has_site(device)) {
		return usable;
	}
	usable = mount_usable(system_alpaca_state_double(device, "SiteLongitude", &MOUNT_DATA->longitude)) && usable;
	if (!mount_has_site(device)) {
		return usable;
	}
	return mount_usable(system_alpaca_state_double(device, "SiteElevation", &MOUNT_DATA->elevation)) && usable;
}

static bool mount_read_offset_rates(indigo_device *device) {
	bool usable = mount_usable(system_alpaca_state_double(device, "RightAscensionRate", &MOUNT_DATA->offset_rate_ra));
	return mount_usable(system_alpaca_state_double(device, "DeclinationRate", &MOUNT_DATA->offset_rate_dec)) && usable;
}

static bool mount_has_offset_rates(indigo_device *device) {
	return system_alpaca_can(device, "cansetrightascensionrate") || system_alpaca_can(device, "cansetdeclinationrate");
}

// Equatorial coordinates as J2000, horizontal coordinates and sidereal time from the last state; what the telescope does not report is computed.
static void mount_set_coordinates(indigo_device *device) {
	mount_data *data = MOUNT_DATA;
	time_t utc = indigo_get_mount_utc(device);
	if (data->coordinates == ALPACA_OK) {
		double ra = data->right_ascension;
		double dec = data->declination;
		indigo_eq_to_j2k(MOUNT_EPOCH_ITEM->number.value, &ra, &dec);
		MOUNT_EQUATORIAL_COORDINATES_RA_ITEM->number.value = mount_wrap_hours(ra);
		MOUNT_EQUATORIAL_COORDINATES_DEC_ITEM->number.value = dec;
	}
	if (system_alpaca_supported(device, "SiderealTime")) {
		MOUNT_LST_TIME_ITEM->number.value = data->sidereal_time;
	} else {
		MOUNT_LST_TIME_ITEM->number.value = indigo_lst(&utc, MOUNT_GEOGRAPHIC_COORDINATES_LONGITUDE_ITEM->number.value);
	}
	if (system_alpaca_supported(device, "Altitude") && system_alpaca_supported(device, "Azimuth")) {
		MOUNT_HORIZONTAL_COORDINATES_ALT_ITEM->number.value = data->altitude;
		MOUNT_HORIZONTAL_COORDINATES_AZ_ITEM->number.value = data->azimuth;
	} else {
		double ra = MOUNT_EQUATORIAL_COORDINATES_RA_ITEM->number.value;
		double dec = MOUNT_EQUATORIAL_COORDINATES_DEC_ITEM->number.value;
		indigo_j2k_to_jnow(&ra, &dec);
		indigo_radec_to_altaz(ra, dec, &utc, MOUNT_GEOGRAPHIC_COORDINATES_LATITUDE_ITEM->number.value, MOUNT_GEOGRAPHIC_COORDINATES_LONGITUDE_ITEM->number.value, MOUNT_GEOGRAPHIC_COORDINATES_ELEVATION_ITEM->number.value, &MOUNT_HORIZONTAL_COORDINATES_ALT_ITEM->number.value, &MOUNT_HORIZONTAL_COORDINATES_AZ_ITEM->number.value);
	}
}

static void mount_update_coordinates(indigo_device *device) {
	system_alpaca_lock(device);
	MOUNT_HORIZONTAL_COORDINATES_PROPERTY->state = MOUNT_EQUATORIAL_COORDINATES_PROPERTY->state;
	system_alpaca_unlock(device);
	indigo_update_property(device, MOUNT_HORIZONTAL_COORDINATES_PROPERTY, NULL);
	indigo_update_property(device, MOUNT_LST_TIME_PROPERTY, NULL);
	indigo_update_property(device, MOUNT_EQUATORIAL_COORDINATES_PROPERTY, NULL);
}

// The switches are set item by item: indigo_set_switch() marks a one-of-many property as changed whenever it is called,
// which would publish MOUNT_PARK and MOUNT_TRACKING on every poll tick although nothing changed.
// Under the lock of the device (it is recursive): mount_coordinates_refusal() reads the items on a bus thread.
static void mount_set_park(indigo_device *device) {
	system_alpaca_lock(device);
	MOUNT_PARK_PARKED_ITEM->sw.value = MOUNT_DATA->at_park;
	MOUNT_PARK_UNPARKED_ITEM->sw.value = !MOUNT_DATA->at_park;
	MOUNT_DATA->parked = MOUNT_DATA->at_park && !MOUNT_PARK_PROPERTY->hidden;
	system_alpaca_unlock(device);
}

static void mount_set_tracking(indigo_device *device) {
	MOUNT_TRACKING_ON_ITEM->sw.value = MOUNT_DATA->tracking;
	MOUNT_TRACKING_OFF_ITEM->sw.value = !MOUNT_DATA->tracking;
}

static void mount_set_side_of_pier(indigo_device *device) {
	MOUNT_SIDE_OF_PIER_EAST_ITEM->sw.value = MOUNT_DATA->side_of_pier == 0;
	MOUNT_SIDE_OF_PIER_WEST_ITEM->sw.value = MOUNT_DATA->side_of_pier == 1;
}

// A text property is published by every update, changed or not, so UTC_TIME is updated by the polling only when the time changed.
static void mount_set_utc(indigo_device *device) {
	if (*MOUNT_DATA->utc && strcmp(MOUNT_UTC_ITEM->text.value, MOUNT_DATA->utc)) {
		indigo_set_text_item_value(MOUNT_UTC_ITEM, MOUNT_DATA->utc);
		MOUNT_DATA->utc_changed = true;
	}
}

static void mount_set_tracking_rate(indigo_device *device) {
	mount_data *data = MOUNT_DATA;
	for (int i = 0; i < data->track_rate_count; i++) {
		MOUNT_TRACK_RATE_PROPERTY->items[i].sw.value = data->track_rates[i] == data->tracking_rate;
	}
}

static void mount_set_guide_rates(indigo_device *device) {
	MOUNT_GUIDE_RATE_RA_ITEM->number.value = MOUNT_DATA->guide_rate_ra / MOUNT_SIDEREAL_RATE * 100;
	MOUNT_GUIDE_RATE_DEC_ITEM->number.value = MOUNT_DATA->guide_rate_dec / MOUNT_SIDEREAL_RATE * 100;
}

static void mount_set_site(indigo_device *device) {
	mount_data *data = MOUNT_DATA;
	MOUNT_GEOGRAPHIC_COORDINATES_LATITUDE_ITEM->number.value = data->latitude;
	MOUNT_GEOGRAPHIC_COORDINATES_LONGITUDE_ITEM->number.value = data->longitude < 0 ? data->longitude + 360 : data->longitude;
	if (system_alpaca_supported(device, "SiteElevation")) {
		MOUNT_GEOGRAPHIC_COORDINATES_ELEVATION_ITEM->number.value = data->elevation;
	}
}

static void mount_set_offset_rates(indigo_device *device) {
	X_ALPACA_OFFSET_RATE_RA_ITEM->number.value = MOUNT_DATA->offset_rate_ra;
	X_ALPACA_OFFSET_RATE_DEC_ITEM->number.value = MOUNT_DATA->offset_rate_dec;
}

// Copy the last state to the properties. A property that is BUSY belongs to its handler or finalizer: its items and its state are left alone,
// except for the values of the coordinates, which follow the telescope during a slew. It is done in one step under the lock of the
// device, so a request that is accepted meanwhile either finds its property untouched or is seen as BUSY here.
static void mount_apply_state(indigo_device *device) {
	mount_data *data = MOUNT_DATA;
	if (data->was_slewing && !data->slewing) {
		data->motion_ended = indigo_monotonic_time();
	}
	data->was_slewing = data->slewing;
	system_alpaca_lock(device);
	mount_set_coordinates(device);
	if (!data->motion.active) {
		if (data->slewing && !data->axis_moving[0] && !data->axis_moving[1] && MOUNT_EQUATORIAL_COORDINATES_PROPERTY->state != INDIGO_BUSY_STATE) {
			MOUNT_EQUATORIAL_COORDINATES_PROPERTY->state = INDIGO_BUSY_STATE;
			data->external_slew = true;
		} else if (!data->slewing && data->external_slew) {
			MOUNT_EQUATORIAL_COORDINATES_PROPERTY->state = INDIGO_OK_STATE;
			data->external_slew = false;
		}
	}
	if (MOUNT_EQUATORIAL_COORDINATES_PROPERTY->state != INDIGO_BUSY_STATE) {
		if (data->coordinates != ALPACA_OK) {
			MOUNT_EQUATORIAL_COORDINATES_PROPERTY->state = INDIGO_ALERT_STATE;
			data->coordinates_failed = true;
		} else if (data->coordinates_failed) {
			MOUNT_EQUATORIAL_COORDINATES_PROPERTY->state = INDIGO_OK_STATE;
			data->coordinates_failed = false;
		}
	}
	if (MOUNT_PARK_PROPERTY->state != INDIGO_BUSY_STATE) {
		mount_set_park(device);
		// a park or an unpark that was reported as failed, and the telescope got there after all
		if (MOUNT_PARK_PROPERTY->state == INDIGO_ALERT_STATE && data->park_alert >= 0 && data->at_park == (data->park_alert == 1) && !data->slewing) {
			MOUNT_PARK_PROPERTY->state = INDIGO_OK_STATE;
			data->park_recovered = true;
			data->park_alert = -1;
		}
	}
	if (MOUNT_HOME_PROPERTY->state == INDIGO_ALERT_STATE && data->home_alert && data->at_home && !data->slewing) {
		MOUNT_HOME_PROPERTY->state = INDIGO_OK_STATE;
		data->home_recovered = true;
		data->home_alert = false;
	}
	if (MOUNT_TRACKING_PROPERTY->state != INDIGO_BUSY_STATE) {
		mount_set_tracking(device);
	}
	if (MOUNT_SIDE_OF_PIER_PROPERTY->state != INDIGO_BUSY_STATE) {
		mount_set_side_of_pier(device);
	}
	if (MOUNT_UTC_TIME_PROPERTY->state != INDIGO_BUSY_STATE) {
		mount_set_utc(device);
	}
	MOUNT_STATE_SLEW_ITEM->light.value = data->slewing ? INDIGO_BUSY_STATE : INDIGO_IDLE_STATE;
	MOUNT_STATE_PARK_ITEM->light.value = data->at_park ? INDIGO_OK_STATE : data->park_requested ? INDIGO_BUSY_STATE : INDIGO_IDLE_STATE;
	MOUNT_STATE_HOME_ITEM->light.value = data->at_home ? INDIGO_OK_STATE : data->home_requested ? INDIGO_BUSY_STATE : INDIGO_IDLE_STATE;
	MOUNT_STATE_TRACKING_ITEM->light.value = data->tracking ? INDIGO_OK_STATE : INDIGO_IDLE_STATE;
	system_alpaca_unlock(device);
}

static void mount_update_state(indigo_device *device) {
	mount_data *data = MOUNT_DATA;
	mount_update_coordinates(device);
	if (data->park_recovered) {
		data->park_recovered = false;
		indigo_update_property(device, MOUNT_PARK_PROPERTY, data->at_park ? "The telescope reached the park position" : "The telescope is unparked");
	} else {
		indigo_update_property(device, MOUNT_PARK_PROPERTY, NULL);
	}
	if (data->home_recovered) {
		data->home_recovered = false;
		indigo_update_property(device, MOUNT_HOME_PROPERTY, "The telescope reached the home position");
	}
	indigo_update_property(device, MOUNT_TRACKING_PROPERTY, NULL);
	indigo_update_property(device, MOUNT_SIDE_OF_PIER_PROPERTY, NULL);
	if (MOUNT_DATA->utc_changed) {
		MOUNT_DATA->utc_changed = false;
		indigo_update_property(device, MOUNT_UTC_TIME_PROPERTY, NULL);
	}
	indigo_update_property(device, MOUNT_STATE_PROPERTY, NULL);
}

static bool mount_read_settings(indigo_device *device) {
	bool usable = mount_read_tracking_rate(device);
	usable = mount_read_guide_rates(device) && usable;
	usable = mount_read_site(device) && usable;
	return mount_read_offset_rates(device) && usable;
}

static void mount_apply_settings(indigo_device *device) {
	system_alpaca_lock(device);
	MOUNT_DATA->site = mount_has_site(device);
	if (MOUNT_TRACK_RATE_PROPERTY->state != INDIGO_BUSY_STATE) {
		mount_set_tracking_rate(device);
	}
	if (MOUNT_GUIDE_RATE_PROPERTY->state != INDIGO_BUSY_STATE) {
		mount_set_guide_rates(device);
	}
	if (MOUNT_GEOGRAPHIC_COORDINATES_PROPERTY->state != INDIGO_BUSY_STATE && mount_has_site(device)) {
		mount_set_site(device);
	}
	if (X_ALPACA_OFFSET_RATE_PROPERTY->state != INDIGO_BUSY_STATE) {
		mount_set_offset_rates(device);
	}
	system_alpaca_unlock(device);
}

static void mount_update_settings(indigo_device *device) {
	indigo_update_property(device, MOUNT_TRACK_RATE_PROPERTY, NULL);
	indigo_update_property(device, MOUNT_GUIDE_RATE_PROPERTY, NULL);
	indigo_update_property(device, MOUNT_GEOGRAPHIC_COORDINATES_PROPERTY, NULL);
	indigo_update_property(device, X_ALPACA_OFFSET_RATE_PROPERTY, NULL);
}

// The telescope answered InvalidWhileParked although the driver did not know that it is parked: another client parked it.
static void mount_check_parked(indigo_device *device, alpaca_result result) {
	if (result == ALPACA_PARKED && !MOUNT_DATA->at_park) {
		MOUNT_DATA->at_park = true;
		system_alpaca_lock(device);
		bool idle = MOUNT_PARK_PROPERTY->state != INDIGO_BUSY_STATE;
		if (idle) {
			mount_set_park(device);
		}
		system_alpaca_unlock(device);
		if (idle) {
			indigo_update_property(device, MOUNT_PARK_PROPERTY, NULL);
		}
	}
}

// Finish a request whose result has two parts: the result of the requests and whether the telescope ended in the requested state.
static void mount_finish(indigo_device *device, indigo_property *property, alpaca_result result, bool achieved, const char *action, const char *missed) {
	if (result == ALPACA_OK && !achieved) {
		system_alpaca_update(device, property, INDIGO_ALERT_STATE, "%s failed: %s", action, missed);
	} else {
		system_alpaca_finish(device, property, result, action);
	}
}

static void mount_finish_coordinates(indigo_device *device, alpaca_result result, const char *action) {
	system_alpaca_finish(device, MOUNT_EQUATORIAL_COORDINATES_PROPERTY, result, action);
	system_alpaca_lock(device);
	MOUNT_HORIZONTAL_COORDINATES_PROPERTY->state = MOUNT_EQUATORIAL_COORDINATES_PROPERTY->state;
	system_alpaca_unlock(device);
	indigo_update_property(device, MOUNT_HORIZONTAL_COORDINATES_PROPERTY, NULL);
	indigo_update_property(device, MOUNT_LST_TIME_PROPERTY, NULL);
}

// A method that starts a motion got no answer, which does not tell whether the telescope executed it: Slewing tells.
// A failure with an answer (an error of the server, a reply that is no reply) is reported as it is, with the reason the server gave;
// should the telescope slew all the same, the polling shows it as a slew that was started elsewhere.
static alpaca_result mount_started(indigo_device *device, alpaca_result result) {
	bool slewing = false;
	if (alpaca_is_transport_error(result) && result != ALPACA_UNREACHABLE && system_alpaca_get_bool(device, "slewing", &slewing) == ALPACA_OK && slewing) {
		return ALPACA_OK;
	}
	return result;
}

static alpaca_result mount_put_tracking(indigo_device *device, bool tracking) {
	alpaca_param params[] = { ALPACA_BOOL_PARAM("Tracking", tracking) };
	alpaca_result result = system_alpaca_put(device, "tracking", params, 1, ALPACA_REPLAYABLE);
	if (result == ALPACA_OK) {
		MOUNT_DATA->tracking = tracking;
	}
	return result;
}

static alpaca_result mount_put_utc(indigo_device *device, time_t utc) {
	char text[INDIGO_NAME_SIZE] = { 0 };
	indigo_timetoisogm(utc, text, sizeof(text) - 2);
	strcat(text, "Z");
	alpaca_param params[] = { ALPACA_STRING_PARAM("UTCDate", text) };
	alpaca_result result = system_alpaca_put(device, "utcdate", params, 1, ALPACA_REPLAYABLE);
	if (result == ALPACA_OK) {
		text[19] = 0;
		strcpy(MOUNT_DATA->utc, text);
	}
	return result;
}

static alpaca_result mount_put_axis_rate(indigo_device *device, int axis, double rate) {
	alpaca_param params[] = { ALPACA_INT_PARAM("Axis", axis), ALPACA_DOUBLE_PARAM("Rate", rate) };
	alpaca_result result = system_alpaca_put(device, "moveaxis", params, 2, ALPACA_REPLAYABLE);
	if (result == ALPACA_OK) {
		MOUNT_DATA->axis_moving[axis] = rate != 0;
	}
	return result;
}

#pragma mark - High level code (mount)

static void mount_motion_finalizer(indigo_device *device);
static void mount_equatorial_coordinates_handler(indigo_device *device);
static void mount_park_handler(indigo_device *device);
static void mount_home_handler(indigo_device *device);
static void mount_side_of_pier_handler(indigo_device *device);
static void mount_motion_ra_handler(indigo_device *device);
static void mount_motion_dec_handler(indigo_device *device);

// HW-4: some telescopes accept a slew, a park, a search for home or a MoveAxis that arrives too soon after the end of a slew, answer
// success and do nothing (the NYX-101, firmware 1.32.1, measured on 2026-10-03: ignored 0 and 1 s after the end, executed 2 s after it).
// A handler is therefore run again once X_ALPACA_SETTLE_TIME has passed since the end of the last motion; the property stays BUSY
// meanwhile and MOUNT_ABORT_MOTION cancels the waiting handler. True when the handler was postponed.
static bool mount_postponed(indigo_device *device, indigo_timer_callback handler) {
	mount_data *data = MOUNT_DATA;
	system_alpaca_lock(device);
	double settle = X_ALPACA_SETTLE_TIME_ITEM->number.value;
	system_alpaca_unlock(device);
	if (settle <= 0 || data->motion_ended == 0) {
		return false;
	}
	double remaining = data->motion_ended + settle - indigo_monotonic_time();
	if (remaining <= 0) {
		return false;
	}
	INDIGO_DRIVER_DEBUG(DRIVER_NAME, "'%s' the last motion ended %.2f s ago, the request waits %.2f s", device->name, settle - remaining, remaining);
	indigo_execute_handler_in(device, remaining, handler);
	return true;
}

// The telescope accepted a method that makes it move: watch it. The coordinates are BUSY during a slew only (slew is true), see MOTION.
static void mount_motion_start(indigo_device *device, const char *action, bool slew) {
	mount_data *data = MOUNT_DATA;
	indigo_cancel_pending_handler(device, mount_motion_finalizer);
	// HW-2: the coordinates may be BUSY for a slew of the telescope this driver did not request (mount_apply_state()); a slew takes the BUSY
	// state over, any other motion ends it, because only the polling that is now suspended for the motion would have ended it
	bool external = data->external_slew;
	data->action = action;
	data->external_slew = data->aborted = false;
	if (external && !slew) {
		system_alpaca_lock(device);
		bool busy = MOUNT_EQUATORIAL_COORDINATES_PROPERTY->state == INDIGO_BUSY_STATE;
		if (busy) {
			MOUNT_EQUATORIAL_COORDINATES_PROPERTY->state = INDIGO_OK_STATE;
		}
		system_alpaca_unlock(device);
		if (busy) {
			mount_update_coordinates(device);
		}
	}
	data->stall_since = 0;
	data->slew_requested = data->slew_requested || slew;
	system_alpaca_operation_start(device, &data->motion, MOUNT_MOTION_TIMEOUT, mount_motion_finalizer);
	if (slew) {
		system_alpaca_lock(device);
		bool idle = MOUNT_EQUATORIAL_COORDINATES_PROPERTY->state != INDIGO_BUSY_STATE;
		MOUNT_EQUATORIAL_COORDINATES_PROPERTY->state = INDIGO_BUSY_STATE;
		system_alpaca_unlock(device);
		if (idle) {
			mount_update_coordinates(device);
		}
	}
}

// A park, an unpark or a search for home that is not at its goal: true once the telescope neither slewed nor moved for MOUNT_STALL_TIME.
// The position is the one of the last poll tick (the polling runs at the active rhythm meanwhile), from Altitude and Azimuth of the
// telescope or computed from its equatorial coordinates.
static bool mount_stalled(indigo_device *device, bool slewing) {
	mount_data *data = MOUNT_DATA;
	double now = indigo_monotonic_time();
	double altitude = MOUNT_HORIZONTAL_COORDINATES_ALT_ITEM->number.value;
	double azimuth = MOUNT_HORIZONTAL_COORDINATES_AZ_ITEM->number.value;
	double azimuth_change = fmod(fabs(azimuth - data->stall_azimuth), 360);
	if (azimuth_change > 180) {
		azimuth_change = 360 - azimuth_change;
	}
	bool progress = fabs(altitude - data->stall_altitude) > MOUNT_PROGRESS || azimuth_change * cos(altitude * M_PI / 180) > MOUNT_PROGRESS;
	if (slewing || progress || data->stall_since == 0) {
		data->stall_since = now;
		data->stall_altitude = altitude;
		data->stall_azimuth = azimuth;
		return false;
	}
	return now - data->stall_since >= MOUNT_STALL_TIME;
}

// The telescope stopped after AbortSlew: every property that waited for the end of a motion ends in ALERT with what the telescope reports now.
static void mount_settle_aborted(indigo_device *device) {
	system_alpaca_lock(device);
	bool home = MOUNT_HOME_PROPERTY->state == INDIGO_BUSY_STATE;
	if (MOUNT_PARK_PROPERTY->state == INDIGO_BUSY_STATE) {
		MOUNT_PARK_PROPERTY->state = INDIGO_ALERT_STATE;
	}
	if (home) {
		MOUNT_HOME_ITEM->sw.value = false;
		MOUNT_HOME_PROPERTY->state = INDIGO_ALERT_STATE;
	}
	if (MOUNT_SIDE_OF_PIER_PROPERTY->state == INDIGO_BUSY_STATE) {
		MOUNT_SIDE_OF_PIER_PROPERTY->state = INDIGO_ALERT_STATE;
	}
	if (MOUNT_EQUATORIAL_COORDINATES_PROPERTY->state == INDIGO_BUSY_STATE) {
		MOUNT_EQUATORIAL_COORDINATES_PROPERTY->state = INDIGO_ALERT_STATE;
	}
	system_alpaca_unlock(device);
	if (home) {
		indigo_update_property(device, MOUNT_HOME_PROPERTY, NULL);
	}
	mount_apply_state(device);
	mount_update_state(device);
}

// The motion is over, with the given result of watching it: read where the telescope is and settle every property that waited for it.
static void mount_motion_done(indigo_device *device, alpaca_result result) {
	mount_data *data = MOUNT_DATA;
	data->motion_ended = indigo_monotonic_time();
	if (data->aborted) {
		data->aborted = false;
		mount_read_state(device);
		mount_settle_aborted(device);
		return;
	}
	if (result == ALPACA_OK && data->stop_tracking) {
		result = mount_put_tracking(device, false);
	}
	if (result == ALPACA_OK) {
		mount_read_state(device);
		result = data->coordinates;
	}
	if (data->park_requested || data->unpark_requested) {
		bool achieved = data->at_park == data->park_requested;
		mount_set_park(device);
		mount_finish(device, MOUNT_PARK_PROPERTY, result, achieved, data->park_requested ? "Park" : "Unpark", data->park_requested ? "the telescope stopped and does not report AtPark" : "the telescope still reports AtPark");
		// a late arrival at the goal ends MOUNT_PARK in OK, see mount_apply_state()
		data->park_alert = result == ALPACA_OK && achieved ? -1 : data->park_requested ? 1 : 0;
	}
	if (data->home_requested) {
		mount_finish(device, MOUNT_HOME_PROPERTY, result, data->at_home, "Find home", "the telescope stopped and does not report AtHome");
		data->home_alert = result != ALPACA_OK || !data->at_home;
	}
	if (data->flip_requested) {
		mount_set_side_of_pier(device);
		system_alpaca_finish(device, MOUNT_SIDE_OF_PIER_PROPERTY, result, "Pier flip");
	}
	bool slew = data->slew_requested;
	data->park_requested = data->unpark_requested = data->home_requested = data->flip_requested = data->stop_tracking = data->slew_requested = false;
	mount_apply_state(device);
	if (slew) {
		mount_finish_coordinates(device, result, "Slew");
	}
	mount_update_state(device);
	if (data->goto_waits) {
		// the goto that was requested behind the unpark: its handler finds the telescope unparked, or refuses the goto
		data->goto_waits = false;
		indigo_execute_handler(device, mount_equatorial_coordinates_handler);
	}
}

// A slew and a pier flip end when Slewing is false. A park and a search for home end when AtPark / AtHome is true and an unpark when AtPark and
// Slewing are false (the completion members of the standard); without them they end when the telescope stalls, see MOTION.
static void mount_motion_finalizer(indigo_device *device) {
	mount_data *data = MOUNT_DATA;
	bool slewing = false;
	if (!system_alpaca_is_active(device)) {
		return;
	}
	alpaca_result result = system_alpaca_state_bool(device, "Slewing", &slewing);
	bool waiting = result == ALPACA_OK && slewing;
	if (result == ALPACA_OK && !data->aborted && (data->park_requested || data->unpark_requested || data->home_requested)) {
		bool at_goal = false;
		result = system_alpaca_state_bool(device, data->park_requested || data->unpark_requested ? "AtPark" : "AtHome", &at_goal);
		if (result == ALPACA_OK) {
			bool reached = data->unpark_requested && !data->park_requested ? !at_goal && !slewing : at_goal;
			waiting = !reached && !mount_stalled(device, slewing);
		}
	}
	if (waiting && system_alpaca_operation_continue(device, &data->motion, mount_motion_finalizer)) {
		return;
	}
	system_alpaca_operation_end(device, &data->motion);
	mount_motion_done(device, waiting ? ALPACA_TIMED_OUT : result);
}

static void mount_equatorial_coordinates_handler(indigo_device *device) {
	mount_data *data = MOUNT_DATA;
	if (!system_alpaca_is_active(device)) {
		return;
	}
	if (data->motion.active && data->unpark_requested) {
		// accepted behind an unpark: mount_motion_done() runs this handler again when the unpark is over; the coordinates stay BUSY meanwhile
		data->goto_waits = true;
		return;
	}
	if (mount_is_parked(device)) {
		indigo_send_message(device, MOUNT_EQUATORIAL_COORDINATES_PROPERTY, "Mount is parked!");
		system_alpaca_update(device, MOUNT_EQUATORIAL_COORDINATES_PROPERTY, INDIGO_ALERT_STATE, NULL);
		return;
	}
	if (!indigo_get_switch(MOUNT_ON_COORDINATES_SET_PROPERTY, MOUNT_ON_COORDINATES_SET_SYNC_ITEM_NAME) && mount_postponed(device, mount_equatorial_coordinates_handler)) {
		return;
	}
	double ra = MOUNT_EQUATORIAL_COORDINATES_RA_ITEM->number.target;
	double dec = MOUNT_EQUATORIAL_COORDINATES_DEC_ITEM->number.target;
	indigo_j2k_to_eq(MOUNT_EPOCH_ITEM->number.value, &ra, &dec);
	alpaca_param params[] = { ALPACA_DOUBLE_PARAM("RightAscension", mount_wrap_hours(ra)), ALPACA_DOUBLE_PARAM("Declination", dec) };
	if (indigo_get_switch(MOUNT_ON_COORDINATES_SET_PROPERTY, MOUNT_ON_COORDINATES_SET_SYNC_ITEM_NAME)) {
		alpaca_result result = system_alpaca_put(device, "synctocoordinates", params, 2, ALPACA_WAIT_STANDARD);
		mount_check_parked(device, result);
		if (result == ALPACA_OK) {
			// no request between a failed one and its message: the message quotes the last answer of the telescope
			mount_read_state(device);
			mount_set_coordinates(device);
		}
		mount_finish_coordinates(device, result, "Sync");
	} else {
		alpaca_result result = ALPACA_OK;
		if (!data->tracking && system_alpaca_can(device, "cansettracking")) {
			result = mount_put_tracking(device, true);
		}
		if (result == ALPACA_OK) {
			result = mount_started(device, system_alpaca_put(device, "slewtocoordinatesasync", params, 2, ALPACA_WAIT_LONG | ALPACA_REPLAYABLE));
		}
		if (result == ALPACA_OK) {
			data->stop_tracking = indigo_get_switch(MOUNT_ON_COORDINATES_SET_PROPERTY, MOUNT_ON_COORDINATES_SET_SLEW_ITEM_NAME);
			mount_motion_start(device, "Slew", true);
		} else {
			mount_check_parked(device, result);
			mount_finish_coordinates(device, result, "Slew");
		}
	}
}

static void mount_park_handler(indigo_device *device) {
	mount_data *data = MOUNT_DATA;
	if (!system_alpaca_is_active(device)) {
		return;
	}
	bool park = indigo_get_switch_target(MOUNT_PARK_PROPERTY, MOUNT_PARK_PARKED_ITEM_NAME);
	if (park && mount_postponed(device, mount_park_handler)) {
		return;
	}
	if (!system_alpaca_can(device, park ? "canpark" : "canunpark")) {
		// MOUNT_PARK exists if the telescope can do one of the two; nothing is sent for the other one
		mount_set_park(device);
		system_alpaca_update(device, MOUNT_PARK_PROPERTY, INDIGO_ALERT_STATE, "The telescope can not be %s", park ? "parked" : "unparked");
		return;
	}
	alpaca_result result = mount_started(device, system_alpaca_put(device, park ? "park" : "unpark", NULL, 0, ALPACA_WAIT_LONG | ALPACA_REPLAYABLE));
	data->park_alert = -1;
	if (result == ALPACA_OK) {
		data->park_requested = park;
		data->unpark_requested = !park;
		data->stop_tracking = false;
		if (park) {
			// from here on the telescope moves to its park position; what would move it elsewhere is refused until MOUNT_PARK is settled
			mount_set_parked(device, true);
		}
		mount_motion_start(device, park ? "Park" : "Unpark", false);
	} else {
		mount_set_park(device);
		system_alpaca_finish(device, MOUNT_PARK_PROPERTY, result, park ? "Park" : "Unpark");
	}
}

static void mount_park_set_handler(indigo_device *device) {
	alpaca_result result = ALPACA_OK;
	if (!system_alpaca_is_active(device)) {
		return;
	}
	if (indigo_get_switch_target(MOUNT_PARK_SET_PROPERTY, MOUNT_PARK_SET_CURRENT_ITEM_NAME)) {
		result = system_alpaca_put(device, "setpark", NULL, 0, ALPACA_REPLAYABLE);
	}
	MOUNT_PARK_SET_CURRENT_ITEM->sw.value = false;
	system_alpaca_finish(device, MOUNT_PARK_SET_PROPERTY, result, "Set park");
}

static void mount_home_handler(indigo_device *device) {
	mount_data *data = MOUNT_DATA;
	if (!system_alpaca_is_active(device)) {
		return;
	}
	bool home = indigo_get_switch_target(MOUNT_HOME_PROPERTY, MOUNT_HOME_ITEM_NAME);
	if (home && mount_postponed(device, mount_home_handler)) {
		return;
	}
	MOUNT_HOME_ITEM->sw.value = false;
	if (home) {
		alpaca_result result = mount_started(device, system_alpaca_put(device, "findhome", NULL, 0, ALPACA_WAIT_LONG | ALPACA_REPLAYABLE));
		data->home_alert = false;
		if (result == ALPACA_OK) {
			data->home_requested = true;
			data->stop_tracking = false;
			indigo_update_property(device, MOUNT_HOME_PROPERTY, NULL);
			mount_motion_start(device, "Find home", false);
		} else {
			mount_check_parked(device, result);
			system_alpaca_finish(device, MOUNT_HOME_PROPERTY, result, "Find home");
		}
	} else {
		system_alpaca_update(device, MOUNT_HOME_PROPERTY, INDIGO_OK_STATE, NULL);
	}
}

static void mount_side_of_pier_handler(indigo_device *device) {
	mount_data *data = MOUNT_DATA;
	if (!system_alpaca_is_active(device)) {
		return;
	}
	if (mount_postponed(device, mount_side_of_pier_handler)) {
		return;
	}
	alpaca_param params[] = { ALPACA_INT_PARAM("SideOfPier", indigo_get_switch_target(MOUNT_SIDE_OF_PIER_PROPERTY, MOUNT_SIDE_OF_PIER_WEST_ITEM_NAME) ? 1 : 0) };
	alpaca_result result = mount_started(device, system_alpaca_put(device, "sideofpier", params, 1, ALPACA_WAIT_LONG | ALPACA_REPLAYABLE));
	if (result == ALPACA_OK) {
		data->flip_requested = true;
		data->stop_tracking = false;
		mount_motion_start(device, "Pier flip", false);
	} else {
		mount_check_parked(device, result);
		mount_set_side_of_pier(device);
		system_alpaca_finish(device, MOUNT_SIDE_OF_PIER_PROPERTY, result, "Pier flip");
	}
}

// End a request for MOUNT_MOTION_DEC or MOUNT_MOTION_RA with the given state; after a failure no motion is on. The properties are
// accepted while they are BUSY, so a bus thread may be writing them: the items and the state are set under the lock of the device.
static void mount_end_motion(indigo_device *device, indigo_property *property, indigo_property_state state) {
	system_alpaca_lock(device);
	if (state != INDIGO_OK_STATE) {
		property->items[0].sw.value = property->items[1].sw.value = false;
	}
	property->state = state;
	system_alpaca_unlock(device);
}

// Side of the pier that decides the sense of the secondary axis, see MANUAL MOTION: read when a motion starts, so that a flip made by
// another client since the last poll tick counts; the value of the last poll tick if it can not be read now. 1 is pierWest; 0, -1
// (pierUnknown) and a telescope that does not implement SideOfPier leave the sense as it is.
static int mount_motion_side_of_pier(indigo_device *device) {
	int side = -1;
	alpaca_result result = system_alpaca_state_int(device, "SideOfPier", &side);
	if (result == ALPACA_UNSUPPORTED) {
		return -1;
	}
	return result == ALPACA_OK ? side : MOUNT_DATA->side_of_pier;
}

// MOUNT_MOTION_DEC and MOUNT_MOTION_RA: MoveAxis with the rate of the selected item of MOUNT_SLEW_RATE, a rate of zero when both items are off.
// The sign of a secondary rate is inverted on pierWest, so that NORTH always moves toward the north celestial pole.
static void mount_move_axis(indigo_device *device, int axis, indigo_property *property, const char *positive, const char *negative) {
	mount_data *data = MOUNT_DATA;
	double rate = 0;
	if (mount_is_parked(device)) {
		indigo_send_message(device, property, "Mount is parked!");
		mount_end_motion(device, property, INDIGO_ALERT_STATE);
		indigo_update_property(device, property, NULL);
		indigo_mount_commit_motion_client(device, property);
		return;
	}
	for (int i = 0; i < 4; i++) {
		if (MOUNT_SLEW_RATE_PROPERTY->items[i].sw.value) {
			rate = data->slew_rates[axis][i];
		}
	}
	if (indigo_get_switch_target(property, negative)) {
		rate = -rate;
	} else if (!indigo_get_switch_target(property, positive)) {
		rate = 0;
	}
	if (rate != 0 && mount_postponed(device, axis == 0 ? mount_motion_ra_handler : mount_motion_dec_handler)) {
		return;
	}
	system_alpaca_lock(device);
	bool sky = X_ALPACA_MOUNT_AXES_SKY_ITEM->sw.value;
	system_alpaca_unlock(device);
	if (sky) {
		rate = -rate;
	} else if (axis == 1 && rate != 0 && mount_motion_side_of_pier(device) == 1) {
		rate = -rate;
	}
	char reason[INDIGO_VALUE_SIZE];
	alpaca_result result = mount_put_axis_rate(device, axis, rate);
	system_alpaca_reason(device, result, reason, sizeof(reason));
	if (result != ALPACA_OK) {
		mount_check_parked(device, result);
	}
	mount_end_motion(device, property, system_alpaca_property_state(result));
	system_alpaca_report(device, property, result, rate != 0 ? "Move" : "Stop", reason);
	indigo_mount_commit_motion_client(device, property);
}

static void mount_motion_dec_handler(indigo_device *device) {
	if (!system_alpaca_is_active(device)) {
		return;
	}
	mount_move_axis(device, 1, MOUNT_MOTION_DEC_PROPERTY, MOUNT_MOTION_NORTH_ITEM_NAME, MOUNT_MOTION_SOUTH_ITEM_NAME);
}

static void mount_motion_ra_handler(indigo_device *device) {
	if (!system_alpaca_is_active(device)) {
		return;
	}
	mount_move_axis(device, 0, MOUNT_MOTION_RA_PROPERTY, MOUNT_MOTION_WEST_ITEM_NAME, MOUNT_MOTION_EAST_ITEM_NAME);
}

// AbortSlew stops a slew, a park, a search for home and MoveAxis. Requests that did not start yet are dropped, and every property that
// waited for the end of a motion ends in ALERT with what the telescope reports after the stop.
// MoveAxis(0) is sent for every axis that moves and AbortSlew always, so the failure to stop one axis neither keeps the other one moving
// nor keeps a slew from being aborted. AbortSlew stops MoveAxis as well (ITelescopeV3), so once it succeeded nothing moves any more.
// A telescope that does not implement AbortSlew has nothing to abort but the motion of its axes, unless this driver watches a slew.
static void mount_abort_motion_handler(indigo_device *device) {
	mount_data *data = MOUNT_DATA;
	alpaca_result result = ALPACA_OK, stop = ALPACA_OK;
	char reason[INDIGO_VALUE_SIZE] = { 0 };
	char stop_reason[INDIGO_VALUE_SIZE] = { 0 };
	if (!system_alpaca_is_active(device)) {
		return;
	}
	if (indigo_get_switch_target(MOUNT_ABORT_MOTION_PROPERTY, MOUNT_ABORT_MOTION_ITEM_NAME)) {
		for (int axis = 0; axis < 2; axis++) {
			if (data->axis_moving[axis]) {
				alpaca_result axis_result = mount_put_axis_rate(device, axis, 0);
				if (axis_result != ALPACA_OK && stop == ALPACA_OK) {
					stop = axis_result;
					system_alpaca_reason(device, stop, stop_reason, sizeof(stop_reason));
				}
			}
		}
		alpaca_result abort = system_alpaca_put(device, "abortslew", NULL, 0, ALPACA_REPLAYABLE);
		system_alpaca_reason(device, abort, reason, sizeof(reason));
		bool aborted = abort == ALPACA_OK;
		bool nothing_to_abort = system_alpaca_not_implemented(abort, 0) && !data->motion.active;
		if (aborted) {
			data->axis_moving[0] = data->axis_moving[1] = false;
			result = ALPACA_OK;
		} else if (nothing_to_abort) {
			result = stop;
			strcpy(reason, stop_reason);
		} else {
			result = abort;
		}
		if (aborted || nothing_to_abort) {
			indigo_cancel_pending_handler(device, mount_equatorial_coordinates_handler);
			indigo_cancel_pending_handler(device, mount_park_handler);
			indigo_cancel_pending_handler(device, mount_home_handler);
			indigo_cancel_pending_handler(device, mount_side_of_pier_handler);
			indigo_cancel_pending_handler(device, mount_motion_dec_handler);
			indigo_cancel_pending_handler(device, mount_motion_ra_handler);
			indigo_cancel_pending_handler(device, mount_motion_finalizer);
			system_alpaca_operation_end(device, &data->motion);
			data->park_requested = data->unpark_requested = data->home_requested = data->flip_requested = data->stop_tracking = data->external_slew = data->slew_requested = data->goto_waits = false;
		}
		if (aborted || stop == ALPACA_OK) {
			system_alpaca_lock(device);
			MOUNT_MOTION_NORTH_ITEM->sw.value = MOUNT_MOTION_SOUTH_ITEM->sw.value = MOUNT_MOTION_WEST_ITEM->sw.value = MOUNT_MOTION_EAST_ITEM->sw.value = false;
			MOUNT_MOTION_DEC_PROPERTY->state = MOUNT_MOTION_RA_PROPERTY->state = INDIGO_OK_STATE;
			system_alpaca_unlock(device);
			indigo_update_property(device, MOUNT_MOTION_DEC_PROPERTY, NULL);
			indigo_update_property(device, MOUNT_MOTION_RA_PROPERTY, NULL);
		}
		if (aborted || nothing_to_abort) {
			mount_read_state(device);
			if (data->slewing && aborted) {
				// AbortSlew returns at once and Slewing stays true until the telescope has stopped
				data->aborted = true;
				system_alpaca_operation_start(device, &data->motion, MOUNT_MOTION_TIMEOUT, mount_motion_finalizer);
				mount_apply_state(device);
				mount_update_state(device);
			} else {
				mount_settle_aborted(device);
			}
		} else {
			mount_check_parked(device, abort);
		}
		if (aborted && stop != ALPACA_OK) {
			indigo_send_message(device, MOUNT_ABORT_MOTION_PROPERTY, "MoveAxis(0) failed: %s%s%s%s, AbortSlew stopped the axis", alpaca_result_text(stop), *stop_reason ? " (" : "", stop_reason, *stop_reason ? ")" : "");
		}
	}
	MOUNT_ABORT_MOTION_ITEM->sw.value = false;
	if (result == ALPACA_OK) {
		system_alpaca_update(device, MOUNT_ABORT_MOTION_PROPERTY, INDIGO_OK_STATE, "Aborted");
		indigo_mount_commit_motion_client(device, MOUNT_ABORT_MOTION_PROPERTY);
	} else {
		system_alpaca_finish_with(device, MOUNT_ABORT_MOTION_PROPERTY, result, "Abort", reason);
	}
}

static void mount_tracking_handler(indigo_device *device) {
	if (!system_alpaca_is_active(device)) {
		return;
	}
	if (mount_is_parked(device)) {
		indigo_send_message(device, MOUNT_TRACKING_PROPERTY, "Mount is parked!");
		mount_set_tracking(device);
		system_alpaca_update(device, MOUNT_TRACKING_PROPERTY, INDIGO_ALERT_STATE, NULL);
		return;
	}
	alpaca_result result = mount_put_tracking(device, indigo_get_switch_target(MOUNT_TRACKING_PROPERTY, MOUNT_TRACKING_ON_ITEM_NAME));
	mount_check_parked(device, result);
	mount_set_tracking(device);
	MOUNT_STATE_TRACKING_ITEM->light.value = MOUNT_DATA->tracking ? INDIGO_OK_STATE : INDIGO_IDLE_STATE;
	indigo_update_property(device, MOUNT_STATE_PROPERTY, NULL);
	system_alpaca_finish(device, MOUNT_TRACKING_PROPERTY, result, "Tracking");
}

static void mount_track_rate_handler(indigo_device *device) {
	mount_data *data = MOUNT_DATA;
	int rate = data->tracking_rate;
	if (!system_alpaca_is_active(device)) {
		return;
	}
	for (int i = 0; i < data->track_rate_count; i++) {
		if (indigo_get_switch_target(MOUNT_TRACK_RATE_PROPERTY, MOUNT_TRACK_RATE_PROPERTY->items[i].name)) {
			rate = data->track_rates[i];
		}
	}
	alpaca_param params[] = { ALPACA_INT_PARAM("TrackingRate", rate) };
	alpaca_result result = system_alpaca_put(device, "trackingrate", params, 1, ALPACA_REPLAYABLE);
	if (result == ALPACA_OK) {
		data->tracking_rate = rate;
	}
	mount_set_tracking_rate(device);
	system_alpaca_finish(device, MOUNT_TRACK_RATE_PROPERTY, result, "Tracking rate");
	if (result == ALPACA_OK && mount_has_offset_rates(device)) {
		// the offset rates read zero unless the telescope tracks at the sidereal rate
		mount_read_offset_rates(device);
		system_alpaca_lock(device);
		bool idle = X_ALPACA_OFFSET_RATE_PROPERTY->state != INDIGO_BUSY_STATE;
		if (idle) {
			mount_set_offset_rates(device);
		}
		system_alpaca_unlock(device);
		if (idle) {
			indigo_update_property(device, X_ALPACA_OFFSET_RATE_PROPERTY, NULL);
		}
	}
}

static void mount_guide_rate_handler(indigo_device *device) {
	if (!system_alpaca_is_active(device)) {
		return;
	}
	mount_data *data = MOUNT_DATA;
	double ra_rate = MOUNT_GUIDE_RATE_RA_ITEM->number.target * MOUNT_SIDEREAL_RATE / 100;
	double dec_rate = MOUNT_GUIDE_RATE_DEC_ITEM->number.target * MOUNT_SIDEREAL_RATE / 100;
	alpaca_param ra[] = { ALPACA_DOUBLE_PARAM("GuideRateRightAscension", ra_rate) };
	alpaca_param dec[] = { ALPACA_DOUBLE_PARAM("GuideRateDeclination", dec_rate) };
	alpaca_result result = system_alpaca_put(device, "guideraterightascension", ra, 1, ALPACA_REPLAYABLE);
	if (result == ALPACA_OK) {
		data->guide_rate_ra = ra_rate;
		result = system_alpaca_put(device, "guideratedeclination", dec, 1, ALPACA_REPLAYABLE);
	}
	if (result == ALPACA_OK) {
		data->guide_rate_dec = dec_rate;
		// a telescope with one guide rate for both axes changes the other one, too; after a failure nothing is read, the message quotes the last answer
		mount_read_guide_rates(device);
	}
	mount_set_guide_rates(device);
	system_alpaca_finish(device, MOUNT_GUIDE_RATE_PROPERTY, result, "Guide rate");
}

static void mount_offset_rate_handler(indigo_device *device) {
	alpaca_result result = ALPACA_OK;
	if (!system_alpaca_is_active(device)) {
		return;
	}
	alpaca_param ra[] = { ALPACA_DOUBLE_PARAM("RightAscensionRate", X_ALPACA_OFFSET_RATE_RA_ITEM->number.target) };
	alpaca_param dec[] = { ALPACA_DOUBLE_PARAM("DeclinationRate", X_ALPACA_OFFSET_RATE_DEC_ITEM->number.target) };
	if (system_alpaca_can(device, "cansetrightascensionrate")) {
		result = system_alpaca_put(device, "rightascensionrate", ra, 1, ALPACA_REPLAYABLE);
		if (result == ALPACA_OK) {
			MOUNT_DATA->offset_rate_ra = X_ALPACA_OFFSET_RATE_RA_ITEM->number.target;
		}
	}
	if (result == ALPACA_OK && system_alpaca_can(device, "cansetdeclinationrate")) {
		result = system_alpaca_put(device, "declinationrate", dec, 1, ALPACA_REPLAYABLE);
		if (result == ALPACA_OK) {
			MOUNT_DATA->offset_rate_dec = X_ALPACA_OFFSET_RATE_DEC_ITEM->number.target;
		}
	}
	if (result == ALPACA_OK) {
		mount_read_offset_rates(device);
	}
	mount_set_offset_rates(device);
	system_alpaca_finish(device, X_ALPACA_OFFSET_RATE_PROPERTY, result, "Offset rate");
}

static void mount_geographic_coordinates_handler(indigo_device *device) {
	if (!system_alpaca_is_active(device)) {
		return;
	}
	mount_data *data = MOUNT_DATA;
	double longitude = MOUNT_GEOGRAPHIC_COORDINATES_LONGITUDE_ITEM->number.target > 180 ? MOUNT_GEOGRAPHIC_COORDINATES_LONGITUDE_ITEM->number.target - 360 : MOUNT_GEOGRAPHIC_COORDINATES_LONGITUDE_ITEM->number.target;
	alpaca_param latitude_params[] = { ALPACA_DOUBLE_PARAM("SiteLatitude", MOUNT_GEOGRAPHIC_COORDINATES_LATITUDE_ITEM->number.target) };
	alpaca_param longitude_params[] = { ALPACA_DOUBLE_PARAM("SiteLongitude", longitude) };
	alpaca_param elevation_params[] = { ALPACA_DOUBLE_PARAM("SiteElevation", MOUNT_GEOGRAPHIC_COORDINATES_ELEVATION_ITEM->number.target) };
	alpaca_result result = system_alpaca_put(device, "sitelatitude", latitude_params, 1, ALPACA_REPLAYABLE);
	if (result == ALPACA_OK) {
		data->latitude = MOUNT_GEOGRAPHIC_COORDINATES_LATITUDE_ITEM->number.target;
		result = system_alpaca_put(device, "sitelongitude", longitude_params, 1, ALPACA_REPLAYABLE);
	}
	if (result == ALPACA_OK) {
		data->longitude = longitude;
	}
	if (result == ALPACA_OK && system_alpaca_supported(device, "SiteElevation")) {
		result = system_alpaca_put(device, "siteelevation", elevation_params, 1, ALPACA_REPLAYABLE);
	}
	if (result == ALPACA_OK) {
		// after a failure nothing is read, the message quotes the last answer of the telescope; the property then shows what was accepted so far
		mount_read_site(device);
	}
	mount_set_site(device);
	system_alpaca_finish(device, MOUNT_GEOGRAPHIC_COORDINATES_PROPERTY, result, "Location");
}

static void mount_utc_time_handler(indigo_device *device) {
	if (!system_alpaca_is_active(device)) {
		return;
	}
	time_t utc = indigo_mount_get_utc_target(device, NULL);
	if (utc == -1) {
		// the request was no date: nothing is sent and the item shows the time of the telescope again
		mount_set_utc(device);
		system_alpaca_update(device, MOUNT_UTC_TIME_PROPERTY, INDIGO_ALERT_STATE, "The time has to be given as YYYY-MM-DDTHH:MM:SS");
		return;
	}
	alpaca_result result = mount_put_utc(device, utc);
	mount_set_utc(device);
	system_alpaca_finish(device, MOUNT_UTC_TIME_PROPERTY, result, "Time");
}

static void mount_set_host_time_handler(indigo_device *device) {
	alpaca_result result = ALPACA_OK;
	if (!system_alpaca_is_active(device)) {
		return;
	}
	if (indigo_get_switch_target(MOUNT_SET_HOST_TIME_PROPERTY, MOUNT_SET_HOST_TIME_ITEM_NAME)) {
		result = mount_put_utc(device, time(NULL));
		if (result == ALPACA_OK) {
			// the time is set: an ALERT left by an earlier request to set it is over
			system_alpaca_lock(device);
			bool idle = MOUNT_UTC_TIME_PROPERTY->state != INDIGO_BUSY_STATE;
			if (idle) {
				mount_set_utc(device);
				MOUNT_UTC_TIME_PROPERTY->state = INDIGO_OK_STATE;
			}
			system_alpaca_unlock(device);
			if (idle) {
				indigo_update_property(device, MOUNT_UTC_TIME_PROPERTY, NULL);
			}
		}
	}
	MOUNT_SET_HOST_TIME_ITEM->sw.value = false;
	system_alpaca_finish(device, MOUNT_SET_HOST_TIME_PROPERTY, result, "Time");
}

static bool mount_on_probe(indigo_device *device) {
	static const char *capabilities[] = { "canpulseguide", "canslewasync", "cansync", "canpark", "canunpark", "cansetpark", "canfindhome", "cansettracking", "cansetpierside", "cansetguiderates", "cansetrightascensionrate", "cansetdeclinationrate" };
	mount_data *data = MOUNT_DATA;
	for (int i = 0; i < (int)(sizeof(capabilities) / sizeof(capabilities[0])); i++) {
		if (system_alpaca_probe_bool(device, capabilities[i], NULL) != ALPACA_OK) {
			return false;
		}
	}
	if (!mount_probe_axis(device, 0) || !mount_probe_axis(device, 1) || !mount_probe_tracking_rates(device)) {
		return false;
	}
	data->equatorial_system = 0;
	if (!mount_usable(system_alpaca_state_int(device, "EquatorialSystem", &data->equatorial_system))) {
		return false;
	}
	data->name[0] = 0;
	if (!mount_usable(system_alpaca_get_string(device, "name", data->name, sizeof(data->name)))) {
		return false;
	}
	return mount_read_state(device) && mount_read_settings(device);
}

static bool mount_on_connect(indigo_device *device) {
	static const char *rate_names[] = { MOUNT_TRACK_RATE_SIDEREAL_ITEM_NAME, MOUNT_TRACK_RATE_LUNAR_ITEM_NAME, MOUNT_TRACK_RATE_SOLAR_ITEM_NAME, MOUNT_TRACK_RATE_KING_ITEM_NAME };
	static const char *rate_labels[] = { "Sidereal rate", "Lunar rate", "Solar rate", "King rate" };
	static const double epochs[] = { 0, 0, 2000, 2050, 1950 };
	mount_data *data = MOUNT_DATA;
	bool can_slew = system_alpaca_can(device, "canslewasync");
	bool can_sync = system_alpaca_can(device, "cansync");
	int count = 0;
	memset(&data->motion, 0, sizeof(data->motion));
	data->action = NULL;
	data->park_requested = data->unpark_requested = data->home_requested = data->flip_requested = data->stop_tracking = data->external_slew = data->coordinates_failed = data->aborted = false;
	data->slew_requested = data->goto_waits = data->home_alert = data->park_recovered = data->home_recovered = data->site_warned = false;
	data->park_alert = -1;
	data->stall_since = 0;
	data->axis_moving[0] = data->axis_moving[1] = false;
	data->utc_changed = false;
	mount_set_parked(device, false);
	mount_note_site(device);
	data->settings_ticks = 0;
	INDIGO_COPY_VALUE(MOUNT_INFO_VENDOR_ITEM->label, "Name");
	INDIGO_COPY_VALUE(MOUNT_INFO_VENDOR_ITEM->text.value, *data->name ? data->name : PRIVATE_DATA->device_name);
	INDIGO_COPY_VALUE(MOUNT_INFO_MODEL_ITEM->text.value, INFO_DEVICE_MODEL_ITEM->text.value);
	INDIGO_COPY_VALUE(MOUNT_INFO_FIRMWARE_ITEM->text.value, INFO_DEVICE_FW_REVISION_ITEM->text.value);
	data->motion_ended = 0;
	data->was_slewing = false;
	if (data->equatorial_system >= 1 && data->equatorial_system <= 4) {
		MOUNT_EPOCH_ITEM->number.value = MOUNT_EPOCH_ITEM->number.target = epochs[data->equatorial_system];
		MOUNT_EPOCH_PROPERTY->perm = INDIGO_RO_PERM;
	} else {
		MOUNT_EPOCH_PROPERTY->perm = INDIGO_RW_PERM;
	}
	if (can_slew) {
		indigo_init_switch_item(MOUNT_ON_COORDINATES_SET_PROPERTY->items + count++, MOUNT_ON_COORDINATES_SET_TRACK_ITEM_NAME, "Slew to target and track", true);
	}
	if (can_sync) {
		indigo_init_switch_item(MOUNT_ON_COORDINATES_SET_PROPERTY->items + count++, MOUNT_ON_COORDINATES_SET_SYNC_ITEM_NAME, "Sync to target", !can_slew);
	}
	if (can_slew && system_alpaca_can(device, "cansettracking")) {
		indigo_init_switch_item(MOUNT_ON_COORDINATES_SET_PROPERTY->items + count++, MOUNT_ON_COORDINATES_SET_SLEW_ITEM_NAME, "Slew to target and stop", false);
	}
	MOUNT_ON_COORDINATES_SET_PROPERTY->count = count > 0 ? count : 1;
	MOUNT_ON_COORDINATES_SET_PROPERTY->hidden = count == 0;
	MOUNT_EQUATORIAL_COORDINATES_PROPERTY->perm = count > 0 ? INDIGO_RW_PERM : INDIGO_RO_PERM;
	system_alpaca_set_state(device, MOUNT_EQUATORIAL_COORDINATES_PROPERTY, INDIGO_OK_STATE);
	MOUNT_PARK_PROPERTY->hidden = !system_alpaca_can(device, "canpark") && !system_alpaca_can(device, "canunpark");
	MOUNT_PARK_SET_PROPERTY->hidden = !system_alpaca_can(device, "cansetpark");
	MOUNT_PARK_SET_PROPERTY->count = 1;
	MOUNT_HOME_PROPERTY->hidden = !system_alpaca_can(device, "canfindhome");
	MOUNT_TRACKING_PROPERTY->perm = system_alpaca_can(device, "cansettracking") ? INDIGO_RW_PERM : INDIGO_RO_PERM;
	for (int i = 0; i < data->track_rate_count; i++) {
		indigo_init_switch_item(MOUNT_TRACK_RATE_PROPERTY->items + i, rate_names[data->track_rates[i]], rate_labels[data->track_rates[i]], false);
	}
	MOUNT_TRACK_RATE_PROPERTY->count = data->track_rate_count > 0 ? data->track_rate_count : 1;
	MOUNT_TRACK_RATE_PROPERTY->hidden = data->track_rate_count == 0 || !system_alpaca_supported(device, "TrackingRate");
	MOUNT_GUIDE_RATE_PROPERTY->hidden = !mount_has_guide_rates(device);
	MOUNT_GUIDE_RATE_PROPERTY->perm = system_alpaca_can(device, "cansetguiderates") ? INDIGO_RW_PERM : INDIGO_RO_PERM;
	MOUNT_GUIDE_RATE_RA_ITEM->number.max = MOUNT_GUIDE_RATE_DEC_ITEM->number.max = 1000;
	MOUNT_MOTION_RA_PROPERTY->hidden = !data->can_move_axis[0];
	MOUNT_MOTION_DEC_PROPERTY->hidden = !data->can_move_axis[1];
	MOUNT_SLEW_RATE_PROPERTY->hidden = !data->can_move_axis[0] && !data->can_move_axis[1];
	MOUNT_MOTION_NORTH_ITEM->sw.value = MOUNT_MOTION_SOUTH_ITEM->sw.value = MOUNT_MOTION_WEST_ITEM->sw.value = MOUNT_MOTION_EAST_ITEM->sw.value = false;
	MOUNT_SIDE_OF_PIER_PROPERTY->hidden = !system_alpaca_supported(device, "SideOfPier");
	MOUNT_SIDE_OF_PIER_PROPERTY->perm = system_alpaca_can(device, "cansetpierside") ? INDIGO_RW_PERM : INDIGO_RO_PERM;
	MOUNT_UTC_TIME_PROPERTY->hidden = MOUNT_SET_HOST_TIME_PROPERTY->hidden = !system_alpaca_supported(device, "UTCDate");
	MOUNT_UTC_TIME_PROPERTY->count = 1;
	MOUNT_STATE_PROPERTY->hidden = false;
	X_ALPACA_OFFSET_RATE_PROPERTY->hidden = !mount_has_offset_rates(device);
	mount_apply_settings(device);
	mount_apply_state(device);
	system_alpaca_lock(device);
	MOUNT_EQUATORIAL_COORDINATES_RA_ITEM->number.target = MOUNT_EQUATORIAL_COORDINATES_RA_ITEM->number.value;
	MOUNT_EQUATORIAL_COORDINATES_DEC_ITEM->number.target = MOUNT_EQUATORIAL_COORDINATES_DEC_ITEM->number.value;
	MOUNT_GUIDE_RATE_RA_ITEM->number.target = MOUNT_GUIDE_RATE_RA_ITEM->number.value;
	MOUNT_GUIDE_RATE_DEC_ITEM->number.target = MOUNT_GUIDE_RATE_DEC_ITEM->number.value;
	X_ALPACA_OFFSET_RATE_RA_ITEM->number.target = X_ALPACA_OFFSET_RATE_RA_ITEM->number.value;
	X_ALPACA_OFFSET_RATE_DEC_ITEM->number.target = X_ALPACA_OFFSET_RATE_DEC_ITEM->number.value;
	if (mount_has_site(device)) {
		MOUNT_GEOGRAPHIC_COORDINATES_LATITUDE_ITEM->number.target = MOUNT_GEOGRAPHIC_COORDINATES_LATITUDE_ITEM->number.value;
		MOUNT_GEOGRAPHIC_COORDINATES_LONGITUDE_ITEM->number.target = MOUNT_GEOGRAPHIC_COORDINATES_LONGITUDE_ITEM->number.value;
		MOUNT_GEOGRAPHIC_COORDINATES_ELEVATION_ITEM->number.target = MOUNT_GEOGRAPHIC_COORDINATES_ELEVATION_ITEM->number.value;
	}
	MOUNT_HORIZONTAL_COORDINATES_PROPERTY->state = MOUNT_EQUATORIAL_COORDINATES_PROPERTY->state;
	system_alpaca_unlock(device);
	if (system_alpaca_can(device, "canpulseguide")) {
		system_alpaca_attach_secondary(device, &system_alpaca_guider_class);
	}
	indigo_define_property(device, X_ALPACA_OFFSET_RATE_PROPERTY, NULL);
	indigo_define_property(device, X_ALPACA_MOUNT_AXES_PROPERTY, NULL);
	indigo_define_property(device, X_ALPACA_SETTLE_TIME_PROPERTY, NULL);
	return true;
}

static void mount_on_disconnect(indigo_device *device) {
	mount_data *data = MOUNT_DATA;
	// a manual motion runs until it is stopped, so it does not outlive the connection; a slew is left to finish
	for (int axis = 0; axis < 2; axis++) {
		if (data->axis_moving[axis]) {
			mount_put_axis_rate(device, axis, 0);
			data->axis_moving[axis] = false;
		}
	}
	system_alpaca_operation_end(device, &data->motion);
	data->park_requested = data->unpark_requested = data->home_requested = data->flip_requested = data->stop_tracking = data->external_slew = data->aborted = false;
	data->slew_requested = data->goto_waits = data->home_alert = false;
	data->park_alert = -1;
	// the properties are still defined, so a request may be accepted while they are reset; its handler finds the session closed
	system_alpaca_lock(device);
	data->site = false;
	MOUNT_MOTION_NORTH_ITEM->sw.value = MOUNT_MOTION_SOUTH_ITEM->sw.value = MOUNT_MOTION_WEST_ITEM->sw.value = MOUNT_MOTION_EAST_ITEM->sw.value = false;
	MOUNT_ABORT_MOTION_ITEM->sw.value = MOUNT_HOME_ITEM->sw.value = MOUNT_PARK_SET_CURRENT_ITEM->sw.value = MOUNT_SET_HOST_TIME_ITEM->sw.value = false;
	MOUNT_ABORT_MOTION_PROPERTY->state = MOUNT_PARK_SET_PROPERTY->state = MOUNT_TRACKING_PROPERTY->state = MOUNT_TRACK_RATE_PROPERTY->state = MOUNT_GUIDE_RATE_PROPERTY->state = INDIGO_OK_STATE;
	MOUNT_GEOGRAPHIC_COORDINATES_PROPERTY->state = MOUNT_UTC_TIME_PROPERTY->state = MOUNT_SET_HOST_TIME_PROPERTY->state = MOUNT_SIDE_OF_PIER_PROPERTY->state = X_ALPACA_OFFSET_RATE_PROPERTY->state = INDIGO_OK_STATE;
	system_alpaca_unlock(device);
	indigo_delete_property(device, X_ALPACA_OFFSET_RATE_PROPERTY, NULL);
	indigo_delete_property(device, X_ALPACA_MOUNT_AXES_PROPERTY, NULL);
	indigo_delete_property(device, X_ALPACA_SETTLE_TIME_PROPERTY, NULL);
}

// A site of exactly 0° / 0° reported by the telescope is not set, see SITE: warn once, and again after the site was something else.
static void mount_warn_site(indigo_device *device) {
	mount_data *data = MOUNT_DATA;
	bool unset = mount_has_site(device) && fabs(data->latitude) < 1e-6 && fabs(data->longitude) < 1e-6;
	if (unset && !data->site_warned) {
		indigo_send_message(device, MOUNT_GEOGRAPHIC_COORDINATES_PROPERTY, "Warning: the Alpaca server reports the site 0° N, 0° E, which is most likely not set; the telescope computes its sidereal time and coordinates for that site until GEOGRAPHIC_COORDINATES is set");
	}
	data->site_warned = unset;
}

static void mount_on_poll(indigo_device *device) {
	mount_data *data = MOUNT_DATA;
	mount_read_state(device);
	mount_apply_state(device);
	mount_update_state(device);
	if (++data->settings_ticks >= MOUNT_SETTINGS_TICKS && !data->motion.active) {
		data->settings_ticks = 0;
		mount_read_settings(device);
		mount_apply_settings(device);
		mount_update_settings(device);
	}
	mount_warn_site(device);
}

#pragma mark - Device API (mount)

static indigo_result mount_enumerate_properties(indigo_device *device, indigo_client *client, indigo_property *property);

static indigo_result mount_attach(indigo_device *device) {
	assert(device != NULL);
	if (indigo_mount_attach(device, DRIVER_NAME, DRIVER_VERSION) == INDIGO_OK) {
		X_ALPACA_OFFSET_RATE_PROPERTY = indigo_init_number_property(NULL, device->name, X_ALPACA_OFFSET_RATE_PROPERTY_NAME, MOUNT_MAIN_GROUP, "Tracking offset rate", INDIGO_OK_STATE, INDIGO_RW_PERM, 2);
		if (X_ALPACA_OFFSET_RATE_PROPERTY == NULL) {
			return INDIGO_FAILED;
		}
		indigo_init_number_item(X_ALPACA_OFFSET_RATE_RA_ITEM, X_ALPACA_OFFSET_RATE_RA_ITEM_NAME, "RA offset (s of RA / sidereal s)", -100, 100, 0, 0);
		indigo_init_number_item(X_ALPACA_OFFSET_RATE_DEC_ITEM, X_ALPACA_OFFSET_RATE_DEC_ITEM_NAME, "Dec offset (\" / s)", -1000, 1000, 0, 0);
		X_ALPACA_MOUNT_AXES_PROPERTY = indigo_init_switch_property(NULL, device->name, X_ALPACA_MOUNT_AXES_PROPERTY_NAME, MOUNT_MAIN_GROUP, "Manual motion axes", INDIGO_OK_STATE, INDIGO_RW_PERM, INDIGO_ONE_OF_MANY_RULE, 2);
		X_ALPACA_SETTLE_TIME_PROPERTY = indigo_init_number_property(NULL, device->name, X_ALPACA_SETTLE_TIME_PROPERTY_NAME, MOUNT_MAIN_GROUP, "Pause after a motion", INDIGO_OK_STATE, INDIGO_RW_PERM, 1);
		if (X_ALPACA_MOUNT_AXES_PROPERTY == NULL || X_ALPACA_SETTLE_TIME_PROPERTY == NULL) {
			return INDIGO_FAILED;
		}
		indigo_init_switch_item(X_ALPACA_MOUNT_AXES_MECHANICAL_ITEM, X_ALPACA_MOUNT_AXES_MECHANICAL_ITEM_NAME, "Mechanical axes (ASCOM)", true);
		indigo_init_switch_item(X_ALPACA_MOUNT_AXES_SKY_ITEM, X_ALPACA_MOUNT_AXES_SKY_ITEM_NAME, "Sky directions (+ east, + south)", false);
		indigo_init_number_item(X_ALPACA_SETTLE_TIME_ITEM, X_ALPACA_SETTLE_TIME_ITEM_NAME, "Time (s)", 0, 10, 0.1, 0);
		return system_alpaca_attach(device) == INDIGO_OK ? mount_enumerate_properties(device, NULL, NULL) : INDIGO_FAILED;
	}
	return INDIGO_FAILED;
}

static indigo_result mount_enumerate_properties(indigo_device *device, indigo_client *client, indigo_property *property) {
	if (system_alpaca_is_active(device)) {
		INDIGO_DEFINE_MATCHING_PROPERTY(X_ALPACA_OFFSET_RATE_PROPERTY);
		INDIGO_DEFINE_MATCHING_PROPERTY(X_ALPACA_MOUNT_AXES_PROPERTY);
		INDIGO_DEFINE_MATCHING_PROPERTY(X_ALPACA_SETTLE_TIME_PROPERTY);
	}
	return indigo_mount_enumerate_properties(device, client, property);
}

static indigo_result mount_change_property(indigo_device *device, indigo_client *client, indigo_property *property) {
	if (system_alpaca_change_property(device, property)) {
		return INDIGO_OK;
	}
	if (indigo_property_match(CONFIG_PROPERTY, property) && indigo_switch_match(CONFIG_SAVE_ITEM, property)) {
		indigo_save_property(device, NULL, X_ALPACA_MOUNT_AXES_PROPERTY);
		indigo_save_property(device, NULL, X_ALPACA_SETTLE_TIME_PROPERTY);
	}
	if (!system_alpaca_is_active(device)) {
		return indigo_mount_change_property(device, client, property);
	}
	if (indigo_property_match_changeable(X_ALPACA_MOUNT_AXES_PROPERTY, property) || indigo_property_match_changeable(X_ALPACA_SETTLE_TIME_PROPERTY, property)) {
		// settings of the driver, nothing is sent to the telescope; the handlers read them under the same lock
		indigo_property *own = indigo_property_match_changeable(X_ALPACA_MOUNT_AXES_PROPERTY, property) ? X_ALPACA_MOUNT_AXES_PROPERTY : X_ALPACA_SETTLE_TIME_PROPERTY;
		system_alpaca_lock(device);
		indigo_property_copy_values(own, property, false);
		own->state = INDIGO_OK_STATE;
		system_alpaca_unlock(device);
		indigo_update_property(device, own, NULL);
		return INDIGO_OK;
	} else if (indigo_property_match_changeable(MOUNT_EQUATORIAL_COORDINATES_PROPERTY, property)) {
		// asked while the coordinates are BUSY as well, so that a request is never dropped without an answer; a refusal keeps the BUSY state of the running slew
		system_alpaca_accept(device, MOUNT_EQUATORIAL_COORDINATES_PROPERTY, property, ALPACA_ACCEPT_TARGETS | ALPACA_ACCEPT_ANYTIME, mount_coordinates_refusal, mount_equatorial_coordinates_handler);
		return INDIGO_OK;
	} else if (indigo_property_match_changeable(MOUNT_ABORT_MOTION_PROPERTY, property)) {
		system_alpaca_accept(device, MOUNT_ABORT_MOTION_PROPERTY, property, ALPACA_ACCEPT_VALUES | ALPACA_ACCEPT_URGENT, NULL, mount_abort_motion_handler);
		return INDIGO_OK;
	} else if (indigo_property_match_changeable(MOUNT_MOTION_DEC_PROPERTY, property)) {
		// refused before its client is recorded as the owner of the motion; a motion request that waits for its handler keeps the property
		if (mount_is_parked(device)) {
			system_alpaca_reject(device, MOUNT_MOTION_DEC_PROPERTY, "Mount is parked!");
			return INDIGO_OK;
		}
		indigo_mount_record_motion_client(device, client, property);
		system_alpaca_accept(device, MOUNT_MOTION_DEC_PROPERTY, property, ALPACA_ACCEPT_VALUES | ALPACA_ACCEPT_ANYTIME, NULL, mount_motion_dec_handler);
		return INDIGO_OK;
	} else if (indigo_property_match_changeable(MOUNT_MOTION_RA_PROPERTY, property)) {
		// refused before its client is recorded as the owner of the motion; a motion request that waits for its handler keeps the property
		if (mount_is_parked(device)) {
			system_alpaca_reject(device, MOUNT_MOTION_RA_PROPERTY, "Mount is parked!");
			return INDIGO_OK;
		}
		indigo_mount_record_motion_client(device, client, property);
		system_alpaca_accept(device, MOUNT_MOTION_RA_PROPERTY, property, ALPACA_ACCEPT_VALUES | ALPACA_ACCEPT_ANYTIME, NULL, mount_motion_ra_handler);
		return INDIGO_OK;
	} else if (indigo_property_match_changeable(MOUNT_PARK_PROPERTY, property)) {
		system_alpaca_accept(device, MOUNT_PARK_PROPERTY, property, ALPACA_ACCEPT_VALUES, NULL, mount_park_handler);
		return INDIGO_OK;
	} else if (indigo_property_match_changeable(MOUNT_PARK_SET_PROPERTY, property)) {
		system_alpaca_accept(device, MOUNT_PARK_SET_PROPERTY, property, ALPACA_ACCEPT_VALUES, NULL, mount_park_set_handler);
		return INDIGO_OK;
	} else if (indigo_property_match_changeable(MOUNT_HOME_PROPERTY, property)) {
		system_alpaca_accept(device, MOUNT_HOME_PROPERTY, property, ALPACA_ACCEPT_VALUES, NULL, mount_home_handler);
		return INDIGO_OK;
	} else if (indigo_property_match_changeable(MOUNT_TRACKING_PROPERTY, property)) {
		system_alpaca_accept(device, MOUNT_TRACKING_PROPERTY, property, ALPACA_ACCEPT_VALUES, mount_parked_refusal, mount_tracking_handler);
		return INDIGO_OK;
	} else if (indigo_property_match_changeable(MOUNT_TRACK_RATE_PROPERTY, property)) {
		system_alpaca_accept(device, MOUNT_TRACK_RATE_PROPERTY, property, ALPACA_ACCEPT_VALUES, NULL, mount_track_rate_handler);
		return INDIGO_OK;
	} else if (indigo_property_match_changeable(MOUNT_GUIDE_RATE_PROPERTY, property)) {
		system_alpaca_accept(device, MOUNT_GUIDE_RATE_PROPERTY, property, ALPACA_ACCEPT_VALUES, NULL, mount_guide_rate_handler);
		return INDIGO_OK;
	} else if (indigo_property_match_changeable(X_ALPACA_OFFSET_RATE_PROPERTY, property)) {
		system_alpaca_accept(device, X_ALPACA_OFFSET_RATE_PROPERTY, property, ALPACA_ACCEPT_VALUES, NULL, mount_offset_rate_handler);
		return INDIGO_OK;
	} else if (indigo_property_match_changeable(MOUNT_SIDE_OF_PIER_PROPERTY, property)) {
		system_alpaca_accept(device, MOUNT_SIDE_OF_PIER_PROPERTY, property, ALPACA_ACCEPT_VALUES, mount_parked_refusal, mount_side_of_pier_handler);
		return INDIGO_OK;
	} else if (indigo_property_match_changeable(MOUNT_GEOGRAPHIC_COORDINATES_PROPERTY, property) && mount_site_owned(device)) {
		system_alpaca_accept(device, MOUNT_GEOGRAPHIC_COORDINATES_PROPERTY, property, ALPACA_ACCEPT_VALUES, NULL, mount_geographic_coordinates_handler);
		return INDIGO_OK;
	} else if (indigo_property_match_changeable(MOUNT_UTC_TIME_PROPERTY, property)) {
		// a request that is dropped because the previous one is not finished must not replace the time the handler is about to send
		system_alpaca_lock(device);
		bool idle = MOUNT_UTC_TIME_PROPERTY->state != INDIGO_BUSY_STATE;
		system_alpaca_unlock(device);
		if (idle) {
			indigo_mount_set_utc_target(device, property);
		}
		system_alpaca_accept(device, MOUNT_UTC_TIME_PROPERTY, property, ALPACA_ACCEPT_VALUES, NULL, mount_utc_time_handler);
		return INDIGO_OK;
	} else if (indigo_property_match_changeable(MOUNT_SET_HOST_TIME_PROPERTY, property)) {
		system_alpaca_accept(device, MOUNT_SET_HOST_TIME_PROPERTY, property, ALPACA_ACCEPT_VALUES, NULL, mount_set_host_time_handler);
		return INDIGO_OK;
	}
	return indigo_mount_change_property(device, client, property);
}

static indigo_result mount_detach(indigo_device *device) {
	assert(device != NULL);
	system_alpaca_detach(device);
	indigo_release_property(X_ALPACA_OFFSET_RATE_PROPERTY);
	indigo_release_property(X_ALPACA_MOUNT_AXES_PROPERTY);
	indigo_release_property(X_ALPACA_SETTLE_TIME_PROPERTY);
	INDIGO_DEVICE_DETACH_LOG(DRIVER_NAME, device->name);
	return indigo_mount_detach(device);
}

#pragma mark - Device class

const alpaca_class system_alpaca_mount_class = {
	.device_type = "Telescope",
	.platform7_version = 4,
	.data_size = sizeof(mount_data),
	.attach = mount_attach,
	.enumerate_properties = mount_enumerate_properties,
	.change_property = mount_change_property,
	.detach = mount_detach,
	.base_change_property = indigo_mount_change_property,
	.on_probe = mount_on_probe,
	.on_connect = mount_on_connect,
	.on_disconnect = mount_on_disconnect,
	.on_poll = mount_on_poll
};
