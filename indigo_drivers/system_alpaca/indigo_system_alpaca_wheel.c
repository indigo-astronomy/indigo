// Copyright (c) 2026 CloudMakers, s. r. o.
// All rights reserved.
//
// You can use this software under the terms of 'INDIGO Astronomy
// open-source license' (see LICENSE.md).
//
// THIS SOFTWARE IS PROVIDED BY THE AUTHORS 'AS IS' AND ANY EXPRESS
// OR IMPLIED WARRANTIES, INCLUDING, BUT NOT LIMITED TO, THE IMPLIED
// WARRANTIES OF MERCHANTABILITY AND FITNESS FOR A PARTICULAR PURPOSE
// ARE DISCLAIMED. IN NO EVENT SHALL THE AUTHOR BE LIABLE FOR ANY
// DIRECT, INDIRECT, INCIDENTAL, SPECIAL, EXEMPLARY, OR CONSEQUENTIAL
// DAMAGES (INCLUDING, BUT NOT LIMITED TO, PROCUREMENT OF SUBSTITUTE
// GOODS OR SERVICES; LOSS OF USE, DATA, OR PROFITS; OR BUSINESS
// INTERRUPTION) HOWEVER CAUSED AND ON ANY THEORY OF LIABILITY,
// WHETHER IN CONTRACT, STRICT LIABILITY, OR TORT (INCLUDING
// NEGLIGENCE OR OTHERWISE) ARISING IN ANY WAY OUT OF THE USE OF THIS
// SOFTWARE, EVEN IF ADVISED OF THE POSSIBILITY OF SUCH DAMAGE.

// version history
// 3.0 by Peter Polakovic <peter.polakovic@cloudmakers.eu>

// Code is generated by AI

/** INDIGO ASCOM Alpaca client driver, FilterWheel device class: Alpaca FilterWheel as an INDIGO filter wheel
 \file indigo_system_alpaca_wheel.c

 Mapping of the Alpaca members onto the INDIGO properties:

 - Names: the number of slots (the length of the array, of FocusOffsets if Names is not usable) and the values of WHEEL_SLOT_NAME.
   WHEEL_SLOT, WHEEL_SLOT_NAME and WHEEL_SLOT_OFFSET are resized to it on every connection, up to WHEEL_MAX_SLOTS slots (room for that
   many is made at attach, so the resize never moves the properties).
 - FocusOffsets: the values of WHEEL_SLOT_OFFSET.
 - Position: WHEEL_SLOT. Alpaca counts the slots from 0 and INDIGO from 1. A change of WHEEL_SLOT is "PUT position Position=<slot - 1>";
   Position is -1 while the wheel turns, so the property stays BUSY as long as the device reports -1 (wheel_slot_finalizer),
   for no longer than WHEEL_MOVE_TIMEOUT_FACTOR times the long request timeout. The slot the device reports then is the value of
   WHEEL_SLOT; if it is not the requested one (another client turned the wheel elsewhere) the request ends in ALERT. A wheel that
   turns without a request of this driver (another client, start-up of the device) shows as WHEEL_SLOT in the BUSY state.
   While Position can not be read (the device answers with an error) WHEEL_SLOT is in ALERT with the last slot; it is OK again
   with the first slot that is read.

 Names and FocusOffsets can not be written in Alpaca. WHEEL_SLOT_NAME and WHEEL_SLOT_OFFSET stay writable as they are for every INDIGO
 wheel: the values of the device are the defaults set on every connection, a change is a local label or offset that is kept by
 the INDIGO base class (and its CONFIG) and never sent to the device. They are read when the device connects and not polled.

 Alpaca has no way to stop a filter wheel, so nothing is sent on disconnect. A request for WHEEL_SLOT while it is BUSY is ignored.

 Threads: change_property runs on a bus thread, everything else on the handler queue of the device. A request is accepted
 with system_alpaca_accept() and a poll tick publishes the slot of the device under the lock of the device, so a tick never
 replaces a request that was just accepted with the old slot of the device; for the same reason a tick asks the device first
 and touches the property afterwards.
 */

#pragma mark - Includes

#include <stdlib.h>
#include <string.h>
#include <assert.h>

#include <indigo/indigo_wheel_driver.h>

#include "indigo_system_alpaca_private.h"

#pragma mark - Common definitions

#define WHEEL_MOVE_TIMEOUT_FACTOR							1
#define WHEEL_MAX_SLOTS												32
#define WHEEL_NAME_SIZE												128

#pragma mark - Private data definition

#define WHEEL_DATA														((wheel_data *)CLASS_DATA)

typedef struct {
	alpaca_operation move;
	bool external;							///< WHEEL_SLOT is BUSY because the wheel turns without a request of this driver
	bool unreadable;						///< WHEEL_SLOT is in ALERT because the polling can not read the slot
	int slot_count;
	int name_count;
	int offset_count;
	int position;								///< Position at the time of the connection: 0-based, -1 while the wheel turns
	int target;									///< 0-based slot the running move ends at, -1 if any slot ends it
	char names[WHEEL_MAX_SLOTS][WHEEL_NAME_SIZE];
	int offsets[WHEEL_MAX_SLOTS];
} wheel_data;

#pragma mark - Low level code

// False if a request made while connecting got no usable answer, so that the connection has to fail.
static bool wheel_answered(alpaca_result result) {
	return !alpaca_is_transport_error(result) && result != ALPACA_PROTOCOL_ERROR && result != ALPACA_SERVER_ERROR && result != ALPACA_FAILED;
}

// Time a move may take: a multiple of the timeout of long requests (X_ALPACA_TIMEOUTS of the bridge device).
static double wheel_move_timeout(indigo_device *device) {
	return WHEEL_MOVE_TIMEOUT_FACTOR * system_alpaca_long_timeout(device);
}

// Handler queue: end a request for WHEEL_SLOT. The slot and the state are set under the lock of the device, the property is published without it.
// slot is the 1-based slot the wheel is in, 0 to leave the value as it is; the target follows the value. A message makes it ALERT.
static void wheel_finish(indigo_device *device, int slot, const char *message) {
	wheel_data *data = WHEEL_DATA;
	data->external = false;
	system_alpaca_lock(device);
	if (slot > 0) {
		WHEEL_SLOT_ITEM->number.value = slot;
	}
	WHEEL_SLOT_ITEM->number.target = WHEEL_SLOT_ITEM->number.value;
	WHEEL_SLOT_PROPERTY->state = message != NULL ? INDIGO_ALERT_STATE : INDIGO_OK_STATE;
	system_alpaca_unlock(device);
	if (message != NULL) {
		indigo_update_property(device, WHEEL_SLOT_PROPERTY, "%s", message);
	} else {
		indigo_update_property(device, WHEEL_SLOT_PROPERTY, NULL);
	}
}

// The message of a failed request, "Move failed: <result> (<reason>)", as system_alpaca_finish() makes it. reason is the text taken
// with system_alpaca_reason() when the request failed, NULL to take it from the last request.
static void wheel_failure(indigo_device *device, alpaca_result result, const char *reason, char *message, size_t size) {
	char text[INDIGO_VALUE_SIZE];
	if (reason == NULL) {
		system_alpaca_reason(device, result, text, sizeof(text));
		reason = text;
	}
	snprintf(message, size, "Move failed: %s%s%s%s", alpaca_result_text(result), *reason ? " (" : "", reason, *reason ? ")" : "");
}

// Completion of a move: Position is -1 while the wheel turns, and that is the only sign of a move in progress. The slot it reports
// afterwards is where the move ended: the requested one, or another one if something else turned the wheel meanwhile.
static void wheel_slot_finalizer(indigo_device *device) {
	wheel_data *data = WHEEL_DATA;
	char message[INDIGO_VALUE_SIZE];
	int position = -1;
	if (!system_alpaca_is_active(device)) {
		return;
	}
	alpaca_result result = system_alpaca_get_int(device, "position", &position);
	if (result == ALPACA_OK && position == -1 && system_alpaca_operation_continue(device, &data->move, wheel_slot_finalizer)) {
		return;
	}
	system_alpaca_operation_end(device, &data->move);
	if (result != ALPACA_OK || position == -1) {
		wheel_failure(device, result != ALPACA_OK ? result : ALPACA_TIMED_OUT, NULL, message, sizeof(message));
		wheel_finish(device, 0, message);
	} else if (position < 0 || position >= data->slot_count) {
		snprintf(message, sizeof(message), "Move failed: the device reports Position %d of %d slots", position, data->slot_count);
		wheel_finish(device, 0, message);
	} else if (data->target >= 0 && position != data->target) {
		snprintf(message, sizeof(message), "Move failed: the wheel stopped at slot %d instead of slot %d", position + 1, data->target + 1);
		wheel_finish(device, position + 1, message);
	} else {
		wheel_finish(device, position + 1, NULL);
	}
}

#pragma mark - High level code (wheel)

static bool wheel_on_probe(indigo_device *device) {
	wheel_data *data = WHEEL_DATA;
	alpaca_channel *channel = system_alpaca_channel(device);
	data->external = data->unreadable = false;
	data->slot_count = data->name_count = data->offset_count = 0;
	data->position = data->target = -1;
	alpaca_result result = system_alpaca_check(device, alpaca_get_string_array(channel, "names", NULL, 0, ALPACA_WAIT_STANDARD, data->names[0], WHEEL_NAME_SIZE, WHEEL_MAX_SLOTS, &data->name_count));
	if (!wheel_answered(result)) {
		INDIGO_DRIVER_ERROR(DRIVER_NAME, "'%s' gave no usable Names (at most %d slots are supported)", device->name, WHEEL_MAX_SLOTS);
		return false;
	}
	if (result != ALPACA_OK) {
		data->name_count = 0;
	}
	result = system_alpaca_check(device, alpaca_get_int_array(channel, "focusoffsets", NULL, 0, ALPACA_WAIT_STANDARD, data->offsets, WHEEL_MAX_SLOTS, &data->offset_count));
	if (!wheel_answered(result)) {
		INDIGO_DRIVER_ERROR(DRIVER_NAME, "'%s' gave no usable FocusOffsets (at most %d slots are supported)", device->name, WHEEL_MAX_SLOTS);
		return false;
	}
	if (result != ALPACA_OK) {
		data->offset_count = 0;
	}
	data->slot_count = data->name_count > 0 ? data->name_count : data->offset_count;
	if (data->slot_count == 0) {
		INDIGO_DRIVER_ERROR(DRIVER_NAME, "'%s' reports no filter slots", device->name);
		return false;
	}
	if (system_alpaca_get_int(device, "position", &data->position) != ALPACA_OK) {
		return false;
	}
	if (data->position < -1 || data->position >= data->slot_count) {
		INDIGO_DRIVER_ERROR(DRIVER_NAME, "'%s' reports Position %d of %d slots", device->name, data->position, data->slot_count);
		return false;
	}
	INDIGO_DRIVER_DEBUG(DRIVER_NAME, "'%s' %d slots (%d names, %d focus offsets), Position = %d", device->name, data->slot_count, data->name_count, data->offset_count, data->position);
	return true;
}

static bool wheel_on_connect(indigo_device *device) {
	wheel_data *data = WHEEL_DATA;
	char name[INDIGO_NAME_SIZE];
	char label[INDIGO_NAME_SIZE];
	char value[WHEEL_NAME_SIZE];
	// within the room made at attach: the properties do not move
	WHEEL_SLOT_NAME_PROPERTY = indigo_resize_property(WHEEL_SLOT_NAME_PROPERTY, data->slot_count);
	WHEEL_SLOT_OFFSET_PROPERTY = indigo_resize_property(WHEEL_SLOT_OFFSET_PROPERTY, data->slot_count);
	for (int i = 0; i < data->slot_count; i++) {
		snprintf(label, sizeof(label), "Slot #%d", i + 1);
		snprintf(value, sizeof(value), "Filter #%d", i + 1);
		snprintf(name, sizeof(name), WHEEL_SLOT_NAME_ITEM_NAME, i + 1);
		indigo_init_text_item_raw(WHEEL_SLOT_NAME_PROPERTY->items + i, name, label, i < data->name_count ? data->names[i] : value);
		snprintf(name, sizeof(name), WHEEL_SLOT_OFFSET_ITEM_NAME, i + 1);
		indigo_init_number_item(WHEEL_SLOT_OFFSET_PROPERTY->items + i, name, label, -1000000, 1000000, 1, i < data->offset_count ? data->offsets[i] : 0);
	}
	WHEEL_SLOT_NAME_PROPERTY->state = WHEEL_SLOT_OFFSET_PROPERTY->state = INDIGO_OK_STATE;
	WHEEL_SLOT_ITEM->number.min = 1;
	WHEEL_SLOT_ITEM->number.max = data->slot_count;
	system_alpaca_lock(device);
	// while the wheel turns the slot is not known: the value is 0 until it stops
	WHEEL_SLOT_ITEM->number.value = WHEEL_SLOT_ITEM->number.target = data->position + 1;
	WHEEL_SLOT_PROPERTY->state = data->position >= 0 ? INDIGO_OK_STATE : INDIGO_BUSY_STATE;
	system_alpaca_unlock(device);
	if (data->position < 0) {
		data->target = -1;
		system_alpaca_operation_start(device, &data->move, wheel_move_timeout(device), wheel_slot_finalizer);
	}
	return true;
}

static void wheel_on_disconnect(indigo_device *device) {
	wheel_data *data = WHEEL_DATA;
	system_alpaca_operation_end(device, &data->move);
	data->external = data->unreadable = false;
}

static void wheel_on_poll(indigo_device *device) {
	wheel_data *data = WHEEL_DATA;
	char reason[INDIGO_VALUE_SIZE] = { 0 };
	bool publish = false, publish_failure = false;
	int position = -1;
	// the slot belongs to the finalizer while a move runs
	if (data->move.active) {
		return;
	}
	// The device is asked first and the property is touched afterwards, in one step under the lock of the device: a request of a client that
	// arrives while the device answers finds the slot as the client knows it, and is not replaced by what the device said.
	alpaca_result result = system_alpaca_state_int(device, "Position", &position);
	system_alpaca_reason(device, result, reason, sizeof(reason));
	if (alpaca_is_transport_error(result)) {
		return;
	}
	system_alpaca_lock(device);
	// a request that was accepted and waits for its handler owns the property
	if (WHEEL_SLOT_PROPERTY->state != INDIGO_BUSY_STATE || data->external) {
		if (result != ALPACA_OK) {
			// the device answers and does not tell where the wheel is: the slot that is shown is not the one of the device any more
			if (WHEEL_SLOT_PROPERTY->state == INDIGO_OK_STATE) {
				WHEEL_SLOT_PROPERTY->state = INDIGO_ALERT_STATE;
				data->unreadable = true;
				publish_failure = true;
			}
		} else if (position == -1 && WHEEL_SLOT_PROPERTY->state != INDIGO_BUSY_STATE) {
			WHEEL_SLOT_PROPERTY->state = INDIGO_BUSY_STATE;
			data->external = true;
			data->unreadable = false;
			publish = true;
		} else if (position >= 0 && position < data->slot_count && (data->external || data->unreadable || WHEEL_SLOT_ITEM->number.value != position + 1)) {
			WHEEL_SLOT_ITEM->number.value = WHEEL_SLOT_ITEM->number.target = position + 1;
			WHEEL_SLOT_PROPERTY->state = INDIGO_OK_STATE;
			data->external = data->unreadable = false;
			publish = true;
		}
	}
	system_alpaca_unlock(device);
	if (publish) {
		indigo_update_property(device, WHEEL_SLOT_PROPERTY, NULL);
	} else if (publish_failure) {
		system_alpaca_report(device, WHEEL_SLOT_PROPERTY, result, "Reading the slot", reason);
	}
}

static void wheel_slot_handler(indigo_device *device) {
	wheel_data *data = WHEEL_DATA;
	char reason[INDIGO_VALUE_SIZE], message[INDIGO_VALUE_SIZE];
	int position = -1;
	if (!system_alpaca_is_active(device)) {
		return;
	}
	data->target = (int)WHEEL_SLOT_ITEM->number.target - 1;
	alpaca_param params[] = { ALPACA_INT_PARAM("Position", data->target) };
	alpaca_result result = system_alpaca_put(device, "position", params, 1, ALPACA_WAIT_LONG | ALPACA_REPLAYABLE);
	// the reason of a failure is taken before Position, which is asked next, replaces it in the channel
	system_alpaca_reason(device, result, reason, sizeof(reason));
	if (result != ALPACA_OK && alpaca_may_have_executed(result) && system_alpaca_get_int(device, "position", &position) == ALPACA_OK && (position == -1 || position == data->target)) {
		INDIGO_DRIVER_DEBUG(DRIVER_NAME, "'%s' gave no valid reply to position (%s) but took the request", device->name, alpaca_result_text(result));
		result = ALPACA_OK;
	}
	if (result == ALPACA_OK) {
		data->external = false;
		system_alpaca_operation_start(device, &data->move, wheel_move_timeout(device), wheel_slot_finalizer);
	} else {
		wheel_failure(device, result, reason, message, sizeof(message));
		wheel_finish(device, 0, message);
	}
}

#pragma mark - Device API (wheel)

static indigo_result wheel_enumerate_properties(indigo_device *device, indigo_client *client, indigo_property *property);

static indigo_result wheel_attach(indigo_device *device) {
	assert(device != NULL);
	if (indigo_wheel_attach(device, DRIVER_NAME, DRIVER_VERSION) == INDIGO_OK) {
		// Room for the largest number of slots is made now, before a bus thread can look at the properties: on connect only the count
		// changes, so the properties never move while indigo_wheel_change_property() may use them on a bus thread.
		int count = WHEEL_SLOT_NAME_PROPERTY->count;
		WHEEL_SLOT_NAME_PROPERTY = indigo_resize_property(indigo_resize_property(WHEEL_SLOT_NAME_PROPERTY, WHEEL_MAX_SLOTS), count);
		WHEEL_SLOT_OFFSET_PROPERTY = indigo_resize_property(indigo_resize_property(WHEEL_SLOT_OFFSET_PROPERTY, WHEEL_MAX_SLOTS), count);
		return system_alpaca_attach(device) == INDIGO_OK ? wheel_enumerate_properties(device, NULL, NULL) : INDIGO_FAILED;
	}
	return INDIGO_FAILED;
}

static indigo_result wheel_enumerate_properties(indigo_device *device, indigo_client *client, indigo_property *property) {
	return indigo_wheel_enumerate_properties(device, client, property);
}

static indigo_result wheel_change_property(indigo_device *device, indigo_client *client, indigo_property *property) {
	if (system_alpaca_change_property(device, property)) {
		return INDIGO_OK;
	}
	if (indigo_property_match_changeable(WHEEL_SLOT_PROPERTY, property)) {
		system_alpaca_accept(device, WHEEL_SLOT_PROPERTY, property, ALPACA_ACCEPT_TARGETS, NULL, wheel_slot_handler);
		return INDIGO_OK;
	}
	return indigo_wheel_change_property(device, client, property);
}

static indigo_result wheel_detach(indigo_device *device) {
	assert(device != NULL);
	system_alpaca_detach(device);
	INDIGO_DEVICE_DETACH_LOG(DRIVER_NAME, device->name);
	return indigo_wheel_detach(device);
}

#pragma mark - Device class

const alpaca_class system_alpaca_wheel_class = {
	.device_type = "FilterWheel",
	.platform7_version = 3,
	.data_size = sizeof(wheel_data),
	.attach = wheel_attach,
	.enumerate_properties = wheel_enumerate_properties,
	.change_property = wheel_change_property,
	.detach = wheel_detach,
	.base_change_property = indigo_wheel_change_property,
	.on_probe = wheel_on_probe,
	.on_connect = wheel_on_connect,
	.on_disconnect = wheel_on_disconnect,
	.on_poll = wheel_on_poll
};
