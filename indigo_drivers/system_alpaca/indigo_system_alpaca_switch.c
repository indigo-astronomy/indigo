// Copyright (c) 2026 CloudMakers, s. r. o.
// All rights reserved.
//
// You can use this software under the terms of 'INDIGO Astronomy
// open-source license' (see LICENSE.md).
//
// THIS SOFTWARE IS PROVIDED BY THE AUTHORS 'AS IS' AND ANY EXPRESS
// OR IMPLIED WARRANTIES, INCLUDING, BUT NOT LIMITED TO, THE IMPLIED
// WARRANTIES OF MERCHANTABILITY AND FITNESS FOR A PARTICULAR PURPOSE
// ARE DISCLAIMED. IN NO EVENT SHALL THE AUTHOR BE LIABLE FOR ANY
// DIRECT, INDIRECT, INCIDENTAL, SPECIAL, EXEMPLARY, OR CONSEQUENTIAL
// DAMAGES (INCLUDING, BUT NOT LIMITED TO, PROCUREMENT OF SUBSTITUTE
// GOODS OR SERVICES; LOSS OF USE, DATA, OR PROFITS; OR BUSINESS
// INTERRUPTION) HOWEVER CAUSED AND ON ANY THEORY OF LIABILITY,
// WHETHER IN CONTRACT, STRICT LIABILITY, OR TORT (INCLUDING
// NEGLIGENCE OR OTHERWISE) ARISING IN ANY WAY OUT OF THE USE OF THIS
// SOFTWARE, EVEN IF ADVISED OF THE POSSIBILITY OF SUCH DAMAGE.

// version history
// 3.0 by Peter Polakovic <peter.polakovic@cloudmakers.eu>

// Code is generated by AI

/** INDIGO ASCOM Alpaca client driver, Switch device class: Alpaca Switch as an INDIGO GPIO device
 \file indigo_system_alpaca_switch.c

 An Alpaca Switch is a list of MaxSwitch numbered "switch devices". Each of them is read once per connection (name, description,
 CanWrite, MinSwitchValue, MaxSwitchValue, SwitchStep, on interface version 3 CanAsync) and becomes one item of one of three properties:

 - a writable boolean switch (minimum 0, maximum 1, step 1) is an item of AUX_GPIO_OUTLETS, set with setswitch;
 - any other writable switch is an item of X_ALPACA_SWITCH_VALUES with the range and step of the device, set with setswitchvalue;
 - a switch that can not be written is an item of AUX_GPIO_SENSORS, a boolean one with the values 0 and 1.

 The items are numbered from 1 within their property (OUTLET_1, VALUE_1, SENSOR_1...) in the order of the Alpaca switch numbers and
 are labelled with the Alpaca names. X_ALPACA_SWITCH_INFO tells which item an Alpaca switch number became and holds its description.
 AUX_OUTLET_NAMES (outlets and values) and AUX_SENSOR_NAMES hold the names of the device. A changed name is sent with setswitchname;
 a switch whose name the device does not let the client set (NotImplemented) keeps the name of the device and is not asked again.
 The names are not saved by INDIGO, the device is the only place they are kept in.

 A switch with CanAsync is set with setasync / setasyncvalue: the property stays BUSY while a finalizer polls statechangecomplete,
 for no longer than the long timeout of the server, and X_ALPACA_SWITCH_ABORT sends cancelasync for the changes that are running.

 Polling: on a Platform 7 device the values come from the devicestate snapshot of the tick (GetSwitch<n> / GetSwitchValue<n>).
 What the snapshot does not have (older devices, or more switches than the snapshot holds) is read switch by switch, at most
 SWITCH_POLL_BATCH requests per tick, in turns.

 Threads: change_property runs on a bus thread, everything else on the handler queue of the device. A request is accepted
 with system_alpaca_accept() and the poll publishes the values of the device under the lock of the device, so a poll tick never
 replaces a request that was just accepted with the old state of the device.
 */

#pragma mark - Includes

#include <stdlib.h>
#include <stdio.h>
#include <string.h>
#include <assert.h>

#include <indigo/indigo_aux_driver.h>

#include "indigo_system_alpaca_private.h"

#pragma mark - Common definitions

#define SWITCH_GROUP												"Switches"

// Largest number of switches of one device the proxy represents; further ones are ignored.
#define SWITCH_LIMIT												128

// Largest number of switches read with a request of their own in one poll tick.
#define SWITCH_POLL_BATCH										8

typedef enum {
	SWITCH_OUTLET = 0,		///< writable boolean switch, item of AUX_GPIO_OUTLETS
	SWITCH_VALUE,					///< writable multi-state switch, item of X_ALPACA_SWITCH_VALUES
	SWITCH_SENSOR,				///< read-only switch, item of AUX_GPIO_SENSORS
	SWITCH_KIND_COUNT
} switch_kind;

typedef struct {
	char name[ALPACA_TEXT_SIZE];
	char description[ALPACA_TEXT_SIZE];
	double min;
	double max;
	double step;
	double value;					///< the last value read from the device, 0 or 1 for a boolean switch
	bool boolean;					///< read with getswitch and set with setswitch / setasync
	bool can_write;
	bool can_async;
	bool name_fixed;			///< setswitchname is not implemented for this switch
	bool pending;					///< an asynchronous change is running
	bool read_failed;			///< the last read of the value failed
	bool named;						///< the item is named by the last accepted request of its property, written under the lock of the device
	switch_kind kind;
	int index;						///< index of the item within the property of its kind
} switch_record;

typedef struct {
	indigo_property *properties[SWITCH_KIND_COUNT];
	indigo_property *outlet_names_property;
	indigo_property *sensor_names_property;
	indigo_property *info_property;
	indigo_property *abort_property;
	alpaca_operation operations[SWITCH_KIND_COUNT];
	bool failed[SWITCH_KIND_COUNT];					///< a change failed while asynchronous changes of the same property are still running
	bool poll_alert[SWITCH_KIND_COUNT];			///< the property is in ALERT because a value could not be read
	switch_record *switches;
	int count;
	int kind_count[SWITCH_KIND_COUNT];
	int async_count;
	int poll_cursor;
} switch_data;

#define SWITCH_DATA													((switch_data *)CLASS_DATA)

#pragma mark - Property definitions

#define AUX_GPIO_OUTLETS_PROPERTY						(SWITCH_DATA->properties[SWITCH_OUTLET])
#define X_ALPACA_SWITCH_VALUES_PROPERTY			(SWITCH_DATA->properties[SWITCH_VALUE])
#define AUX_GPIO_SENSORS_PROPERTY						(SWITCH_DATA->properties[SWITCH_SENSOR])
#define AUX_OUTLET_NAMES_PROPERTY						(SWITCH_DATA->outlet_names_property)
#define AUX_SENSOR_NAMES_PROPERTY						(SWITCH_DATA->sensor_names_property)
#define X_ALPACA_SWITCH_INFO_PROPERTY				(SWITCH_DATA->info_property)
#define X_ALPACA_SWITCH_ABORT_PROPERTY			(SWITCH_DATA->abort_property)
#define X_ALPACA_SWITCH_ABORT_ITEM					(X_ALPACA_SWITCH_ABORT_PROPERTY->items + 0)

#define X_ALPACA_SWITCH_VALUES_PROPERTY_NAME	"X_ALPACA_SWITCH_VALUES"
#define X_ALPACA_SWITCH_INFO_PROPERTY_NAME		"X_ALPACA_SWITCH_INFO"
#define X_ALPACA_SWITCH_ABORT_PROPERTY_NAME		"X_ALPACA_SWITCH_ABORT"
#define X_ALPACA_SWITCH_ABORT_ITEM_NAME				"ABORT"

#pragma mark - Low level code

static alpaca_result switch_get_bool(indigo_device *device, const char *member, int id, bool *value) {
	alpaca_param params[] = { ALPACA_INT_PARAM("Id", id) };
	return system_alpaca_check(device, alpaca_get_bool(system_alpaca_channel(device), member, params, 1, ALPACA_WAIT_STANDARD, value));
}

static alpaca_result switch_get_double(indigo_device *device, const char *member, int id, double *value) {
	alpaca_param params[] = { ALPACA_INT_PARAM("Id", id) };
	return system_alpaca_check(device, alpaca_get_double(system_alpaca_channel(device), member, params, 1, ALPACA_WAIT_STANDARD, value));
}

static alpaca_result switch_get_string(indigo_device *device, const char *member, int id, char *value, size_t size) {
	alpaca_param params[] = { ALPACA_INT_PARAM("Id", id) };
	return system_alpaca_check(device, alpaca_get_string(system_alpaca_channel(device), member, params, 1, ALPACA_WAIT_STANDARD, value, size));
}

// Value of a switch in the devicestate snapshot of the running poll tick; false if the snapshot does not have it.
static bool switch_state_value(indigo_device *device, int id, double *value) {
	char name[ALPACA_MEMBER_SIZE];
	bool state = false;
	if (SWITCH_DATA->switches[id].boolean) {
		snprintf(name, sizeof(name), "GetSwitch%d", id);
		if (!alpaca_state_bool(&PRIVATE_DATA->state, name, &state)) {
			return false;
		}
		*value = state ? 1 : 0;
		return true;
	}
	snprintf(name, sizeof(name), "GetSwitchValue%d", id);
	return alpaca_state_double(&PRIVATE_DATA->state, name, value);
}

// Read the value of a switch from the device and remember it.
static alpaca_result switch_read(indigo_device *device, int id) {
	switch_record *record = SWITCH_DATA->switches + id;
	double value = 0;
	bool state = false;
	alpaca_result result = record->boolean ? switch_get_bool(device, "getswitch", id, &state) : switch_get_double(device, "getswitchvalue", id, &value);
	if (result == ALPACA_OK) {
		record->value = record->boolean ? (state ? 1 : 0) : value;
	}
	record->read_failed = result != ALPACA_OK;
	return result;
}

// Start the change of a switch. A synchronous change may take as long as the device needs, so it gets the long timeout.
// Setting a value twice has the effect of setting it once, so every variant may be sent again after a socket error.
static alpaca_result switch_write(indigo_device *device, int id, double value) {
	switch_record *record = SWITCH_DATA->switches + id;
	if (record->boolean) {
		alpaca_param params[] = { ALPACA_INT_PARAM("Id", id), ALPACA_BOOL_PARAM("State", value != 0) };
		return system_alpaca_put(device, record->can_async ? "setasync" : "setswitch", params, 2, (record->can_async ? ALPACA_WAIT_STANDARD : ALPACA_WAIT_LONG) | ALPACA_REPLAYABLE);
	}
	alpaca_param params[] = { ALPACA_INT_PARAM("Id", id), ALPACA_DOUBLE_PARAM("Value", value) };
	return system_alpaca_put(device, record->can_async ? "setasyncvalue" : "setswitchvalue", params, 2, (record->can_async ? ALPACA_WAIT_STANDARD : ALPACA_WAIT_LONG) | ALPACA_REPLAYABLE);
}

// Text of a failed request in the form system_alpaca_finish() uses. It is taken right after the request, because the read back
// that follows replaces the error of the channel.
static void switch_failure(indigo_device *device, alpaca_result result, const char *action, const char *name, char *message, size_t size) {
	char reason[INDIGO_VALUE_SIZE];
	system_alpaca_reason(device, result, reason, sizeof(reason));
	snprintf(message, size, "%s '%s' failed: %s%s%s%s", action, name, alpaca_result_text(result), *reason ? " (" : "", reason, *reason ? ")" : "");
}

static indigo_item *switch_name_item(indigo_device *device, const switch_record *record) {
	if (record->kind == SWITCH_SENSOR) {
		return AUX_SENSOR_NAMES_PROPERTY->items + record->index;
	}
	return AUX_OUTLET_NAMES_PROPERTY->items + (record->kind == SWITCH_VALUE ? SWITCH_DATA->kind_count[SWITCH_OUTLET] : 0) + record->index;
}

// Copy the values read from the device to the items of the property of the given kind. Returns true if an item changed.
static bool switch_copy_values(indigo_device *device, switch_kind kind) {
	bool changed = false;
	for (int id = 0; id < SWITCH_DATA->count; id++) {
		switch_record *record = SWITCH_DATA->switches + id;
		if (record->kind != kind) {
			continue;
		}
		indigo_item *item = SWITCH_DATA->properties[kind]->items + record->index;
		if (kind == SWITCH_OUTLET) {
			changed = changed || item->sw.value != (record->value != 0);
			item->sw.value = record->value != 0;
		} else {
			changed = changed || item->number.value != record->value || item->number.target != record->value;
			item->number.value = item->number.target = record->value;
		}
	}
	return changed;
}

static void switch_set_interface(indigo_device *device, int interface) {
	char text[16];
	snprintf(text, sizeof(text), "%d", interface);
	if (strcmp(INFO_DEVICE_INTERFACE_ITEM->text.value, text)) {
		INDIGO_COPY_VALUE(INFO_DEVICE_INTERFACE_ITEM->text.value, text);
		indigo_update_property(device, INFO_PROPERTY, NULL);
	}
}

// A property of the previous connection is reused; one the device has no items for any more is released.
static void switch_drop_property(indigo_property **property) {
	indigo_release_property(*property);
	*property = NULL;
}

// Handler queue: end a request. The state is set under the lock, the property is published without it.
static void switch_finish(indigo_device *device, indigo_property *property, const char *message) {
	system_alpaca_set_state(device, property, message != NULL && *message ? INDIGO_ALERT_STATE : INDIGO_OK_STATE);
	if (message != NULL && *message) {
		indigo_update_property(device, property, "%s", message);
	} else {
		indigo_update_property(device, property, NULL);
	}
}

#pragma mark - High level code (switch)

// Completion of the asynchronous changes of one property: every running change is asked for StateChangeComplete, the value of a
// finished one is read back, and the property leaves BUSY when none is left.
static void switch_finalize(indigo_device *device, switch_kind kind, indigo_timer_callback finalizer) {
	indigo_property *property = SWITCH_DATA->properties[kind];
	alpaca_operation *operation = SWITCH_DATA->operations + kind;
	char message[INDIGO_VALUE_SIZE] = { 0 };
	bool running = false;
	for (int id = 0; id < SWITCH_DATA->count; id++) {
		switch_record *record = SWITCH_DATA->switches + id;
		bool complete = false;
		if (record->kind != kind || !record->pending) {
			continue;
		}
		alpaca_result result = switch_get_bool(device, "statechangecomplete", id, &complete);
		if (result == ALPACA_OK && !complete) {
			running = true;
			continue;
		}
		record->pending = false;
		if (result != ALPACA_OK && *message == 0) {
			switch_failure(device, result, "Change of", record->name, message, sizeof(message));
		}
		if (!alpaca_is_transport_error(result)) {
			result = switch_read(device, id);
			if (result != ALPACA_OK && *message == 0) {
				switch_failure(device, result, "Reading", record->name, message, sizeof(message));
			}
		}
	}
	if (*message) {
		SWITCH_DATA->failed[kind] = true;
	}
	if (running && system_alpaca_operation_continue(device, operation, finalizer)) {
		if (*message) {
			indigo_update_property(device, property, "%s", message);
		}
		return;
	}
	if (running) {
		for (int id = 0; id < SWITCH_DATA->count; id++) {
			switch_record *record = SWITCH_DATA->switches + id;
			if (record->kind == kind && record->pending) {
				record->pending = false;
				if (*message == 0) {
					snprintf(message, sizeof(message), "Change of '%s' failed: %s", record->name, alpaca_result_text(ALPACA_TIMED_OUT));
				}
			}
		}
		SWITCH_DATA->failed[kind] = true;
	}
	system_alpaca_operation_end(device, operation);
	switch_copy_values(device, kind);
	system_alpaca_set_state(device, property, SWITCH_DATA->failed[kind] ? INDIGO_ALERT_STATE : INDIGO_OK_STATE);
	SWITCH_DATA->failed[kind] = false;
	if (*message) {
		indigo_update_property(device, property, "%s", message);
	} else {
		indigo_update_property(device, property, NULL);
	}
}

static void switch_outlets_finalizer(indigo_device *device) {
	if (!system_alpaca_is_active(device)) {
		return;
	}
	switch_finalize(device, SWITCH_OUTLET, switch_outlets_finalizer);
}

static void switch_values_finalizer(indigo_device *device) {
	if (!system_alpaca_is_active(device)) {
		return;
	}
	switch_finalize(device, SWITCH_VALUE, switch_values_finalizer);
}

// A change of AUX_GPIO_OUTLETS or X_ALPACA_SWITCH_VALUES: every switch the request names or whose requested value differs from the value
// of the device is set, the synchronous ones first. The first failure ends the request; the values of the device are published in any case.
static void switch_change(indigo_device *device, switch_kind kind, indigo_timer_callback finalizer) {
	indigo_property *property = SWITCH_DATA->properties[kind];
	char message[INDIGO_VALUE_SIZE] = { 0 };
	bool running = false;
	for (int pass = 0; pass < 2 && *message == 0; pass++) {
		for (int id = 0; id < SWITCH_DATA->count && *message == 0; id++) {
			switch_record *record = SWITCH_DATA->switches + id;
			if (record->kind != kind || record->can_async != (pass == 1)) {
				continue;
			}
			indigo_item *item = property->items + record->index;
			double requested = kind == SWITCH_OUTLET ? (item->sw.value ? 1 : 0) : item->number.target;
			// a switch the request names is set even if the last value read from it is the requested one: the poll may not have seen
			// the device change it since (without devicestate a tick reads SWITCH_POLL_BATCH switches), and setting it again does no harm
			if (requested == record->value && !record->named) {
				continue;
			}
			alpaca_result result = switch_write(device, id, requested);
			if (result == ALPACA_OK && record->can_async) {
				record->pending = true;
				running = true;
				continue;
			}
			if (result != ALPACA_OK) {
				switch_failure(device, result, "Change of", record->name, message, sizeof(message));
			}
			if (!alpaca_is_transport_error(result)) {
				// the value is read back after a success and after a failure the device may have executed all the same
				alpaca_result read_result = switch_read(device, id);
				if (read_result != ALPACA_OK && *message == 0) {
					switch_failure(device, read_result, "Reading", record->name, message, sizeof(message));
				} else if (result == ALPACA_OK && read_result == ALPACA_OK && record->boolean && record->value != requested) {
					snprintf(message, sizeof(message), "Change of '%s' failed: the device did not change it", record->name);
				}
			}
		}
	}
	if (running) {
		// the property stays BUSY until the finalizer has seen the end of every asynchronous change
		SWITCH_DATA->failed[kind] = *message != 0;
		if (*message) {
			indigo_update_property(device, property, "%s", message);
		}
		system_alpaca_operation_start(device, SWITCH_DATA->operations + kind, system_alpaca_long_timeout(device), finalizer);
		return;
	}
	switch_copy_values(device, kind);
	switch_finish(device, property, message);
}

static void switch_outlets_handler(indigo_device *device) {
	if (!system_alpaca_is_active(device)) {
		return;
	}
	switch_change(device, SWITCH_OUTLET, switch_outlets_finalizer);
}

static void switch_values_handler(indigo_device *device) {
	if (!system_alpaca_is_active(device)) {
		return;
	}
	switch_change(device, SWITCH_VALUE, switch_values_finalizer);
}

// A change of AUX_OUTLET_NAMES or AUX_SENSOR_NAMES: every changed name is sent to the device and read back. The property shows
// the names of the device afterwards, so a name the device did not take is back to what it was.
static void switch_rename(indigo_device *device, indigo_property *property, bool sensors) {
	char message[INDIGO_VALUE_SIZE] = { 0 };
	bool renamed[SWITCH_KIND_COUNT] = { false };
	for (int id = 0; id < SWITCH_DATA->count; id++) {
		switch_record *record = SWITCH_DATA->switches + id;
		if ((record->kind == SWITCH_SENSOR) != sensors) {
			continue;
		}
		indigo_item *item = switch_name_item(device, record);
		if (*message == 0 && strcmp(indigo_get_text_item_value(item), record->name)) {
			alpaca_param params[] = { ALPACA_INT_PARAM("Id", id), ALPACA_STRING_PARAM("Name", indigo_get_text_item_value(item)) };
			alpaca_result result = record->name_fixed ? ALPACA_UNSUPPORTED : system_alpaca_put(device, "setswitchname", params, 2, ALPACA_REPLAYABLE);
			if (system_alpaca_not_implemented(result, 2)) {
				record->name_fixed = true;
				snprintf(message, sizeof(message), "The device does not allow to rename '%s'", record->name);
			} else if (result != ALPACA_OK) {
				switch_failure(device, result, "Renaming", record->name, message, sizeof(message));
			}
			if (!record->name_fixed && !alpaca_is_transport_error(result)) {
				char name[ALPACA_TEXT_SIZE] = { 0 };
				alpaca_result read_result = switch_get_string(device, "getswitchname", id, name, sizeof(name));
				if (read_result != ALPACA_OK && *message == 0) {
					switch_failure(device, read_result, "Reading the name of", record->name, message, sizeof(message));
				} else if (read_result == ALPACA_OK && strcmp(name, record->name)) {
					snprintf(record->name, sizeof(record->name), "%s", name);
					renamed[record->kind] = true;
				}
			}
		}
		indigo_set_text_item_value(item, record->name);
	}
	for (int kind = 0; kind < SWITCH_KIND_COUNT; kind++) {
		if (renamed[kind]) {
			// the label of an item is part of the definition of its property
			indigo_delete_property(device, SWITCH_DATA->properties[kind], NULL);
			for (int id = 0; id < SWITCH_DATA->count; id++) {
				switch_record *record = SWITCH_DATA->switches + id;
				if ((int)record->kind == kind) {
					INDIGO_COPY_VALUE(SWITCH_DATA->properties[kind]->items[record->index].label, record->name);
				}
			}
			indigo_define_property(device, SWITCH_DATA->properties[kind], NULL);
		}
	}
	switch_finish(device, property, message);
}

static void switch_outlet_names_handler(indigo_device *device) {
	if (!system_alpaca_is_active(device)) {
		return;
	}
	switch_rename(device, AUX_OUTLET_NAMES_PROPERTY, false);
}

static void switch_sensor_names_handler(indigo_device *device) {
	if (!system_alpaca_is_active(device)) {
		return;
	}
	switch_rename(device, AUX_SENSOR_NAMES_PROPERTY, true);
}

// X_ALPACA_SWITCH_ABORT: cancelasync for every asynchronous change that is running. The finalizers of the changes see the
// result (StateChangeComplete answers OperationCancelled) and end the changes.
static void switch_abort_handler(indigo_device *device) {
	char message[INDIGO_VALUE_SIZE] = { 0 };
	alpaca_result result = ALPACA_OK;
	if (!system_alpaca_is_active(device)) {
		return;
	}
	for (int id = 0; id < SWITCH_DATA->count && X_ALPACA_SWITCH_ABORT_ITEM->sw.value && !alpaca_is_transport_error(result); id++) {
		if (SWITCH_DATA->switches[id].pending) {
			alpaca_param params[] = { ALPACA_INT_PARAM("Id", id) };
			alpaca_result cancel_result = system_alpaca_put(device, "cancelasync", params, 1, ALPACA_REPLAYABLE);
			if (cancel_result != ALPACA_OK) {
				result = cancel_result;
				if (*message == 0) {
					switch_failure(device, result, "Cancel of the change of", SWITCH_DATA->switches[id].name, message, sizeof(message));
				}
			}
		}
	}
	X_ALPACA_SWITCH_ABORT_ITEM->sw.value = false;
	switch_finish(device, X_ALPACA_SWITCH_ABORT_PROPERTY, message);
}

// Read the list of switches. Only a transport error and a device without a usable MaxSwitch fail the connection; a switch that does
// not answer one of its members gets a default for it (a generated name, read-only, a boolean range).
static bool switch_on_probe(indigo_device *device) {
	int count = 0;
	indigo_safe_free(SWITCH_DATA->switches);
	SWITCH_DATA->switches = NULL;
	SWITCH_DATA->count = SWITCH_DATA->async_count = SWITCH_DATA->poll_cursor = 0;
	if (system_alpaca_get_int(device, "maxswitch", &count) != ALPACA_OK) {
		return false;
	}
	if (count > SWITCH_LIMIT) {
		indigo_send_message(device, ALERT_PROPERTY, "%s has %d switches, only the first %d are used", device->name, count, SWITCH_LIMIT);
		count = SWITCH_LIMIT;
	}
	if (count <= 0) {
		return true;
	}
	SWITCH_DATA->switches = indigo_safe_malloc(count * sizeof(switch_record));
	for (int id = 0; id < count; id++) {
		switch_record *record = SWITCH_DATA->switches + id;
		alpaca_result results[8] = { ALPACA_OK };
		results[0] = switch_get_string(device, "getswitchname", id, record->name, sizeof(record->name));
		results[1] = switch_get_string(device, "getswitchdescription", id, record->description, sizeof(record->description));
		results[2] = switch_get_bool(device, "canwrite", id, &record->can_write);
		results[3] = switch_get_double(device, "minswitchvalue", id, &record->min);
		results[4] = switch_get_double(device, "maxswitchvalue", id, &record->max);
		results[5] = switch_get_double(device, "switchstep", id, &record->step);
		if (PRIVATE_DATA->interface_version >= 3) {
			results[6] = switch_get_bool(device, "canasync", id, &record->can_async);
		}
		for (int i = 0; i < 7; i++) {
			if (alpaca_is_transport_error(results[i])) {
				return false;
			}
		}
		if (results[0] != ALPACA_OK || *record->name == 0) {
			snprintf(record->name, sizeof(record->name), "Switch %d", id);
		}
		if (results[1] != ALPACA_OK) {
			*record->description = 0;
		}
		if (results[3] != ALPACA_OK || results[4] != ALPACA_OK || !(record->max > record->min)) {
			// without a usable range the switch is taken for a boolean one that can only be read
			record->min = 0;
			record->max = record->step = 1;
			record->can_write = false;
		} else if (results[5] != ALPACA_OK || !(record->step > 0)) {
			record->step = 0;
		}
		record->can_write = record->can_write && results[2] == ALPACA_OK;
		record->can_async = record->can_async && record->can_write && results[6] == ALPACA_OK;
		record->boolean = record->min == 0 && record->max == 1 && record->step == 1;
		record->kind = !record->can_write ? SWITCH_SENSOR : record->boolean ? SWITCH_OUTLET : SWITCH_VALUE;
		if (alpaca_is_transport_error(switch_read(device, id))) {
			return false;
		}
		SWITCH_DATA->count = id + 1;
	}
	return true;
}

// Build the properties from the list of switches. The counts are set before anything is defined.
static bool switch_on_connect(indigo_device *device) {
	static const char *property_names[SWITCH_KIND_COUNT] = { AUX_GPIO_OUTLETS_PROPERTY_NAME, X_ALPACA_SWITCH_VALUES_PROPERTY_NAME, AUX_GPIO_SENSORS_PROPERTY_NAME };
	static const char *item_names[SWITCH_KIND_COUNT] = { "OUTLET_%d", "VALUE_%d", "SENSOR_%d" };
	static const char *name_item_names[SWITCH_KIND_COUNT] = { "GPIO_OUTLET_NAME_%d", "VALUE_NAME_%d", "GPIO_SENSOR_NAME_%d" };
	int *kind_count = SWITCH_DATA->kind_count;
	char name[INDIGO_NAME_SIZE], item_name[INDIGO_NAME_SIZE], label[INDIGO_NAME_SIZE];
	memset(SWITCH_DATA->kind_count, 0, sizeof(SWITCH_DATA->kind_count));
	memset(SWITCH_DATA->failed, 0, sizeof(SWITCH_DATA->failed));
	memset(SWITCH_DATA->poll_alert, 0, sizeof(SWITCH_DATA->poll_alert));
	for (int id = 0; id < SWITCH_DATA->count; id++) {
		switch_record *record = SWITCH_DATA->switches + id;
		record->index = kind_count[record->kind]++;
		SWITCH_DATA->async_count += record->can_async ? 1 : 0;
		SWITCH_DATA->poll_alert[record->kind] = SWITCH_DATA->poll_alert[record->kind] || record->read_failed;
	}
	if (kind_count[SWITCH_OUTLET] > 0) {
		AUX_GPIO_OUTLETS_PROPERTY = indigo_init_switch_property(AUX_GPIO_OUTLETS_PROPERTY, device->name, AUX_GPIO_OUTLETS_PROPERTY_NAME, SWITCH_GROUP, "Outlets", INDIGO_OK_STATE, INDIGO_RW_PERM, INDIGO_ANY_OF_MANY_RULE, kind_count[SWITCH_OUTLET]);
	} else {
		switch_drop_property(&AUX_GPIO_OUTLETS_PROPERTY);
	}
	if (kind_count[SWITCH_VALUE] > 0) {
		X_ALPACA_SWITCH_VALUES_PROPERTY = indigo_init_number_property(X_ALPACA_SWITCH_VALUES_PROPERTY, device->name, X_ALPACA_SWITCH_VALUES_PROPERTY_NAME, SWITCH_GROUP, "Values", INDIGO_OK_STATE, INDIGO_RW_PERM, kind_count[SWITCH_VALUE]);
	} else {
		switch_drop_property(&X_ALPACA_SWITCH_VALUES_PROPERTY);
	}
	if (kind_count[SWITCH_SENSOR] > 0) {
		AUX_GPIO_SENSORS_PROPERTY = indigo_init_number_property(AUX_GPIO_SENSORS_PROPERTY, device->name, AUX_GPIO_SENSORS_PROPERTY_NAME, SWITCH_GROUP, "Sensors", INDIGO_OK_STATE, INDIGO_RO_PERM, kind_count[SWITCH_SENSOR]);
		AUX_SENSOR_NAMES_PROPERTY = indigo_init_text_property(AUX_SENSOR_NAMES_PROPERTY, device->name, AUX_SENSOR_NAMES_PROPERTY_NAME, SWITCH_GROUP, "Sensor names", INDIGO_OK_STATE, INDIGO_RW_PERM, kind_count[SWITCH_SENSOR]);
	} else {
		switch_drop_property(&AUX_GPIO_SENSORS_PROPERTY);
		switch_drop_property(&AUX_SENSOR_NAMES_PROPERTY);
	}
	if (kind_count[SWITCH_OUTLET] + kind_count[SWITCH_VALUE] > 0) {
		AUX_OUTLET_NAMES_PROPERTY = indigo_init_text_property(AUX_OUTLET_NAMES_PROPERTY, device->name, AUX_OUTLET_NAMES_PROPERTY_NAME, SWITCH_GROUP, "Outlet names", INDIGO_OK_STATE, INDIGO_RW_PERM, kind_count[SWITCH_OUTLET] + kind_count[SWITCH_VALUE]);
	} else {
		switch_drop_property(&AUX_OUTLET_NAMES_PROPERTY);
	}
	if (SWITCH_DATA->count > 0) {
		X_ALPACA_SWITCH_INFO_PROPERTY = indigo_init_text_property(X_ALPACA_SWITCH_INFO_PROPERTY, device->name, X_ALPACA_SWITCH_INFO_PROPERTY_NAME, SWITCH_GROUP, "Alpaca switches", INDIGO_OK_STATE, INDIGO_RO_PERM, SWITCH_DATA->count);
	} else {
		switch_drop_property(&X_ALPACA_SWITCH_INFO_PROPERTY);
	}
	if (SWITCH_DATA->async_count > 0) {
		X_ALPACA_SWITCH_ABORT_PROPERTY = indigo_init_switch_property(X_ALPACA_SWITCH_ABORT_PROPERTY, device->name, X_ALPACA_SWITCH_ABORT_PROPERTY_NAME, SWITCH_GROUP, "Cancel asynchronous changes", INDIGO_OK_STATE, INDIGO_RW_PERM, INDIGO_ANY_OF_MANY_RULE, 1);
		indigo_init_switch_item(X_ALPACA_SWITCH_ABORT_ITEM, X_ALPACA_SWITCH_ABORT_ITEM_NAME, "Cancel", false);
	} else {
		switch_drop_property(&X_ALPACA_SWITCH_ABORT_PROPERTY);
	}
	for (int id = 0; id < SWITCH_DATA->count; id++) {
		switch_record *record = SWITCH_DATA->switches + id;
		indigo_item *item = SWITCH_DATA->properties[record->kind]->items + record->index;
		snprintf(item_name, sizeof(item_name), item_names[record->kind], record->index + 1);
		if (record->kind == SWITCH_OUTLET) {
			indigo_init_switch_item(item, item_name, record->name, record->value != 0);
		} else {
			indigo_init_number_item(item, item_name, record->name, record->min, record->max, record->step, record->value);
		}
		snprintf(name, sizeof(name), "SWITCH_%d", id);
		snprintf(label, sizeof(label), "Switch %d", id);
		indigo_init_text_item(X_ALPACA_SWITCH_INFO_PROPERTY->items + id, name, label, "%s.%s%s%s", property_names[record->kind], item_name, *record->description ? ": " : "", record->description);
		snprintf(name, sizeof(name), name_item_names[record->kind], record->index + 1);
		indigo_init_text_item_raw(switch_name_item(device, record), name, label, record->name);
	}
	for (int kind = 0; kind < SWITCH_KIND_COUNT; kind++) {
		if (SWITCH_DATA->properties[kind] != NULL) {
			SWITCH_DATA->properties[kind]->state = SWITCH_DATA->poll_alert[kind] ? INDIGO_ALERT_STATE : INDIGO_OK_STATE;
			indigo_define_property(device, SWITCH_DATA->properties[kind], NULL);
		}
	}
	indigo_define_property(device, AUX_OUTLET_NAMES_PROPERTY, NULL);
	indigo_define_property(device, AUX_SENSOR_NAMES_PROPERTY, NULL);
	indigo_define_property(device, X_ALPACA_SWITCH_INFO_PROPERTY, NULL);
	indigo_define_property(device, X_ALPACA_SWITCH_ABORT_PROPERTY, NULL);
	// the Alpaca interface does not tell what a switch is used for, so the proxy is a GPIO device and never a powerbox
	switch_set_interface(device, SWITCH_DATA->count > 0 ? INDIGO_INTERFACE_AUX_GPIO : INDIGO_INTERFACE_AUX);
	return true;
}

// An asynchronous change that is running is left to the device, it is not cancelled.
static void switch_on_disconnect(indigo_device *device) {
	for (int kind = 0; kind < SWITCH_KIND_COUNT; kind++) {
		system_alpaca_operation_end(device, SWITCH_DATA->operations + kind);
		indigo_delete_property(device, SWITCH_DATA->properties[kind], NULL);
	}
	indigo_delete_property(device, AUX_OUTLET_NAMES_PROPERTY, NULL);
	indigo_delete_property(device, AUX_SENSOR_NAMES_PROPERTY, NULL);
	indigo_delete_property(device, X_ALPACA_SWITCH_INFO_PROPERTY, NULL);
	indigo_delete_property(device, X_ALPACA_SWITCH_ABORT_PROPERTY, NULL);
	for (int id = 0; id < SWITCH_DATA->count; id++) {
		SWITCH_DATA->switches[id].pending = false;
	}
	switch_set_interface(device, INDIGO_INTERFACE_AUX_GPIO);
}

// Poll tick: the values of the switches whose property is not BUSY. A property is in ALERT while a value of it can not be read.
static void switch_on_poll(indigo_device *device) {
	char message[INDIGO_VALUE_SIZE] = { 0 };
	bool busy[SWITCH_KIND_COUNT] = { false };
	int budget = SWITCH_POLL_BATCH, last = -1;
	alpaca_result result = ALPACA_OK;
	system_alpaca_lock(device);
	for (int kind = 0; kind < SWITCH_KIND_COUNT; kind++) {
		busy[kind] = SWITCH_DATA->properties[kind] != NULL && SWITCH_DATA->properties[kind]->state == INDIGO_BUSY_STATE;
	}
	system_alpaca_unlock(device);
	for (int n = 0; n < SWITCH_DATA->count && !alpaca_is_transport_error(result); n++) {
		int id = (SWITCH_DATA->poll_cursor + n) % SWITCH_DATA->count;
		switch_record *record = SWITCH_DATA->switches + id;
		double value = 0;
		if (busy[record->kind]) {
			continue;
		}
		if (switch_state_value(device, id, &value)) {
			record->value = value;
			record->read_failed = false;
		} else if (budget > 0) {
			bool failed = record->read_failed;
			budget--;
			last = id;
			result = switch_read(device, id);
			if (result != ALPACA_OK && !failed && *message == 0) {
				switch_failure(device, result, "Reading", record->name, message, sizeof(message));
			}
		}
	}
	if (last >= 0) {
		SWITCH_DATA->poll_cursor = (last + 1) % SWITCH_DATA->count;
	}
	for (int kind = 0; kind < SWITCH_KIND_COUNT; kind++) {
		indigo_property *property = SWITCH_DATA->properties[kind];
		bool alert = false, changed = false;
		if (property == NULL || busy[kind]) {
			continue;
		}
		for (int id = 0; id < SWITCH_DATA->count; id++) {
			alert = alert || ((int)SWITCH_DATA->switches[id].kind == kind && SWITCH_DATA->switches[id].read_failed);
		}
		// a request that was accepted since the tick started keeps its values: the property is BUSY then
		system_alpaca_lock(device);
		if (property->state != INDIGO_BUSY_STATE) {
			changed = switch_copy_values(device, kind);
			if (alert != SWITCH_DATA->poll_alert[kind]) {
				SWITCH_DATA->poll_alert[kind] = alert;
				property->state = alert ? INDIGO_ALERT_STATE : INDIGO_OK_STATE;
				changed = true;
			}
		}
		system_alpaca_unlock(device);
		if (changed && alert && *message) {
			indigo_update_property(device, property, "%s", message);
		} else if (changed) {
			indigo_update_property(device, property, NULL);
		}
	}
}

// Bus thread: the steps of system_alpaca_accept() for AUX_GPIO_OUTLETS and X_ALPACA_SWITCH_VALUES, and which switches the request names.
static void switch_accept(indigo_device *device, switch_kind kind, indigo_property *request, indigo_timer_callback handler) {
	indigo_property *property = SWITCH_DATA->properties[kind];
	system_alpaca_lock(device);
	bool accepted = property->state != INDIGO_BUSY_STATE;
	if (accepted) {
		for (int id = 0; id < SWITCH_DATA->count; id++) {
			switch_record *record = SWITCH_DATA->switches + id;
			if (record->kind == kind) {
				record->named = indigo_get_item(request, property->items[record->index].name) != NULL;
			}
		}
		if (kind == SWITCH_OUTLET) {
			indigo_property_copy_values(property, request, false);
		} else {
			indigo_property_copy_targets(property, request, false);
		}
		property->state = INDIGO_BUSY_STATE;
	}
	system_alpaca_unlock(device);
	if (accepted) {
		indigo_update_property(device, property, NULL);
		indigo_execute_handler(device, handler);
	}
}

#pragma mark - Device API (switch)

static indigo_result switch_enumerate_properties(indigo_device *device, indigo_client *client, indigo_property *property);

static indigo_result switch_attach(indigo_device *device) {
	assert(device != NULL);
	if (indigo_aux_attach(device, DRIVER_NAME, DRIVER_VERSION, INDIGO_INTERFACE_AUX_GPIO) == INDIGO_OK) {
		return system_alpaca_attach(device) == INDIGO_OK ? switch_enumerate_properties(device, NULL, NULL) : INDIGO_FAILED;
	}
	return INDIGO_FAILED;
}

static indigo_result switch_enumerate_properties(indigo_device *device, indigo_client *client, indigo_property *property) {
	if (system_alpaca_is_active(device)) {
		INDIGO_DEFINE_MATCHING_PROPERTY(AUX_GPIO_OUTLETS_PROPERTY);
		INDIGO_DEFINE_MATCHING_PROPERTY(X_ALPACA_SWITCH_VALUES_PROPERTY);
		INDIGO_DEFINE_MATCHING_PROPERTY(AUX_GPIO_SENSORS_PROPERTY);
		INDIGO_DEFINE_MATCHING_PROPERTY(AUX_OUTLET_NAMES_PROPERTY);
		INDIGO_DEFINE_MATCHING_PROPERTY(AUX_SENSOR_NAMES_PROPERTY);
		INDIGO_DEFINE_MATCHING_PROPERTY(X_ALPACA_SWITCH_INFO_PROPERTY);
		INDIGO_DEFINE_MATCHING_PROPERTY(X_ALPACA_SWITCH_ABORT_PROPERTY);
	}
	return indigo_aux_enumerate_properties(device, client, property);
}

static indigo_result switch_change_property(indigo_device *device, indigo_client *client, indigo_property *property) {
	if (system_alpaca_change_property(device, property)) {
		return INDIGO_OK;
	}
	// the properties of the class are built on every connection: they exist, and their pointers are read, only while the session is open
	if (!system_alpaca_is_active(device)) {
		return indigo_aux_change_property(device, client, property);
	}
	if (indigo_property_match_changeable(AUX_GPIO_OUTLETS_PROPERTY, property)) {
		switch_accept(device, SWITCH_OUTLET, property, switch_outlets_handler);
		return INDIGO_OK;
	}
	if (indigo_property_match_changeable(X_ALPACA_SWITCH_VALUES_PROPERTY, property)) {
		switch_accept(device, SWITCH_VALUE, property, switch_values_handler);
		return INDIGO_OK;
	}
	if (indigo_property_match_changeable(AUX_OUTLET_NAMES_PROPERTY, property)) {
		system_alpaca_accept(device, AUX_OUTLET_NAMES_PROPERTY, property, ALPACA_ACCEPT_VALUES, NULL, switch_outlet_names_handler);
		return INDIGO_OK;
	}
	if (indigo_property_match_changeable(AUX_SENSOR_NAMES_PROPERTY, property)) {
		system_alpaca_accept(device, AUX_SENSOR_NAMES_PROPERTY, property, ALPACA_ACCEPT_VALUES, NULL, switch_sensor_names_handler);
		return INDIGO_OK;
	}
	if (indigo_property_match_changeable(X_ALPACA_SWITCH_ABORT_PROPERTY, property)) {
		system_alpaca_accept(device, X_ALPACA_SWITCH_ABORT_PROPERTY, property, ALPACA_ACCEPT_VALUES, NULL, switch_abort_handler);
		return INDIGO_OK;
	}
	return indigo_aux_change_property(device, client, property);
}

static indigo_result switch_detach(indigo_device *device) {
	assert(device != NULL);
	system_alpaca_detach(device);
	for (int kind = 0; kind < SWITCH_KIND_COUNT; kind++) {
		indigo_release_property(SWITCH_DATA->properties[kind]);
	}
	indigo_release_property(AUX_OUTLET_NAMES_PROPERTY);
	indigo_release_property(AUX_SENSOR_NAMES_PROPERTY);
	indigo_release_property(X_ALPACA_SWITCH_INFO_PROPERTY);
	indigo_release_property(X_ALPACA_SWITCH_ABORT_PROPERTY);
	indigo_safe_free(SWITCH_DATA->switches);
	INDIGO_DEVICE_DETACH_LOG(DRIVER_NAME, device->name);
	return indigo_aux_detach(device);
}

#pragma mark - Device class

const alpaca_class system_alpaca_switch_class = {
	.device_type = "Switch",
	.platform7_version = 3,
	.data_size = sizeof(switch_data),
	.attach = switch_attach,
	.enumerate_properties = switch_enumerate_properties,
	.change_property = switch_change_property,
	.detach = switch_detach,
	.base_change_property = indigo_aux_change_property,
	.on_probe = switch_on_probe,
	.on_connect = switch_on_connect,
	.on_disconnect = switch_on_disconnect,
	.on_poll = switch_on_poll
};
