// Copyright (c) 2026 CloudMakers, s. r. o.
// All rights reserved.
//
// You can use this software under the terms of 'INDIGO Astronomy
// open-source license' (see LICENSE.md).
//
// THIS SOFTWARE IS PROVIDED BY THE AUTHORS 'AS IS' AND ANY EXPRESS
// OR IMPLIED WARRANTIES, INCLUDING, BUT NOT LIMITED TO, THE IMPLIED
// WARRANTIES OF MERCHANTABILITY AND FITNESS FOR A PARTICULAR PURPOSE
// ARE DISCLAIMED. IN NO EVENT SHALL THE AUTHOR BE LIABLE FOR ANY
// DIRECT, INDIRECT, INCIDENTAL, SPECIAL, EXEMPLARY, OR CONSEQUENTIAL
// DAMAGES (INCLUDING, BUT NOT LIMITED TO, PROCUREMENT OF SUBSTITUTE
// GOODS OR SERVICES; LOSS OF USE, DATA, OR PROFITS; OR BUSINESS
// INTERRUPTION) HOWEVER CAUSED AND ON ANY THEORY OF LIABILITY,
// WHETHER IN CONTRACT, STRICT LIABILITY, OR TORT (INCLUDING
// NEGLIGENCE OR OTHERWISE) ARISING IN ANY WAY OUT OF THE USE OF THIS
// SOFTWARE, EVEN IF ADVISED OF THE POSSIBILITY OF SUCH DAMAGE.

// version history
// 3.0 by Peter Polakovic <peter.polakovic@cloudmakers.eu>

// Code is generated by AI

/** INDIGO ASCOM Alpaca client driver, Focuser device class: Alpaca Focuser as an INDIGO focuser
 \file indigo_system_alpaca_focuser.c

 Mapping of the Alpaca members onto the INDIGO properties:

 - Absolute, Position, MaxStep: an absolute focuser has FOCUSER_POSITION (0 ... MaxStep, the value is the measured Position and the
   target the requested one) and the read-only FOCUSER_LIMITS (0 and MaxStep). A relative focuser has neither: there is no position
   to show and none is made up.
 - Move: a change of FOCUSER_POSITION is "PUT move Position=<target>". FOCUSER_STEPS with FOCUSER_DIRECTION is a relative move:
   for an absolute focuser the target is computed from a fresh Position and kept within 0 ... MaxStep, for a relative one the signed
   number of steps is sent. MOVE_INWARD is the negative direction, as in the other INDIGO focuser drivers; Alpaca does not say
   which sign is inward, so FOCUSER_REVERSE_MOTION, a setting of the driver that is never sent to the device, swaps the two.
   MaxIncrement is the upper limit of FOCUSER_STEPS.
 - IsMoving: completion of a move (focuser_move_finalizer), for no longer than FOCUSER_MOVE_TIMEOUT_FACTOR times the long request
   timeout. Some focusers report IsMoving false before Position has reached the target (the Askar-WAF focuser, Alpaca server
   1.0.7, is at 986 when IsMoving turns false and at 984, the target, a moment later). So when IsMoving turns false at the end of a
   move of an absolute focuser at a Position other than the target, the move is watched on while Position settles, until it is the
   target, IsMoving is true again (the move goes on) or FOCUSER_MOVE_SETTLE_TIME seconds have passed; the move then ends as before,
   OK with the Position that was read last (HW-5). Motion the driver did not start (a hand controller, temperature compensation, another client) shows as FOCUSER_POSITION
   in the BUSY state. While IsMoving or Position can not be read (the device answers with an error) FOCUSER_POSITION is in ALERT
   with the last position; it is OK again with the first position that is read.
 - Halt: FOCUSER_ABORT_MOTION. A focuser without Halt answers NotImplemented to the first request; the property is removed then.
   A move stopped by Halt ends in ALERT at once. A focuser may report IsMoving for a while after Halt (OmniSim does for its settle
   time); while it does so at the position where it stopped, for at most FOCUSER_HALT_SETTLE_TIME seconds, that is the stopped move
   settling and not a new motion of the device, so FOCUSER_POSITION stays in ALERT.
 - Temperature: FOCUSER_TEMPERATURE, hidden if the member is not implemented.
 - TempCompAvailable, TempComp: FOCUSER_MODE, hidden if compensation is not available. AUTOMATIC is TempComp=True. As in every
   INDIGO focuser driver the motion properties are removed and FOCUSER_POSITION is read-only while the mode is AUTOMATIC, so no move
   is requested while the device compensates, whatever its interface version is (IFocuserV1 and V2 refuse such a move).
 - StepSize: X_ALPACA_STEP_SIZE (read-only, microns), defined if the member is implemented.

 Alpaca has no speed, no backlash, no sync and no compensation coefficient, so FOCUSER_SPEED, FOCUSER_BACKLASH,
 FOCUSER_ON_POSITION_SET and FOCUSER_COMPENSATION stay hidden.

 A request for a motion property that is BUSY is ignored and the move in progress goes on; a request for the other motion
 property is rejected with a message. Nothing is sent to the device on disconnect: a move in progress is left to finish.

 Threads: change_property runs on a bus thread, everything else on the handler queue of the device. A request is accepted
 with system_alpaca_accept() and a poll tick publishes what the device says under the lock of the device, so a tick never replaces
 a request that was just accepted with the old state of the device; for the same reason a tick asks the device first and touches
 the properties afterwards.
 */

#pragma mark - Includes

#include <stdlib.h>
#include <string.h>
#include <stdint.h>
#include <assert.h>

#include <indigo/indigo_focuser_driver.h>

#include "indigo_system_alpaca_private.h"

#pragma mark - Common definitions

#define FOCUSER_MOVE_TIMEOUT_FACTOR						6
#define FOCUSER_DEFAULT_RANGE									9999999

/** Longest time in seconds IsMoving after a Halt is taken for the settling of the stopped move (OMNI-1).
 */
#define FOCUSER_HALT_SETTLE_TIME							3

/** Longest time in seconds Position may still change after IsMoving turned false at the end of a move started by the driver (HW-5).
 */
#define FOCUSER_MOVE_SETTLE_TIME							3

#pragma mark - Property definitions

#define X_ALPACA_STEP_SIZE_PROPERTY						(FOCUSER_DATA->x_alpaca_step_size_property)
#define X_ALPACA_STEP_SIZE_ITEM								(X_ALPACA_STEP_SIZE_PROPERTY->items + 0)

#define X_ALPACA_STEP_SIZE_PROPERTY_NAME			"X_ALPACA_STEP_SIZE"
#define X_ALPACA_STEP_SIZE_ITEM_NAME					"STEP_SIZE"

#pragma mark - Private data definition

#define FOCUSER_DATA													((focuser_data *)CLASS_DATA)

typedef struct {
	indigo_property *x_alpaca_step_size_property;
	alpaca_operation move;
	bool absolute;							///< Absolute: the focuser has a position and Move takes a target
	bool has_temperature;				///< Temperature is implemented
	bool temperature_valid;			///< the last Temperature read succeeded
	bool has_temp_comp;					///< TempCompAvailable
	bool has_step_size;					///< StepSize is implemented
	bool automatic;							///< TempComp as last reported by the device; FOCUSER_MODE and the defined properties follow it
	bool moving;								///< IsMoving at the time of the connection
	bool external;							///< FOCUSER_POSITION is BUSY because the device moves without a request of this driver
	bool halted;								///< Halt stopped a move and the device may still settle at halt_position (OMNI-1)
	int halt_position;					///< Position read right after Halt
	double halt_time;						///< time of the Halt
	bool unreadable;						///< FOCUSER_POSITION is in ALERT because the polling can not read the position
	int target;									///< target of the move of an absolute focuser in progress
	bool settling;							///< IsMoving turned false short of target at settle_time and Position may still change (HW-5)
	double settle_time;					///< time IsMoving was first seen false short of target
	int max_step;
	int max_increment;
	int position;
	double temperature;
	double step_size;
} focuser_data;

#pragma mark - Low level code

static void focuser_position_handler(indigo_device *device);
static void focuser_steps_handler(indigo_device *device);

// False if a request made while connecting got no usable answer, so that the connection has to fail.
static bool focuser_answered(alpaca_result result) {
	return !alpaca_is_transport_error(result) && result != ALPACA_PROTOCOL_ERROR && result != ALPACA_SERVER_ERROR && result != ALPACA_FAILED;
}

// Time a move may take: a multiple of the timeout of long requests (X_ALPACA_TIMEOUTS of the bridge device).
static double focuser_move_timeout(indigo_device *device) {
	return FOCUSER_MOVE_TIMEOUT_FACTOR * system_alpaca_long_timeout(device);
}

// Refusal of a request for a motion property while the other motion property is BUSY (the property of the request itself is not,
// or the request would have been dropped). Called by system_alpaca_accept() with the lock of the device held.
static const char *focuser_motion_refusal(indigo_device *device) {
	return FOCUSER_POSITION_PROPERTY->state == INDIGO_BUSY_STATE || FOCUSER_STEPS_PROPERTY->state == INDIGO_BUSY_STATE ? "Another motion operation is pending" : NULL;
}

// End of a move, or of a request that did not start one: the motion properties get the state of the result. A relative focuser has
// FOCUSER_STEPS only; its hidden FOCUSER_POSITION never leaves the OK state.
static void focuser_finish(indigo_device *device, alpaca_result result, const char *action, const char *reason) {
	focuser_data *data = FOCUSER_DATA;
	indigo_property_state state = system_alpaca_property_state(result);
	data->external = false;
	system_alpaca_lock(device);
	FOCUSER_STEPS_PROPERTY->state = state;
	if (data->absolute) {
		FOCUSER_POSITION_PROPERTY->state = state;
		if (result != ALPACA_OK) {
			FOCUSER_POSITION_ITEM->number.target = FOCUSER_POSITION_ITEM->number.value;
		}
	}
	system_alpaca_unlock(device);
	// FOCUSER_POSITION is published last: a client that waits for it finds FOCUSER_STEPS settled
	if (data->absolute) {
		if (FOCUSER_STEPS_PROPERTY->defined) {
			indigo_update_property(device, FOCUSER_STEPS_PROPERTY, NULL);
		}
		system_alpaca_report(device, FOCUSER_POSITION_PROPERTY, result, action, reason);
	} else if (FOCUSER_STEPS_PROPERTY->defined) {
		system_alpaca_report(device, FOCUSER_STEPS_PROPERTY, result, action, reason);
	}
}

// Completion of a move: IsMoving is polled until it is false, Position is published on the way. An absolute focuser whose IsMoving
// is false short of the target is watched on while its Position settles, for at most FOCUSER_MOVE_SETTLE_TIME seconds (HW-5).
static void focuser_move_finalizer(indigo_device *device) {
	focuser_data *data = FOCUSER_DATA;
	bool moving = false, settling = false;
	int position = 0;
	if (!system_alpaca_is_active(device)) {
		return;
	}
	alpaca_result result = system_alpaca_get_bool(device, "ismoving", &moving);
	if (result == ALPACA_OK && data->absolute) {
		result = system_alpaca_get_int(device, "position", &position);
		if (result == ALPACA_OK) {
			FOCUSER_POSITION_ITEM->number.value = position;
		}
	}
	if (result == ALPACA_OK && !moving && data->absolute && position != data->target) {
		double now = indigo_monotonic_time();
		if (!data->settling) {
			INDIGO_DRIVER_DEBUG(DRIVER_NAME, "'%s' IsMoving is false at %d, the target is %d: the position may still settle", device->name, position, data->target);
			data->settling = true;
			data->settle_time = now;
		}
		settling = now - data->settle_time < FOCUSER_MOVE_SETTLE_TIME;
	} else {
		data->settling = false;
	}
	if (result == ALPACA_OK && (moving || settling) && system_alpaca_operation_continue(device, &data->move, focuser_move_finalizer)) {
		indigo_update_property(device, FOCUSER_POSITION_PROPERTY, NULL);
		return;
	}
	data->settling = false;
	system_alpaca_operation_end(device, &data->move);
	focuser_finish(device, result == ALPACA_OK && moving ? ALPACA_TIMED_OUT : result, "Move", NULL);
}

// Send Move with an absolute target or with signed relative steps. Move is not repeated when its reply is lost;
// IsMoving tells whether the device accepted it.
static void focuser_start(indigo_device *device, int position) {
	focuser_data *data = FOCUSER_DATA;
	alpaca_param params[] = { ALPACA_INT_PARAM("Position", position) };
	char reason[INDIGO_VALUE_SIZE];
	bool moving = false;
	alpaca_result result = system_alpaca_put(device, "move", params, 1, ALPACA_WAIT_LONG);
	system_alpaca_reason(device, result, reason, sizeof(reason));
	if (result != ALPACA_OK && alpaca_may_have_executed(result) && system_alpaca_get_bool(device, "ismoving", &moving) == ALPACA_OK && moving) {
		INDIGO_DRIVER_DEBUG(DRIVER_NAME, "'%s' gave no valid reply to move (%s) but is moving", device->name, alpaca_result_text(result));
		result = ALPACA_OK;
	}
	if (result == ALPACA_OK) {
		data->external = data->halted = data->settling = false;
		data->target = position;
		system_alpaca_lock(device);
		FOCUSER_STEPS_PROPERTY->state = INDIGO_BUSY_STATE;
		if (data->absolute) {
			FOCUSER_POSITION_PROPERTY->state = INDIGO_BUSY_STATE;
		}
		system_alpaca_unlock(device);
		indigo_update_property(device, FOCUSER_STEPS_PROPERTY, NULL);
		indigo_update_property(device, FOCUSER_POSITION_PROPERTY, NULL);
		system_alpaca_operation_start(device, &data->move, focuser_move_timeout(device), focuser_move_finalizer);
	} else {
		focuser_finish(device, result, "Move", reason);
	}
}

// Make the defined properties follow the compensation mode: the motion properties exist in the manual mode only and
// FOCUSER_POSITION is read-only in the automatic one. A request that did not start yet is cancelled by the automatic mode.
// The switch of FOCUSER_MODE is set by the caller.
static void focuser_apply_mode(indigo_device *device, bool automatic) {
	focuser_data *data = FOCUSER_DATA;
	// a bus thread enumerates the properties by it
	system_alpaca_lock(device);
	data->automatic = automatic;
	system_alpaca_unlock(device);
	indigo_delete_property(device, FOCUSER_POSITION_PROPERTY, NULL);
	if (automatic) {
		indigo_cancel_pending_handler(device, focuser_position_handler);
		indigo_cancel_pending_handler(device, focuser_steps_handler);
		system_alpaca_lock(device);
		FOCUSER_STEPS_PROPERTY->state = INDIGO_OK_STATE;
		if (!data->external) {
			FOCUSER_POSITION_PROPERTY->state = INDIGO_OK_STATE;
			FOCUSER_POSITION_ITEM->number.target = FOCUSER_POSITION_ITEM->number.value;
		}
		system_alpaca_unlock(device);
		indigo_delete_property(device, FOCUSER_REVERSE_MOTION_PROPERTY, NULL);
		indigo_delete_property(device, FOCUSER_DIRECTION_PROPERTY, NULL);
		indigo_delete_property(device, FOCUSER_STEPS_PROPERTY, NULL);
		indigo_delete_property(device, FOCUSER_ABORT_MOTION_PROPERTY, NULL);
	} else {
		indigo_define_property(device, FOCUSER_REVERSE_MOTION_PROPERTY, NULL);
		indigo_define_property(device, FOCUSER_DIRECTION_PROPERTY, NULL);
		indigo_define_property(device, FOCUSER_STEPS_PROPERTY, NULL);
		indigo_define_property(device, FOCUSER_ABORT_MOTION_PROPERTY, NULL);
	}
	FOCUSER_POSITION_PROPERTY->perm = automatic ? INDIGO_RO_PERM : INDIGO_RW_PERM;
	indigo_define_property(device, FOCUSER_POSITION_PROPERTY, NULL);
}

// A request for a move that was accepted just before the device went to the automatic mode is given up: no move is sent while
// the device compensates.
static void focuser_give_up(indigo_device *device) {
	focuser_data *data = FOCUSER_DATA;
	system_alpaca_lock(device);
	FOCUSER_STEPS_PROPERTY->state = INDIGO_OK_STATE;
	if (!data->external) {
		FOCUSER_POSITION_PROPERTY->state = INDIGO_OK_STATE;
		FOCUSER_POSITION_ITEM->number.target = FOCUSER_POSITION_ITEM->number.value;
	}
	system_alpaca_unlock(device);
	indigo_update_property(device, FOCUSER_POSITION_PROPERTY, NULL);
}

#pragma mark - High level code (focuser)

static bool focuser_on_probe(indigo_device *device) {
	focuser_data *data = FOCUSER_DATA;
	data->absolute = data->has_temperature = data->temperature_valid = data->has_temp_comp = data->has_step_size = data->automatic = data->moving = data->external = data->unreadable = data->halted = data->settling = false;
	data->max_step = data->max_increment = data->position = 0;
	data->temperature = data->step_size = 0;
	if (system_alpaca_probe_bool(device, "absolute", &data->absolute) != ALPACA_OK) {
		return false;
	}
	alpaca_result result = system_alpaca_get_int(device, "maxstep", &data->max_step);
	if (!focuser_answered(result)) {
		return false;
	}
	if (result != ALPACA_OK || data->max_step <= 0) {
		data->max_step = FOCUSER_DEFAULT_RANGE;
	}
	result = system_alpaca_get_int(device, "maxincrement", &data->max_increment);
	if (!focuser_answered(result)) {
		return false;
	}
	if (result != ALPACA_OK || data->max_increment <= 0) {
		data->max_increment = data->max_step;
	}
	// an absolute focuser that can not tell its position can not be used: Move would be given a target computed from nothing
	if (data->absolute && system_alpaca_get_int(device, "position", &data->position) != ALPACA_OK) {
		return false;
	}
	result = system_alpaca_get_bool(device, "ismoving", &data->moving);
	if (!focuser_answered(result)) {
		return false;
	}
	data->moving = result == ALPACA_OK && data->moving;
	result = system_alpaca_get_double(device, "temperature", &data->temperature);
	if (!focuser_answered(result)) {
		return false;
	}
	data->has_temperature = !alpaca_is_unsupported(result);
	data->temperature_valid = result == ALPACA_OK;
	if (!data->has_temperature) {
		system_alpaca_set_unsupported(device, "temperature");
	}
	if (system_alpaca_probe_bool(device, "tempcompavailable", &data->has_temp_comp) != ALPACA_OK) {
		return false;
	}
	if (data->has_temp_comp) {
		result = system_alpaca_get_bool(device, "tempcomp", &data->automatic);
		if (!focuser_answered(result)) {
			return false;
		}
		data->has_temp_comp = result == ALPACA_OK;
		data->automatic = data->has_temp_comp && data->automatic;
	}
	result = system_alpaca_get_double(device, "stepsize", &data->step_size);
	if (!focuser_answered(result)) {
		return false;
	}
	data->has_step_size = result == ALPACA_OK && data->step_size > 0;
	INDIGO_DRIVER_DEBUG(DRIVER_NAME, "'%s' Absolute = %d, MaxStep = %d, MaxIncrement = %d, Temperature %s, TempCompAvailable = %d, StepSize %s", device->name, data->absolute, data->max_step, data->max_increment, data->has_temperature ? "implemented" : "not implemented", data->has_temp_comp, data->has_step_size ? "implemented" : "not implemented");
	return true;
}

static bool focuser_on_connect(indigo_device *device) {
	focuser_data *data = FOCUSER_DATA;
	FOCUSER_SPEED_PROPERTY->hidden = true;
	FOCUSER_BACKLASH_PROPERTY->hidden = true;
	FOCUSER_COMPENSATION_PROPERTY->hidden = true;
	FOCUSER_ON_POSITION_SET_PROPERTY->hidden = true;
	FOCUSER_REVERSE_MOTION_PROPERTY->hidden = false;
	FOCUSER_ABORT_MOTION_PROPERTY->hidden = false;
	FOCUSER_POSITION_PROPERTY->hidden = !data->absolute;
	FOCUSER_LIMITS_PROPERTY->hidden = !data->absolute;
	FOCUSER_TEMPERATURE_PROPERTY->hidden = !data->has_temperature;
	FOCUSER_MODE_PROPERTY->hidden = !data->has_temp_comp;
	X_ALPACA_STEP_SIZE_PROPERTY->hidden = !data->has_step_size;
	data->external = data->absolute && data->moving;
	system_alpaca_lock(device);
	FOCUSER_POSITION_PROPERTY->state = data->external ? INDIGO_BUSY_STATE : INDIGO_OK_STATE;
	FOCUSER_STEPS_PROPERTY->state = INDIGO_OK_STATE;
	FOCUSER_ABORT_MOTION_PROPERTY->state = INDIGO_OK_STATE;
	FOCUSER_MODE_PROPERTY->state = INDIGO_OK_STATE;
	system_alpaca_unlock(device);
	FOCUSER_POSITION_PROPERTY->perm = data->automatic ? INDIGO_RO_PERM : INDIGO_RW_PERM;
	FOCUSER_POSITION_ITEM->number.min = 0;
	FOCUSER_POSITION_ITEM->number.max = data->max_step;
	FOCUSER_POSITION_ITEM->number.value = FOCUSER_POSITION_ITEM->number.target = data->position;
	FOCUSER_LIMITS_PROPERTY->perm = INDIGO_RO_PERM;
	FOCUSER_LIMITS_MIN_POSITION_ITEM->number.min = FOCUSER_LIMITS_MIN_POSITION_ITEM->number.max = FOCUSER_LIMITS_MIN_POSITION_ITEM->number.value = FOCUSER_LIMITS_MIN_POSITION_ITEM->number.target = 0;
	FOCUSER_LIMITS_MAX_POSITION_ITEM->number.min = 0;
	FOCUSER_LIMITS_MAX_POSITION_ITEM->number.max = FOCUSER_LIMITS_MAX_POSITION_ITEM->number.value = FOCUSER_LIMITS_MAX_POSITION_ITEM->number.target = data->max_step;
	FOCUSER_STEPS_ITEM->number.min = 0;
	FOCUSER_STEPS_ITEM->number.max = data->max_increment;
	FOCUSER_STEPS_ITEM->number.value = FOCUSER_STEPS_ITEM->number.target = 0;
	FOCUSER_ABORT_MOTION_ITEM->sw.value = false;
	FOCUSER_TEMPERATURE_PROPERTY->state = data->temperature_valid ? INDIGO_OK_STATE : INDIGO_ALERT_STATE;
	FOCUSER_TEMPERATURE_ITEM->number.value = FOCUSER_TEMPERATURE_ITEM->number.target = data->temperature;
	indigo_set_switch(FOCUSER_MODE_PROPERTY, data->automatic ? FOCUSER_MODE_AUTOMATIC_ITEM : FOCUSER_MODE_MANUAL_ITEM, true);
	X_ALPACA_STEP_SIZE_ITEM->number.value = X_ALPACA_STEP_SIZE_ITEM->number.target = data->step_size;
	// the base class defines FOCUSER_POSITION in the manual mode only
	if (data->automatic) {
		indigo_define_property(device, FOCUSER_POSITION_PROPERTY, NULL);
	}
	indigo_define_property(device, X_ALPACA_STEP_SIZE_PROPERTY, NULL);
	return true;
}

static void focuser_on_disconnect(indigo_device *device) {
	focuser_data *data = FOCUSER_DATA;
	system_alpaca_operation_end(device, &data->move);
	data->external = data->unreadable = data->halted = data->settling = false;
	// The properties are still defined, so a request may be accepted while they are reset; its handler finds the session closed.
	// A change of the mode that was requested and not carried out must not decide what the base class deletes.
	system_alpaca_lock(device);
	FOCUSER_ABORT_MOTION_ITEM->sw.value = false;
	FOCUSER_ABORT_MOTION_PROPERTY->state = FOCUSER_MODE_PROPERTY->state = INDIGO_OK_STATE;
	indigo_set_switch(FOCUSER_MODE_PROPERTY, data->automatic ? FOCUSER_MODE_AUTOMATIC_ITEM : FOCUSER_MODE_MANUAL_ITEM, true);
	if (data->automatic) {
		FOCUSER_POSITION_PROPERTY->state = INDIGO_OK_STATE;
	}
	system_alpaca_unlock(device);
	if (data->automatic) {
		indigo_delete_property(device, FOCUSER_POSITION_PROPERTY, NULL);
	}
	indigo_delete_property(device, X_ALPACA_STEP_SIZE_PROPERTY, NULL);
}

static void focuser_on_poll(indigo_device *device) {
	focuser_data *data = FOCUSER_DATA;
	bool automatic = false, moving = false, has_mode = false, has_position = false, publish_mode = false, publish_position = false, publish_failure = false;
	char reason[INDIGO_VALUE_SIZE] = { 0 };
	alpaca_result position_result = ALPACA_OK;
	int position = 0;
	if (data->has_temperature) {
		double temperature = 0;
		alpaca_result result = system_alpaca_state_double(device, "Temperature", &temperature);
		if (result == ALPACA_OK && (FOCUSER_TEMPERATURE_ITEM->number.value != temperature || FOCUSER_TEMPERATURE_PROPERTY->state != INDIGO_OK_STATE)) {
			FOCUSER_TEMPERATURE_ITEM->number.value = temperature;
			FOCUSER_TEMPERATURE_PROPERTY->state = INDIGO_OK_STATE;
			indigo_update_property(device, FOCUSER_TEMPERATURE_PROPERTY, NULL);
		} else if (result != ALPACA_OK && !alpaca_is_transport_error(result) && FOCUSER_TEMPERATURE_PROPERTY->state != INDIGO_ALERT_STATE) {
			FOCUSER_TEMPERATURE_PROPERTY->state = INDIGO_ALERT_STATE;
			indigo_update_property(device, FOCUSER_TEMPERATURE_PROPERTY, NULL);
		}
	}
	// the rest belongs to the finalizer while a move runs
	if (data->move.active) {
		return;
	}
	// The device is asked first and the properties are touched afterwards, in one step under the lock of the device: a request of a client that
	// arrives while the device answers finds its property as the client knows it, and is not replaced by what the device said.
	if (data->has_temp_comp) {
		has_mode = system_alpaca_get_bool(device, "tempcomp", &automatic) == ALPACA_OK;
	}
	if (data->absolute) {
		position_result = system_alpaca_state_bool(device, "IsMoving", &moving);
		if (position_result == ALPACA_OK) {
			position_result = system_alpaca_state_int(device, "Position", &position);
		}
		system_alpaca_reason(device, position_result, reason, sizeof(reason));
		has_position = position_result == ALPACA_OK;
	}
	system_alpaca_lock(device);
	// a request that was accepted and waits for its handler owns the properties
	if (FOCUSER_STEPS_PROPERTY->state != INDIGO_BUSY_STATE && FOCUSER_MODE_PROPERTY->state != INDIGO_BUSY_STATE && (FOCUSER_POSITION_PROPERTY->state != INDIGO_BUSY_STATE || data->external)) {
		if (has_mode && automatic != data->automatic) {
			// the mode of the device is a fact, whatever the last request for a change ended with
			indigo_set_switch(FOCUSER_MODE_PROPERTY, automatic ? FOCUSER_MODE_AUTOMATIC_ITEM : FOCUSER_MODE_MANUAL_ITEM, true);
			FOCUSER_MODE_PROPERTY->state = INDIGO_OK_STATE;
			publish_mode = true;
		}
		if (has_position) {
			// the stopped move settles while IsMoving stays true at the position of the Halt, for a short time (OMNI-1)
			data->halted = data->halted && moving && position == data->halt_position && indigo_monotonic_time() - data->halt_time < FOCUSER_HALT_SETTLE_TIME;
			if (moving && data->halted) {
				// OmniSim reports IsMoving for its settle time after Halt: that is no new motion of the device
			} else if (moving && FOCUSER_POSITION_PROPERTY->state != INDIGO_BUSY_STATE) {
				FOCUSER_POSITION_PROPERTY->state = INDIGO_BUSY_STATE;
				data->external = true;
			} else if (!moving && (data->external || (data->unreadable && FOCUSER_POSITION_PROPERTY->state == INDIGO_ALERT_STATE))) {
				FOCUSER_POSITION_PROPERTY->state = INDIGO_OK_STATE;
				data->external = false;
			}
			data->unreadable = false;
			FOCUSER_POSITION_ITEM->number.value = position;
			if (!moving) {
				FOCUSER_POSITION_ITEM->number.target = position;
			}
			publish_position = true;
		} else if (data->absolute && !alpaca_is_transport_error(position_result) && FOCUSER_POSITION_PROPERTY->state == INDIGO_OK_STATE) {
			// the device answers and does not tell where it is: the position that is shown is not the one of the device any more
			FOCUSER_POSITION_PROPERTY->state = INDIGO_ALERT_STATE;
			data->unreadable = true;
			publish_failure = true;
		}
	}
	system_alpaca_unlock(device);
	if (publish_mode) {
		focuser_apply_mode(device, automatic);
		indigo_update_property(device, FOCUSER_MODE_PROPERTY, NULL);
	}
	if (publish_position) {
		indigo_update_property(device, FOCUSER_POSITION_PROPERTY, NULL);
	} else if (publish_failure) {
		system_alpaca_report(device, FOCUSER_POSITION_PROPERTY, position_result, "Reading the position", reason);
	}
}

static void focuser_position_handler(indigo_device *device) {
	if (!system_alpaca_is_active(device)) {
		return;
	}
	if (FOCUSER_DATA->automatic) {
		focuser_give_up(device);
		return;
	}
	focuser_start(device, (int)FOCUSER_POSITION_ITEM->number.target);
}

static void focuser_steps_handler(indigo_device *device) {
	focuser_data *data = FOCUSER_DATA;
	if (!system_alpaca_is_active(device)) {
		return;
	}
	if (data->automatic) {
		focuser_give_up(device);
		return;
	}
	int steps = (int)FOCUSER_STEPS_ITEM->number.target;
	if (FOCUSER_DIRECTION_MOVE_INWARD_ITEM->sw.value != FOCUSER_REVERSE_MOTION_ENABLED_ITEM->sw.value) {
		steps = -steps;
	}
	if (data->absolute) {
		int position = 0;
		alpaca_result result = system_alpaca_get_int(device, "position", &position);
		if (result != ALPACA_OK) {
			focuser_finish(device, result, "Move", NULL);
			return;
		}
		// in 64 bits: MaxStep and MaxIncrement may both be INT_MAX
		int64_t sum = (int64_t)position + steps;
		int target = sum < 0 ? 0 : sum > data->max_step ? data->max_step : (int)sum;
		// FOCUSER_STEPS is BUSY, so no request for FOCUSER_POSITION is accepted meanwhile
		FOCUSER_POSITION_ITEM->number.value = position;
		FOCUSER_POSITION_ITEM->number.target = target;
		if (target == position) {
			focuser_finish(device, ALPACA_OK, NULL, NULL);
		} else {
			focuser_start(device, target);
		}
	} else if (steps == 0) {
		focuser_finish(device, ALPACA_OK, NULL, NULL);
	} else {
		focuser_start(device, steps);
	}
}

static void focuser_abort_motion_handler(indigo_device *device) {
	focuser_data *data = FOCUSER_DATA;
	char reason[INDIGO_VALUE_SIZE];
	bool settle = false;
	int position = 0;
	if (!system_alpaca_is_active(device)) {
		return;
	}
	FOCUSER_ABORT_MOTION_ITEM->sw.value = false;
	if (data->automatic) {
		// the request was accepted just before the device went to the automatic mode, which removed the property
		system_alpaca_set_state(device, FOCUSER_ABORT_MOTION_PROPERTY, INDIGO_OK_STATE);
		return;
	}
	alpaca_result result = system_alpaca_put(device, "halt", NULL, 0, ALPACA_REPLAYABLE);
	system_alpaca_reason(device, result, reason, sizeof(reason));
	if (result == ALPACA_OK) {
		// the device confirmed the halt: the move is not watched any more, and IsMoving that it may report while it settles is not a new motion
		indigo_cancel_pending_handler(device, focuser_move_finalizer);
		system_alpaca_operation_end(device, &data->move);
		if (data->absolute && system_alpaca_get_int(device, "position", &position) == ALPACA_OK) {
			FOCUSER_POSITION_ITEM->number.value = position;
			data->halted = true;
			data->halt_position = position;
			data->halt_time = indigo_monotonic_time();
		}
	}
	// A request that did not start yet is given up, and so is a move that was stopped. A move in progress whose halt failed is watched
	// on, and a move of the device itself that could not be stopped stays BUSY: the device still moves.
	indigo_cancel_pending_handler(device, focuser_position_handler);
	indigo_cancel_pending_handler(device, focuser_steps_handler);
	system_alpaca_lock(device);
	if (!data->move.active && (FOCUSER_POSITION_PROPERTY->state == INDIGO_BUSY_STATE || FOCUSER_STEPS_PROPERTY->state == INDIGO_BUSY_STATE) && (result == ALPACA_OK || !data->external)) {
		data->external = false;
		FOCUSER_STEPS_PROPERTY->state = INDIGO_ALERT_STATE;
		if (data->absolute) {
			FOCUSER_POSITION_ITEM->number.target = FOCUSER_POSITION_ITEM->number.value;
			FOCUSER_POSITION_PROPERTY->state = INDIGO_ALERT_STATE;
		}
		settle = true;
	}
	system_alpaca_unlock(device);
	if (settle) {
		indigo_update_property(device, FOCUSER_STEPS_PROPERTY, NULL);
		indigo_update_property(device, FOCUSER_POSITION_PROPERTY, NULL);
	}
	system_alpaca_finish_with(device, FOCUSER_ABORT_MOTION_PROPERTY, result, "Abort", reason);
	if (alpaca_is_unsupported(result)) {
		system_alpaca_set_unsupported(device, "halt");
		indigo_delete_property(device, FOCUSER_ABORT_MOTION_PROPERTY, NULL);
		FOCUSER_ABORT_MOTION_PROPERTY->hidden = true;
	}
}

static void focuser_mode_handler(indigo_device *device) {
	focuser_data *data = FOCUSER_DATA;
	if (!system_alpaca_is_active(device)) {
		return;
	}
	bool automatic = FOCUSER_MODE_AUTOMATIC_ITEM->sw.value;
	if (data->move.active) {
		indigo_set_switch(FOCUSER_MODE_PROPERTY, data->automatic ? FOCUSER_MODE_AUTOMATIC_ITEM : FOCUSER_MODE_MANUAL_ITEM, true);
		system_alpaca_update(device, FOCUSER_MODE_PROPERTY, INDIGO_ALERT_STATE, "Focuser is moving: request can not be completed");
		return;
	}
	alpaca_param params[] = { ALPACA_BOOL_PARAM("TempComp", automatic) };
	char reason[INDIGO_VALUE_SIZE];
	alpaca_result result = system_alpaca_put(device, "tempcomp", params, 1, ALPACA_REPLAYABLE);
	system_alpaca_reason(device, result, reason, sizeof(reason));
	if (result != ALPACA_OK) {
		indigo_set_switch(FOCUSER_MODE_PROPERTY, data->automatic ? FOCUSER_MODE_AUTOMATIC_ITEM : FOCUSER_MODE_MANUAL_ITEM, true);
	} else if (automatic != data->automatic) {
		focuser_apply_mode(device, automatic);
	}
	system_alpaca_finish_with(device, FOCUSER_MODE_PROPERTY, result, "Temperature compensation change", reason);
}

#pragma mark - Device API (focuser)

static indigo_result focuser_enumerate_properties(indigo_device *device, indigo_client *client, indigo_property *property);

static indigo_result focuser_attach(indigo_device *device) {
	assert(device != NULL);
	if (indigo_focuser_attach(device, DRIVER_NAME, DRIVER_VERSION) == INDIGO_OK) {
		X_ALPACA_STEP_SIZE_PROPERTY = indigo_init_number_property(NULL, device->name, X_ALPACA_STEP_SIZE_PROPERTY_NAME, FOCUSER_MAIN_GROUP, "Step size", INDIGO_OK_STATE, INDIGO_RO_PERM, 1);
		if (X_ALPACA_STEP_SIZE_PROPERTY == NULL) {
			return INDIGO_FAILED;
		}
		indigo_init_number_item(X_ALPACA_STEP_SIZE_ITEM, X_ALPACA_STEP_SIZE_ITEM_NAME, "Step size (microns)", 0, 100000, 0, 0);
		X_ALPACA_STEP_SIZE_PROPERTY->hidden = true;
		return system_alpaca_attach(device) == INDIGO_OK ? focuser_enumerate_properties(device, NULL, NULL) : INDIGO_FAILED;
	}
	return INDIGO_FAILED;
}

// The base class enumerates the motion properties by FOCUSER_MODE, which a request for another mode changes before its handler has
// changed the mode of the device. While the session is open they are enumerated here by the mode the device has, which decides
// what is defined (focuser_apply_mode()).
static indigo_result focuser_enumerate_properties(indigo_device *device, indigo_client *client, indigo_property *property) {
	if (system_alpaca_is_active(device)) {
		system_alpaca_lock(device);
		bool automatic = FOCUSER_DATA->automatic;
		system_alpaca_unlock(device);
		if (!automatic) {
			INDIGO_DEFINE_MATCHING_PROPERTY(FOCUSER_SPEED_PROPERTY);
			INDIGO_DEFINE_MATCHING_PROPERTY(FOCUSER_REVERSE_MOTION_PROPERTY);
			INDIGO_DEFINE_MATCHING_PROPERTY(FOCUSER_DIRECTION_PROPERTY);
			INDIGO_DEFINE_MATCHING_PROPERTY(FOCUSER_STEPS_PROPERTY);
			INDIGO_DEFINE_MATCHING_PROPERTY(FOCUSER_ABORT_MOTION_PROPERTY);
			INDIGO_DEFINE_MATCHING_PROPERTY(FOCUSER_BACKLASH_PROPERTY);
		}
		INDIGO_DEFINE_MATCHING_PROPERTY(FOCUSER_POSITION_PROPERTY);
		INDIGO_DEFINE_MATCHING_PROPERTY(FOCUSER_LIMITS_PROPERTY);
		INDIGO_DEFINE_MATCHING_PROPERTY(FOCUSER_ON_POSITION_SET_PROPERTY);
		INDIGO_DEFINE_MATCHING_PROPERTY(FOCUSER_TEMPERATURE_PROPERTY);
		INDIGO_DEFINE_MATCHING_PROPERTY(FOCUSER_COMPENSATION_PROPERTY);
		INDIGO_DEFINE_MATCHING_PROPERTY(FOCUSER_MODE_PROPERTY);
		INDIGO_DEFINE_MATCHING_PROPERTY(X_ALPACA_STEP_SIZE_PROPERTY);
		return indigo_device_enumerate_properties(device, client, property);
	}
	return indigo_focuser_enumerate_properties(device, client, property);
}

static indigo_result focuser_change_property(indigo_device *device, indigo_client *client, indigo_property *property) {
	if (system_alpaca_change_property(device, property)) {
		return INDIGO_OK;
	}
	if (indigo_property_match_changeable(FOCUSER_POSITION_PROPERTY, property)) {
		system_alpaca_accept(device, FOCUSER_POSITION_PROPERTY, property, ALPACA_ACCEPT_TARGETS, focuser_motion_refusal, focuser_position_handler);
		return INDIGO_OK;
	}
	if (indigo_property_match_changeable(FOCUSER_STEPS_PROPERTY, property)) {
		system_alpaca_accept(device, FOCUSER_STEPS_PROPERTY, property, ALPACA_ACCEPT_VALUES, focuser_motion_refusal, focuser_steps_handler);
		return INDIGO_OK;
	}
	if (indigo_property_match_changeable(FOCUSER_ABORT_MOTION_PROPERTY, property)) {
		system_alpaca_accept(device, FOCUSER_ABORT_MOTION_PROPERTY, property, ALPACA_ACCEPT_VALUES | ALPACA_ACCEPT_URGENT, NULL, focuser_abort_motion_handler);
		return INDIGO_OK;
	}
	if (indigo_property_match_changeable(FOCUSER_MODE_PROPERTY, property)) {
		system_alpaca_accept(device, FOCUSER_MODE_PROPERTY, property, ALPACA_ACCEPT_VALUES, NULL, focuser_mode_handler);
		return INDIGO_OK;
	}
	return indigo_focuser_change_property(device, client, property);
}

static indigo_result focuser_detach(indigo_device *device) {
	assert(device != NULL);
	system_alpaca_detach(device);
	indigo_release_property(X_ALPACA_STEP_SIZE_PROPERTY);
	INDIGO_DEVICE_DETACH_LOG(DRIVER_NAME, device->name);
	return indigo_focuser_detach(device);
}

#pragma mark - Device class

const alpaca_class system_alpaca_focuser_class = {
	.device_type = "Focuser",
	.platform7_version = 4,
	.data_size = sizeof(focuser_data),
	.attach = focuser_attach,
	.enumerate_properties = focuser_enumerate_properties,
	.change_property = focuser_change_property,
	.detach = focuser_detach,
	.base_change_property = indigo_focuser_change_property,
	.on_probe = focuser_on_probe,
	.on_connect = focuser_on_connect,
	.on_disconnect = focuser_on_disconnect,
	.on_poll = focuser_on_poll
};
