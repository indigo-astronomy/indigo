// Copyright (c) 2026 CloudMakers, s. r. o.
// All rights reserved.
//
// You can use this software under the terms of 'INDIGO Astronomy
// open-source license' (see LICENSE.md).
//
// THIS SOFTWARE IS PROVIDED BY THE AUTHORS 'AS IS' AND ANY EXPRESS
// OR IMPLIED WARRANTIES, INCLUDING, BUT NOT LIMITED TO, THE IMPLIED
// WARRANTIES OF MERCHANTABILITY AND FITNESS FOR A PARTICULAR PURPOSE
// ARE DISCLAIMED. IN NO EVENT SHALL THE AUTHOR BE LIABLE FOR ANY
// DIRECT, INDIRECT, INCIDENTAL, SPECIAL, EXEMPLARY, OR CONSEQUENTIAL
// DAMAGES (INCLUDING, BUT NOT LIMITED TO, PROCUREMENT OF SUBSTITUTE
// GOODS OR SERVICES; LOSS OF USE, DATA, OR PROFITS; OR BUSINESS
// INTERRUPTION) HOWEVER CAUSED AND ON ANY THEORY OF LIABILITY,
// WHETHER IN CONTRACT, STRICT LIABILITY, OR TORT (INCLUDING
// NEGLIGENCE OR OTHERWISE) ARISING IN ANY WAY OUT OF THE USE OF THIS
// SOFTWARE, EVEN IF ADVISED OF THE POSSIBILITY OF SUCH DAMAGE.

// version history
// 3.0 by Peter Polakovic <peter.polakovic@cloudmakers.eu>

// Code is generated by AI

/** INDIGO ASCOM Alpaca client driver, Camera device class: Alpaca Camera as an INDIGO CCD, with a guider as its secondary device when the camera can pulse guide
 \file indigo_system_alpaca_ccd.c

 MAPPING

 CCD_INFO                cameraxsize, cameraysize, maxbinx, maxbiny, pixelsizex, pixelsizey, maxadu (as a number of bits)
 CCD_FRAME               startx, starty, numx, numy. INDIGO counts unbinned pixels, Alpaca binned ones: StartX = LEFT / BinX, NumX = WIDTH / BinX.
 CCD_BIN                 binx, biny; both items are kept equal unless canasymmetricbin
 CCD_MODE                readoutmode / readoutmodes if the camera has more than one readout mode, the square binnings (BIN_1x1...) otherwise
 CCD_READ_MODE           fastreadout if canfastreadout
 CCD_EXPOSURE            startexposure Duration (seconds), Light; limits from exposuremin, exposuremax, exposureresolution
 CCD_FRAME_TYPE          Light=True for LIGHT and FLAT, Light=False for BIAS, DARK and DARKFLAT; BIAS uses the shortest exposure
 CCD_ABORT_EXPOSURE      abortexposure, or stopexposure with the image thrown away; abortexposure is sent also when no exposure of this
                         connection runs, because the camera may be busy with one that was started before the connection was lost
 CCD_GAIN, CCD_OFFSET    gain, offset of a camera that takes a value (gainmin .. gainmax)
 X_ALPACA_GAIN, _OFFSET  gain, offset of a camera that takes the index of a name (gains, offsets): one switch item per name
 CCD_COOLER              cooleron
 CCD_TEMPERATURE         ccdtemperature (value), setccdtemperature (target); BUSY while the cooler is on and the sensor is not at the set point
 CCD_COOLER_POWER        coolerpower if cangetcoolerpower
 CCD_EGAIN               electronsperadu
 X_ALPACA_SENSOR         sensorname, sensortype with bayeroffsetx / bayeroffsety, fullwellcapacity
 CCD_IMAGE               imagearray
 BAYERPAT                sensortype RGGB with bayeroffsetx / bayeroffsety and the origin of the frame, for unbinned frames only

 The frame and the binning are not sent when they are changed, but in front of startexposure, and only the members that differ from
 what the camera was last told: the camera checks them at StartExposure anyway (ICameraV3), and many cameras reset the subframe when
 the binning changes, so the binning goes first and the subframe is sent again after it.
 CCD_FRAME shows the frame the client asked for moved onto the binned pixels of the current binning. The requested frame is kept, so
 a change of the binning starts from it again and the order in which CCD_FRAME and CCD_BIN are set (or restored) does not matter.

 Alpaca has no streaming, CCD_STREAMING stays hidden.

 EXPOSURE

 ccd_exposure_handler sends the frame and startexposure, starts the common countdown with indigo_ccd_exposure_setup() and leaves the
 rest to ccd_exposure_finalizer, which reads ImageReady and CameraState (one devicestate request on a Platform 7 camera) until the
 image is ready, the camera reports an error or the long timeout has passed after the end of the exposure. startexposure is never
 sent twice: if its reply is lost, CameraState tells whether the exposure runs. An exposure that fails after it started is ended on
 the camera (abortexposure, or stopexposure if that is all the camera can do), so that the camera takes the next one.

 IMAGE TRANSFER

 The image is fetched by ccd_download_handler on a queue of its own (one thread per connected camera) through the transfer channel
 of the device, a second connection to the server. Neither the handler queue of the device nor its ordinary connection is used, so
 polling, the cooler, an abort, a disconnect and the guider of the camera keep working while an image of any size comes in; only a
 new exposure has to wait for the transfer to end. The transfer can not be interrupted, it ends by itself or by the timeouts of the
 long timeout class (first byte: long timeout, silence within the reply: standard timeout). An abort during a transfer therefore
 completes when the transfer has ended (the image is thrown away), and a disconnect or a detach waits for it the same way.

 The reply is either ImageBytes or, if the server answers with JSON, the JSON array read by alpaca_json_parse_image(). Both hold the
 elements in the order Value[x][y] or Value[x][y][plane], column by column. They are copied once into the image buffer, top-down
 row by row, as 8 or 16 bits per channel: 8 bits if MaxADU and the data fit, 16 bits otherwise, shifted right if they need more than
 16 bits. Negative elements become 0. A rank 3 image with three planes becomes RGB24 or RGB48 in the order R, G, B.
 Memory: the body of the reply in the transfer channel (reused), the image buffer (reused), and for JSON the array of int32 (reused).

 THREADS

 change_property runs on a bus thread, the image transfer on the transfer queue and everything else on the handler queue of the device.
 A request is accepted with system_alpaca_accept(); the polling and the handlers that touch a property of another request (the frame
 when the binning changes, the binning when a binning mode is selected) do it under the lock of the device and leave a property alone
 that is BUSY because a request for it waits. The same lock guards what the transfer queue and the handler queue share (running,
 cancelled) and the count of the set points that wait for their handler: CCD_TEMPERATURE is accepted while it is BUSY.
 */

#pragma mark - Includes

#include <stdlib.h>
#include <string.h>
#include <stdarg.h>
#include <math.h>
#include <assert.h>

#include <indigo/indigo_ccd_driver.h>

#include "indigo_system_alpaca_private.h"

#pragma mark - Common definitions

#define CCD_DATA													((ccd_data *)CLASS_DATA)

#define CCD_IMAGE_ACCEPT									"application/imagebytes, application/json"
#define CCD_IMAGEBYTES_HEADER_SIZE				44
#define CCD_BODY_RESERVE									(1024 * 1024)
#define CCD_BODY_BYTES_PER_ELEMENT				12
#define CCD_MESSAGE_SIZE									256
#define CCD_MAX_LEVELS										64
#define CCD_MAX_MODES											32
#define CCD_TRANSPOSE_BLOCK								32
#define CCD_TEMPERATURE_TOLERANCE					0.5
#define CCD_SHORTEST_POLL									0.01
#define CCD_STATE_FAILURE_LIMIT						5

// CameraState
#define CCD_CAMERA_IDLE										0
#define CCD_CAMERA_WAITING								1
#define CCD_CAMERA_DOWNLOAD								4
#define CCD_CAMERA_ERROR									5

// SensorType
#define CCD_SENSOR_MONOCHROME							0
#define CCD_SENSOR_COLOR									1
#define CCD_SENSOR_RGGB										2
#define CCD_SENSOR_TYPE_COUNT							6

// element types of ImageBytes; CCD_ELEMENT_NATIVE_INT32 is the array filled by alpaca_json_parse_image()
#define CCD_ELEMENT_INT16									1
#define CCD_ELEMENT_INT32									2
#define CCD_ELEMENT_DOUBLE								3
#define CCD_ELEMENT_SINGLE								4
#define CCD_ELEMENT_UINT64								5
#define CCD_ELEMENT_BYTE									6
#define CCD_ELEMENT_INT64									7
#define CCD_ELEMENT_UINT16								8
#define CCD_ELEMENT_UINT32								9
#define CCD_ELEMENT_NATIVE_INT32					10

// how Gain and Offset are set
#define CCD_LEVEL_NONE										0
#define CCD_LEVEL_VALUE										1
#define CCD_LEVEL_INDEX										2

// phases of an exposure
#define CCD_PHASE_IDLE										0
#define CCD_PHASE_EXPOSE									1		// startexposure was accepted, ccd_exposure_finalizer waits for the image
#define CCD_PHASE_DISCARD									2		// the exposure was aborted and the camera could only stop it or not even that: ccd_exposure_finalizer waits until the camera is free
#define CCD_PHASE_DOWNLOAD								3		// ccd_download_handler fetches the image, ccd_download_finalizer publishes it
#define CCD_PHASE_CANCEL									4		// the exposure was aborted during the transfer: ccd_download_finalizer throws the image away

#pragma mark - Property definitions

#define X_ALPACA_SENSOR_PROPERTY					(CCD_DATA->x_alpaca_sensor_property)
#define X_ALPACA_SENSOR_NAME_ITEM					(X_ALPACA_SENSOR_PROPERTY->items + 0)
#define X_ALPACA_SENSOR_TYPE_ITEM					(X_ALPACA_SENSOR_PROPERTY->items + 1)
#define X_ALPACA_SENSOR_FULL_WELL_ITEM		(X_ALPACA_SENSOR_PROPERTY->items + 2)

#define X_ALPACA_SENSOR_PROPERTY_NAME			"X_ALPACA_SENSOR"
#define X_ALPACA_SENSOR_NAME_ITEM_NAME		"NAME"
#define X_ALPACA_SENSOR_TYPE_ITEM_NAME		"TYPE"
#define X_ALPACA_SENSOR_FULL_WELL_ITEM_NAME	"FULL_WELL_CAPACITY"

#define X_ALPACA_GAIN_PROPERTY						(CCD_DATA->x_alpaca_gain_property)
#define X_ALPACA_GAIN_PROPERTY_NAME				"X_ALPACA_GAIN"

#define X_ALPACA_OFFSET_PROPERTY					(CCD_DATA->x_alpaca_offset_property)
#define X_ALPACA_OFFSET_PROPERTY_NAME			"X_ALPACA_OFFSET"

#pragma mark - Private data definition

typedef struct {
	int mode;
	int value;
	int min;
	int max;
	int count;
	char names[CCD_MAX_LEVELS][INDIGO_NAME_SIZE];
} ccd_level;

// State of the image transfer. channel, max_adu and the results are written by one thread at a time (the handler queue of the device
// before the transfer starts and after it ended, the transfer queue in between); running and cancelled are guarded by the lock of the device.
typedef struct {
	alpaca_channel *channel;
	bool running;
	bool cancelled;
	int max_adu;
	alpaca_result result;
	char message[CCD_MESSAGE_SIZE];
	int width;
	int height;
	int bpp;
} ccd_download;

typedef struct {
	indigo_property *x_alpaca_sensor_property;
	indigo_property *x_alpaca_gain_property;
	indigo_property *x_alpaca_offset_property;
	// description of the camera, read by ccd_on_probe
	int width;
	int height;
	int max_bin_x;
	int max_bin_y;
	int max_adu;
	int sensor_type;
	int bayer_offset_x;
	int bayer_offset_y;
	double pixel_size_x;
	double pixel_size_y;
	double exposure_min;
	double exposure_max;
	double exposure_resolution;
	double electrons_per_adu;
	double full_well_capacity;
	bool has_exposure_limits;
	bool has_electrons_per_adu;
	bool has_full_well_capacity;
	bool has_sensor_type;
	bool has_temperature;
	bool has_cooler;
	bool has_cooler_power;
	char sensor_name[ALPACA_TEXT_SIZE];
	char readout_modes[CCD_MAX_MODES][INDIGO_NAME_SIZE];
	int readout_mode_count;
	// settings the camera accepted last
	int readout_mode;
	bool fast_readout;
	ccd_level gain;
	ccd_level offset;
	bool cooler_on;
	double set_point;
	int set_point_requests;
	double temperature;
	double cooler_power;
	double thermal_poll_time;
	// frame of the camera as it was read or written last, in the units of Alpaca
	bool frame_known;
	int bin_x;
	int bin_y;
	int start_x;
	int start_y;
	int num_x;
	int num_y;
	// frame the client asked for last, in unbinned pixels; CCD_FRAME is this frame moved onto the binned pixels of the current binning
	int frame_left;
	int frame_top;
	int frame_width;
	int frame_height;
	int bits_per_pixel;
	// exposure
	alpaca_operation exposure;
	int phase;
	double exposure_end;
	int exposure_left;
	int exposure_top;
	bool exposure_binned;
	bool no_device_state;
	int state_failures;								///< consecutive looks at an exposure whose devicestate got an answer that is no snapshot
	alpaca_device_state state;
	// image transfer
	indigo_queue *transfer_queue;
	ccd_download download;
	unsigned char *image;
	size_t image_size;
	void *json_pixels;
	size_t json_capacity;
} ccd_data;

#pragma mark - Low level code

static const char *ccd_capabilities[] = { "canabortexposure", "canasymmetricbin", "canfastreadout", "cangetcoolerpower", "canpulseguide", "cansetccdtemperature", "canstopexposure" };
static const char *ccd_sensor_types[CCD_SENSOR_TYPE_COUNT] = { "Monochrome", "Color", "RGGB", "CMYG", "CMYG2", "LRGB" };
// index: (BayerOffsetY + top of the frame) % 2 * 2 + (BayerOffsetX + left of the frame) % 2
static const char *ccd_bayer_patterns[] = { "RGGB", "GRBG", "GBRG", "BGGR" };

static uint32_t ccd_le32(const unsigned char *bytes) {
	return (uint32_t)bytes[0] | (uint32_t)bytes[1] << 8 | (uint32_t)bytes[2] << 16 | (uint32_t)bytes[3] << 24;
}

static uint64_t ccd_le64(const unsigned char *bytes) {
	return (uint64_t)ccd_le32(bytes) | (uint64_t)ccd_le32(bytes + 4) << 32;
}

// Copy text of the given length as one line of valid UTF-8 that fits size bytes: a byte that is not part of a valid UTF-8 sequence
// becomes '?', a control character becomes a space and the copy ends at a character boundary.
static void ccd_copy_text(char *target, size_t size, const char *source, size_t length) {
	size_t used = 0;
	for (size_t i = 0; i < length && source[i] != 0;) {
		unsigned char lead = (unsigned char)source[i];
		size_t count = lead < 0x80 ? 1 : lead >= 0xC2 && lead < 0xE0 ? 2 : lead >= 0xE0 && lead < 0xF0 ? 3 : lead >= 0xF0 && lead < 0xF5 ? 4 : 0;
		bool valid = count > 0 && i + count <= length;
		for (size_t j = 1; valid && j < count; j++) {
			valid = ((unsigned char)source[i + j] & 0xC0) == 0x80;
		}
		if (!valid) {
			count = 1;
		}
		if (used + count >= size) {
			break;
		}
		if (!valid) {
			target[used++] = '?';
		} else if (lead < 0x20 || lead == 0x7F) {
			target[used++] = ' ';
		} else {
			memcpy(target + used, source + i, count);
			used += count;
		}
		i += count;
	}
	target[used] = 0;
}

static int ccd_element_size(int type) {
	switch (type) {
		case CCD_ELEMENT_BYTE:
			return 1;
		case CCD_ELEMENT_INT16:
		case CCD_ELEMENT_UINT16:
			return 2;
		case CCD_ELEMENT_INT32:
		case CCD_ELEMENT_UINT32:
		case CCD_ELEMENT_SINGLE:
		case CCD_ELEMENT_NATIVE_INT32:
			return 4;
		case CCD_ELEMENT_DOUBLE:
		case CCD_ELEMENT_INT64:
		case CCD_ELEMENT_UINT64:
			return 8;
		default:
			return 0;
	}
}

// Value of one element. ImageBytes is little endian whatever the host is.
static inline double ccd_element(const unsigned char *bytes, int type) {
	uint32_t bits32 = 0;
	uint64_t bits64 = 0;
	int32_t integer = 0;
	float single = 0;
	double real = 0;
	switch (type) {
		case CCD_ELEMENT_BYTE:
			return bytes[0];
		case CCD_ELEMENT_INT16:
			return (int16_t)(uint16_t)(bytes[0] | bytes[1] << 8);
		case CCD_ELEMENT_UINT16:
			return (uint16_t)(bytes[0] | bytes[1] << 8);
		case CCD_ELEMENT_INT32:
			return (int32_t)ccd_le32(bytes);
		case CCD_ELEMENT_UINT32:
			return ccd_le32(bytes);
		case CCD_ELEMENT_SINGLE:
			bits32 = ccd_le32(bytes);
			memcpy(&single, &bits32, sizeof(single));
			return single;
		case CCD_ELEMENT_INT64:
			return (double)(int64_t)ccd_le64(bytes);
		case CCD_ELEMENT_UINT64:
			return (double)ccd_le64(bytes);
		case CCD_ELEMENT_DOUBLE:
			bits64 = ccd_le64(bytes);
			memcpy(&real, &bits64, sizeof(real));
			return real;
		case CCD_ELEMENT_NATIVE_INT32:
			memcpy(&integer, bytes, sizeof(integer));
			return integer;
		default:
			return 0;
	}
}

// Smallest and largest element; elements that are not numbers are skipped.
static void ccd_scan(const unsigned char *source, int type, size_t count, double *minimum, double *maximum) {
	size_t size = (size_t)ccd_element_size(type);
	double low = INFINITY, high = -INFINITY;
	for (size_t i = 0; i < count; i++, source += size) {
		double value = ccd_element(source, type);
		if (value < low) {
			low = value;
		}
		if (value > high) {
			high = value;
		}
	}
	*minimum = low <= high ? low : 0;
	*maximum = low <= high ? high : 0;
}

// Copy the Alpaca array (x outer, y inner, plane innermost) into an image stored top-down row by row with the planes interleaved.
// The columns are taken in blocks, so that both the source and the target are walked through almost sequentially whatever the size
// of the image is. With copy the elements already have the width and the range of the target and are copied as they are; otherwise
// each element is shifted right by shift bits, limited to the range of the target and stored as bytes little endian bytes.
static void ccd_transpose(const unsigned char *source, int type, size_t width, size_t height, size_t planes, bool copy, int shift, size_t bytes, unsigned char *target) {
	size_t size = (size_t)ccd_element_size(type);
	size_t pixel = planes * size;
	size_t column = height * pixel;
	double scale = ldexp(1, -shift);
	double limit = bytes == 1 ? 255 : 65535;
	for (size_t block = 0; block < width; block += CCD_TRANSPOSE_BLOCK) {
		size_t end = block + CCD_TRANSPOSE_BLOCK < width ? block + CCD_TRANSPOSE_BLOCK : width;
		for (size_t y = 0; y < height; y++) {
			const unsigned char *in = source + block * column + y * pixel;
			unsigned char *out = target + (y * width + block) * planes * bytes;
			for (size_t x = block; x < end; x++, in += column) {
				if (copy) {
					for (size_t i = 0; i < pixel; i++) {
						*out++ = in[i];
					}
				} else {
					for (size_t plane = 0; plane < planes; plane++) {
						double value = floor(ccd_element(in + plane * size, type) * scale + (shift ? 0 : 0.5));
						unsigned level = !(value > 0) ? 0 : value >= limit ? (unsigned)limit : (unsigned)value;
						*out++ = (unsigned char)level;
						if (bytes == 2) {
							*out++ = (unsigned char)(level >> 8);
						}
					}
				}
			}
		}
	}
}

static alpaca_result ccd_download_error(ccd_data *data, alpaca_result result, const char *format, ...) {
	va_list args;
	va_start(args, format);
	vsnprintf(data->download.message, sizeof(data->download.message), format, args);
	va_end(args);
	return result;
}

// Store the image that came in as width * height * planes elements of the given type. minimum and maximum are the limits of the
// elements if they are known already (scanned). The depth of the image follows MaxADU, so it does not change from frame to frame
// with the content, and the data only if they do not fit into what MaxADU promises.
static alpaca_result ccd_store_image(ccd_data *data, const unsigned char *source, int type, size_t width, size_t height, size_t planes, double minimum, double maximum, bool scanned) {
	size_t count = width * height * planes;
	size_t bytes = 1;
	int shift = 0;
	if (!scanned && (type == CCD_ELEMENT_BYTE || (type == CCD_ELEMENT_UINT16 && data->download.max_adu > 255))) {
		// the type itself keeps the elements within the range of the target
		minimum = maximum = 0;
	} else if (!scanned) {
		ccd_scan(source, type, count, &minimum, &maximum);
	}
	double range = fmax(data->download.max_adu, maximum);
	if (range > 255) {
		bytes = 2;
		while (range > 65535) {
			range = floor(range / 2);
			shift++;
		}
	}
	bool copy = shift == 0 && minimum >= 0 && ((type == CCD_ELEMENT_BYTE && bytes == 1) || ((type == CCD_ELEMENT_UINT16 || type == CCD_ELEMENT_INT16) && bytes == 2));
	size_t needed = FITS_HEADER_SIZE + count * bytes + FITS_LOGICAL_RECORD_LENGTH;
	if (needed > data->image_size) {
		data->image = indigo_safe_realloc(data->image, needed);
		data->image_size = needed;
	}
	ccd_transpose(source, type, width, height, planes, copy, shift, bytes, data->image + FITS_HEADER_SIZE);
	data->download.width = (int)width;
	data->download.height = (int)height;
	data->download.bpp = (int)(8 * bytes * planes);
	return ALPACA_OK;
}

// ImageBytes: 44 bytes of little endian int32 metadata, then the elements from DataStart on, or the UTF-8 text of the error.
static alpaca_result ccd_decode_imagebytes(ccd_data *data, alpaca_channel *channel, const alpaca_http_response *response) {
	const unsigned char *body = (const unsigned char *)response->body.data;
	size_t size = response->body.size;
	char text[CCD_MESSAGE_SIZE - 16];
	if (body == NULL || size < CCD_IMAGEBYTES_HEADER_SIZE) {
		return ccd_download_error(data, ALPACA_PROTOCOL_ERROR, "ImageBytes reply of %lu bytes is shorter than its metadata", (unsigned long)size);
	}
	int version = (int32_t)ccd_le32(body);
	int error_number = (int32_t)ccd_le32(body + 4);
	uint32_t echo = ccd_le32(body + 8);
	int data_start = (int32_t)ccd_le32(body + 16);
	int image_type = (int32_t)ccd_le32(body + 20);
	int transmission_type = (int32_t)ccd_le32(body + 24);
	int rank = (int32_t)ccd_le32(body + 28);
	int dimension1 = (int32_t)ccd_le32(body + 32);
	int dimension2 = (int32_t)ccd_le32(body + 36);
	int dimension3 = (int32_t)ccd_le32(body + 40);
	if (version != 1) {
		return ccd_download_error(data, ALPACA_PROTOCOL_ERROR, "Unsupported ImageBytes metadata version %d", version);
	}
	if (echo != 0 && !alpaca_accept_transaction_id(channel, echo)) {
		// the reply to another request: the connection is out of step
		alpaca_channel_close(channel);
		return ccd_download_error(data, ALPACA_PROTOCOL_ERROR, "ClientTransactionID %u of the image does not match the request", (unsigned)echo);
	}
	if (data_start < CCD_IMAGEBYTES_HEADER_SIZE || (size_t)data_start > size) {
		return ccd_download_error(data, ALPACA_PROTOCOL_ERROR, "ImageBytes DataStart %d is outside the reply of %lu bytes", data_start, (unsigned long)size);
	}
	if (error_number != 0) {
		ccd_copy_text(text, sizeof(text), (const char *)body + data_start, size - (size_t)data_start);
		return ccd_download_error(data, alpaca_error_result(error_number), "%s (0x%X)", *text ? text : "No error message", (unsigned)error_number);
	}
	if (rank != 2 && rank != 3) {
		return ccd_download_error(data, ALPACA_PROTOCOL_ERROR, "Unsupported ImageBytes rank %d", rank);
	}
	if (dimension1 <= 0 || dimension2 <= 0 || (rank == 3 && dimension3 != 3)) {
		return ccd_download_error(data, ALPACA_PROTOCOL_ERROR, "Unsupported ImageBytes dimensions %d x %d x %d", dimension1, dimension2, dimension3);
	}
	// the elements may be transmitted in a narrower type than the one of the array (the server narrows them when the values fit), never in a wider one
	bool known_types = image_type >= CCD_ELEMENT_INT16 && image_type <= CCD_ELEMENT_UINT32 && transmission_type >= CCD_ELEMENT_INT16 && transmission_type <= CCD_ELEMENT_UINT32;
	if (!known_types || ccd_element_size(transmission_type) > ccd_element_size(image_type)) {
		return ccd_download_error(data, ALPACA_PROTOCOL_ERROR, "Unsupported ImageBytes element types %d transmitted as %d", image_type, transmission_type);
	}
	size_t planes = rank == 3 ? 3 : 1;
	uint64_t expected = (uint64_t)dimension1 * (uint64_t)dimension2 * planes * (uint64_t)ccd_element_size(transmission_type);
	if (expected != size - (size_t)data_start) {
		return ccd_download_error(data, ALPACA_PROTOCOL_ERROR, "ImageBytes data of %lu bytes do not match %d x %d x %d elements of %d bytes", (unsigned long)(size - (size_t)data_start), dimension1, dimension2, (int)planes, ccd_element_size(transmission_type));
	}
	return ccd_store_image(data, body + data_start, transmission_type, (size_t)dimension1, (size_t)dimension2, planes, 0, 0, false);
}

// The server answered imagearray with the JSON envelope although ImageBytes was offered.
static alpaca_result ccd_decode_json(ccd_data *data, alpaca_channel *channel, const alpaca_http_response *response) {
	alpaca_json_image image = { 0 };
	char error[ALPACA_TEXT_SIZE] = { 0 };
	char text[CCD_MESSAGE_SIZE - 16];
	if (response->body.data == NULL || !alpaca_json_parse_image(response->body.data, response->body.size, ALPACA_JSON_IMAGE_INT32, &data->json_pixels, &data->json_capacity, true, &image, error, sizeof(error))) {
		return ccd_download_error(data, ALPACA_PROTOCOL_ERROR, "Malformed JSON image (%s)", error);
	}
	if (image.has_client_transaction_id && image.client_transaction_id != 0 && !alpaca_accept_transaction_id(channel, image.client_transaction_id)) {
		alpaca_channel_close(channel);
		return ccd_download_error(data, ALPACA_PROTOCOL_ERROR, "ClientTransactionID %u of the image does not match the request", (unsigned)image.client_transaction_id);
	}
	if (image.has_error_number && image.error_number != 0) {
		int error_number = image.error_number > INT32_MAX || image.error_number < INT32_MIN ? 0x4FF : (int)image.error_number;
		ccd_copy_text(text, sizeof(text), image.error_message, strlen(image.error_message));
		return ccd_download_error(data, alpaca_error_result(error_number), "%s (0x%X)", *text ? text : "No error message", (unsigned)error_number);
	}
	if (!image.has_value) {
		return ccd_download_error(data, ALPACA_PROTOCOL_ERROR, "Value is missing");
	}
	if ((image.rank != 2 && image.rank != 3) || image.dimensions[0] <= 0 || image.dimensions[1] <= 0 || (image.rank == 3 && image.dimensions[2] != 3)) {
		return ccd_download_error(data, ALPACA_PROTOCOL_ERROR, "Unsupported JSON image of rank %d, %d x %d x %d", image.rank, image.dimensions[0], image.dimensions[1], image.dimensions[2]);
	}
	return ccd_store_image(data, data->json_pixels, CCD_ELEMENT_NATIVE_INT32, (size_t)image.dimensions[0], (size_t)image.dimensions[1], image.rank == 3 ? 3 : 1, image.minimum, image.maximum, true);
}

// Longest time the camera may need after the end of an exposure until its image is ready: the long timeout of its server.
static double ccd_long_timeout(indigo_device *device) {
	return system_alpaca_long_timeout(device);
}

// Result of reading a member in ccd_on_probe: note whether the camera has it and return false if the camera did not answer at all.
static bool ccd_probed(indigo_device *device, const char *member, alpaca_result result, bool *supported) {
	if (supported != NULL) {
		*supported = result == ALPACA_OK;
	}
	if (alpaca_is_unsupported(result)) {
		system_alpaca_set_unsupported(device, member);
	}
	return !alpaca_is_transport_error(result);
}

static bool ccd_probe_int(indigo_device *device, const char *member, int *value, bool *supported) {
	return ccd_probed(device, member, system_alpaca_get_int(device, member, value), supported);
}

static bool ccd_probe_double(indigo_device *device, const char *member, double *value, bool *supported) {
	return ccd_probed(device, member, system_alpaca_get_double(device, member, value), supported);
}

static bool ccd_probe_flag(indigo_device *device, const char *member, bool *value, bool *supported) {
	return ccd_probed(device, member, system_alpaca_get_bool(device, member, value), supported);
}

// Find out how Gain or Offset is set: as a value between a minimum and a maximum, or as the index of a name of a list.
// A list with more names than a property of this driver holds is used by the index as a value.
static bool ccd_probe_level(indigo_device *device, const char *member, const char *min_member, const char *max_member, const char *list_member, ccd_level *level) {
	bool has_min = false, has_max = false, has_value = false;
	memset(level, 0, sizeof(ccd_level));
	if (!ccd_probe_int(device, min_member, &level->min, &has_min) || !ccd_probe_int(device, max_member, &level->max, &has_max)) {
		return false;
	}
	if (has_min && has_max && level->max >= level->min) {
		level->mode = CCD_LEVEL_VALUE;
	} else {
		alpaca_channel *channel = system_alpaca_channel(device);
		const alpaca_json_value *list = NULL;
		alpaca_result result = system_alpaca_check(device, alpaca_get_value(channel, list_member, NULL, 0, ALPACA_WAIT_STANDARD, &list));
		if (result == ALPACA_OK) {
			for (const alpaca_json_value *name = alpaca_json_first(list); name != NULL; name = alpaca_json_next(name)) {
				const char *text = "";
				alpaca_json_get_string(name, &text);
				if (level->count < CCD_MAX_LEVELS) {
					ccd_copy_text(level->names[level->count], INDIGO_NAME_SIZE, text, strlen(text));
				}
				level->count++;
			}
			alpaca_end(channel);
			if (level->count > 0) {
				level->mode = level->count <= CCD_MAX_LEVELS ? CCD_LEVEL_INDEX : CCD_LEVEL_VALUE;
				level->min = 0;
				level->max = level->count - 1;
			}
		} else if (!ccd_probed(device, list_member, result, NULL)) {
			return false;
		}
	}
	if (level->mode != CCD_LEVEL_NONE) {
		if (!ccd_probe_int(device, member, &level->value, &has_value)) {
			return false;
		}
		if (!has_value) {
			level->mode = CCD_LEVEL_NONE;
		}
	}
	return true;
}

// Remember the values of CCD_FRAME as the frame the client asked for.
static void ccd_remember_frame(indigo_device *device) {
	ccd_data *data = CCD_DATA;
	data->frame_left = (int)CCD_FRAME_LEFT_ITEM->number.value;
	data->frame_top = (int)CCD_FRAME_TOP_ITEM->number.value;
	data->frame_width = (int)CCD_FRAME_WIDTH_ITEM->number.value;
	data->frame_height = (int)CCD_FRAME_HEIGHT_ITEM->number.value;
}

// Bring CCD_FRAME in line with the binning and the sensor: the frame the client asked for is moved onto the binned pixels and cut to
// the sensor. It starts from the requested frame every time, so the frame does not shrink step by step when the binning changes
// and a saved configuration is restored whatever the order of CCD_FRAME and CCD_BIN is.
// Returns false if the requested frame had to be cut because it does not fit the sensor.
static bool ccd_normalize_frame(indigo_device *device) {
	ccd_data *data = CCD_DATA;
	int bin_x = (int)CCD_BIN_HORIZONTAL_ITEM->number.value, bin_y = (int)CCD_BIN_VERTICAL_ITEM->number.value;
	int max_x = data->width / bin_x > 0 ? data->width / bin_x : 1, max_y = data->height / bin_y > 0 ? data->height / bin_y : 1;
	int start_x = data->frame_left / bin_x, start_y = data->frame_top / bin_y;
	int num_x = data->frame_width / bin_x, num_y = data->frame_height / bin_y;
	bool fits = true;
	if (start_x < 0 || start_x >= max_x) {
		start_x = start_x < 0 ? 0 : max_x - 1;
		fits = false;
	}
	if (start_y < 0 || start_y >= max_y) {
		start_y = start_y < 0 ? 0 : max_y - 1;
		fits = false;
	}
	if (num_x < 1) {
		num_x = 1;
	}
	if (num_y < 1) {
		num_y = 1;
	}
	if (start_x + num_x > max_x) {
		num_x = max_x - start_x;
		fits = false;
	}
	if (start_y + num_y > max_y) {
		num_y = max_y - start_y;
		fits = false;
	}
	CCD_FRAME_LEFT_ITEM->number.value = CCD_FRAME_LEFT_ITEM->number.target = start_x * bin_x;
	CCD_FRAME_TOP_ITEM->number.value = CCD_FRAME_TOP_ITEM->number.target = start_y * bin_y;
	CCD_FRAME_WIDTH_ITEM->number.value = CCD_FRAME_WIDTH_ITEM->number.target = num_x * bin_x;
	CCD_FRAME_HEIGHT_ITEM->number.value = CCD_FRAME_HEIGHT_ITEM->number.target = num_y * bin_y;
	// the depth is what the camera delivers, it can not be chosen
	CCD_FRAME_BITS_PER_PIXEL_ITEM->number.value = CCD_FRAME_BITS_PER_PIXEL_ITEM->number.target = data->bits_per_pixel;
	return fits;
}

// PUT one member of the frame unless the camera has the value already.
static alpaca_result ccd_put_frame_member(indigo_device *device, const char *member, const char *name, int value, int *known, bool force) {
	if (!force && *known == value) {
		return ALPACA_OK;
	}
	alpaca_param params[] = { ALPACA_INT_PARAM(name, value) };
	alpaca_result result = system_alpaca_put(device, member, params, 1, ALPACA_REPLAYABLE);
	if (result == ALPACA_OK) {
		*known = value;
	}
	return result;
}

// Send the binning and the subframe of CCD_BIN and CCD_FRAME to the camera, as far as it does not have them.
static alpaca_result ccd_apply_frame(indigo_device *device) {
	ccd_data *data = CCD_DATA;
	int bin_x = (int)CCD_BIN_HORIZONTAL_ITEM->number.value, bin_y = (int)CCD_BIN_VERTICAL_ITEM->number.value;
	int start_x = (int)CCD_FRAME_LEFT_ITEM->number.value / bin_x, start_y = (int)CCD_FRAME_TOP_ITEM->number.value / bin_y;
	int num_x = (int)CCD_FRAME_WIDTH_ITEM->number.value / bin_x, num_y = (int)CCD_FRAME_HEIGHT_ITEM->number.value / bin_y;
	bool force = !data->frame_known;
	// a camera may reset its subframe when the binning changes, so the subframe is sent again after the binning
	bool rebinned = force || data->bin_x != bin_x || data->bin_y != bin_y;
	data->frame_known = false;
	alpaca_result result = ccd_put_frame_member(device, "binx", "BinX", bin_x, &data->bin_x, force);
	if (result == ALPACA_OK) {
		result = ccd_put_frame_member(device, "biny", "BinY", bin_y, &data->bin_y, force);
	}
	if (result == ALPACA_OK) {
		result = ccd_put_frame_member(device, "startx", "StartX", start_x, &data->start_x, rebinned);
	}
	if (result == ALPACA_OK) {
		result = ccd_put_frame_member(device, "starty", "StartY", start_y, &data->start_y, rebinned);
	}
	if (result == ALPACA_OK) {
		result = ccd_put_frame_member(device, "numx", "NumX", num_x, &data->num_x, rebinned);
	}
	if (result == ALPACA_OK) {
		result = ccd_put_frame_member(device, "numy", "NumY", num_y, &data->num_y, rebinned);
	}
	data->frame_known = result == ALPACA_OK;
	return result;
}

// Read CameraState and ImageReady: with one devicestate request from a Platform 7 camera, member by member otherwise.
// Like the poll of the core, a devicestate that gets an answer that is no snapshot (HTTP 500, a reply that can not be read, an error of
// the device) is no failure of the exposure: the members are read in the same call, and after CCD_STATE_FAILURE_LIMIT such answers in a
// row devicestate is not used for the exposures of this connection any more. Only a request without an answer (and NotConnected) is
// returned as it is; the core decides about the transport.
static alpaca_result ccd_read_progress(indigo_device *device, int *state, bool *ready) {
	ccd_data *data = CCD_DATA;
	if (PRIVATE_DATA->platform7 && !data->no_device_state) {
		alpaca_result result = system_alpaca_check(device, alpaca_get_device_state(system_alpaca_channel(device), &data->state));
		if (result == ALPACA_OK && alpaca_state_int(&data->state, "CameraState", state) && alpaca_state_bool(&data->state, "ImageReady", ready)) {
			data->state_failures = 0;
			return ALPACA_OK;
		}
		if (alpaca_is_transport_error(result) || result == ALPACA_NOT_CONNECTED) {
			return result;
		}
		if (result == ALPACA_OK || alpaca_is_unsupported(result)) {
			INDIGO_DRIVER_DEBUG(DRIVER_NAME, "'%s' does not report CameraState and ImageReady in devicestate, reading the members", device->name);
			data->no_device_state = true;
		} else if (++data->state_failures >= CCD_STATE_FAILURE_LIMIT) {
			INDIGO_DRIVER_DEBUG(DRIVER_NAME, "'%s' devicestate -> %s %d times in a row, reading the members from now on", device->name, alpaca_result_text(result), data->state_failures);
			data->no_device_state = true;
		} else {
			INDIGO_DRIVER_DEBUG(DRIVER_NAME, "'%s' devicestate -> %s, reading the members", device->name, alpaca_result_text(result));
		}
	}
	alpaca_result result = system_alpaca_get_int(device, "camerastate", state);
	if (result == ALPACA_OK) {
		result = system_alpaca_get_bool(device, "imageready", ready);
	}
	return result;
}

// BAYERPAT of the frame of the last exposure, NULL if the frame has no known colour filter pattern.
static const char *ccd_bayer_pattern(indigo_device *device) {
	ccd_data *data = CCD_DATA;
	if (data->sensor_type != CCD_SENSOR_RGGB || data->exposure_binned) {
		return NULL;
	}
	// the offsets of the Bayer matrix refer to the pixel 0, 0 of the sensor and do not follow the subframe
	return ccd_bayer_patterns[((data->bayer_offset_y + data->exposure_top) & 1) * 2 + ((data->bayer_offset_x + data->exposure_left) & 1)];
}

// Answer a request that failed because the camera does not implement the setter: the property stays, read only.
static void ccd_finish(indigo_device *device, indigo_property *property, alpaca_result result, const char *action) {
	if (result == ALPACA_UNSUPPORTED) {
		indigo_delete_property(device, property, NULL);
		property->perm = INDIGO_RO_PERM;
		system_alpaca_set_state(device, property, INDIGO_OK_STATE);
		indigo_define_property(device, property, "%s can not be changed on this camera", action);
	} else {
		system_alpaca_finish(device, property, result, action);
	}
}

#pragma mark - High level code (ccd)

static void ccd_exposure_finalizer(indigo_device *device);
static void ccd_download_finalizer(indigo_device *device);

// End of an exposure that failed: CCD_EXPOSURE and CCD_IMAGE go to ALERT.
static void ccd_exposure_failed(indigo_device *device, const char *action, alpaca_result result, const char *detail) {
	ccd_data *data = CCD_DATA;
	system_alpaca_operation_end(device, &data->exposure);
	data->phase = CCD_PHASE_IDLE;
	indigo_ccd_failure_cleanup(device);
	CCD_EXPOSURE_ITEM->number.value = 0;
	system_alpaca_update(device, CCD_EXPOSURE_PROPERTY, INDIGO_ALERT_STATE, "%s failed: %s%s%s%s", action, alpaca_result_text(result), *detail ? " (" : "", detail, *detail ? ")" : "");
}

// What indigo_ccd_abort_exposure_cleanup() does (streaming aside, Alpaca has none), with CCD_EXPOSURE and CCD_ABORT_EXPOSURE written under
// the lock of the device: a bus thread accepts the next exposure under that lock. CCD_EXPOSURE goes to ALERT if it was BUSY and
// CCD_ABORT_EXPOSURE to OK, otherwise CCD_ABORT_EXPOSURE goes to ALERT. The countdown of the base class ends by itself at its next step,
// because CCD_EXPOSURE is not BUSY any more.
static void ccd_abort_cleanup(indigo_device *device) {
	indigo_ccd_failure_cleanup(device);
	system_alpaca_lock(device);
	bool exposing = CCD_EXPOSURE_PROPERTY->state == INDIGO_BUSY_STATE;
	if (exposing) {
		CCD_EXPOSURE_PROPERTY->state = INDIGO_ALERT_STATE;
		CCD_EXPOSURE_ITEM->number.value = 0;
	}
	CCD_ABORT_EXPOSURE_PROPERTY->state = exposing ? INDIGO_OK_STATE : INDIGO_ALERT_STATE;
	CCD_ABORT_EXPOSURE_ITEM->sw.value = false;
	system_alpaca_unlock(device);
	if (exposing) {
		indigo_update_property(device, CCD_EXPOSURE_PROPERTY, NULL);
	}
	indigo_update_property(device, CCD_ABORT_EXPOSURE_PROPERTY, NULL);
}

// End of an exposure that was aborted: CCD_EXPOSURE goes to ALERT and CCD_ABORT_EXPOSURE to OK.
static void ccd_exposure_aborted(indigo_device *device) {
	ccd_data *data = CCD_DATA;
	system_alpaca_operation_end(device, &data->exposure);
	indigo_cancel_pending_handler(device, ccd_exposure_finalizer);
	data->phase = CCD_PHASE_IDLE;
	ccd_abort_cleanup(device);
}

// End the exposure on the camera as far as the camera can do it: nobody waits for its image any more.
static void ccd_cancel_on_camera(indigo_device *device) {
	if (system_alpaca_can(device, "canabortexposure")) {
		system_alpaca_put(device, "abortexposure", NULL, 0, ALPACA_REPLAYABLE);
	} else if (system_alpaca_can(device, "canstopexposure")) {
		system_alpaca_put(device, "stopexposure", NULL, 0, ALPACA_REPLAYABLE);
	}
}

// Schedule the next look at the camera, or return false if the time of the exposure is over. The camera is asked every active poll
// interval, at the expected end of the exposure, and more often right after it: an image is usually ready a moment after the end.
static bool ccd_exposure_continue(indigo_device *device) {
	ccd_data *data = CCD_DATA;
	double now = indigo_monotonic_time();
	double delay = system_alpaca_poll_interval(true);
	if (!data->exposure.active || now >= data->exposure.deadline) {
		return false;
	}
	if (data->phase == CCD_PHASE_EXPOSE) {
		delay = fmin(delay, fmax(CCD_SHORTEST_POLL, fabs(now - data->exposure_end)));
	}
	indigo_execute_handler_in(device, delay, ccd_exposure_finalizer);
	return true;
}

// Fetch and decode the image. Runs on the transfer queue, see IMAGE TRANSFER at the top of this file.
static void ccd_download_handler(indigo_device *device) {
	ccd_data *data = PRIVATE_DATA->class_data;
	alpaca_channel *channel = data->download.channel;
	const alpaca_http_response *response = NULL;
	double started = indigo_monotonic_time();
	size_t size = 0;
	alpaca_result result = alpaca_get_raw(channel, "imagearray", NULL, 0, ALPACA_WAIT_LONG, CCD_IMAGE_ACCEPT, &response, NULL);
	double received = indigo_monotonic_time();
	if (result == ALPACA_OK) {
		size = response->body.size;
		system_alpaca_lock(device);
		bool cancelled = data->download.cancelled;
		system_alpaca_unlock(device);
		if (cancelled) {
			result = ccd_download_error(data, ALPACA_CANCELLED, "aborted");
		} else if (*response->content_encoding) {
			result = ccd_download_error(data, ALPACA_PROTOCOL_ERROR, "Unsupported content encoding '%s'", response->content_encoding);
		} else if (alpaca_http_response_is(response, "application/imagebytes")) {
			result = ccd_decode_imagebytes(data, channel, response);
		} else if (alpaca_http_response_is(response, "application/json")) {
			result = ccd_decode_json(data, channel, response);
		} else {
			result = ccd_download_error(data, ALPACA_PROTOCOL_ERROR, "Unsupported content type '%s'", response->content_type);
		}
		alpaca_end(channel);
	} else {
		ccd_download_error(data, result, "%s", alpaca_last_error_message(channel));
	}
	INDIGO_DRIVER_DEBUG(DRIVER_NAME, "'%s' imagearray -> %s%s%s, %lu bytes in %.3f s, decoded in %.3f s", device->name, alpaca_result_text(result), result == ALPACA_OK ? "" : ": ", result == ALPACA_OK ? "" : data->download.message, (unsigned long)size, received - started, indigo_monotonic_time() - received);
	system_alpaca_lock(device);
	data->download.result = result;
	data->download.running = false;
	system_alpaca_unlock(device);
	indigo_execute_handler(device, ccd_download_finalizer);
}

// The image is ready on the camera: hand the transfer over to the transfer queue.
static void ccd_start_download(indigo_device *device) {
	ccd_data *data = CCD_DATA;
	// enough for the whole sensor in any element type of ImageBytes and as JSON text
	size_t limit = (size_t)data->width * (size_t)data->height * (data->sensor_type == CCD_SENSOR_COLOR ? 3 : 1) * CCD_BODY_BYTES_PER_ELEMENT + CCD_BODY_RESERVE;
	data->phase = CCD_PHASE_DOWNLOAD;
	// the buffer of the previous image is written from now on and may move
	CCD_IMAGE_ITEM->blob.value = NULL;
	CCD_IMAGE_ITEM->blob.size = 0;
	system_alpaca_lock(device);
	data->download.channel = system_alpaca_transfer_channel(device, limit);
	data->download.max_adu = data->max_adu;
	data->download.result = ALPACA_FAILED;
	data->download.message[0] = 0;
	data->download.cancelled = false;
	data->download.running = true;
	system_alpaca_unlock(device);
	indigo_queue_add(data->transfer_queue, device, INDIGO_TASK_PRIORITY_NORMAL, 0, ccd_download_handler, NULL);
}

// Completion of the transfer, queued by ccd_download_handler: publish the image, or end the exposure that was aborted meanwhile.
static void ccd_download_finalizer(indigo_device *device) {
	ccd_data *data = CCD_DATA;
	if (!system_alpaca_is_active(device) || !data->exposure.active || (data->phase != CCD_PHASE_DOWNLOAD && data->phase != CCD_PHASE_CANCEL)) {
		return;
	}
	system_alpaca_lock(device);
	bool running = data->download.running;
	system_alpaca_unlock(device);
	if (running) {
		return;
	}
	alpaca_result result = system_alpaca_check(device, data->download.result);
	if (data->phase == CCD_PHASE_CANCEL) {
		ccd_exposure_aborted(device);
	} else if (result != ALPACA_OK) {
		ccd_exposure_failed(device, "Image download", result, data->download.message);
	} else {
		const char *pattern = data->download.bpp <= 16 ? ccd_bayer_pattern(device) : NULL;
		indigo_fits_keyword keywords[] = { { INDIGO_FITS_STRING, "BAYERPAT", .string = pattern, "Bayer color pattern" }, { 0 } };
		system_alpaca_operation_end(device, &data->exposure);
		data->phase = CCD_PHASE_IDLE;
		if (data->bits_per_pixel != data->download.bpp) {
			data->bits_per_pixel = data->download.bpp;
			system_alpaca_lock(device);
			CCD_FRAME_BITS_PER_PIXEL_ITEM->number.value = CCD_FRAME_BITS_PER_PIXEL_ITEM->number.target = data->download.bpp;
			system_alpaca_unlock(device);
			indigo_update_property(device, CCD_FRAME_PROPERTY, NULL);
		}
		indigo_process_image(device, data->image, data->download.width, data->download.height, data->download.bpp, true, true, pattern != NULL ? keywords : NULL, false);
		CCD_EXPOSURE_ITEM->number.value = 0;
		system_alpaca_update(device, CCD_EXPOSURE_PROPERTY, INDIGO_OK_STATE, NULL);
	}
}

static void ccd_exposure_finalizer(indigo_device *device) {
	ccd_data *data = CCD_DATA;
	char detail[ALPACA_TEXT_SIZE] = { 0 };
	int state = CCD_CAMERA_IDLE;
	bool ready = false;
	if (!system_alpaca_is_active(device) || !data->exposure.active || (data->phase != CCD_PHASE_EXPOSE && data->phase != CCD_PHASE_DISCARD)) {
		return;
	}
	alpaca_result result = ccd_read_progress(device, &state, &ready);
	// a request without an answer is not the end of the exposure: the core decides when the transport is lost
	bool failed = result != ALPACA_OK && !alpaca_is_transport_error(result);
	if (data->phase == CCD_PHASE_DISCARD) {
		bool idle = result == ALPACA_OK && (ready || state == CCD_CAMERA_IDLE || state == CCD_CAMERA_ERROR);
		if (idle || failed || !ccd_exposure_continue(device)) {
			ccd_exposure_aborted(device);
		}
	} else if (failed) {
		// the camera may still be exposing: it is told to end the exposure, or it would refuse the next one
		system_alpaca_reason(device, result, detail, sizeof(detail));
		ccd_cancel_on_camera(device);
		ccd_exposure_failed(device, "Exposure", result, detail);
	} else if (result == ALPACA_OK && ready) {
		ccd_start_download(device);
	} else if (result == ALPACA_OK && state == CCD_CAMERA_ERROR) {
		ccd_cancel_on_camera(device);
		ccd_exposure_failed(device, "Exposure", ALPACA_DEVICE_ERROR, "the camera reports an error");
	} else if (!ccd_exposure_continue(device)) {
		// the camera is not left exposing for ever
		ccd_cancel_on_camera(device);
		ccd_exposure_failed(device, "Exposure", ALPACA_TIMED_OUT, "the image is not ready");
	}
}

static void ccd_exposure_handler(indigo_device *device) {
	ccd_data *data = CCD_DATA;
	char detail[ALPACA_TEXT_SIZE] = { 0 };
	int state = CCD_CAMERA_IDLE;
	if (!system_alpaca_is_active(device)) {
		return;
	}
	indigo_use_shortest_exposure_if_bias(device);
	double duration = CCD_EXPOSURE_ITEM->number.target;
	bool light = CCD_FRAME_TYPE_LIGHT_ITEM->sw.value || CCD_FRAME_TYPE_FLAT_ITEM->sw.value;
	alpaca_result result = ccd_apply_frame(device);
	if (result == ALPACA_OK) {
		alpaca_param params[] = { ALPACA_DOUBLE_PARAM("Duration", duration), ALPACA_BOOL_PARAM("Light", light) };
		result = system_alpaca_put(device, "startexposure", params, 2, ALPACA_WAIT_STANDARD);
	}
	system_alpaca_reason(device, result, detail, sizeof(detail));
	if (alpaca_may_have_executed(result) && data->frame_known && system_alpaca_get_int(device, "camerastate", &state) == ALPACA_OK && state >= CCD_CAMERA_WAITING && state <= CCD_CAMERA_DOWNLOAD) {
		// the reply to startexposure was lost, but the camera got the request: the exposure runs and is not started again
		INDIGO_DRIVER_DEBUG(DRIVER_NAME, "'%s' startexposure -> %s, but CameraState is %d", device->name, alpaca_result_text(result), state);
		result = ALPACA_OK;
	}
	if (result == ALPACA_OK) {
		double interval = system_alpaca_poll_interval(true);
		data->phase = CCD_PHASE_EXPOSE;
		data->exposure_end = indigo_monotonic_time() + duration;
		data->exposure_left = (int)CCD_FRAME_LEFT_ITEM->number.value;
		data->exposure_top = (int)CCD_FRAME_TOP_ITEM->number.value;
		data->exposure_binned = data->bin_x != 1 || data->bin_y != 1;
		indigo_update_property(device, CCD_EXPOSURE_PROPERTY, NULL);
		indigo_ccd_exposure_setup(device);
		system_alpaca_operation_start(device, &data->exposure, duration + ccd_long_timeout(device), ccd_exposure_finalizer);
		if (duration < interval) {
			// an exposure shorter than the poll interval is looked at as soon as it can be over
			indigo_cancel_pending_handler(device, ccd_exposure_finalizer);
			ccd_exposure_continue(device);
		}
	} else {
		ccd_exposure_failed(device, "Exposure", result, detail);
	}
}

static void ccd_abort_exposure_handler(indigo_device *device) {
	ccd_data *data = CCD_DATA;
	if (!system_alpaca_is_active(device)) {
		return;
	}
	// an exposure that was requested and did not start yet is not started any more
	indigo_cancel_pending_handler(device, ccd_exposure_handler);
	if (!data->exposure.active || !CCD_ABORT_EXPOSURE_ITEM->sw.value) {
		// No exposure of this connection runs. The camera is told all the same: it may be busy with an exposure that was started
		// before the connection was lost, and nothing else would make it idle again.
		if (CCD_ABORT_EXPOSURE_ITEM->sw.value && system_alpaca_can(device, "canabortexposure")) {
			system_alpaca_put(device, "abortexposure", NULL, 0, ALPACA_REPLAYABLE);
		}
		ccd_abort_cleanup(device);
	} else if (data->phase == CCD_PHASE_DOWNLOAD) {
		// the transfer can not be interrupted: its image is thrown away when it ends, CCD_ABORT_EXPOSURE stays BUSY until then
		system_alpaca_lock(device);
		data->download.cancelled = true;
		system_alpaca_unlock(device);
		data->phase = CCD_PHASE_CANCEL;
	} else if (data->phase == CCD_PHASE_EXPOSE) {
		alpaca_result result = system_alpaca_can(device, "canabortexposure") ? system_alpaca_put(device, "abortexposure", NULL, 0, ALPACA_REPLAYABLE) : ALPACA_UNSUPPORTED;
		if (result == ALPACA_OK) {
			ccd_exposure_aborted(device);
		} else {
			// the camera can not abort (now): the exposure is stopped if the camera can do that, and its image is not fetched
			bool stopped = system_alpaca_can(device, "canstopexposure") && system_alpaca_put(device, "stopexposure", NULL, 0, ALPACA_REPLAYABLE) == ALPACA_OK;
			data->phase = CCD_PHASE_DISCARD;
			if (stopped) {
				data->exposure.deadline = indigo_monotonic_time() + ccd_long_timeout(device);
			} else {
				indigo_update_property(device, CCD_ABORT_EXPOSURE_PROPERTY, "The camera can not abort the exposure, its image will be discarded");
			}
		}
	}
}

static void ccd_frame_handler(indigo_device *device) {
	if (!system_alpaca_is_active(device)) {
		return;
	}
	ccd_remember_frame(device);
	if (ccd_normalize_frame(device)) {
		system_alpaca_update(device, CCD_FRAME_PROPERTY, INDIGO_OK_STATE, NULL);
	} else {
		// what is left of the frame is the frame from now on
		ccd_remember_frame(device);
		system_alpaca_update(device, CCD_FRAME_PROPERTY, INDIGO_ALERT_STATE, "The frame does not fit the sensor");
	}
}

// Select the item of CCD_MODE that stands for the binning, if CCD_MODE lists binnings.
static void ccd_sync_bin_mode(indigo_device *device) {
	char name[INDIGO_NAME_SIZE];
	if (CCD_DATA->readout_mode_count < 2) {
		snprintf(name, sizeof(name), "BIN_%dx%d", (int)CCD_BIN_HORIZONTAL_ITEM->number.value, (int)CCD_BIN_VERTICAL_ITEM->number.value);
		for (int i = 0; i < CCD_MODE_PROPERTY->count; i++) {
			CCD_MODE_PROPERTY->items[i].sw.value = !strcmp(CCD_MODE_PROPERTY->items[i].name, name);
		}
	}
}

// The binning changed: CCD_FRAME is moved onto the binned pixels and is a valid frame again, whatever the last request for it ended
// with, and CCD_MODE shows the binning. Both are properties of other requests: one that is BUSY has a request waiting for its
// handler, which works with the new binning anyway, so it is left alone. Returns which of the two have to be published.
static void ccd_follow_binning(indigo_device *device, bool *frame, bool *mode) {
	system_alpaca_lock(device);
	*frame = CCD_FRAME_PROPERTY->state != INDIGO_BUSY_STATE;
	*mode = CCD_MODE_PROPERTY->state != INDIGO_BUSY_STATE;
	if (*frame) {
		ccd_normalize_frame(device);
		CCD_FRAME_PROPERTY->state = INDIGO_OK_STATE;
	}
	if (*mode) {
		ccd_sync_bin_mode(device);
	}
	system_alpaca_unlock(device);
}

static void ccd_bin_handler(indigo_device *device) {
	if (!system_alpaca_is_active(device)) {
		return;
	}
	int bin_x = (int)CCD_BIN_HORIZONTAL_ITEM->number.target, bin_y = (int)CCD_BIN_VERTICAL_ITEM->number.target;
	if (!system_alpaca_can(device, "canasymmetricbin") && bin_x != bin_y) {
		// the camera bins both axes alike: the item that was changed decides
		if (bin_x != (int)CCD_BIN_HORIZONTAL_ITEM->number.value) {
			bin_y = bin_x;
		} else {
			bin_x = bin_y;
		}
	}
	bool frame = false, mode = false;
	CCD_BIN_HORIZONTAL_ITEM->number.value = CCD_BIN_HORIZONTAL_ITEM->number.target = bin_x;
	CCD_BIN_VERTICAL_ITEM->number.value = CCD_BIN_VERTICAL_ITEM->number.target = bin_y;
	ccd_follow_binning(device, &frame, &mode);
	if (frame) {
		indigo_update_property(device, CCD_FRAME_PROPERTY, NULL);
	}
	if (mode) {
		indigo_update_property(device, CCD_MODE_PROPERTY, NULL);
	}
	system_alpaca_update(device, CCD_BIN_PROPERTY, INDIGO_OK_STATE, NULL);
}

static void ccd_mode_handler(indigo_device *device) {
	ccd_data *data = CCD_DATA;
	int selected = 0, bin_x = 0, bin_y = 0;
	if (!system_alpaca_is_active(device)) {
		return;
	}
	for (int i = 0; i < CCD_MODE_PROPERTY->count; i++) {
		if (CCD_MODE_PROPERTY->items[i].sw.value) {
			selected = i;
		}
	}
	if (data->readout_mode_count >= 2) {
		alpaca_param params[] = { ALPACA_INT_PARAM("ReadoutMode", selected) };
		alpaca_result result = system_alpaca_put(device, "readoutmode", params, 1, ALPACA_REPLAYABLE);
		if (result == ALPACA_OK) {
			data->readout_mode = selected;
		}
		indigo_set_switch(CCD_MODE_PROPERTY, CCD_MODE_PROPERTY->items + data->readout_mode, true);
		ccd_finish(device, CCD_MODE_PROPERTY, result, "Readout mode");
	} else {
		if (sscanf(CCD_MODE_PROPERTY->items[selected].name, "BIN_%dx%d", &bin_x, &bin_y) == 2) {
			// A binning mode selects the whole sensor, like in the other camera drivers. CCD_BIN and CCD_FRAME are properties of other
			// requests: one that is BUSY has a request waiting for its handler, which is the newer wish, so it is left alone.
			system_alpaca_lock(device);
			bool bin = CCD_BIN_PROPERTY->state != INDIGO_BUSY_STATE, frame = CCD_FRAME_PROPERTY->state != INDIGO_BUSY_STATE;
			if (bin) {
				CCD_BIN_HORIZONTAL_ITEM->number.value = CCD_BIN_HORIZONTAL_ITEM->number.target = bin_x;
				CCD_BIN_VERTICAL_ITEM->number.value = CCD_BIN_VERTICAL_ITEM->number.target = bin_y;
			}
			if (frame) {
				data->frame_left = data->frame_top = 0;
				data->frame_width = data->width;
				data->frame_height = data->height;
				ccd_normalize_frame(device);
				CCD_FRAME_PROPERTY->state = INDIGO_OK_STATE;
			}
			system_alpaca_unlock(device);
			if (frame) {
				indigo_update_property(device, CCD_FRAME_PROPERTY, NULL);
			}
			if (bin) {
				indigo_update_property(device, CCD_BIN_PROPERTY, NULL);
			}
		}
		system_alpaca_update(device, CCD_MODE_PROPERTY, INDIGO_OK_STATE, NULL);
	}
}

static void ccd_read_mode_handler(indigo_device *device) {
	ccd_data *data = CCD_DATA;
	if (!system_alpaca_is_active(device)) {
		return;
	}
	alpaca_param params[] = { ALPACA_BOOL_PARAM("FastReadout", CCD_READ_MODE_HIGH_SPEED_ITEM->sw.value) };
	alpaca_result result = system_alpaca_put(device, "fastreadout", params, 1, ALPACA_REPLAYABLE);
	if (result == ALPACA_OK) {
		data->fast_readout = CCD_READ_MODE_HIGH_SPEED_ITEM->sw.value;
	}
	indigo_set_switch(CCD_READ_MODE_PROPERTY, data->fast_readout ? CCD_READ_MODE_HIGH_SPEED_ITEM : CCD_READ_MODE_LOW_NOISE_ITEM, true);
	ccd_finish(device, CCD_READ_MODE_PROPERTY, result, "Fast readout");
}

// Set Gain or Offset and show what the camera accepted last, in the number property (a value) or in the switch property (an index).
static void ccd_set_level(indigo_device *device, const char *member, const char *name, ccd_level *level, indigo_property *property, const char *action) {
	int value = level->value;
	if (property->type == INDIGO_NUMBER_VECTOR) {
		value = (int)property->items[0].number.target;
	} else {
		for (int i = 0; i < property->count; i++) {
			if (property->items[i].sw.value) {
				value = i;
			}
		}
	}
	alpaca_param params[] = { ALPACA_INT_PARAM(name, value) };
	alpaca_result result = system_alpaca_put(device, member, params, 1, ALPACA_REPLAYABLE);
	if (result == ALPACA_OK) {
		level->value = value;
	}
	if (property->type == INDIGO_NUMBER_VECTOR) {
		property->items[0].number.value = property->items[0].number.target = level->value;
	} else if (level->value >= 0 && level->value < property->count) {
		indigo_set_switch(property, property->items + level->value, true);
	}
	ccd_finish(device, property, result, action);
}

static void ccd_gain_handler(indigo_device *device) {
	if (!system_alpaca_is_active(device)) {
		return;
	}
	ccd_set_level(device, "gain", "Gain", &CCD_DATA->gain, CCD_GAIN_PROPERTY, "Gain");
}

static void ccd_offset_handler(indigo_device *device) {
	if (!system_alpaca_is_active(device)) {
		return;
	}
	ccd_set_level(device, "offset", "Offset", &CCD_DATA->offset, CCD_OFFSET_PROPERTY, "Offset");
}

static void ccd_x_alpaca_gain_handler(indigo_device *device) {
	if (!system_alpaca_is_active(device)) {
		return;
	}
	ccd_set_level(device, "gain", "Gain", &CCD_DATA->gain, X_ALPACA_GAIN_PROPERTY, "Gain");
}

static void ccd_x_alpaca_offset_handler(indigo_device *device) {
	if (!system_alpaca_is_active(device)) {
		return;
	}
	ccd_set_level(device, "offset", "Offset", &CCD_DATA->offset, X_ALPACA_OFFSET_PROPERTY, "Offset");
}

// A new set point was requested and ccd_temperature_handler did not send it yet. Until then CCD_TEMPERATURE is BUSY because of the
// request and is left alone by everything else. Called with the lock of the device held: the count is written by the bus thread.
static bool ccd_set_point_pending(indigo_device *device) {
	return CCD_DATA->set_point_requests > 0;
}

// State of CCD_TEMPERATURE: BUSY while the cooler works towards the set point.
static indigo_property_state ccd_temperature_state(indigo_device *device) {
	ccd_data *data = CCD_DATA;
	return CCD_TEMPERATURE_PROPERTY->perm == INDIGO_RW_PERM && data->cooler_on && fabs(data->temperature - data->set_point) > CCD_TEMPERATURE_TOLERANCE ? INDIGO_BUSY_STATE : INDIGO_OK_STATE;
}

static void ccd_cooler_handler(indigo_device *device) {
	ccd_data *data = CCD_DATA;
	if (!system_alpaca_is_active(device)) {
		return;
	}
	alpaca_param params[] = { ALPACA_BOOL_PARAM("CoolerOn", CCD_COOLER_ON_ITEM->sw.value) };
	alpaca_result result = system_alpaca_put(device, "cooleron", params, 1, ALPACA_REPLAYABLE);
	if (result == ALPACA_OK) {
		data->cooler_on = CCD_COOLER_ON_ITEM->sw.value;
	}
	indigo_set_switch(CCD_COOLER_PROPERTY, data->cooler_on ? CCD_COOLER_ON_ITEM : CCD_COOLER_OFF_ITEM, true);
	ccd_finish(device, CCD_COOLER_PROPERTY, result, "Cooler");
	if (result == ALPACA_OK && !CCD_TEMPERATURE_PROPERTY->hidden) {
		system_alpaca_lock(device);
		bool changed = !ccd_set_point_pending(device) && CCD_TEMPERATURE_PROPERTY->state != ccd_temperature_state(device);
		if (changed) {
			CCD_TEMPERATURE_PROPERTY->state = ccd_temperature_state(device);
		}
		system_alpaca_unlock(device);
		if (changed) {
			indigo_update_property(device, CCD_TEMPERATURE_PROPERTY, NULL);
		}
	}
}

static void ccd_temperature_handler(indigo_device *device) {
	ccd_data *data = CCD_DATA;
	system_alpaca_lock(device);
	if (data->set_point_requests > 0) {
		data->set_point_requests--;
	}
	system_alpaca_unlock(device);
	if (!system_alpaca_is_active(device)) {
		return;
	}
	// the property is accepted while it is BUSY, so the bus thread may be writing the target
	system_alpaca_lock(device);
	double set_point = CCD_TEMPERATURE_ITEM->number.target;
	system_alpaca_unlock(device);
	alpaca_param params[] = { ALPACA_DOUBLE_PARAM("SetCCDTemperature", set_point) };
	alpaca_result result = system_alpaca_put(device, "setccdtemperature", params, 1, ALPACA_REPLAYABLE);
	if (result == ALPACA_OK) {
		data->set_point = set_point;
		// a newer set point that waits for its handler keeps the property BUSY
		system_alpaca_lock(device);
		if (!ccd_set_point_pending(device)) {
			CCD_TEMPERATURE_PROPERTY->state = ccd_temperature_state(device);
		}
		system_alpaca_unlock(device);
		indigo_update_property(device, CCD_TEMPERATURE_PROPERTY, NULL);
	} else {
		char reason[INDIGO_VALUE_SIZE];
		system_alpaca_reason(device, result, reason, sizeof(reason));
		system_alpaca_lock(device);
		bool superseded = ccd_set_point_pending(device);
		if (!superseded) {
			CCD_TEMPERATURE_ITEM->number.target = data->set_point;
		}
		system_alpaca_unlock(device);
		if (superseded) {
			// the newer set point owns the property; the failure of this one is told all the same
			system_alpaca_report(device, CCD_TEMPERATURE_PROPERTY, result, "Set point", reason);
		} else {
			ccd_finish(device, CCD_TEMPERATURE_PROPERTY, result, "Set point");
		}
	}
}

static bool ccd_on_probe(indigo_device *device) {
	ccd_data *data = CCD_DATA;
	alpaca_channel *channel = system_alpaca_channel(device);
	bool supported = false, has_offsets = false;
	bool known[6] = { false };
	int count = 0;
	if (system_alpaca_get_int(device, "cameraxsize", &data->width) != ALPACA_OK || system_alpaca_get_int(device, "cameraysize", &data->height) != ALPACA_OK) {
		return false;
	}
	if (data->width <= 0 || data->height <= 0) {
		INDIGO_DRIVER_ERROR(DRIVER_NAME, "'%s' reports a sensor of %d x %d pixels", device->name, data->width, data->height);
		return false;
	}
	for (size_t i = 0; i < sizeof(ccd_capabilities) / sizeof(ccd_capabilities[0]); i++) {
		if (alpaca_is_transport_error(system_alpaca_probe_bool(device, ccd_capabilities[i], NULL))) {
			return false;
		}
	}
	// the frame: what the camera does not tell is the whole sensor without binning
	data->max_bin_x = data->max_bin_y = data->bin_x = data->bin_y = 1;
	data->start_x = data->start_y = 0;
	data->num_x = data->width;
	data->num_y = data->height;
	if (!ccd_probe_int(device, "maxbinx", &data->max_bin_x, NULL) || !ccd_probe_int(device, "maxbiny", &data->max_bin_y, NULL)) {
		return false;
	}
	if (!ccd_probe_int(device, "binx", &data->bin_x, known + 0) || !ccd_probe_int(device, "biny", &data->bin_y, known + 1) || !ccd_probe_int(device, "startx", &data->start_x, known + 2)) {
		return false;
	}
	if (!ccd_probe_int(device, "starty", &data->start_y, known + 3) || !ccd_probe_int(device, "numx", &data->num_x, known + 4) || !ccd_probe_int(device, "numy", &data->num_y, known + 5)) {
		return false;
	}
	data->frame_known = known[0] && known[1] && known[2] && known[3] && known[4] && known[5];
	data->max_bin_x = data->max_bin_x < 1 ? 1 : data->max_bin_x;
	data->max_bin_y = data->max_bin_y < 1 ? 1 : data->max_bin_y;
	// the sensor
	data->pixel_size_x = data->pixel_size_y = 0;
	data->max_adu = 65535;
	data->sensor_type = CCD_SENSOR_MONOCHROME;
	data->bayer_offset_x = data->bayer_offset_y = 0;
	data->sensor_name[0] = 0;
	if (!ccd_probe_double(device, "pixelsizex", &data->pixel_size_x, NULL) || !ccd_probe_double(device, "pixelsizey", &data->pixel_size_y, NULL) || !ccd_probe_int(device, "maxadu", &data->max_adu, NULL)) {
		return false;
	}
	if (!ccd_probe_double(device, "electronsperadu", &data->electrons_per_adu, &data->has_electrons_per_adu) || !ccd_probe_double(device, "fullwellcapacity", &data->full_well_capacity, &data->has_full_well_capacity)) {
		return false;
	}
	if (!ccd_probe_int(device, "sensortype", &data->sensor_type, &data->has_sensor_type) || !ccd_probed(device, "sensorname", system_alpaca_get_string(device, "sensorname", data->sensor_name, sizeof(data->sensor_name)), NULL)) {
		return false;
	}
	if (data->sensor_type == CCD_SENSOR_RGGB) {
		if (!ccd_probe_int(device, "bayeroffsetx", &data->bayer_offset_x, &supported) || !ccd_probe_int(device, "bayeroffsety", &data->bayer_offset_y, &has_offsets)) {
			return false;
		}
		if (!supported || !has_offsets) {
			data->bayer_offset_x = data->bayer_offset_y = 0;
		}
	}
	data->max_adu = data->max_adu < 1 ? 65535 : data->max_adu;
	// the exposure
	if (!ccd_probe_double(device, "exposuremin", &data->exposure_min, &supported) || !ccd_probe_double(device, "exposuremax", &data->exposure_max, &data->has_exposure_limits)) {
		return false;
	}
	data->has_exposure_limits = data->has_exposure_limits && supported && data->exposure_max > data->exposure_min && data->exposure_min >= 0;
	data->exposure_resolution = 0;
	if (data->has_exposure_limits && !ccd_probe_double(device, "exposureresolution", &data->exposure_resolution, NULL)) {
		return false;
	}
	// readout modes
	data->readout_mode_count = data->readout_mode = 0;
	data->fast_readout = false;
	alpaca_result result = system_alpaca_check(device, alpaca_get_string_array(channel, "readoutmodes", NULL, 0, ALPACA_WAIT_STANDARD, data->readout_modes[0], INDIGO_NAME_SIZE, CCD_MAX_MODES, &count));
	if (!ccd_probed(device, "readoutmodes", result, &supported)) {
		return false;
	}
	if (supported && count >= 2) {
		if (!ccd_probe_int(device, "readoutmode", &data->readout_mode, &supported)) {
			return false;
		}
		data->readout_mode_count = supported && data->readout_mode >= 0 && data->readout_mode < count ? count : 0;
	}
	if (system_alpaca_can(device, "canfastreadout") && !ccd_probe_flag(device, "fastreadout", &data->fast_readout, NULL)) {
		return false;
	}
	// gain and offset
	if (!ccd_probe_level(device, "gain", "gainmin", "gainmax", "gains", &data->gain) || !ccd_probe_level(device, "offset", "offsetmin", "offsetmax", "offsets", &data->offset)) {
		return false;
	}
	// cooling
	data->cooler_on = false;
	data->temperature = data->set_point = data->cooler_power = 0;
	if (!ccd_probe_double(device, "ccdtemperature", &data->temperature, &data->has_temperature) || !ccd_probe_flag(device, "cooleron", &data->cooler_on, &data->has_cooler)) {
		return false;
	}
	data->set_point = data->temperature;
	if (system_alpaca_can(device, "cansetccdtemperature") && !ccd_probe_double(device, "setccdtemperature", &data->set_point, NULL)) {
		return false;
	}
	data->has_cooler_power = false;
	if (system_alpaca_can(device, "cangetcoolerpower") && !ccd_probe_double(device, "coolerpower", &data->cooler_power, &data->has_cooler_power)) {
		return false;
	}
	return true;
}

// Fill a switch property with the names of a list of the camera and select one of them.
static void ccd_fill_list(indigo_property *property, const char *prefix, const char names[][INDIGO_NAME_SIZE], int count, int selected) {
	char name[INDIGO_NAME_SIZE];
	char label[INDIGO_NAME_SIZE + 16];
	for (int i = 0; i < count; i++) {
		snprintf(name, sizeof(name), "%s_%d", prefix, i);
		snprintf(label, sizeof(label), "%s", names[i]);
		if (*label == 0) {
			snprintf(label, sizeof(label), "%s %d", prefix, i);
		}
		indigo_init_switch_item(property->items + i, name, label, i == selected);
	}
	property->count = count;
}

// Set up CCD_GAIN / CCD_OFFSET (a value) and X_ALPACA_GAIN / X_ALPACA_OFFSET (the index of a name) for the way the camera sets the level.
static void ccd_setup_level(const ccd_level *level, indigo_property *value_property, indigo_property *index_property, const char *prefix) {
	value_property->hidden = level->mode != CCD_LEVEL_VALUE;
	index_property->hidden = level->mode != CCD_LEVEL_INDEX;
	value_property->perm = index_property->perm = INDIGO_RW_PERM;
	value_property->state = index_property->state = INDIGO_OK_STATE;
	if (level->mode == CCD_LEVEL_VALUE) {
		value_property->items[0].number.min = level->min;
		value_property->items[0].number.max = level->max;
		value_property->items[0].number.step = 1;
		value_property->items[0].number.value = value_property->items[0].number.target = level->value;
	} else if (level->mode == CCD_LEVEL_INDEX) {
		ccd_fill_list(index_property, prefix, level->names, level->count, level->value);
	}
}

static bool ccd_on_connect(indigo_device *device) {
	ccd_data *data = CCD_DATA;
	char name[INDIGO_NAME_SIZE];
	char label[INDIGO_NAME_SIZE];
	bool symmetric = !system_alpaca_can(device, "canasymmetricbin");
	int max_bin_x = symmetric && data->max_bin_y < data->max_bin_x ? data->max_bin_y : data->max_bin_x;
	int max_bin_y = symmetric && data->max_bin_x < data->max_bin_y ? data->max_bin_x : data->max_bin_y;
	int bits = 0;
	for (unsigned adu = (unsigned)data->max_adu; adu > 0; adu >>= 1) {
		bits++;
	}
	data->phase = CCD_PHASE_IDLE;
	data->no_device_state = false;
	data->state_failures = 0;
	data->thermal_poll_time = 0;
	system_alpaca_lock(device);
	data->download.running = false;
	data->set_point_requests = 0;
	system_alpaca_unlock(device);
	data->transfer_queue = indigo_queue_create(device);
	if (data->transfer_queue == NULL) {
		return false;
	}
	// CCD_INFO
	CCD_INFO_WIDTH_ITEM->number.value = data->width;
	CCD_INFO_HEIGHT_ITEM->number.value = data->height;
	CCD_INFO_MAX_HORIZONAL_BIN_ITEM->number.value = max_bin_x;
	CCD_INFO_MAX_VERTICAL_BIN_ITEM->number.value = max_bin_y;
	CCD_INFO_PIXEL_WIDTH_ITEM->number.value = data->pixel_size_x;
	CCD_INFO_PIXEL_HEIGHT_ITEM->number.value = data->pixel_size_y;
	CCD_INFO_PIXEL_SIZE_ITEM->number.value = (data->pixel_size_x + data->pixel_size_y) / 2;
	CCD_INFO_BITS_PER_PIXEL_ITEM->number.value = bits;
	// CCD_BIN and CCD_FRAME start with what the camera is set to
	CCD_BIN_PROPERTY->perm = max_bin_x > 1 || max_bin_y > 1 ? INDIGO_RW_PERM : INDIGO_RO_PERM;
	CCD_BIN_HORIZONTAL_ITEM->number.min = CCD_BIN_VERTICAL_ITEM->number.min = 1;
	CCD_BIN_HORIZONTAL_ITEM->number.max = max_bin_x;
	CCD_BIN_VERTICAL_ITEM->number.max = max_bin_y;
	CCD_BIN_HORIZONTAL_ITEM->number.value = CCD_BIN_HORIZONTAL_ITEM->number.target = data->bin_x >= 1 && data->bin_x <= max_bin_x ? data->bin_x : 1;
	CCD_BIN_VERTICAL_ITEM->number.value = CCD_BIN_VERTICAL_ITEM->number.target = data->bin_y >= 1 && data->bin_y <= max_bin_y ? data->bin_y : 1;
	CCD_FRAME_LEFT_ITEM->number.max = CCD_FRAME_WIDTH_ITEM->number.max = data->width;
	CCD_FRAME_TOP_ITEM->number.max = CCD_FRAME_HEIGHT_ITEM->number.max = data->height;
	CCD_FRAME_LEFT_ITEM->number.value = (double)data->start_x * data->bin_x;
	CCD_FRAME_TOP_ITEM->number.value = (double)data->start_y * data->bin_y;
	CCD_FRAME_WIDTH_ITEM->number.value = data->num_x > 0 ? (double)data->num_x * data->bin_x : data->width;
	CCD_FRAME_HEIGHT_ITEM->number.value = data->num_y > 0 ? (double)data->num_y * data->bin_y : data->height;
	ccd_remember_frame(device);
	data->bits_per_pixel = (data->max_adu > 255 ? 16 : 8) * (data->sensor_type == CCD_SENSOR_COLOR ? 3 : 1);
	ccd_normalize_frame(device);
	CCD_FRAME_BITS_PER_PIXEL_ITEM->number.min = 8;
	CCD_FRAME_BITS_PER_PIXEL_ITEM->number.max = 48;
	CCD_FRAME_PROPERTY->state = CCD_BIN_PROPERTY->state = INDIGO_OK_STATE;
	// CCD_MODE: the readout modes of the camera, or the square binnings if it has no choice of readout modes
	CCD_MODE_PROPERTY->perm = INDIGO_RW_PERM;
	CCD_MODE_PROPERTY->state = INDIGO_OK_STATE;
	if (data->readout_mode_count >= 2) {
		ccd_fill_list(CCD_MODE_PROPERTY, "MODE", data->readout_modes, data->readout_mode_count, data->readout_mode);
	} else {
		int count = max_bin_x < max_bin_y ? max_bin_x : max_bin_y;
		for (int i = 0; i < count && i < CCD_MAX_MODES; i++) {
			snprintf(name, sizeof(name), "BIN_%dx%d", i + 1, i + 1);
			snprintf(label, sizeof(label), "RAW %dx%d", data->width / (i + 1), data->height / (i + 1));
			indigo_init_switch_item(CCD_MODE_PROPERTY->items + i, name, label, false);
		}
		CCD_MODE_PROPERTY->count = count < CCD_MAX_MODES ? count : CCD_MAX_MODES;
		ccd_sync_bin_mode(device);
	}
	CCD_READ_MODE_PROPERTY->hidden = !system_alpaca_can(device, "canfastreadout");
	CCD_READ_MODE_PROPERTY->perm = INDIGO_RW_PERM;
	CCD_READ_MODE_PROPERTY->state = INDIGO_OK_STATE;
	indigo_set_switch(CCD_READ_MODE_PROPERTY, data->fast_readout ? CCD_READ_MODE_HIGH_SPEED_ITEM : CCD_READ_MODE_LOW_NOISE_ITEM, true);
	// CCD_EXPOSURE
	if (data->has_exposure_limits) {
		CCD_EXPOSURE_ITEM->number.min = data->exposure_min;
		CCD_EXPOSURE_ITEM->number.max = data->exposure_max;
		if (data->exposure_resolution > 0) {
			CCD_EXPOSURE_ITEM->number.step = data->exposure_resolution;
		}
	}
	CCD_STREAMING_PROPERTY->hidden = true;
	// gain and offset
	ccd_setup_level(&data->gain, CCD_GAIN_PROPERTY, X_ALPACA_GAIN_PROPERTY, "GAIN");
	ccd_setup_level(&data->offset, CCD_OFFSET_PROPERTY, X_ALPACA_OFFSET_PROPERTY, "OFFSET");
	CCD_EGAIN_PROPERTY->hidden = !data->has_electrons_per_adu;
	CCD_EGAIN_ITEM->number.value = data->electrons_per_adu;
	// cooling
	CCD_COOLER_PROPERTY->hidden = !data->has_cooler;
	CCD_COOLER_PROPERTY->perm = INDIGO_RW_PERM;
	CCD_COOLER_PROPERTY->state = INDIGO_OK_STATE;
	indigo_set_switch(CCD_COOLER_PROPERTY, data->cooler_on ? CCD_COOLER_ON_ITEM : CCD_COOLER_OFF_ITEM, true);
	CCD_TEMPERATURE_PROPERTY->hidden = !data->has_temperature;
	CCD_TEMPERATURE_PROPERTY->perm = system_alpaca_can(device, "cansetccdtemperature") ? INDIGO_RW_PERM : INDIGO_RO_PERM;
	CCD_TEMPERATURE_ITEM->number.value = data->temperature;
	CCD_TEMPERATURE_ITEM->number.target = data->set_point;
	CCD_TEMPERATURE_PROPERTY->state = ccd_temperature_state(device);
	CCD_COOLER_POWER_PROPERTY->hidden = !data->has_cooler_power;
	CCD_COOLER_POWER_ITEM->number.value = data->cooler_power;
	CCD_COOLER_POWER_PROPERTY->state = INDIGO_OK_STATE;
	// X_ALPACA_SENSOR
	X_ALPACA_SENSOR_PROPERTY->hidden = !data->has_sensor_type && *data->sensor_name == 0 && !data->has_full_well_capacity;
	indigo_set_text_item_value(X_ALPACA_SENSOR_NAME_ITEM, data->sensor_name);
	if (!data->has_sensor_type || data->sensor_type < 0 || data->sensor_type >= CCD_SENSOR_TYPE_COUNT) {
		indigo_set_text_item_value(X_ALPACA_SENSOR_TYPE_ITEM, "");
	} else if (data->sensor_type == CCD_SENSOR_RGGB) {
		snprintf(label, sizeof(label), "Bayer %s", ccd_bayer_patterns[(data->bayer_offset_y & 1) * 2 + (data->bayer_offset_x & 1)]);
		indigo_set_text_item_value(X_ALPACA_SENSOR_TYPE_ITEM, label);
	} else {
		indigo_set_text_item_value(X_ALPACA_SENSOR_TYPE_ITEM, ccd_sensor_types[data->sensor_type]);
	}
	snprintf(label, sizeof(label), "%g", data->full_well_capacity);
	indigo_set_text_item_value(X_ALPACA_SENSOR_FULL_WELL_ITEM, data->has_full_well_capacity ? label : "");
	if (system_alpaca_can(device, "canpulseguide")) {
		system_alpaca_attach_secondary(device, &system_alpaca_guider_class);
	}
	indigo_define_property(device, X_ALPACA_SENSOR_PROPERTY, NULL);
	indigo_define_property(device, X_ALPACA_GAIN_PROPERTY, NULL);
	indigo_define_property(device, X_ALPACA_OFFSET_PROPERTY, NULL);
	return true;
}

static void ccd_on_disconnect(indigo_device *device) {
	ccd_data *data = CCD_DATA;
	if (data->exposure.active && data->phase == CCD_PHASE_EXPOSE) {
		ccd_cancel_on_camera(device);
	}
	// a transfer in progress uses the transfer channel, which is released after this hook: it is waited for
	system_alpaca_lock(device);
	data->download.cancelled = true;
	system_alpaca_unlock(device);
	indigo_queue_delete(&data->transfer_queue);
	system_alpaca_operation_end(device, &data->exposure);
	data->phase = CCD_PHASE_IDLE;
	data->download.channel = NULL;
	CCD_IMAGE_ITEM->blob.value = NULL;
	CCD_IMAGE_ITEM->blob.size = 0;
	indigo_safe_free(data->image);
	indigo_safe_free(data->json_pixels);
	data->image = NULL;
	data->image_size = 0;
	data->json_pixels = NULL;
	data->json_capacity = 0;
	// what a cancelled handler left BUSY; the properties are still defined, so a request may be accepted while they are reset
	system_alpaca_lock(device);
	data->download.running = false;
	CCD_ABORT_EXPOSURE_ITEM->sw.value = false;
	CCD_ABORT_EXPOSURE_PROPERTY->state = CCD_FRAME_PROPERTY->state = CCD_BIN_PROPERTY->state = CCD_MODE_PROPERTY->state = CCD_READ_MODE_PROPERTY->state = INDIGO_OK_STATE;
	CCD_GAIN_PROPERTY->state = CCD_OFFSET_PROPERTY->state = CCD_COOLER_PROPERTY->state = CCD_IMAGE_FILE_PROPERTY->state = INDIGO_OK_STATE;
	system_alpaca_unlock(device);
	indigo_delete_property(device, X_ALPACA_SENSOR_PROPERTY, NULL);
	indigo_delete_property(device, X_ALPACA_GAIN_PROPERTY, NULL);
	indigo_delete_property(device, X_ALPACA_OFFSET_PROPERTY, NULL);
}

// Cooling is read once per idle poll interval, also while an exposure makes the device tick faster: it changes slowly.
// Each of the three properties is read for itself, a camera may have any of them without the others.
static void ccd_on_poll(indigo_device *device) {
	ccd_data *data = CCD_DATA;
	double now = indigo_monotonic_time();
	double temperature = data->temperature, power = data->cooler_power;
	bool cooler_on = data->cooler_on;
	if (now < data->thermal_poll_time || (CCD_TEMPERATURE_PROPERTY->hidden && CCD_COOLER_PROPERTY->hidden && CCD_COOLER_POWER_PROPERTY->hidden)) {
		return;
	}
	data->thermal_poll_time = now + 0.9 * system_alpaca_poll_interval(false);
	// A change of the cooler that is on its way to the camera is not overwritten by what the camera says before it got it: the camera
	// is asked first and the property is touched afterwards, under the lock of the device and only if no request for it waits.
	system_alpaca_lock(device);
	bool cooler_idle = CCD_COOLER_PROPERTY->state != INDIGO_BUSY_STATE;
	system_alpaca_unlock(device);
	if (!CCD_COOLER_PROPERTY->hidden && cooler_idle && system_alpaca_get_bool(device, "cooleron", &cooler_on) == ALPACA_OK && cooler_on != data->cooler_on) {
		system_alpaca_lock(device);
		bool changed = CCD_COOLER_PROPERTY->state != INDIGO_BUSY_STATE;
		if (changed) {
			// the cooler was switched by somebody else
			data->cooler_on = cooler_on;
			indigo_set_switch(CCD_COOLER_PROPERTY, cooler_on ? CCD_COOLER_ON_ITEM : CCD_COOLER_OFF_ITEM, true);
		}
		system_alpaca_unlock(device);
		if (changed) {
			indigo_update_property(device, CCD_COOLER_PROPERTY, NULL);
		}
	}
	if (!CCD_TEMPERATURE_PROPERTY->hidden) {
		alpaca_result result = system_alpaca_state_double(device, "CCDTemperature", &temperature);
		if (result == ALPACA_OK) {
			data->temperature = temperature;
		}
		indigo_property_state state = result == ALPACA_OK ? ccd_temperature_state(device) : INDIGO_ALERT_STATE;
		// a new set point that is on its way to the camera keeps the property BUSY until ccd_temperature_handler has sent it
		system_alpaca_lock(device);
		bool changed = !ccd_set_point_pending(device) && (CCD_TEMPERATURE_ITEM->number.value != data->temperature || CCD_TEMPERATURE_PROPERTY->state != state);
		if (changed) {
			CCD_TEMPERATURE_ITEM->number.value = data->temperature;
			CCD_TEMPERATURE_PROPERTY->state = state;
		}
		system_alpaca_unlock(device);
		if (changed) {
			indigo_update_property(device, CCD_TEMPERATURE_PROPERTY, NULL);
		}
	}
	if (!CCD_COOLER_POWER_PROPERTY->hidden) {
		alpaca_result result = system_alpaca_state_double(device, "CoolerPower", &power);
		indigo_property_state state = result == ALPACA_OK ? INDIGO_OK_STATE : INDIGO_ALERT_STATE;
		if (result == ALPACA_OK) {
			data->cooler_power = power;
		}
		if (CCD_COOLER_POWER_ITEM->number.value != data->cooler_power || CCD_COOLER_POWER_PROPERTY->state != state) {
			CCD_COOLER_POWER_ITEM->number.value = data->cooler_power;
			system_alpaca_update(device, CCD_COOLER_POWER_PROPERTY, state, NULL);
		}
	}
}

// Refusal of a change of the settings of an exposure while one is in progress. Called by system_alpaca_accept() with the lock of the device held.
static const char *ccd_exposure_refusal(indigo_device *device) {
	return CCD_EXPOSURE_PROPERTY->state == INDIGO_BUSY_STATE ? "Exposure in progress" : NULL;
}

#pragma mark - Device API (ccd)

static indigo_result ccd_enumerate_properties(indigo_device *device, indigo_client *client, indigo_property *property);

static indigo_result ccd_attach(indigo_device *device) {
	assert(device != NULL);
	if (indigo_ccd_attach(device, DRIVER_NAME, DRIVER_VERSION) == INDIGO_OK) {
		X_ALPACA_SENSOR_PROPERTY = indigo_init_text_property(NULL, device->name, X_ALPACA_SENSOR_PROPERTY_NAME, CCD_MAIN_GROUP, "Sensor", INDIGO_OK_STATE, INDIGO_RO_PERM, 3);
		if (X_ALPACA_SENSOR_PROPERTY == NULL) {
			return INDIGO_FAILED;
		}
		indigo_init_text_item(X_ALPACA_SENSOR_NAME_ITEM, X_ALPACA_SENSOR_NAME_ITEM_NAME, "Name", "");
		indigo_init_text_item(X_ALPACA_SENSOR_TYPE_ITEM, X_ALPACA_SENSOR_TYPE_ITEM_NAME, "Type", "");
		indigo_init_text_item(X_ALPACA_SENSOR_FULL_WELL_ITEM, X_ALPACA_SENSOR_FULL_WELL_ITEM_NAME, "Full well capacity (e-)", "");
		X_ALPACA_GAIN_PROPERTY = indigo_init_switch_property(NULL, device->name, X_ALPACA_GAIN_PROPERTY_NAME, CCD_MAIN_GROUP, "Gain", INDIGO_OK_STATE, INDIGO_RW_PERM, INDIGO_ONE_OF_MANY_RULE, CCD_MAX_LEVELS);
		if (X_ALPACA_GAIN_PROPERTY == NULL) {
			return INDIGO_FAILED;
		}
		X_ALPACA_GAIN_PROPERTY->count = 0;
		X_ALPACA_GAIN_PROPERTY->hidden = true;
		X_ALPACA_OFFSET_PROPERTY = indigo_init_switch_property(NULL, device->name, X_ALPACA_OFFSET_PROPERTY_NAME, CCD_MAIN_GROUP, "Offset", INDIGO_OK_STATE, INDIGO_RW_PERM, INDIGO_ONE_OF_MANY_RULE, CCD_MAX_LEVELS);
		if (X_ALPACA_OFFSET_PROPERTY == NULL) {
			return INDIGO_FAILED;
		}
		X_ALPACA_OFFSET_PROPERTY->count = 0;
		X_ALPACA_OFFSET_PROPERTY->hidden = true;
		return system_alpaca_attach(device) == INDIGO_OK ? ccd_enumerate_properties(device, NULL, NULL) : INDIGO_FAILED;
	}
	return INDIGO_FAILED;
}

static indigo_result ccd_enumerate_properties(indigo_device *device, indigo_client *client, indigo_property *property) {
	if (system_alpaca_is_active(device)) {
		INDIGO_DEFINE_MATCHING_PROPERTY(X_ALPACA_SENSOR_PROPERTY);
		INDIGO_DEFINE_MATCHING_PROPERTY(X_ALPACA_GAIN_PROPERTY);
		INDIGO_DEFINE_MATCHING_PROPERTY(X_ALPACA_OFFSET_PROPERTY);
	}
	return indigo_ccd_enumerate_properties(device, client, property);
}

static indigo_result ccd_change_property(indigo_device *device, indigo_client *client, indigo_property *property) {
	if (system_alpaca_change_property(device, property)) {
		return INDIGO_OK;
	}
	if (indigo_property_match_changeable(CCD_EXPOSURE_PROPERTY, property)) {
		system_alpaca_accept(device, CCD_EXPOSURE_PROPERTY, property, ALPACA_ACCEPT_VALUES, NULL, ccd_exposure_handler);
		return INDIGO_OK;
	} else if (indigo_property_match_changeable(CCD_ABORT_EXPOSURE_PROPERTY, property)) {
		system_alpaca_accept(device, CCD_ABORT_EXPOSURE_PROPERTY, property, ALPACA_ACCEPT_VALUES | ALPACA_ACCEPT_URGENT, NULL, ccd_abort_exposure_handler);
		return INDIGO_OK;
	} else if (indigo_property_match_changeable(CCD_FRAME_PROPERTY, property)) {
		system_alpaca_accept(device, CCD_FRAME_PROPERTY, property, ALPACA_ACCEPT_VALUES, ccd_exposure_refusal, ccd_frame_handler);
		return INDIGO_OK;
	} else if (indigo_property_match_changeable(CCD_BIN_PROPERTY, property)) {
		system_alpaca_accept(device, CCD_BIN_PROPERTY, property, ALPACA_ACCEPT_TARGETS, ccd_exposure_refusal, ccd_bin_handler);
		return INDIGO_OK;
	} else if (indigo_property_match_changeable(CCD_MODE_PROPERTY, property)) {
		system_alpaca_accept(device, CCD_MODE_PROPERTY, property, ALPACA_ACCEPT_VALUES, ccd_exposure_refusal, ccd_mode_handler);
		return INDIGO_OK;
	} else if (indigo_property_match_changeable(CCD_READ_MODE_PROPERTY, property)) {
		system_alpaca_accept(device, CCD_READ_MODE_PROPERTY, property, ALPACA_ACCEPT_VALUES, ccd_exposure_refusal, ccd_read_mode_handler);
		return INDIGO_OK;
	} else if (indigo_property_match_changeable(CCD_GAIN_PROPERTY, property)) {
		system_alpaca_accept(device, CCD_GAIN_PROPERTY, property, ALPACA_ACCEPT_TARGETS, ccd_exposure_refusal, ccd_gain_handler);
		return INDIGO_OK;
	} else if (indigo_property_match_changeable(CCD_OFFSET_PROPERTY, property)) {
		system_alpaca_accept(device, CCD_OFFSET_PROPERTY, property, ALPACA_ACCEPT_TARGETS, ccd_exposure_refusal, ccd_offset_handler);
		return INDIGO_OK;
	} else if (indigo_property_match_changeable(X_ALPACA_GAIN_PROPERTY, property)) {
		system_alpaca_accept(device, X_ALPACA_GAIN_PROPERTY, property, ALPACA_ACCEPT_VALUES, ccd_exposure_refusal, ccd_x_alpaca_gain_handler);
		return INDIGO_OK;
	} else if (indigo_property_match_changeable(X_ALPACA_OFFSET_PROPERTY, property)) {
		system_alpaca_accept(device, X_ALPACA_OFFSET_PROPERTY, property, ALPACA_ACCEPT_VALUES, ccd_exposure_refusal, ccd_x_alpaca_offset_handler);
		return INDIGO_OK;
	} else if (indigo_property_match_changeable(CCD_COOLER_PROPERTY, property)) {
		system_alpaca_accept(device, CCD_COOLER_PROPERTY, property, ALPACA_ACCEPT_VALUES, NULL, ccd_cooler_handler);
		return INDIGO_OK;
	} else if (indigo_property_match_changeable(CCD_TEMPERATURE_PROPERTY, property)) {
		// CCD_TEMPERATURE is BUSY while the cooler works towards the set point; a new set point is accepted all the same.
		// The steps of system_alpaca_accept(), and the count of the set points that wait for their handler.
		system_alpaca_lock(device);
		CCD_DATA->set_point_requests++;
		indigo_property_copy_targets(CCD_TEMPERATURE_PROPERTY, property, false);
		CCD_TEMPERATURE_PROPERTY->state = INDIGO_BUSY_STATE;
		system_alpaca_unlock(device);
		indigo_update_property(device, CCD_TEMPERATURE_PROPERTY, NULL);
		indigo_execute_handler(device, ccd_temperature_handler);
		return INDIGO_OK;
	} else if (indigo_property_match(CONFIG_PROPERTY, property)) {
		if (indigo_switch_match(CONFIG_SAVE_ITEM, property)) {
			indigo_save_property(device, NULL, X_ALPACA_GAIN_PROPERTY);
			indigo_save_property(device, NULL, X_ALPACA_OFFSET_PROPERTY);
		}
	}
	return indigo_ccd_change_property(device, client, property);
}

static indigo_result ccd_detach(indigo_device *device) {
	assert(device != NULL);
	system_alpaca_detach(device);
	indigo_release_property(X_ALPACA_SENSOR_PROPERTY);
	indigo_release_property(X_ALPACA_GAIN_PROPERTY);
	indigo_release_property(X_ALPACA_OFFSET_PROPERTY);
	INDIGO_DEVICE_DETACH_LOG(DRIVER_NAME, device->name);
	return indigo_ccd_detach(device);
}

#pragma mark - Device class

const alpaca_class system_alpaca_ccd_class = {
	.device_type = "Camera",
	.platform7_version = 4,
	.data_size = sizeof(ccd_data),
	.attach = ccd_attach,
	.enumerate_properties = ccd_enumerate_properties,
	.change_property = ccd_change_property,
	.detach = ccd_detach,
	.base_change_property = indigo_ccd_change_property,
	.on_probe = ccd_on_probe,
	.on_connect = ccd_on_connect,
	.on_disconnect = ccd_on_disconnect,
	.on_poll = ccd_on_poll
};
