// Copyright (c) 2026 CloudMakers, s. r. o.
// All rights reserved.
//
// You can use this software under the terms of 'INDIGO Astronomy
// open-source license' (see LICENSE.md).
//
// THIS SOFTWARE IS PROVIDED BY THE AUTHORS 'AS IS' AND ANY EXPRESS
// OR IMPLIED WARRANTIES, INCLUDING, BUT NOT LIMITED TO, THE IMPLIED
// WARRANTIES OF MERCHANTABILITY AND FITNESS FOR A PARTICULAR PURPOSE
// ARE DISCLAIMED. IN NO EVENT SHALL THE AUTHOR BE LIABLE FOR ANY
// DIRECT, INDIRECT, INCIDENTAL, SPECIAL, EXEMPLARY, OR CONSEQUENTIAL
// DAMAGES (INCLUDING, BUT NOT LIMITED TO, PROCUREMENT OF SUBSTITUTE
// GOODS OR SERVICES; LOSS OF USE, DATA, OR PROFITS; OR BUSINESS
// INTERRUPTION) HOWEVER CAUSED AND ON ANY THEORY OF LIABILITY,
// WHETHER IN CONTRACT, STRICT LIABILITY, OR TORT (INCLUDING
// NEGLIGENCE OR OTHERWISE) ARISING IN ANY WAY OUT OF THE USE OF THIS
// SOFTWARE, EVEN IF ADVISED OF THE POSSIBILITY OF SUCH DAMAGE.

// version history
// 3.0 by Peter Polakovic <peter.polakovic@cloudmakers.eu>

// Code is generated by AI

/** INDIGO ASCOM Alpaca client driver, guider device class: secondary guider device of an Alpaca Camera or Telescope that can pulse guide
 \file indigo_system_alpaca_guider.c

 GUIDER_GUIDE_DEC and GUIDER_GUIDE_RA are PulseGuide of the primary device: Direction 0 north, 1 south, 2 east, 3 west, Duration in whole
 milliseconds. The request is never sent twice: a pulse that may or may not have reached the device ends in ALERT.

 COMPLETION

 PulseGuide returns when the pulse has started (or, with older devices, when it is over) and IsPulseGuiding tells when it is over.
 The finalizer of an axis runs when the duration has passed since PulseGuide returned, which is the earliest time at which the pulse
 is certainly over, and then reads IsPulseGuiding; a PulseGuide that took at least as long as the pulse is checked at once.
 While IsPulseGuiding is true the finalizer repeats in the rhythm of the active polling, for at most GUIDER_GRACE seconds.
 A pulse that is over is followed by a poll tick of the primary device (system_alpaca_poll_now()) before the property is completed,
 so the coordinates of a telescope already show the pulse when a client sees it end.
 A device without IsPulseGuiding completes by the duration alone. IsPulseGuiding is one flag for both axes: while the pulse of the
 other axis still has time to run it says nothing about this axis, so the axis completes by its duration.

 REPLACEMENT

 A request for an axis whose pulse still runs replaces it, as in the other INDIGO guiders: the pending finalizer is cancelled and the
 new PulseGuide is sent; what the device does with a pulse that overlaps the previous one is up to the device. Requests that queue up
 for one axis are coalesced, only the last one is sent. A finalizer that finds a newer request waiting leaves the property to it.
 A request with both items zero ends the running pulse with PulseGuide of Duration 0 (the ASCOM simulators end a pulse that way;
 a device that refuses it leaves the request in ALERT) and is a no-op when no pulse runs. The same is sent, as a courtesy, for the
 pulses that are still running when the device disconnects.

 GUIDER_RATE is not used: a camera has no guide rate, and the guide rates of a telescope are MOUNT_GUIDE_RATE of the mount device.

 Threads: change_property runs on a bus thread, everything else on the handler queue of the primary device. A request is accepted
 while its property is BUSY as well, so the items and the state of GUIDER_GUIDE_DEC and GUIDER_GUIDE_RA are written by both sides;
 both do it under the lock of the device, together with the count of the requests that wait for their handler. A finalizer ends
 a pulse (the items back to zero, the state of the result) in one step under that lock and only if no request waits, so the end
 of a pulse never takes the place of a request that was just accepted.
 */

#pragma mark - Includes

#include <stdlib.h>
#include <string.h>
#include <math.h>
#include <assert.h>

#include <indigo/indigo_guider_driver.h>

#include "indigo_system_alpaca_private.h"

#pragma mark - Common definitions

/** Time in seconds IsPulseGuiding may stay true after the pulse should have ended.
 */
#define GUIDER_GRACE											5.0

/** Alpaca GuideDirections.
 */
#define GUIDER_NORTH											0
#define GUIDER_SOUTH											1
#define GUIDER_EAST												2
#define GUIDER_WEST												3

#pragma mark - Private data definition

#define GUIDER_DATA												((guider_data *)CLASS_DATA)

typedef struct {
	bool active;										///< a pulse was started and its completion was not published yet
	int direction;									///< direction of that pulse
	double end;											///< time at which that pulse is certainly over
	double deadline;								///< time until which IsPulseGuiding is watched
	int waiting;										///< requests whose handler did not run yet, guarded by the lock of the device
	double requested[2];						///< durations of the two items in the last request, guarded by the lock of the device
} guider_axis;

typedef struct {
	guider_axis ra;
	guider_axis dec;
} guider_data;

#pragma mark - Low level code (guider)

// Bus thread: a request arrived and is accepted whatever the state of the property is. Its durations are kept for the handler:
// the items of the property are written by the next request while the handler of this one may still be reading them.
// The durations are taken from the property after indigo_property_copy_values(), which limits them to the range of the items and skips a
// value that is not finite; an item the request does not name is 0.
static void guider_accept(indigo_device *device, guider_axis *axis, indigo_property *property, indigo_property *request, indigo_timer_callback handler) {
	system_alpaca_lock(device);
	axis->waiting++;
	property->items[0].number.value = property->items[0].number.target = property->items[1].number.value = property->items[1].number.target = 0;
	indigo_property_copy_values(property, request, false);
	axis->requested[0] = property->items[0].number.value;
	axis->requested[1] = property->items[1].number.value;
	property->state = INDIGO_BUSY_STATE;
	system_alpaca_unlock(device);
	indigo_update_property(device, property, NULL);
	indigo_execute_priority_handler_in(device, INDIGO_TASK_PRIORITY_TIME, 0, handler);
}

// The handler of a request starts. Returns the number of requests that still wait behind it and the durations of the last one.
// The handler that goes on shows its durations: the finalizer of the previous pulse may have zeroed the items after the request was copied.
static int guider_take(indigo_device *device, guider_axis *axis, indigo_property *property, double *requested) {
	system_alpaca_lock(device);
	int waiting = axis->waiting > 0 ? --axis->waiting : 0;
	requested[0] = axis->requested[0];
	requested[1] = axis->requested[1];
	if (waiting == 0) {
		property->items[0].number.value = requested[0];
		property->items[1].number.value = requested[1];
	}
	system_alpaca_unlock(device);
	return waiting;
}

static int guider_waiting(indigo_device *device, guider_axis *axis) {
	system_alpaca_lock(device);
	int waiting = axis->waiting;
	system_alpaca_unlock(device);
	return waiting;
}

static void guider_reset(indigo_device *device, guider_axis *axis) {
	system_alpaca_lock(device);
	axis->waiting = 0;
	axis->requested[0] = axis->requested[1] = 0;
	system_alpaca_unlock(device);
	axis->active = false;
}

static alpaca_result guider_pulse(indigo_device *device, int direction, int duration) {
	alpaca_param params[] = { ALPACA_INT_PARAM("Direction", direction), ALPACA_INT_PARAM("Duration", duration) };
	return system_alpaca_put(device, "pulseguide", params, 2, ALPACA_WAIT_LONG);
}

// End the request of an axis: the items go back to zero and the property gets the state of the result, in one step under the lock
// of the device and only if no newer request waits for its handler: a newer request owns the property, which is BUSY because of it.
// Returns false if the property was left to a newer request. reason is the text taken with system_alpaca_reason().
static bool guider_complete(indigo_device *device, guider_axis *axis, indigo_property *property, alpaca_result result, const char *action, const char *reason) {
	system_alpaca_lock(device);
	bool completed = axis->waiting == 0;
	if (completed) {
		axis->active = false;
		property->items[0].number.value = property->items[1].number.value = 0;
		property->state = system_alpaca_property_state(result);
	}
	system_alpaca_unlock(device);
	if (completed) {
		system_alpaca_report(device, property, result, action, reason);
	}
	return completed;
}

#pragma mark - High level code (guider)

// Completion of the pulse of one axis, see the description at the top of this file.
static void guider_finalize(indigo_device *device, guider_axis *axis, guider_axis *other, indigo_property *property, indigo_timer_callback finalizer) {
	char reason[INDIGO_VALUE_SIZE] = { 0 };
	alpaca_result result = ALPACA_OK;
	bool guiding = false;
	if (!axis->active || guider_waiting(device, axis) > 0) {
		return;
	}
	double now = indigo_monotonic_time();
	if (!other->active || other->end <= now) {
		result = system_alpaca_state_bool(device, "IsPulseGuiding", &guiding);
		system_alpaca_reason(device, result, reason, sizeof(reason));
		if (alpaca_is_unsupported(result)) {
			result = ALPACA_OK;
			guiding = false;
		}
		if (result == ALPACA_OK && guiding && indigo_monotonic_time() < axis->deadline) {
			indigo_execute_priority_handler_in(device, INDIGO_TASK_PRIORITY_TIME, system_alpaca_poll_interval(true), finalizer);
			return;
		}
	}
	if (result == ALPACA_OK && !guiding) {
		// a client reads the coordinates as soon as the pulse is reported over; the next regular poll may be a second away
		system_alpaca_poll_now(device);
	}
	guider_complete(device, axis, property, result == ALPACA_OK && guiding ? ALPACA_TIMED_OUT : result, "Guiding", reason);
}

// A request for one axis. first and second are the Alpaca directions of the two items of the property.
static void guider_guide(indigo_device *device, guider_axis *axis, indigo_property *property, int first, int second, indigo_timer_callback finalizer) {
	char reason[INDIGO_VALUE_SIZE] = { 0 };
	double requested[2] = { 0, 0 };
	if (guider_take(device, axis, property, requested) > 0) {
		return;
	}
	indigo_cancel_pending_handler(device, finalizer);
	int duration = (int)lround(requested[0] > 0 ? requested[0] : requested[1]);
	if (duration > 0) {
		int direction = requested[0] > 0 ? first : second;
		indigo_update_property(device, property, NULL);
		double started = indigo_monotonic_time();
		alpaca_result result = guider_pulse(device, direction, duration);
		double returned = indigo_monotonic_time();
		if (result == ALPACA_OK) {
			double remaining = returned - started >= duration / 1000.0 ? 0 : duration / 1000.0;
			axis->active = true;
			axis->direction = direction;
			axis->end = returned + remaining;
			axis->deadline = axis->end + GUIDER_GRACE;
			indigo_execute_priority_handler_in(device, INDIGO_TASK_PRIORITY_TIME, remaining, finalizer);
		} else {
			system_alpaca_reason(device, result, reason, sizeof(reason));
			axis->active = false;
			if (!guider_complete(device, axis, property, result, "Guiding", reason)) {
				// the property stays BUSY for the request that arrived meanwhile, the failure of this one is told all the same
				system_alpaca_report(device, property, result, "Guiding", reason);
			}
		}
	} else {
		alpaca_result result = axis->active ? guider_pulse(device, axis->direction, 0) : ALPACA_OK;
		system_alpaca_reason(device, result, reason, sizeof(reason));
		axis->active = false;
		if (!guider_complete(device, axis, property, result, "Guiding stop", reason) && result != ALPACA_OK) {
			system_alpaca_report(device, property, result, "Guiding stop", reason);
		}
	}
}

static void guider_guide_dec_finalizer(indigo_device *device) {
	if (!system_alpaca_is_active(device) || PRIVATE_DATA->detaching) {
		return;
	}
	guider_finalize(device, &GUIDER_DATA->dec, &GUIDER_DATA->ra, GUIDER_GUIDE_DEC_PROPERTY, guider_guide_dec_finalizer);
}

static void guider_guide_ra_finalizer(indigo_device *device) {
	if (!system_alpaca_is_active(device) || PRIVATE_DATA->detaching) {
		return;
	}
	guider_finalize(device, &GUIDER_DATA->ra, &GUIDER_DATA->dec, GUIDER_GUIDE_RA_PROPERTY, guider_guide_ra_finalizer);
}

static void guider_guide_dec_handler(indigo_device *device) {
	if (!system_alpaca_is_active(device) || PRIVATE_DATA->detaching) {
		return;
	}
	guider_guide(device, &GUIDER_DATA->dec, GUIDER_GUIDE_DEC_PROPERTY, GUIDER_NORTH, GUIDER_SOUTH, guider_guide_dec_finalizer);
}

static void guider_guide_ra_handler(indigo_device *device) {
	if (!system_alpaca_is_active(device) || PRIVATE_DATA->detaching) {
		return;
	}
	guider_guide(device, &GUIDER_DATA->ra, GUIDER_GUIDE_RA_PROPERTY, GUIDER_EAST, GUIDER_WEST, guider_guide_ra_finalizer);
}

static bool guider_on_connect(indigo_device *device) {
	guider_reset(device, &GUIDER_DATA->ra);
	guider_reset(device, &GUIDER_DATA->dec);
	system_alpaca_lock(device);
	GUIDER_GUIDE_NORTH_ITEM->number.value = GUIDER_GUIDE_NORTH_ITEM->number.target = GUIDER_GUIDE_SOUTH_ITEM->number.value = GUIDER_GUIDE_SOUTH_ITEM->number.target = 0;
	GUIDER_GUIDE_EAST_ITEM->number.value = GUIDER_GUIDE_EAST_ITEM->number.target = GUIDER_GUIDE_WEST_ITEM->number.value = GUIDER_GUIDE_WEST_ITEM->number.target = 0;
	GUIDER_GUIDE_DEC_PROPERTY->state = GUIDER_GUIDE_RA_PROPERTY->state = INDIGO_OK_STATE;
	system_alpaca_unlock(device);
	return true;
}

static void guider_on_disconnect(indigo_device *device) {
	guider_data *data = GUIDER_DATA;
	// a pulse that still runs is ended; the result does not matter, the pulse ends by itself
	if (data->dec.active) {
		guider_pulse(device, data->dec.direction, 0);
	}
	if (data->ra.active) {
		guider_pulse(device, data->ra.direction, 0);
	}
	// A detach calls this hook with the lock of the device of the framework held and has emptied the queue before (see THREADS in
	// indigo_system_alpaca_private.h): a cancel here would wait for a finalizer the queue has taken already, which waits for the lock.
	if (!PRIVATE_DATA->detaching) {
		indigo_cancel_pending_handler(device, guider_guide_dec_finalizer);
		indigo_cancel_pending_handler(device, guider_guide_ra_finalizer);
	}
	guider_reset(device, &data->dec);
	guider_reset(device, &data->ra);
	// the properties are still defined, so a request may be accepted while they are reset; its handler finds the session closed
	system_alpaca_lock(device);
	GUIDER_GUIDE_NORTH_ITEM->number.value = GUIDER_GUIDE_SOUTH_ITEM->number.value = GUIDER_GUIDE_EAST_ITEM->number.value = GUIDER_GUIDE_WEST_ITEM->number.value = 0;
	GUIDER_GUIDE_DEC_PROPERTY->state = GUIDER_GUIDE_RA_PROPERTY->state = INDIGO_OK_STATE;
	system_alpaca_unlock(device);
}

#pragma mark - Device API (guider)

static indigo_result guider_enumerate_properties(indigo_device *device, indigo_client *client, indigo_property *property);

static indigo_result guider_attach(indigo_device *device) {
	assert(device != NULL);
	if (indigo_guider_attach(device, DRIVER_NAME, DRIVER_VERSION) == INDIGO_OK) {
		return system_alpaca_attach(device) == INDIGO_OK ? guider_enumerate_properties(device, NULL, NULL) : INDIGO_FAILED;
	}
	return INDIGO_FAILED;
}

static indigo_result guider_enumerate_properties(indigo_device *device, indigo_client *client, indigo_property *property) {
	return indigo_guider_enumerate_properties(device, client, property);
}

static indigo_result guider_change_property(indigo_device *device, indigo_client *client, indigo_property *property) {
	if (system_alpaca_change_property(device, property)) {
		return INDIGO_OK;
	}
	if (indigo_property_match_changeable(GUIDER_GUIDE_DEC_PROPERTY, property)) {
		guider_accept(device, &GUIDER_DATA->dec, GUIDER_GUIDE_DEC_PROPERTY, property, guider_guide_dec_handler);
		return INDIGO_OK;
	} else if (indigo_property_match_changeable(GUIDER_GUIDE_RA_PROPERTY, property)) {
		guider_accept(device, &GUIDER_DATA->ra, GUIDER_GUIDE_RA_PROPERTY, property, guider_guide_ra_handler);
		return INDIGO_OK;
	}
	return indigo_guider_change_property(device, client, property);
}

static indigo_result guider_detach(indigo_device *device) {
	assert(device != NULL);
	system_alpaca_detach(device);
	INDIGO_DEVICE_DETACH_LOG(DRIVER_NAME, device->name);
	return indigo_guider_detach(device);
}

#pragma mark - Device class

const alpaca_class system_alpaca_guider_class = {
	.name_suffix = " (guider)",
	.data_size = sizeof(guider_data),
	.attach = guider_attach,
	.enumerate_properties = guider_enumerate_properties,
	.change_property = guider_change_property,
	.detach = guider_detach,
	.base_change_property = indigo_guider_change_property,
	.on_connect = guider_on_connect,
	.on_disconnect = guider_on_disconnect
};
