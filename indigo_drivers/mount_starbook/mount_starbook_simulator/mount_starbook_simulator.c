// Vixen StarBook mount HTTP simulator
//
// Copyright (c) 2026 CloudMakers, s. r. o.
// All rights reserved.
//
// You can use this software under the terms of 'INDIGO Astronomy
// open-source license' (see LICENSE.md).
//
// This source file was generated by a Codex agent.

#define _DEFAULT_SOURCE

#include <arpa/inet.h>
#include <errno.h>
#include <limits.h>
#include <math.h>
#include <netinet/in.h>
#include <signal.h>
#include <stdbool.h>
#include <stdio.h>
#include <stdlib.h>
#include <string.h>
#include <sys/select.h>
#include <sys/socket.h>
#include <sys/time.h>
#include <time.h>
#include <unistd.h>

#include "../../../indigo_test/simulator_common/serial_simulator_common.h"

typedef struct {
	bool headless;
	bool trace;
	const char *ready_file;
	const char *trace_file;
	const char *fault_path;
	const char *fault_reply;
	const char *drop_path;
	bool fault_used;
	bool drop_used;
} simulator_options;

typedef struct {
	double version;
	double ra;
	double dec;
	int goto_state;
	int track_state;
	int pierside;
	int year;
	int month;
	int day;
	int hour;
	int minute;
	int second;
	int timezone;
	char longitude[16];
	char latitude[16];
	int speed;
	bool north;
	bool south;
	bool east;
	bool west;
	int goto_polls;
} simulator_state;

static simulator_options options = {
	.headless = false,
	.trace = false,
	.ready_file = NULL,
	.trace_file = NULL,
	.fault_path = NULL,
	.fault_reply = NULL,
	.drop_path = NULL,
	.fault_used = false,
	.drop_used = false
};

static simulator_state state = {
	.version = 4.20,
	.ra = 6.0,
	.dec = 45.0,
	.goto_state = 0,
	.track_state = 1,
	.pierside = 0,
	.year = 2026,
	.month = 8,
	.day = 24,
	.hour = 22,
	.minute = 15,
	.second = 30,
	.timezone = 2,
	.longitude = "E017+06",
	.latitude = "N48+08",
	.speed = 3,
	.north = false,
	.south = false,
	.east = false,
	.west = false,
	.goto_polls = 0
};

static const char *simulator_name = "mount_starbook";
static volatile sig_atomic_t running = 1;
static int server_fd = -1;

static void usage(const char *name) {
	printf("Vixen StarBook mount HTTP simulator\n");
	printf("Usage: %s [OPTIONS]\n", name);
	printf("  --headless              Disable terminal-oriented output\n");
	printf("  --ready-file <path>     Write INDIGO_SIMULATOR_PORT after TCP setup\n");
	printf("  --trace                 Log HTTP requests\n");
	printf("  --trace-file <path>     Append timestamped HTTP requests\n");
	printf("  --version <number>      Select simulated firmware version\n");
	printf("  --fault-reply <path> <body>  Replace one matching response body\n");
	printf("  --drop-reply <path>     Drop one matching HTTP response\n");
	printf("  -h, --help              Show this help and exit\n");
}

static bool parse_args(int argc, char *argv[]) {
	for (int i = 1; i < argc; i++) {
		if (!strcmp(argv[i], "-h") || !strcmp(argv[i], "--help")) {
			usage(argv[0]);
			exit(0);
		} else if (!strcmp(argv[i], "--headless")) {
			options.headless = true;
			options.trace = false;
		} else if (!strcmp(argv[i], "--trace")) {
			options.trace = true;
		} else if (!strcmp(argv[i], "--trace-file")) {
			if (++i == argc) return false;
			options.trace_file = argv[i];
		} else if (!strcmp(argv[i], "--version")) {
			if (++i == argc) return false;
			state.version = strtod(argv[i], NULL);
		} else if (!strcmp(argv[i], "--fault-reply")) {
			if (i + 2 >= argc) return false;
			options.fault_path = argv[++i];
			options.fault_reply = argv[++i];
		} else if (!strcmp(argv[i], "--drop-reply")) {
			if (++i == argc) return false;
			options.drop_path = argv[i];
		} else if (!strcmp(argv[i], "--ready-file")) {
			if (++i == argc) {
				fprintf(stderr, "--ready-file requires a path\n");
				return false;
			}
			options.ready_file = argv[i];
		} else {
			fprintf(stderr, "Unknown option '%s'\n", argv[i]);
			return false;
		}
	}
	return true;
}

static bool path_matches(const char *pattern, const char *path) {
	if (pattern == NULL) {
		return false;
	}
	size_t length = strlen(pattern);
	return length > 0 && pattern[length - 1] == '*' ? !strncmp(pattern, path, length - 1) : !strcmp(pattern, path);
}

static double monotonic_time(void) {
	struct timespec now;
	clock_gettime(CLOCK_MONOTONIC, &now);
	return now.tv_sec + now.tv_nsec / 1000000000.0;
}

static void trace_request(const char *path) {
	if (options.trace_file == NULL) {
		return;
	}
	FILE *file = fopen(options.trace_file, "a");
	if (file != NULL) {
		fprintf(file, "%.6f %s\n", monotonic_time(), path);
		fclose(file);
	}
}

static void signal_handler(int sig) {
	(void)sig;
	running = 0;
	if (server_fd >= 0) {
		close(server_fd);
		server_fd = -1;
	}
}

static int open_server_socket(int *port) {
	int fd = socket(AF_INET, SOCK_STREAM, 0);
	if (fd < 0) {
		perror("socket");
		return -1;
	}
	int reuse = 1;
	setsockopt(fd, SOL_SOCKET, SO_REUSEADDR, &reuse, sizeof(reuse));
	struct sockaddr_in addr;
	memset(&addr, 0, sizeof(addr));
	addr.sin_family = AF_INET;
	addr.sin_addr.s_addr = htonl(INADDR_LOOPBACK);
	addr.sin_port = 0;
	if (bind(fd, (struct sockaddr *)&addr, sizeof(addr)) < 0) {
		perror("bind");
		close(fd);
		return -1;
	}
	if (listen(fd, 8) < 0) {
		perror("listen");
		close(fd);
		return -1;
	}
	socklen_t len = sizeof(addr);
	if (getsockname(fd, (struct sockaddr *)&addr, &len) < 0) {
		perror("getsockname");
		close(fd);
		return -1;
	}
	*port = ntohs(addr.sin_port);
	return fd;
}

static bool write_all(int fd, const char *data, size_t length) {
	while (running && length > 0) {
		ssize_t written = write(fd, data, length);
		if (written > 0) {
			data += written;
			length -= (size_t)written;
		} else if (written < 0 && (errno == EINTR || errno == EAGAIN || errno == EWOULDBLOCK)) {
			usleep(1000);
		} else {
			return false;
		}
	}
	return true;
}

static bool query_value(const char *path, const char *key, char *value, size_t size) {
	const char *cursor = strchr(path, '?');
	if (cursor == NULL) {
		return false;
	}
	cursor++;
	size_t key_length = strlen(key);
	while (*cursor) {
		if (!strncmp(cursor, key, key_length) && cursor[key_length] == '=') {
			const char *start = cursor + key_length + 1;
			const char *end = strchr(start, '&');
			size_t length = end == NULL ? strlen(start) : (size_t)(end - start);
			if (length >= size) {
				length = size - 1;
			}
			memcpy(value, start, length);
			value[length] = '\0';
			return true;
		}
		cursor = strchr(cursor, '&');
		if (cursor == NULL) {
			break;
		}
		cursor++;
	}
	return false;
}

static double parse_starbook_degree(const char *value) {
	char *end = NULL;
	double degrees = strtod(value, &end);
	if (end != NULL && *end == '+') {
		degrees += strtod(end + 1, NULL) / 60.0;
	}
	return degrees;
}

static void update_place_from_path(const char *path) {
	char value[32];
	if (query_value(path, "LONGITUDE", value, sizeof(value))) {
		snprintf(state.longitude, sizeof(state.longitude), "%s", value);
	}
	if (query_value(path, "LATITUDE", value, sizeof(value))) {
		snprintf(state.latitude, sizeof(state.latitude), "%s", value);
	}
	if (query_value(path, "TIMEZONE", value, sizeof(value))) {
		state.timezone = atoi(value);
	}
}

static void update_time_from_path(const char *path) {
	char value[64];
	if (query_value(path, "TIME", value, sizeof(value))) {
		sscanf(value, "%d+%d+%d+%d+%d+%d", &state.year, &state.month, &state.day, &state.hour, &state.minute, &state.second);
	}
}

static void update_radec_from_path(const char *path) {
	char value[32];
	if (query_value(path, "ra", value, sizeof(value))) {
		state.ra = parse_starbook_degree(value);
	}
	if (query_value(path, "dec", value, sizeof(value))) {
		int sign = value[0] == '-' ? -1 : 1;
		const char *text = value[0] == '-' || value[0] == '+' ? value + 1 : value;
		state.dec = sign * parse_starbook_degree(text);
	}
}

static void response_body(const char *path, char *body, size_t size) {
	if (!strncmp(path, "/VERSION", 8)) {
		snprintf(body, size, "VERSION=%.2f", state.version);
	} else if (!strncmp(path, "/GETSTATUS2", 11)) {
		if (state.north) state.dec += 0.01;
		if (state.south) state.dec -= 0.01;
		if (state.east) state.ra += 0.01;
		if (state.west) state.ra -= 0.01;
		snprintf(body, size, "RA=%.6f&DEC=%.6f&GOTO=%d&STATE=%s", state.ra, state.dec, state.goto_state, state.track_state == 0 ? "STOP" : "TRACK");
		if (state.goto_polls > 0 && --state.goto_polls == 0) state.goto_state = 0;
	} else if (!strncmp(path, "/GETSTATUS", 10)) {
		int ra_hours = (int)state.ra;
		int ra_tenths = (int)((state.ra - ra_hours) * 600);
		int dec_degrees = (int)fabs(state.dec);
		int dec_minutes = (int)((fabs(state.dec) - dec_degrees) * 60);
		snprintf(body, size, "RA=%02d+%02d.%d&DEC=%c%02d+%02d&GOTO=%d&STATE=%s", ra_hours, ra_tenths / 10, ra_tenths % 10, state.dec < 0 ? '-' : '+', dec_degrees, dec_minutes, state.goto_state, state.track_state == 0 ? "STOP" : "TRACK");
		if (state.goto_polls > 0 && --state.goto_polls == 0) state.goto_state = 0;
	} else if (!strncmp(path, "/GETTRACKSTATUS", 15)) {
		snprintf(body, size, "TRACK=%d", state.track_state);
	} else if (!strncmp(path, "/GET_PIERSIDE", 13)) {
		snprintf(body, size, "PIERSIDE=%d", state.pierside);
	} else if (!strncmp(path, "/GETPLACE", 9)) {
		snprintf(body, size, "LONGITUDE=%s&LATITUDE=%s&timezone=%d", state.longitude, state.latitude, state.timezone);
	} else if (!strncmp(path, "/GETTIME", 8)) {
		snprintf(body, size, "TIME=%04d+%02d+%02d+%02d+%02d+%02d", state.year, state.month, state.day, state.hour, state.minute, state.second);
	} else if (!strncmp(path, "/SETPLACE", 9)) {
		update_place_from_path(path);
		snprintf(body, size, "OK");
	} else if (!strncmp(path, "/SETTIME", 8)) {
		update_time_from_path(path);
		snprintf(body, size, "OK");
	} else if (!strncmp(path, "/GOTORADEC", 10) || !strncmp(path, "/ALIGN", 6)) {
		update_radec_from_path(path);
		state.track_state = 1;
		state.goto_state = !strncmp(path, "/GOTORADEC", 10);
		state.goto_polls = state.goto_state ? 4 : 0;
		snprintf(body, size, "OK");
	} else if (!strncmp(path, "/MOVE", 5)) {
		char value[8];
		if (query_value(path, "NORTH", value, sizeof(value))) {
			state.north = atoi(value) != 0;
		}
		if (query_value(path, "SOUTH", value, sizeof(value))) {
			state.south = atoi(value) != 0;
		}
		if (query_value(path, "EAST", value, sizeof(value))) {
			state.east = atoi(value) != 0;
		}
		if (query_value(path, "WEST", value, sizeof(value))) {
			state.west = atoi(value) != 0;
		}
		snprintf(body, size, "OK");
	} else if (!strncmp(path, "/MOVEPULSE", 10)) {
		snprintf(body, size, "OK");
	} else if (!strncmp(path, "/SETSPEED", 9)) {
		char value[8];
		if (query_value(path, "speed", value, sizeof(value))) {
			state.speed = atoi(value);
		}
		snprintf(body, size, "OK");
	} else if (!strncmp(path, "/STOP", 5)) {
		state.track_state = 0;
		state.goto_state = 0;
		state.goto_polls = 0;
		snprintf(body, size, "OK");
	} else if (!strncmp(path, "/START", 6)) {
		state.track_state = 1;
		snprintf(body, size, "OK");
	} else if (!strncmp(path, "/RESET", 6)) {
		state.track_state = 0;
		state.goto_state = 0;
		snprintf(body, size, "OK");
	} else {
		snprintf(body, size, "ERROR:FORMAT");
	}
}

static void handle_client(int client_fd) {
	char request[2048];
	ssize_t count = read(client_fd, request, sizeof(request) - 1);
	if (count <= 0) {
		return;
	}
	request[count] = '\0';
	char method[16] = { 0 };
	char path[1024] = { 0 };
	if (sscanf(request, "%15s %1023s", method, path) != 2) {
		return;
	}
	if (options.trace) {
		fprintf(stderr, "-> %s %s\n", method, path);
	}
	trace_request(path);
	if (!options.drop_used && path_matches(options.drop_path, path)) {
		options.drop_used = true;
		return;
	}

	char body[1024];
	if (!options.fault_used && path_matches(options.fault_path, path)) {
		options.fault_used = true;
		snprintf(body, sizeof(body), "%s", options.fault_reply);
	} else {
		response_body(path, body, sizeof(body));
	}
	char html[1400];
	snprintf(html, sizeof(html), "<html><HEAD></HEAD><!--%s--></html>", body);
	char response[1800];
	snprintf(response, sizeof(response),
		"HTTP/1.1 200 OK\r\n"
		"Content-Type: text/html\r\n"
		"Content-Length: %zu\r\n"
		"Connection: close\r\n"
		"\r\n"
		"%s",
		strlen(html),
		html
	);
	write_all(client_fd, response, strlen(response));
}

int main(int argc, char *argv[]) {
	if (!parse_args(argc, argv)) {
		return 2;
	}
	int port = 0;
	server_fd = open_server_socket(&port);
	if (server_fd < 0) {
		return 1;
	}
	char endpoint[128];
	snprintf(endpoint, sizeof(endpoint), "127.0.0.1:%d", port);
	if (options.ready_file != NULL && !serial_simulator_write_ready_file(options.ready_file, simulator_name, endpoint)) {
		close(server_fd);
		return 1;
	}
	if (!options.headless) {
		printf("StarBook simulator ready on %s\n", endpoint);
		fflush(stdout);
	}

	signal(SIGINT, signal_handler);
	signal(SIGTERM, signal_handler);
	while (running) {
		fd_set readfds;
		FD_ZERO(&readfds);
		FD_SET(server_fd, &readfds);
		struct timeval timeout = { 0, 100000 };
		int selected = select(server_fd + 1, &readfds, NULL, NULL, &timeout);
		if (selected < 0) {
			if (errno == EINTR) {
				continue;
			}
			break;
		}
		if (selected == 0) {
			continue;
		}
		int client_fd = accept(server_fd, NULL, NULL);
		if (client_fd < 0) {
			if (errno == EINTR) {
				continue;
			}
			break;
		}
		handle_client(client_fd);
		close(client_fd);
	}
	if (server_fd >= 0) {
		close(server_fd);
	}
	return 0;
}
