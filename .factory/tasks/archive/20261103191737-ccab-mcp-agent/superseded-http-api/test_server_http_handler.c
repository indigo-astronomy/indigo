// Copyright (c) 2026 INDIGO initiative
// All rights reserved.
//
// You may use this software under the terms of 'INDIGO Astronomy
// open-source license' (see LICENSE.md).
//
// THIS SOFTWARE IS PROVIDED BY THE AUTHORS 'AS IS' AND ANY EXPRESS
// OR IMPLIED WARRANTIES, INCLUDING, BUT NOT LIMITED TO, THE IMPLIED
// WARRANTIES OF MERCHANTABILITY AND FITNESS FOR A PARTICULAR PURPOSE
// ARE DISCLAIMED. IN NO EVENT SHALL THE AUTHOR BE LIABLE FOR ANY
// DIRECT, INDIRECT, INCIDENTAL, SPECIAL, EXEMPLARY, OR CONSEQUENTIAL
// DAMAGES (INCLUDING, BUT NOT LIMITED TO, PROCUREMENT OF SUBSTITUTE
// GOODS OR SERVICES; LOSS OF USE, DATA, OR PROFITS; OR BUSINESS
// INTERRUPTION) HOWEVER CAUSED AND ON ANY THEORY OF LIABILITY,
// WHETHER IN CONTRACT, STRICT LIABILITY, OR TORT (INCLUDING
// NEGLIGENCE OR OTHERWISE) ARISING IN ANY WAY OUT OF THE USE OF THIS
// SOFTWARE, EVEN IF ADVISED OF THE POSSIBILITY OF SUCH DAMAGE.

// Code is generated by AI

// Buffered HTTP handlers exercise the production transport on ephemeral local sockets.

#include <arpa/inet.h>
#include <errno.h>
#include <netinet/in.h>
#include <netinet/tcp.h>
#include <pthread.h>
#include <signal.h>
#include <stdatomic.h>
#include <stdio.h>
#include <string.h>
#include <sys/socket.h>
#include <sys/time.h>
#include <unistd.h>

#include <indigo/indigo_bus.h>
#include <indigo/indigo_server_tcp.h>
#include <indigo/indigo_timer.h>

#include "../test_runner.h"

#define WAIT_UNTIL(condition, timeout) ({ double deadline_ = indigo_monotonic_time() + (timeout); bool ready_ = (condition); while (!ready_ && indigo_monotonic_time() < deadline_) { indigo_usleep(1000); ready_ = (condition); } ready_; })

static atomic_int clients;
static atomic_int calls;
static atomic_int legacy_calls;
static atomic_bool listening;
static atomic_bool finished;
static pthread_t server_thread;
static bool server_started;
static pthread_mutex_t fixture_mutex = PTHREAD_MUTEX_INITIALIZER;
static pthread_cond_t fixture_condition = PTHREAD_COND_INITIALIZER;
static bool hold_callbacks;
static int context_marker;
static struct {
	char method[32];
	char path[1024];
	char query[1024];
	char first_header[128];
	char second_header[128];
	unsigned char body[64];
	size_t body_length;
	size_t duplicate_count;
	unsigned long byte_sum;
	bool context_matches;
	bool empty_body_is_null;
} observed;

static void server_callback(int count) {
	atomic_store(&clients, count);
	atomic_store(&listening, true);
}

static void *run_server(void *data) {
	indigo_server_start(server_callback);
	atomic_store(&finished, true);
	return NULL;
}

static int connect_client(void) {
	int fd = socket(AF_INET, SOCK_STREAM, 0);
	if (fd < 0) {
		return -1;
	}
	struct sockaddr_in address = { 0 };
	address.sin_family = AF_INET;
	address.sin_port = htons(indigo_server_tcp_port);
	address.sin_addr.s_addr = htonl(INADDR_LOOPBACK);
	struct timeval timeout = { 3, 0 };
	setsockopt(fd, SOL_SOCKET, SO_RCVTIMEO, &timeout, sizeof(timeout));
	setsockopt(fd, SOL_SOCKET, SO_SNDTIMEO, &timeout, sizeof(timeout));
	int enabled = 1;
	setsockopt(fd, IPPROTO_TCP, TCP_NODELAY, &enabled, sizeof(enabled));
	if (connect(fd, (struct sockaddr *)&address, sizeof(address)) != 0) {
		close(fd);
		return -1;
	}
	return fd;
}

static bool send_bytes(int fd, const void *bytes, size_t size) {
	const char *cursor = bytes;
	while (size) {
		ssize_t count = write(fd, cursor, size);
		if (count <= 0) {
			return false;
		}
		cursor += count;
		size -= count;
	}
	return true;
}

static bool receive_closed(int fd, char *response, size_t capacity) {
	size_t size = 0;
	while (size + 1 < capacity) {
		ssize_t count = read(fd, response + size, capacity - size - 1);
		if (count == 0 || (count < 0 && errno == ECONNRESET)) {
			response[size] = 0;
			return true;
		}
		if (count < 0) {
			response[size] = 0;
			return false;
		}
		size += count;
	}
	response[size] = 0;
	return false;
}

static bool exchange(const void *request, size_t size, char *response, size_t capacity) {
	int fd = connect_client();
	if (fd < 0) {
		return false;
	}
	bool sent = send_bytes(fd, request, size);
	shutdown(fd, SHUT_WR);
	bool closed = receive_closed(fd, response, capacity);
	close(fd);
	return sent && closed;
}

static void capture_handler(indigo_uni_handle *handle, const indigo_http_request *request, void *context) {
	pthread_mutex_lock(&fixture_mutex);
	memset(&observed, 0, sizeof(observed));
	snprintf(observed.method, sizeof(observed.method), "%s", request->method);
	snprintf(observed.path, sizeof(observed.path), "%s", request->path);
	snprintf(observed.query, sizeof(observed.query), "%s", request->query ? request->query : "<absent>");
	const char *first = indigo_server_http_header(request, "x-test");
	snprintf(observed.first_header, sizeof(observed.first_header), "%s", first ? first : "<absent>");
	for (size_t i = 0; i < request->header_count; i++) {
		if (!strcasecmp(request->headers[i].name, "X-Test")) {
			if (++observed.duplicate_count == 2) {
				snprintf(observed.second_header, sizeof(observed.second_header), "%s", request->headers[i].value);
			}
		}
	}
	observed.context_matches = context == &context_marker;
	observed.body_length = request->body_length;
	for (size_t i = 0; i < request->body_length; i++) {
		observed.byte_sum += request->body[i];
	}
	observed.empty_body_is_null = request->body == NULL;
	if (request->body_length > 0 && request->body_length <= sizeof(observed.body)) {
		memcpy(observed.body, request->body, request->body_length);
	}
	atomic_fetch_add(&calls, 1);
	pthread_cond_broadcast(&fixture_condition);
	while (hold_callbacks) {
		pthread_cond_wait(&fixture_condition, &fixture_mutex);
	}
	pthread_mutex_unlock(&fixture_mutex);
	indigo_uni_printf(handle, "HTTP/1.1 200 OK\r\nContent-Length: 2\r\nConnection: close\r\n\r\nok");
}

static void probe_handler(indigo_uni_handle *handle, const indigo_http_request *request, void *context) {
	indigo_uni_printf(handle, "HTTP/1.1 200 OK\r\nContent-Length: 0\r\nConnection: close\r\n\r\n");
}

static bool legacy_handler(indigo_uni_handle *handle, char *method, char *path, char *params) {
	atomic_fetch_add(&legacy_calls, 1);
	if (!strcmp(method, "PUT")) {
		char header[1024], body[4];
		bool length_seen = false;
		while (indigo_uni_read_line(handle, header, sizeof(header) - 1) > 0) {
			length_seen = length_seen || !strcmp(header, "Content-Length: 4");
		}
		if (!length_seen || indigo_uni_read(handle, body, sizeof(body)) != sizeof(body) || memcmp(body, "\0dat", 4)) {
			indigo_uni_printf(handle, "HTTP/1.1 500 Failed\r\nContent-Length: 0\r\nConnection: close\r\n\r\n");
			return false;
		}
	}
	indigo_uni_printf(handle, "HTTP/1.1 200 OK\r\nContent-Length: 0\r\nConnection: close\r\nX-Legacy: yes\r\n\r\n");
	return false;
}

static bool rejected(const void *request, size_t size, int expected_status) {
	int before = atomic_load(&calls);
	char response[1024];
	bool closed = exchange(request, size, response, sizeof(response));
	int status = 0;
	sscanf(response, "HTTP/1.1 %d", &status);
	return closed && atomic_load(&calls) == before && status == expected_status;
}

static void registration_reports_conflicts_and_invalid_paths(void) {
	ASSERT_FALSE(indigo_server_add_http_handler(NULL, capture_handler, NULL));
	ASSERT_FALSE(indigo_server_add_http_handler("relative", capture_handler, NULL));
	ASSERT_FALSE(indigo_server_add_http_handler("/invalid?query", capture_handler, NULL));
	ASSERT_FALSE(indigo_server_add_http_handler("/invalid#fragment", capture_handler, NULL));
	ASSERT_FALSE(indigo_server_add_http_handler("/invalid space", capture_handler, NULL));
	ASSERT_FALSE(indigo_server_add_http_handler("/null", NULL, NULL));
	ASSERT_FALSE(indigo_server_add_http_handler("/http-test", capture_handler, NULL));
	indigo_server_add_handler("/owned", legacy_handler);
	bool refused = !indigo_server_add_http_handler("/owned", capture_handler, NULL);
	indigo_server_remove_resource("/owned");
	ASSERT_TRUE(refused);
}

static void post_preserves_headers_context_query_and_binary_body(void) {
	const unsigned char request[] = "POST /http-test?name=a%20b&n=1 HTTP/1.1\r\nHost: localhost\r\nX-Test:  first \t\r\nx-test: second\r\nContent-Length: 5\r\n\r\n\0a\nb\xff";
	char response[1024];
	ASSERT_TRUE(exchange(request, sizeof(request) - 1, response, sizeof(response)));
	ASSERT_TRUE(strstr(response, "200 OK") != NULL);
	ASSERT_STREQ("POST", observed.method);
	ASSERT_STREQ("/http-test", observed.path);
	ASSERT_STREQ("name=a%20b&n=1", observed.query);
	ASSERT_STREQ("first", observed.first_header);
	ASSERT_STREQ("second", observed.second_header);
	ASSERT_EQ_INT(2, observed.duplicate_count);
	ASSERT_TRUE(observed.context_matches);
	ASSERT_EQ_INT(5, observed.body_length);
	ASSERT_TRUE(!memcmp(observed.body, "\0a\nb\xff", 5));
}

static void methods_and_zero_length_bodies_are_delivered(void) {
	const char *methods[] = { "GET", "POST", "PUT", "DELETE", "OPTIONS", "HEAD", "custom", "X-THING" };
	for (size_t i = 0; i < sizeof(methods) / sizeof(methods[0]); i++) {
		char request[256], response[1024];
		int length = snprintf(request, sizeof(request), "%s /http-test HTTP/1.1\r\nContent-Length: 0\r\n\r\n", methods[i]);
		ASSERT_TRUE(exchange(request, length, response, sizeof(response)));
		ASSERT_TRUE(strstr(response, "200 OK") != NULL);
		ASSERT_STREQ(methods[i], observed.method);
		ASSERT_STREQ("<absent>", observed.query);
		ASSERT_EQ_INT(0, observed.body_length);
		ASSERT_TRUE(observed.empty_body_is_null);
	}
}

static void exact_routing_preserves_legacy_prefix_and_put_ownership(void) {
	const char *paths[] = { "/http-test-extra", "/http-test/child", "/http%2Dtest", "/http-test#fragment" };
	for (size_t i = 0; i < sizeof(paths) / sizeof(paths[0]); i++) {
		char request[256], response[1024];
		int before = atomic_load(&calls);
		int length = snprintf(request, sizeof(request), "GET %s HTTP/1.1\r\nConnection: close\r\n\r\n", paths[i]);
		ASSERT_TRUE(exchange(request, length, response, sizeof(response)));
		ASSERT_EQ_INT(before, atomic_load(&calls));
		ASSERT_TRUE(strstr(response, "X-Legacy: yes") != NULL);
	}
	const char request[] = "PUT /http-test-child HTTP/1.1\r\nContent-Length: 4\r\n\r\n\0dat";
	char response[1024];
	ASSERT_TRUE(exchange(request, sizeof(request) - 1, response, sizeof(response)));
	ASSERT_TRUE(strstr(response, "200 OK") != NULL);
	ASSERT_TRUE(strstr(response, "X-Legacy: yes") != NULL);
}

static void body_fragments_are_read_by_length(void) {
	int fd = connect_client();
	ASSERT_TRUE(fd >= 0);
	const char head[] = "POST /http-test HTTP/1.1\r\nContent-Length: 4\r\n\r\n";
	int before = atomic_load(&calls);
	bool sent = send_bytes(fd, head, sizeof(head) - 1) && send_bytes(fd, "a\0", 2);
	indigo_usleep(20000);
	bool premature = atomic_load(&calls) != before;
	sent = sent && send_bytes(fd, "\nb", 2);
	char response[1024];
	bool closed = receive_closed(fd, response, sizeof(response));
	close(fd);
	ASSERT_TRUE(sent && closed && !premature);
	ASSERT_EQ_INT(before + 1, atomic_load(&calls));
	ASSERT_EQ_INT(4, observed.body_length);
	ASSERT_TRUE(!memcmp(observed.body, "a\0\nb", 4));
}

static void long_request_lines_are_not_truncated(void) {
	char query[701], request[1024], response[1024];
	memset(query, 'a', sizeof(query) - 1);
	query[sizeof(query) - 1] = 0;
	int length = snprintf(request, sizeof(request), "GET /http-test?%s HTTP/1.1\r\n\r\n", query);
	ASSERT_TRUE(exchange(request, length, response, sizeof(response)));
	ASSERT_TRUE(strstr(response, "200 OK") != NULL);
	ASSERT_STREQ(query, observed.query);
}

static void malformed_framing_never_calls_handler(void) {
	const char *requests[] = {
		"POST /http-test HTTP/1.1\r\n\r\n",
		"PUT /http-test HTTP/1.1\r\n\r\n",
		"POST /http-test HTTP/1.1\r\nContent-Length: -1\r\n\r\n",
		"POST /http-test HTTP/1.1\r\nContent-Length: +1\r\n\r\n",
		"POST /http-test HTTP/1.1\r\nContent-Length: 1x\r\n\r\n",
		"POST /http-test HTTP/1.1\r\nContent-Length: 999999999999999999999999999\r\n\r\n",
		"POST /http-test HTTP/1.1\r\nContent-Length: 0\r\ncontent-length: 0\r\n\r\n",
		"POST /http-test HTTP/1.1\r\nContent-Length: 0,0\r\n\r\n",
		"POST /http-test HTTP/1.1\r\nTransfer-Encoding: chunked\r\nContent-Length: 0\r\n\r\n",
		"POST /http-test HTTP/1.1\r\nTransfer-Encoding: identity\r\n\r\n",
		"POST /http-test HTTP/1.1\r\nContent-Length: 0\r\nExpect: 100-continue\r\n\r\n",
		"GET /http-test HTTP/1.1\r\nBad Header: value\r\n\r\n",
		"GET /http-test HTTP/1.1\r\nX-Bad : value\r\n\r\n",
		"GET /http-test HTTP/1.1\r\nX-Bad: a\001b\r\n\r\n",
		"GET /http-test HTTP/1.1\r\n folded\r\n\r\n",
		"GET /http-test HTTP/1.1\r\nMissing-Colon\r\n\r\n",
		"GET /http-test HTTP/9.9\r\n\r\n",
		"GET /http-test HTTP/1.1 extra\r\n\r\n",
		"GET /http-test?x=#bad HTTP/1.1\r\n\r\n",
		"GET /http-test?x=a\rb HTTP/1.1\r\n\r\n",
		"GET /http-test HTTP/1.1\r\nX-Bad: a\rb\r\n\r\n"
	};
	for (size_t i = 0; i < sizeof(requests) / sizeof(requests[0]); i++) {
		int expected_status = i < 2 ? 411 : i == 10 ? 417 : 400;
		if (!rejected(requests[i], strlen(requests[i]), expected_status)) {
			fprintf(stderr, "Invalid request %zu reached handler or connection stayed open\n", i);
			ASSERT_TRUE(false);
		}
	}
}

static void oversized_and_incomplete_bodies_never_call_handler(void) {
	char request[256];
	int length = snprintf(request, sizeof(request), "POST /http-test HTTP/1.1\r\nContent-Length: %u\r\n\r\n", INDIGO_HTTP_MAX_BODY_SIZE + 1);
	ASSERT_TRUE(rejected(request, length, 413));
	const char short_body[] = "POST /http-test HTTP/1.1\r\nContent-Length: 4\r\n\r\nab";
	ASSERT_TRUE(rejected(short_body, sizeof(short_body) - 1, 400));
	int fd = connect_client();
	ASSERT_TRUE(fd >= 0);
	const char stalled[] = "POST /http-test HTTP/1.1\r\nContent-Length: 4\r\n\r\na";
	int before = atomic_load(&calls);
	bool sent = send_bytes(fd, stalled, sizeof(stalled) - 1);
	char response[1024];
	double started = indigo_monotonic_time();
	bool closed = receive_closed(fd, response, sizeof(response));
	double elapsed = indigo_monotonic_time() - started;
	close(fd);
	ASSERT_TRUE(sent && closed);
	ASSERT_TRUE(elapsed < 2.5);
	ASSERT_TRUE(strstr(response, "HTTP/1.1 408 ") != NULL);
	ASSERT_EQ_INT(before, atomic_load(&calls));
}

static void maximum_body_is_accepted_without_truncation(void) {
	unsigned char *request = malloc(INDIGO_HTTP_MAX_BODY_SIZE + 256);
	ASSERT_TRUE(request != NULL);
	int length = snprintf((char *)request, 256, "POST /http-test HTTP/1.1\r\nContent-Length: %u\r\n\r\n", INDIGO_HTTP_MAX_BODY_SIZE);
	memset(request + length, 0xa5, INDIGO_HTTP_MAX_BODY_SIZE);
	char response[1024];
	bool result = exchange(request, length + INDIGO_HTTP_MAX_BODY_SIZE, response, sizeof(response));
	free(request);
	ASSERT_TRUE(result);
	ASSERT_TRUE(strstr(response, "200 OK") != NULL);
	ASSERT_EQ_INT(INDIGO_HTTP_MAX_BODY_SIZE, observed.body_length);
	ASSERT_TRUE(observed.byte_sum == (unsigned long)INDIGO_HTTP_MAX_BODY_SIZE * 0xa5);
}

static void pipelined_requests_are_not_replayed(void) {
	const char request[] = "POST /http-test HTTP/1.1\r\nContent-Length: 0\r\n\r\nGET /http-test HTTP/1.1\r\n\r\n";
	char response[1024];
	int before = atomic_load(&calls);
	ASSERT_TRUE(exchange(request, sizeof(request) - 1, response, sizeof(response)));
	ASSERT_EQ_INT(before + 1, atomic_load(&calls));
	ASSERT_TRUE(strstr(response, "200 OK") != NULL);
}

static atomic_bool removal_started;
static atomic_bool removal_finished;

static void *remove_handler(void *data) {
	atomic_store(&removal_started, true);
	indigo_server_remove_resource(data);
	atomic_store(&removal_finished, true);
	return NULL;
}

static void release_callbacks(void) {
	pthread_mutex_lock(&fixture_mutex);
	hold_callbacks = false;
	pthread_cond_broadcast(&fixture_condition);
	pthread_mutex_unlock(&fixture_mutex);
}

static void admission_limit_rejects_excess_without_callback(void) {
	pthread_mutex_lock(&fixture_mutex);
	hold_callbacks = true;
	pthread_mutex_unlock(&fixture_mutex);
	int fds[INDIGO_HTTP_MAX_REQUESTS];
	int before = atomic_load(&calls);
	bool accepted = true;
	const char request[] = "GET /http-test HTTP/1.1\r\n\r\n";
	for (size_t i = 0; i < INDIGO_HTTP_MAX_REQUESTS; i++) {
		fds[i] = connect_client();
		accepted = accepted && fds[i] >= 0;
		if (fds[i] >= 0) {
			accepted = send_bytes(fds[i], request, sizeof(request) - 1) && accepted;
		}
	}
	accepted = WAIT_UNTIL(atomic_load(&calls) == before + INDIGO_HTTP_MAX_REQUESTS, 2) && accepted;
	char response[1024];
	bool refused = exchange(request, sizeof(request) - 1, response, sizeof(response));
	int status = 0;
	sscanf(response, "HTTP/1.1 %d", &status);
	int reached = atomic_load(&calls);
	release_callbacks();
	bool drained = true;
	for (size_t i = 0; i < INDIGO_HTTP_MAX_REQUESTS; i++) {
		if (fds[i] >= 0) {
			drained = receive_closed(fds[i], response, sizeof(response)) && drained;
			close(fds[i]);
		}
	}
	ASSERT_TRUE(accepted && refused && status == 503 && drained);
	ASSERT_EQ_INT(before + INDIGO_HTTP_MAX_REQUESTS, reached);
}

static void removal_waits_for_active_callback_and_route_can_be_reused(void) {
	pthread_mutex_lock(&fixture_mutex);
	hold_callbacks = true;
	pthread_mutex_unlock(&fixture_mutex);
	int fd = connect_client();
	ASSERT_TRUE(fd >= 0);
	const char request[] = "GET /http-test HTTP/1.1\r\n\r\n";
	int before = atomic_load(&calls);
	bool sent = send_bytes(fd, request, sizeof(request) - 1);
	bool entered = WAIT_UNTIL(atomic_load(&calls) == before + 1, 1);
	atomic_store(&removal_started, false);
	atomic_store(&removal_finished, false);
	pthread_t remover;
	bool spawned = pthread_create(&remover, NULL, remove_handler, "/http-test") == 0;
	bool started = spawned && WAIT_UNTIL(atomic_load(&removal_started), 1);
	bool registered = started && WAIT_UNTIL(indigo_server_add_http_handler("/http-test", capture_handler, &context_marker), 1);
	bool waited = registered && !atomic_load(&removal_finished);
	release_callbacks();
	char response[1024];
	bool closed = receive_closed(fd, response, sizeof(response));
	close(fd);
	if (spawned) {
		pthread_join(remover, NULL);
	}
	ASSERT_TRUE(sent && entered && started && waited && closed && registered);
	ASSERT_TRUE(atomic_load(&removal_finished));
}

static void removal_during_incomplete_body_has_a_finite_deadline(void) {
	ASSERT_TRUE(indigo_server_add_http_handler("/body-drain", capture_handler, &context_marker));
	pthread_mutex_lock(&fixture_mutex);
	hold_callbacks = true;
	pthread_mutex_unlock(&fixture_mutex);
	int fds[INDIGO_HTTP_MAX_REQUESTS - 1];
	int before = atomic_load(&calls);
	bool accepted = true;
	const char held[] = "GET /http-test HTTP/1.1\r\n\r\n";
	for (size_t i = 0; i < INDIGO_HTTP_MAX_REQUESTS - 1; i++) {
		fds[i] = connect_client();
		accepted = accepted && fds[i] >= 0;
		if (fds[i] >= 0) {
			accepted = send_bytes(fds[i], held, sizeof(held) - 1) && accepted;
		}
	}
	accepted = WAIT_UNTIL(atomic_load(&calls) == before + INDIGO_HTTP_MAX_REQUESTS - 1, 2) && accepted;
	int fd = connect_client();
	const char request[] = "POST /body-drain HTTP/1.1\r\nContent-Length: 8\r\n\r\na";
	bool sent = fd >= 0 && send_bytes(fd, request, sizeof(request) - 1);
	// Fifteen barrier-held callbacks plus the partial body fill admission. A 503
	// response proves that the body read acquired the sixteenth request reference.
	char probe[1024];
	const char probe_request[] = "GET /probe HTTP/1.1\r\n\r\n";
	bool admitted = WAIT_UNTIL(exchange(probe_request, sizeof(probe_request) - 1, probe, sizeof(probe)) && strstr(probe, "HTTP/1.1 503 ") != NULL, 0.2);
	atomic_store(&removal_started, false);
	atomic_store(&removal_finished, false);
	pthread_t remover;
	bool spawned = pthread_create(&remover, NULL, remove_handler, "/body-drain") == 0;
	bool withdrawn = spawned && WAIT_UNTIL(indigo_server_add_http_handler("/body-drain", capture_handler, &context_marker), 1);
	bool waited = withdrawn && !atomic_load(&removal_finished);
	bool completed = spawned && WAIT_UNTIL(atomic_load(&removal_finished), 2);
	char response[1024];
	bool closed = fd >= 0 && receive_closed(fd, response, sizeof(response));
	if (fd >= 0) {
		close(fd);
	}
	if (spawned) {
		pthread_join(remover, NULL);
	}
	indigo_server_remove_resource("/body-drain");
	release_callbacks();
	bool drained = true;
	for (size_t i = 0; i < INDIGO_HTTP_MAX_REQUESTS - 1; i++) {
		if (fds[i] >= 0) {
			drained = receive_closed(fds[i], probe, sizeof(probe)) && drained;
			close(fds[i]);
		}
	}
	ASSERT_TRUE(sent && accepted && admitted && withdrawn && waited && completed && closed && drained);
	ASSERT_TRUE(strstr(response, "HTTP/1.1 408 ") != NULL);
	ASSERT_EQ_INT(before + INDIGO_HTTP_MAX_REQUESTS - 1, atomic_load(&calls));
}

int main(void) {
	signal(SIGPIPE, SIG_IGN);
	alarm(45);
	if (!indigo_test_use_private_home()) {
		return 1;
	}
	int result = 1;
	if (indigo_start() == INDIGO_OK) {
		indigo_use_bonjour = false;
		indigo_server_tcp_port = 0;
		if (pthread_create(&server_thread, NULL, run_server, NULL) == 0) {
			server_started = true;
			if (WAIT_UNTIL(atomic_load(&listening) && indigo_server_tcp_port != 0, 5)) {
				indigo_server_add_handler("/http", legacy_handler);
				if (indigo_server_add_http_handler("/http-test", capture_handler, &context_marker) && indigo_server_add_http_handler("/probe", probe_handler, NULL)) {
					const indigo_test_case tests[] = {
						{ "registration_reports_conflicts_and_invalid_paths", registration_reports_conflicts_and_invalid_paths },
						{ "post_preserves_headers_context_query_and_binary_body", post_preserves_headers_context_query_and_binary_body },
						{ "methods_and_zero_length_bodies_are_delivered", methods_and_zero_length_bodies_are_delivered },
						{ "exact_routing_preserves_legacy_prefix_and_put_ownership", exact_routing_preserves_legacy_prefix_and_put_ownership },
						{ "body_fragments_are_read_by_length", body_fragments_are_read_by_length },
						{ "long_request_lines_are_not_truncated", long_request_lines_are_not_truncated },
						{ "malformed_framing_never_calls_handler", malformed_framing_never_calls_handler },
						{ "oversized_and_incomplete_bodies_never_call_handler", oversized_and_incomplete_bodies_never_call_handler },
						{ "maximum_body_is_accepted_without_truncation", maximum_body_is_accepted_without_truncation },
						{ "pipelined_requests_are_not_replayed", pipelined_requests_are_not_replayed },
						{ "admission_limit_rejects_excess_without_callback", admission_limit_rejects_excess_without_callback },
						{ "removal_waits_for_active_callback_and_route_can_be_reused", removal_waits_for_active_callback_and_route_can_be_reused },
						{ "removal_during_incomplete_body_has_a_finite_deadline", removal_during_incomplete_body_has_a_finite_deadline }
					};
					result = indigo_run_tests("server buffered HTTP handler integration tests", tests, sizeof(tests) / sizeof(tests[0]));
				}
				indigo_server_remove_resources();
			}
		}
		if (server_started) {
			WAIT_UNTIL(atomic_load(&clients) == 0, 4);
			int port = indigo_server_tcp_port;
			indigo_server_shutdown();
			if (!WAIT_UNTIL(atomic_load(&finished), 1)) {
				indigo_server_tcp_port = port;
				int wake = connect_client();
				if (wake >= 0) {
					close(wake);
				}
			}
			pthread_join(server_thread, NULL);
		}
		indigo_stop();
	}
	indigo_test_remove_private_home();
	return result;
}
